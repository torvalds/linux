## Documentation/devicetree/bindings/arm/bcm/brcm,bcm4908.yaml
```yaml
# SPDX-License-Identifier: GPL-2.0 OR BSD-2-Clause
%YAML 1.2
---
$id: http://devicetree.org/schemas/arm/bcm/brcm,bcm4908.yaml#
$schema: http://devicetree.org/meta-schemas/core.yaml#

title: Broadcom BCM4908 device tree bindings

description:
  Broadcom BCM4906 / BCM4908 / BCM49408 Wi-Fi/network SoCs with Brahma CPUs.

maintainers:
  - Rafał Miłecki <rafal@milecki.pl>

properties:
  $nodename:
    const: '/'
  compatible:
    oneOf:
      - description: BCM4906 based boards
        items:
          - enum:
              - netgear,r8000p
              - tplink,archer-c2300-v1
          - const: brcm,bcm4906
          - const: brcm,bcm4908

      - description: BCM4908 based boards
        items:
          - enum:
              - asus,gt-ac5300
              - netgear,raxe500
          - const: brcm,bcm4908

      - description: BCM49408 based boards
        items:
          - const: brcm,bcm49408
          - const: brcm,bcm4908

additionalProperties: true

...
```

## Documentation/devicetree/bindings/arm/bcm/brcm,bcm53573.yaml
```yaml
# SPDX-License-Identifier: GPL-2.0-only OR BSD-2-Clause
%YAML 1.2
---
$id: http://devicetree.org/schemas/arm/bcm/brcm,bcm53573.yaml#
$schema: http://devicetree.org/meta-schemas/core.yaml#

title: Broadcom BCM53573 SoCs family

description:
  Broadcom BCM53573 / BCM47189 Wi-Fi SoCs derived from Northstar.

maintainers:
  - Rafał Miłecki <rafal@milecki.pl>

properties:
  $nodename:
    const: '/'
  compatible:
    oneOf:
      - description: BCM53573 based boards
        items:
          - enum:
              - tenda,ac6-v1
              - tenda,w15e-v1
          - const: brcm,bcm53573

      - description: BCM47189 based boards
        items:
          - enum:
              - brcm,bcm947189acdbmr
              - luxul,xap-810-v1
              - luxul,xap-1440-v1
              - tenda,ac9
          - const: brcm,bcm47189
          - const: brcm,bcm53573

additionalProperties: true

...
```

## Documentation/devicetree/bindings/arm/bcm/brcm,bcm63138.txt
```
Broadcom BCM63138 DSL System-on-a-Chip device tree bindings
-----------------------------------------------------------

Boards compatible with the BCM63138 DSL System-on-a-Chip should have the
following properties:

Required root node property:

compatible: should be "brcm,bcm63138"

An optional Boot lookup table Device Tree node is required for secondary CPU
initialization as well as a 'resets' phandle to the correct PMB controller as
defined in reset/brcm,bcm63138-pmb.txt for this secondary CPU, and an
'enable-method' property.

Required properties for the Boot lookup table node:
- compatible: should be "brcm,bcm63138-bootlut"
- reg: register base address and length for the Boot Lookup table

Optional properties for the primary CPU node:
- enable-method: should be "brcm,bcm63138"

Optional properties for the secondary CPU node:
- enable-method: should be "brcm,bcm63138"
- resets: phandle to the relevant PMB controller, one integer indicating the internal
  bus number, and a second integer indicating the address of the CPU in the PMB
  internal bus number.

Example:

	cpus {
		cpu@0 {
			compatible = "arm,cotex-a9";
			reg = <0>;
			...
			enable-method = "brcm,bcm63138";
		};

		cpu@1 {
			compatible = "arm,cortex-a9";
			reg = <1>;
			...
			enable-method = "brcm,bcm63138";
			resets = <&pmb0 4 1>;
		};
	};

	bootlut: bootlut@8000 {
		compatible = "brcm,bcm63138-bootlut";
		reg = <0x8000 0x50>;
	};

=======
reboot
------
Two nodes are required for software reboot: a timer node and a syscon-reboot node.

Timer node:

- compatible: Must be "brcm,bcm6328-timer", "syscon"
- reg: Register base address and length

Syscon reboot node:

See Documentation/devicetree/bindings/power/reset/syscon-reboot.yaml for the
detailed list of properties, the two values defined below are specific to the
BCM6328-style timer:

- offset: Should be 0x34 to denote the offset of the TIMER_WD_TIMER_RESET register
  from the beginning of the TIMER block
- mask: Should be 1 for the SoftRst bit.

Example:

	timer: timer@80 {
		compatible = "brcm,bcm6328-timer", "syscon";
		reg = <0x80 0x3c>;
	};

	reboot {
		compatible = "syscon-reboot";
		regmap = <&timer>;
		offset = <0x34>;
		mask = <0x1>;
	};
```

## Documentation/devicetree/bindings/arm/bcm/brcm,bcmbca.yaml
```yaml
# SPDX-License-Identifier: GPL-2.0 OR BSD-2-Clause
%YAML 1.2
---
$id: http://devicetree.org/schemas/arm/bcm/brcm,bcmbca.yaml#
$schema: http://devicetree.org/meta-schemas/core.yaml#

title: Broadcom Broadband SoC

description:
  Broadcom Broadband SoCs include family of high performance DSL/PON/Wireless
  chips that can be used as home gateway, router and WLAN AP for residential,
  enterprise and carrier applications.

maintainers:
  - William Zhang <william.zhang@broadcom.com>
  - Anand Gore <anand.gore@broadcom.com>
  - Kursad Oney <kursad.oney@broadcom.com>
  - Rafał Miłecki <rafal@milecki.pl>

properties:
  $nodename:
    const: '/'
  compatible:
    oneOf:
      - description: BCM47622 based boards
        items:
          - enum:
              - brcm,bcm947622
          - const: brcm,bcm47622
          - const: brcm,bcmbca

      - description: BCM4906 based boards
        items:
          - enum:
              - netgear,r8000p
              - tplink,archer-c2300-v1
              - zyxel,ex3510b
          - const: brcm,bcm4906
          - const: brcm,bcm4908
          - const: brcm,bcmbca

      - description: BCM4908 based boards
        items:
          - enum:
              - asus,gt-ac5300
              - brcm,bcm94908
              - netgear,raxe500
          - const: brcm,bcm4908
          - const: brcm,bcmbca

      - description: BCM49408 based boards
        items:
          - const: brcm,bcm49408
          - const: brcm,bcm4908
          - const: brcm,bcmbca

      - description: BCM4912 based boards
        items:
          - enum:
              - asus,gt-ax6000
              - brcm,bcm94912
          - const: brcm,bcm4912
          - const: brcm,bcmbca

      - description: BCM63138 based boards
        items:
          - enum:
              - brcm,bcm963138
              - brcm,BCM963138DVT
          - const: brcm,bcm63138
          - const: brcm,bcmbca

      - description: BCM63146 based boards
        items:
          - enum:
              - brcm,bcm963146
          - const: brcm,bcm63146
          - const: brcm,bcmbca

      - description: BCM63148 based boards
        items:
          - enum:
              - brcm,bcm963148
          - const: brcm,bcm63148
          - const: brcm,bcmbca

      - description: BCM63158 based boards
        items:
          - enum:
              - brcm,bcm963158
          - const: brcm,bcm63158
          - const: brcm,bcmbca

      - description: BCM63178 based boards
        items:
          - enum:
              - brcm,bcm963178
          - const: brcm,bcm63178
          - const: brcm,bcmbca

      - description: BCM6756 based boards
        items:
          - enum:
              - brcm,bcm96756
          - const: brcm,bcm6756
          - const: brcm,bcmbca

      - description: BCM6813 based boards
        items:
          - enum:
              - brcm,bcm96813
          - const: brcm,bcm6813
          - const: brcm,bcmbca

      - description: BCM6846 based boards
        items:
          - enum:
              - brcm,bcm96846
              - genexis,xg6846b
          - const: brcm,bcm6846
          - const: brcm,bcmbca

      - description: BCM6855 based boards
        items:
          - enum:
              - brcm,bcm96855
          - const: brcm,bcm6855
          - const: brcm,bcmbca

      - description: BCM6856 based boards
        items:
          - enum:
              - brcm,bcm96856
          - const: brcm,bcm6856
          - const: brcm,bcmbca

      - description: BCM6858 based boards
        items:
          - enum:
              - brcm,bcm96858
          - const: brcm,bcm6858
          - const: brcm,bcmbca

      - description: BCM6878 based boards
        items:
          - enum:
              - brcm,bcm96878
          - const: brcm,bcm6878
          - const: brcm,bcmbca

additionalProperties: true

...
```

## Documentation/devicetree/bindings/arm/bcm/brcm,brcmstb.txt
```
ARM Broadcom STB platforms Device Tree Bindings
-----------------------------------------------
Boards with Broadcom Brahma15 ARM-based BCMxxxx (generally BCM7xxx variants)
SoC shall have the following DT organization:

Required root node properties:
    - compatible: "brcm,bcm<chip_id>", "brcm,brcmstb"

example:
/ {
    #address-cells = <2>;
    #size-cells = <2>;
    model = "Broadcom STB (bcm7445)";
    compatible = "brcm,bcm7445", "brcm,brcmstb";

Further, syscon nodes that map platform-specific registers used for general
system control is required:

    - compatible: "brcm,bcm<chip_id>-sun-top-ctrl", "syscon"
    - compatible: "brcm,bcm<chip_id>-cpu-biu-ctrl",
		  "brcm,brcmstb-cpu-biu-ctrl",
		  "syscon"
    - compatible: "brcm,bcm<chip_id>-hif-continuation", "syscon"

cpu-biu-ctrl node
-------------------
SoCs with Broadcom Brahma15 ARM-based and Brahma53 ARM64-based CPUs have a
specific Bus Interface Unit (BIU) block which controls and interfaces the CPU
complex to the different Memory Controller Ports (MCP), one per memory
controller (MEMC). This BIU block offers a feature called Write Pairing which
consists in collapsing two adjacent cache lines into a single (bursted) write
transaction towards the memory controller (MEMC) to maximize write bandwidth.

Required properties:

    - compatible: must be "brcm,bcm7445-cpu-biu-ctrl", "brcm,brcmstb-cpu-biu-ctrl", "syscon"

Optional properties:

    - brcm,write-pairing:
	Boolean property, which when present indicates that the chip
	supports write-pairing.

example:
    rdb {
        #address-cells = <1>;
        #size-cells = <1>;
        compatible = "simple-bus";
        ranges = <0 0x00 0xf0000000 0x1000000>;

        sun_top_ctrl: syscon@404000 {
            compatible = "brcm,bcm7445-sun-top-ctrl", "syscon";
            reg = <0x404000 0x51c>;
        };

        hif_cpubiuctrl: syscon@3e2400 {
            compatible = "brcm,bcm7445-cpu-biu-ctrl", "brcm,brcmstb-cpu-biu-ctrl", "syscon";
            reg = <0x3e2400 0x5b4>;
            brcm,write-pairing;
        };

        hif_continuation: syscon@452000 {
            compatible = "brcm,bcm7445-hif-continuation", "syscon";
            reg = <0x452000 0x100>;
        };
    };

Nodes that allow for support of SMP initialization and reboot are required:

smpboot
-------
Required properties:

    - compatible
        The string "brcm,brcmstb-smpboot".

    - syscon-cpu
        A phandle / integer array property which lets the BSP know the location
        of certain CPU power-on registers.

        The layout of the property is as follows:
            o a phandle to the "hif_cpubiuctrl" syscon node
            o offset to the base CPU power zone register
            o offset to the base CPU reset register

    - syscon-cont
        A phandle pointing to the syscon node which describes the CPU boot
        continuation registers.
            o a phandle to the "hif_continuation" syscon node

example:
    smpboot {
        compatible = "brcm,brcmstb-smpboot";
        syscon-cpu = <&hif_cpubiuctrl 0x88 0x178>;
        syscon-cont = <&hif_continuation>;
    };

reboot
-------
Required properties

    - compatible
        The string property "brcm,brcmstb-reboot" for 40nm/28nm chips with
        the new SYS_CTRL interface, or "brcm,bcm7038-reboot" for 65nm
        chips with the old SUN_TOP_CTRL interface.

    - syscon
        A phandle / integer array that points to the syscon node which describes
        the general system reset registers.
            o a phandle to "sun_top_ctrl"
            o offset to the "reset source enable" register
            o offset to the "software master reset" register

example:
    reboot {
        compatible = "brcm,brcmstb-reboot";
        syscon = <&sun_top_ctrl 0x304 0x308>;
    };



Power management
----------------

For power management (particularly, S2/S3/S5 system suspend), the following SoC
components are needed:

= Always-On control block (AON CTRL)

This hardware provides control registers for the "always-on" (even in low-power
modes) hardware, such as the Power Management State Machine (PMSM).

Required properties:
- compatible     : should contain "brcm,brcmstb-aon-ctrl"
- reg            : the register start and length for the AON CTRL block

Example:

aon-ctrl@410000 {
	compatible = "brcm,brcmstb-aon-ctrl";
	reg = <0x410000 0x400>;
};

= Memory controllers

A Broadcom STB SoC typically has a number of independent memory controllers,
each of which may have several associated hardware blocks, which are versioned
independently (control registers, DDR PHYs, etc.). One might consider
describing these controllers as a parent "memory controllers" block, which
contains N sub-nodes (one for each controller in the system), each of which is
associated with a number of hardware register resources (e.g., its PHY). See
the example device tree snippet below.

== MEMC (MEMory Controller)

Represents a single memory controller instance.

Required properties:
- compatible     : should contain "brcm,brcmstb-memc" and "simple-bus"

Should contain subnodes for any of the following relevant hardware resources:

== DDR PHY control

Control registers for this memory controller's DDR PHY.

Required properties:
- compatible     : should contain one of these
	"brcm,brcmstb-ddr-phy-v71.1"
	"brcm,brcmstb-ddr-phy-v72.0"
	"brcm,brcmstb-ddr-phy-v225.1"
	"brcm,brcmstb-ddr-phy-v240.1"
	"brcm,brcmstb-ddr-phy-v240.2"

- reg            : the DDR PHY register range

== DDR SHIMPHY

Control registers for this memory controller's DDR SHIMPHY.

Required properties:
- compatible     : should contain "brcm,brcmstb-ddr-shimphy-v1.0"
- reg            : the DDR SHIMPHY register range

== MEMC DDR control

Sequencer DRAM parameters and control registers. Used for Self-Refresh
Power-Down (SRPD), among other things.

See Documentation/devicetree/bindings/memory-controllers/brcm,brcmstb-memc-ddr.yaml for a
full list of supported compatible strings and properties.

Example:

memory_controllers {
	ranges;
	compatible = "simple-bus";

	memc@0 {
		compatible = "brcm,brcmstb-memc", "simple-bus";
		ranges;

		ddr-phy@f1106000 {
			compatible = "brcm,brcmstb-ddr-phy-v240.1";
			reg = <0xf1106000 0x21c>;
		};

		shimphy@f1108000 {
			compatible = "brcm,brcmstb-ddr-shimphy-v1.0";
			reg = <0xf1108000 0xe4>;
		};

		memc-ddr@f1102000 {
			reg = <0xf1102000 0x800>;
			compatible = "brcm,brcmstb-memc-ddr";
		};
	};

	memc@1 {
		compatible = "brcm,brcmstb-memc", "simple-bus";
		ranges;

		ddr-phy@f1186000 {
			compatible = "brcm,brcmstb-ddr-phy-v240.1";
			reg = <0xf1186000 0x21c>;
		};

		shimphy@f1188000 {
			compatible = "brcm,brcmstb-ddr-shimphy-v1.0";
			reg = <0xf1188000 0xe4>;
		};

		memc-ddr@f1182000 {
			reg = <0xf1182000 0x800>;
			compatible = "brcm,brcmstb-memc-ddr";
		};
	};

	memc@2 {
		compatible = "brcm,brcmstb-memc", "simple-bus";
		ranges;

		ddr-phy@f1206000 {
			compatible = "brcm,brcmstb-ddr-phy-v240.1";
			reg = <0xf1206000 0x21c>;
		};

		shimphy@f1208000 {
			compatible = "brcm,brcmstb-ddr-shimphy-v1.0";
			reg = <0xf1208000 0xe4>;
		};

		memc-ddr@f1202000 {
			reg = <0xf1202000 0x800>;
			compatible = "brcm,brcmstb-memc-ddr";
		};
	};
};
```
