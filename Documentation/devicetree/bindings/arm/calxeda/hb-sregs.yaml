## Documentation/devicetree/bindings/arm/davinci.txt
```
Texas Instruments DaVinci Platforms Device Tree Bindings
--------------------------------------------------------

DA850/OMAP-L138/AM18x Evaluation Module (EVM) board
Required root node properties:
    - compatible = "ti,da850-evm", "ti,da850";

EnBW AM1808 based CMC board
Required root node properties:
    - compatible = "enbw,cmc", "ti,da850;

Generic DaVinci Boards
----------------------

DA850/OMAP-L138/AM18x generic board
Required root node properties:
    - compatible = "ti,da850";
```

## Documentation/devicetree/bindings/arm/davinci/nand.txt
```
* Texas Instruments Davinci NAND

This file provides information, what the device node for the
davinci nand interface contain.

Required properties:
- compatible: "ti,davinci-nand";
- reg : contain 2 offset/length values:
        - offset and length for the access window
        - offset and length for accessing the aemif control registers
- ti,davinci-chipselect: Indicates on the davinci_nand driver which
                         chipselect is used for accessing the nand.

Recommended properties :
- ti,davinci-mask-ale: mask for ale
- ti,davinci-mask-cle: mask for cle
- ti,davinci-mask-chipsel: mask for chipselect
- ti,davinci-ecc-mode: ECC mode valid values for davinci driver:
		- "none"
		- "soft"
		- "hw"
- ti,davinci-ecc-bits: used ECC bits, currently supported 1 or 4.
- ti,davinci-nand-buswidth: buswidth 8 or 16
- ti,davinci-nand-use-bbt: use flash based bad block table support.

nand device bindings may contain additional sub-nodes describing
partitions of the address space. See partition.txt for more detail.

Example(da850 EVM ):
nand_cs3@62000000 {
	compatible = "ti,davinci-nand";
	reg = <0x62000000 0x807ff
		0x68000000 0x8000>;
	ti,davinci-chipselect = <1>;
	ti,davinci-mask-ale = <0>;
	ti,davinci-mask-cle = <0>;
	ti,davinci-mask-chipsel = <0>;
	ti,davinci-ecc-mode = "hw";
	ti,davinci-ecc-bits = <4>;
	ti,davinci-nand-use-bbt;

	partition@180000 {
		label = "ubifs";
		reg = <0x180000 0x7e80000>;
	};
};
```

## Documentation/devicetree/bindings/arm/digicolor.txt
```
Conexant Digicolor Platforms Device Tree Bindings

Each device tree must specify which Conexant Digicolor SoC it uses.
Must be the following compatible string:

  cnxt,cx92755
```

## Documentation/devicetree/bindings/arm/digicolor.yaml
```yaml
# SPDX-License-Identifier: GPL-2.0
%YAML 1.2
---
$id: http://devicetree.org/schemas/arm/digicolor.yaml#
$schema: http://devicetree.org/meta-schemas/core.yaml#

title: Conexant Digicolor Platforms

maintainers:
  - Baruch Siach <baruch@tkos.co.il>

properties:
  $nodename:
    const: "/"
  compatible:
    const: cnxt,cx92755

additionalProperties: true

...
```

## Documentation/devicetree/bindings/arm/emtrion.txt
```
Emtrion Devicetree Bindings
===========================

emCON Series:
-------------

Required root node properties
	- compatible:
	- "emtrion,emcon-mx6", "fsl,imx6q"; 		: emCON-MX6D or emCON-MX6Q SoM
	- "emtrion,emcon-mx6-avari", "fsl,imx6q";	: emCON-MX6D or emCON-MX6Q SoM on Avari Base
	- "emtrion,emcon-mx6", "fsl,imx6dl"; 		: emCON-MX6S or emCON-MX6DL SoM
	- "emtrion,emcon-mx6-avari", "fsl,imx6dl";	: emCON-MX6S or emCON-MX6DL SoM on Avari Base
```
