## Documentation/devicetree/bindings/arm/calxeda/hb-sregs.yaml
```yaml
# SPDX-License-Identifier: (GPL-2.0-only OR BSD-2-Clause)
%YAML 1.2
---
$id: http://devicetree.org/schemas/arm/calxeda/hb-sregs.yaml#
$schema: http://devicetree.org/meta-schemas/core.yaml#

title: Calxeda Highbank system registers

description: |
  The Calxeda Highbank system has a block of MMIO registers controlling
  several generic system aspects. Those can be used to control some power
  management, they also contain some gate and PLL clocks.

maintainers:
  - Andre Przywara <andre.przywara@arm.com>

properties:
  compatible:
    const: calxeda,hb-sregs

  reg:
    maxItems: 1

  clocks:
    type: object

required:
  - compatible
  - reg

additionalProperties: false

examples:
  - |
    sregs@fff3c000 {
        compatible = "calxeda,hb-sregs";
        reg = <0xfff3c000 0x1000>;

        clocks {
            #address-cells = <1>;
            #size-cells = <0>;

            osc: oscillator {
                #clock-cells = <0>;
                compatible = "fixed-clock";
                clock-frequency = <33333000>;
            };
        };
    };
```

## Documentation/devicetree/bindings/arm/calxeda/l2ecc.txt
```
Calxeda Highbank L2 cache ECC

Properties:
- compatible : Should be "calxeda,hb-sregs-l2-ecc"
- reg : Address and size for ECC error interrupt clear registers.
- interrupts : Should be single bit error interrupt, then double bit error
	interrupt.

Example:

	sregs@fff3c200 {
		compatible = "calxeda,hb-sregs-l2-ecc";
		reg = <0xfff3c200 0x100>;
		interrupts = <0 71 4  0 72 4>;
	};
```

## Documentation/devicetree/bindings/arm/calxeda/l2ecc.yaml
```yaml
# SPDX-License-Identifier: (GPL-2.0-only OR BSD-2-Clause)
%YAML 1.2
---
$id: http://devicetree.org/schemas/arm/calxeda/l2ecc.yaml#
$schema: http://devicetree.org/meta-schemas/core.yaml#

title: Calxeda Highbank L2 cache ECC

description: |
  Binding for the Calxeda Highbank L2 cache controller ECC device.
  This does not cover the actual L2 cache controller control registers,
  but just the error reporting functionality.

maintainers:
  - Andre Przywara <andre.przywara@arm.com>

properties:
  compatible:
    const: "calxeda,hb-sregs-l2-ecc"

  reg:
    maxItems: 1

  interrupts:
    items:
      - description: single bit error interrupt
      - description: double bit error interrupt

required:
  - compatible
  - reg
  - interrupts

additionalProperties: false

examples:
  - |
    sregs@fff3c200 {
        compatible = "calxeda,hb-sregs-l2-ecc";
        reg = <0xfff3c200 0x100>;
        interrupts = <0 71 4>, <0 72 4>;
    };
```

## Documentation/devicetree/bindings/arm/calxeda/mem-ctrlr.txt
```
Calxeda DDR memory controller

Properties:
- compatible : Should be:
  - "calxeda,hb-ddr-ctrl" for ECX-1000
  - "calxeda,ecx-2000-ddr-ctrl" for ECX-2000
- reg : Address and size for DDR controller registers.
- interrupts : Interrupt for DDR controller.

Example:

	memory-controller@fff00000 {
		compatible = "calxeda,hb-ddr-ctrl";
		reg = <0xfff00000 0x1000>;
		interrupts = <0 91 4>;
	};
```

## Documentation/devicetree/bindings/arm/cavium,thunder-88xx.yaml
```yaml
# SPDX-License-Identifier: (GPL-2.0-only OR BSD-2-Clause)
%YAML 1.2
---
$id: http://devicetree.org/schemas/arm/cavium,thunder-88xx.yaml#
$schema: http://devicetree.org/meta-schemas/core.yaml#

title: Cavium Thunder 88xx SoC

maintainers:
  - Robert Richter <rric@kernel.org>

properties:
  $nodename:
    const: '/'
  compatible:
    items:
      - const: cavium,thunder-88xx

additionalProperties: true
```

## Documentation/devicetree/bindings/arm/cavium-thunder.txt
```
Cavium Thunder platform device tree bindings
--------------------------------------------

Boards with Cavium's Thunder SoC shall have following properties.

Root Analde
---------
Required root analde properties:

  - compatible = "cavium,thunder-88xx";
```

## Documentation/devicetree/bindings/arm/cavium-thunder2.txt
```
Cavium ThunderX2 CN99XX platform tree bindings
----------------------------------------------

Boards with Cavium ThunderX2 CN99XX SoC shall have the root property:
  compatible = "cavium,thunderx2-cn9900", "brcm,vulcan-soc";

These SoC uses the "cavium,thunder2" core which will be compatible
with "brcm,vulcan".
```

## Documentation/devicetree/bindings/arm/cci-control-port.yaml
```yaml
# SPDX-License-Identifier: GPL-2.0
%YAML 1.2
---
$id: http://devicetree.org/schemas/arm/cci-control-port.yaml#
$schema: http://devicetree.org/meta-schemas/core.yaml#

title: CCI Interconnect Bus Masters

maintainers:
  - Lorenzo Pieralisi <lorenzo.pieralisi@arm.com>

description: |
  Masters in the device tree connected to a CCI port (inclusive of CPUs
  and their cpu nodes).

select: true

properties:
  cci-control-port:
    $ref: /schemas/types.yaml#/definitions/phandle

additionalProperties: true

examples:
  - |
    cpus {
        #address-cells = <1>;
        #size-cells = <0>;

        cpu@0 {
            compatible = "arm,cortex-a15";
            device_type = "cpu";
            cci-control-port = <&cci_control1>;
            reg = <0>;
        };
    };

...
```

## Documentation/devicetree/bindings/arm/cci.txt
```
=======================================================
ARM CCI cache coherent interconnect binding description
=======================================================

ARM multi-cluster systems maintain intra-cluster coherency through a
cache coherent interconnect (CCI) that is capable of monitoring bus
transactions and manage coherency, TLB invalidations and memory barriers.

It allows snooping and distributed virtual memory message broadcast across
clusters, through memory mapped interface, with a global control register
space and multiple sets of interface control registers, one per slave
interface.

Bindings for the CCI node follow the ePAPR standard, available from:

www.power.org/documentation/epapr-version-1-1/

with the addition of the bindings described in this document which are
specific to ARM.

* CCI interconnect node

	Description: Describes a CCI cache coherent Interconnect component

	Node name must be "cci".
	Node's parent must be the root node /, and the address space visible
	through the CCI interconnect is the same as the one seen from the
	root node (ie from CPUs perspective as per DT standard).
	Every CCI node has to define the following properties:

	- compatible
		Usage: required
		Value type: <string>
		Definition: must contain one of the following:
			    "arm,cci-400"
			    "arm,cci-500"
			    "arm,cci-550"

	- reg
		Usage: required
		Value type: Integer cells. A register entry, expressed as a pair
			    of cells, containing base and size.
		Definition: A standard property. Specifies base physical
			    address of CCI control registers common to all
			    interfaces.

	- ranges:
		Usage: required
		Value type: Integer cells. An array of range entries, expressed
			    as a tuple of cells, containing child address,
			    parent address and the size of the region in the
			    child address space.
		Definition: A standard property. Follow rules in the ePAPR for
			    hierarchical bus addressing. CCI interfaces
			    addresses refer to the parent node addressing
			    scheme to declare their register bases.

	CCI interconnect node can define the following child nodes:

	- CCI control interface nodes

		Node name must be "slave-if".
		Parent node must be CCI interconnect node.

		A CCI control interface node must contain the following
		properties:

		- compatible
			Usage: required
			Value type: <string>
			Definition: must be set to
				    "arm,cci-400-ctrl-if"

		- interface-type:
			Usage: required
			Value type: <string>
			Definition: must be set to one of {"ace", "ace-lite"}
				    depending on the interface type the node
				    represents.

		- reg:
			Usage: required
			Value type: Integer cells. A register entry, expressed
				    as a pair of cells, containing base and
				    size.
			Definition: the base address and size of the
				    corresponding interface programming
				    registers.

	- CCI PMU node

		Parent node must be CCI interconnect node.

		A CCI pmu node must contain the following properties:

		- compatible
			Usage: required
			Value type: <string>
			Definition: Must contain one of:
				 "arm,cci-400-pmu,r0"
				 "arm,cci-400-pmu,r1"
				 "arm,cci-400-pmu"  - DEPRECATED, permitted only where OS has
						      secure access to CCI registers
				 "arm,cci-500-pmu,r0"
				 "arm,cci-550-pmu,r0"
		- reg:
			Usage: required
			Value type: Integer cells. A register entry, expressed
				    as a pair of cells, containing base and
				    size.
			Definition: the base address and size of the
				    corresponding interface programming
				    registers.

		- interrupts:
			Usage: required
			Value type: Integer cells. Array of interrupt specifier
				    entries, as defined in
				    ../interrupt-controller/interrupts.txt.
			Definition: list of counter overflow interrupts, one per
				    counter. The interrupts must be specified
				    starting with the cycle counter overflow
				    interrupt, followed by counter0 overflow
				    interrupt, counter1 overflow interrupt,...
				    ,counterN overflow interrupt.

				    The CCI PMU has an interrupt signal for each
				    counter. The number of interrupts must be
				    equal to the number of counters.

* CCI interconnect bus masters

	Description: masters in the device tree connected to a CCI port
		     (inclusive of CPUs and their cpu nodes).

	A CCI interconnect bus master node must contain the following
	properties:

	- cci-control-port:
		Usage: required
		Value type: <phandle>
		Definition: a phandle containing the CCI control interface node
			    the master is connected to.

Example:

	cpus {
		#size-cells = <0>;
		#address-cells = <1>;

		CPU0: cpu@0 {
			device_type = "cpu";
			compatible = "arm,cortex-a15";
			cci-control-port = <&cci_control1>;
			reg = <0x0>;
		};

		CPU1: cpu@1 {
			device_type = "cpu";
			compatible = "arm,cortex-a15";
			cci-control-port = <&cci_control1>;
			reg = <0x1>;
		};

		CPU2: cpu@100 {
			device_type = "cpu";
			compatible = "arm,cortex-a7";
			cci-control-port = <&cci_control2>;
			reg = <0x100>;
		};

		CPU3: cpu@101 {
			device_type = "cpu";
			compatible = "arm,cortex-a7";
			cci-control-port = <&cci_control2>;
			reg = <0x101>;
		};

	};

	dma0: dma@3000000 {
		compatible = "arm,pl330", "arm,primecell";
		cci-control-port = <&cci_control0>;
		reg = <0x0 0x3000000 0x0 0x1000>;
		interrupts = <10>;
		#dma-cells = <1>;
		#dma-channels = <8>;
		#dma-requests = <32>;
	};

	cci@2c090000 {
		compatible = "arm,cci-400";
		#address-cells = <1>;
		#size-cells = <1>;
		reg = <0x0 0x2c090000 0 0x1000>;
		ranges = <0x0 0x0 0x2c090000 0x10000>;

		cci_control0: slave-if@1000 {
			compatible = "arm,cci-400-ctrl-if";
			interface-type = "ace-lite";
			reg = <0x1000 0x1000>;
		};

		cci_control1: slave-if@4000 {
			compatible = "arm,cci-400-ctrl-if";
			interface-type = "ace";
			reg = <0x4000 0x1000>;
		};

		cci_control2: slave-if@5000 {
			compatible = "arm,cci-400-ctrl-if";
			interface-type = "ace";
			reg = <0x5000 0x1000>;
		};

		pmu@9000 {
			 compatible = "arm,cci-400-pmu";
			 reg = <0x9000 0x5000>;
			 interrupts = <0 101 4>,
				      <0 102 4>,
				      <0 103 4>,
				      <0 104 4>,
				      <0 105 4>;
		};
	};

This CCI node corresponds to a CCI component whose control registers sits
at address 0x000000002c090000.
CCI slave interface @0x000000002c091000 is connected to dma controller dma0.
CCI slave interface @0x000000002c094000 is connected to CPUs {CPU0, CPU1};
CCI slave interface @0x000000002c095000 is connected to CPUs {CPU2, CPU3};
```

## Documentation/devicetree/bindings/arm/ccn.txt
```
* ARM CCN (Cache Coherent Network)

Required properties:

- compatible: (standard compatible string) should be one of:
	"arm,ccn-502"
	"arm,ccn-504"
	"arm,ccn-508"

- reg: (standard registers property) physical address and size
	(16MB) of the configuration registers block

- interrupts: (standard interrupt property) single interrupt
	generated by the control block

Example:

	ccn@2000000000 {
		compatible = "arm,ccn-504";
		reg = <0x20 0x00000000 0 0x1000000>;
		interrupts = <0 181 4>;
	};
```

## Documentation/devicetree/bindings/arm/cirrus/cirrus,ep9301.yaml
```yaml
# SPDX-License-Identifier: GPL-2.0-only OR BSD-2-Clause
%YAML 1.2
---
$id: http://devicetree.org/schemas/arm/cirrus/cirrus,ep9301.yaml#
$schema: http://devicetree.org/meta-schemas/core.yaml#

title: Cirrus Logic EP93xx platforms

description:
  The EP93xx SoC is a ARMv4T-based with 200 MHz ARM9 CPU.

maintainers:
  - Alexander Sverdlin <alexander.sverdlin@gmail.com>
  - Nikita Shubin <nikita.shubin@maquefel.me>

properties:
  $nodename:
    const: '/'
  compatible:
    oneOf:
      - description: The TS-7250 is a compact, full-featured Single Board
          Computer (SBC) based upon the Cirrus EP9302 ARM9 CPU
        items:
          - const: technologic,ts7250
          - const: cirrus,ep9301

      - description: The Liebherr BK3 is a derivate from ts7250 board
        items:
          - const: liebherr,bk3
          - const: cirrus,ep9301

      - description: EDB302 is an evaluation board by Cirrus Logic,
          based on a Cirrus Logic EP9302 CPU
        items:
          - const: cirrus,edb9302
          - const: cirrus,ep9301

additionalProperties: true
```

## Documentation/devicetree/bindings/arm/cix.yaml
```yaml
# SPDX-License-Identifier: GPL-2.0-only OR BSD-2-Clause
%YAML 1.2
---
$id: http://devicetree.org/schemas/arm/cix.yaml#
$schema: http://devicetree.org/meta-schemas/core.yaml#

title: CIX platforms

maintainers:
  - Peter Chen <peter.chen@cixtech.com>
  - Fugang Duan <fugang.duan@cixtech.com>

properties:
  $nodename:
    const: '/'
  compatible:
    oneOf:

      - description: Sky1 based boards
        items:
          - enum:
              - radxa,orion-o6 # Radxa Orion O6 board
              - xunlong,orangepi-6-plus # Xunlong orangepi 6 plus board
          - const: cix,sky1

additionalProperties: true

...
```

## Documentation/devicetree/bindings/arm/coherency-fabric.txt
```
Coherency fabric
----------------
Available on Marvell SOCs: Armada 370 and Armada XP

Required properties:

- compatible: "marvell,coherency-fabric"

- reg: Should contain coherency fabric registers location and
  length. First pair for the coherency fabric registers, second pair
  for the per-CPU fabric registers registers.

Example:

coherency-fabric@d0020200 {
	compatible = "marvell,coherency-fabric";
	reg = <0xd0020200 0xb0>,
		<0xd0021810 0x1c>;

};
```

## Documentation/devicetree/bindings/arm/compulab-boards.txt
```
CompuLab SB-SOM is a multi-module baseboard capable of carrying:
 - CM-T43
 - CM-T54
 - CM-QS600
 - CL-SOM-AM57x
 - CL-SOM-iMX7
modules with minor modifications to the SB-SOM assembly.

Required root node properties:
    - compatible = should be "compulab,sb-som"

Compulab CL-SOM-iMX7 is a miniature System-on-Module (SoM) based on
Freescale i.MX7 ARM Cortex-A7 System-on-Chip.

Required root node properties:
    - compatible = "compulab,cl-som-imx7", "fsl,imx7d";

Compulab SBC-iMX7 is a single board computer based on the
Freescale i.MX7 system-on-chip. SBC-iMX7 is implemented with
the CL-SOM-iMX7 System-on-Module providing most of the functions,
and SB-SOM-iMX7 carrier board providing additional peripheral
functions and connectors.

Required root node properties:
    - compatible = "compulab,sbc-imx7", "compulab,cl-som-imx7", "fsl,imx7d";
```
