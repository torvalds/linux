## Documentation/devicetree/bindings/arm/rockchip.yaml
```yaml
# SPDX-License-Identifier: GPL-2.0
%YAML 1.2
---
$id: http://devicetree.org/schemas/arm/rockchip.yaml#
$schema: http://devicetree.org/meta-schemas/core.yaml#

title: Rockchip platforms

maintainers:
  - Heiko Stuebner <heiko@sntech.de>

properties:
  $nodename:
    const: '/'
  compatible:
    oneOf:

      - description: 96boards RK3399 Ficus (ROCK960 Enterprise Edition)
        items:
          - const: vamrs,ficus
          - const: rockchip,rk3399

      - description: 96boards RK3399 Rock960 (ROCK960 Consumer Edition)
        items:
          - const: vamrs,rock960
          - const: rockchip,rk3399

      - description: Amarula Vyasa RK3288
        items:
          - const: amarula,vyasa-rk3288
          - const: rockchip,rk3288

      - description: Anbernic RG351M
        items:
          - const: anbernic,rg351m
          - const: rockchip,rk3326

      - description: Anbernic RG353P
        items:
          - const: anbernic,rg353p
          - const: rockchip,rk3566

      - description: Anbernic RG353PS
        items:
          - const: anbernic,rg353ps
          - const: rockchip,rk3566

      - description: Anbernic RG353V
        items:
          - const: anbernic,rg353v
          - const: rockchip,rk3566

      - description: Anbernic RG353VS
        items:
          - const: anbernic,rg353vs
          - const: rockchip,rk3566

      - description: Anbernic RG503
        items:
          - const: anbernic,rg503
          - const: rockchip,rk3566

      - description: Asus Tinker board
        items:
          - const: asus,rk3288-tinker
          - const: rockchip,rk3288

      - description: Asus Tinker board S
        items:
          - const: asus,rk3288-tinker-s
          - const: rockchip,rk3288

      - description: Beelink A1
        items:
          - const: azw,beelink-a1
          - const: rockchip,rk3328

      - description: bq Curie 2 tablet
        items:
          - const: mundoreader,bq-curie2
          - const: rockchip,rk3066a

      - description: bq Edison 2 Quad-Core tablet
        items:
          - const: mundoreader,bq-edison2qc
          - const: rockchip,rk3188

      - description: ChipSPARK PopMetal-RK3288
        items:
          - const: chipspark,popmetal-rk3288
          - const: rockchip,rk3288

      - description: ChipSPARK Rayeager PX2
        items:
          - const: chipspark,rayeager-px2
          - const: rockchip,rk3066a

      - description: Edgeble Neural Compute Module 2(Neu2) SoM based boards
        items:
          - const: edgeble,neural-compute-module-2-io   # Edgeble Neural Compute Module 2 IO Board
          - const: edgeble,neural-compute-module-2      # Edgeble Neural Compute Module 2 SoM
          - const: rockchip,rv1126

      - description: Edgeble Neural Compute Module 6(Neu6) Model A SoM based boards
        items:
          - const: edgeble,neural-compute-module-6a-io  # Edgeble Neural Compute Module 6A IO Board
          - const: edgeble,neural-compute-module-6a     # Edgeble Neural Compute Module 6A SoM
          - const: rockchip,rk3588

      - description: Edgeble Neural Compute Module 6(Neu6) Model B SoM based boards
        items:
          - const: edgeble,neural-compute-module-6b-io  # Edgeble Neural Compute Module 6B IO Board
          - const: edgeble,neural-compute-module-6b     # Edgeble Neural Compute Module 6B SoM
          - const: rockchip,rk3588

      - description: Elgin RV1108 R1
        items:
          - const: elgin,rv1108-r1
          - const: rockchip,rv1108

      - description: EmbedFire LubanCat 1
        items:
          - const: embedfire,lubancat-1
          - const: rockchip,rk3566

      - description: EmbedFire LubanCat 2
        items:
          - const: embedfire,lubancat-2
          - const: rockchip,rk3568

      - description: Engicam PX30.Core C.TOUCH 2.0
        items:
          - const: engicam,px30-core-ctouch2
          - const: engicam,px30-core
          - const: rockchip,px30

      - description: Engicam PX30.Core C.TOUCH 2.0 10.1" Open Frame
        items:
          - const: engicam,px30-core-ctouch2-of10
          - const: engicam,px30-core
          - const: rockchip,px30

      - description: Engicam PX30.Core EDIMM2.2 Starter Kit
        items:
          - const: engicam,px30-core-edimm2.2
          - const: engicam,px30-core
          - const: rockchip,px30

      - description: Firefly Firefly-RK3288
        items:
          - enum:
              - firefly,firefly-rk3288
              - firefly,firefly-rk3288-beta
          - const: rockchip,rk3288

      - description: Firefly Firefly-RK3288 Reload
        items:
          - const: firefly,firefly-rk3288-reload
          - const: rockchip,rk3288

      - description: Firefly Firefly-RK3399
        items:
          - const: firefly,firefly-rk3399
          - const: rockchip,rk3399

      - description: Firefly ROC-RK3308-CC
        items:
          - const: firefly,roc-rk3308-cc
          - const: rockchip,rk3308

      - description: Firefly roc-rk3328-cc
        items:
          - const: firefly,roc-rk3328-cc
          - const: rockchip,rk3328

      - description: Firefly ROC-RK3328-PC
        items:
          - const: firefly,roc-rk3328-pc
          - const: rockchip,rk3328

      - description: Firefly ROC-RK3399-PC
        items:
          - enum:
              - firefly,roc-rk3399-pc
              - firefly,roc-rk3399-pc-mezzanine
          - const: rockchip,rk3399

      - description: Firefly ROC-RK3399-PC-PLUS
        items:
          - enum:
              - firefly,roc-rk3399-pc-plus
          - const: rockchip,rk3399

      - description: Firefly Station M2
        items:
          - const: firefly,rk3566-roc-pc
          - const: rockchip,rk3566

      - description: Firefly Station P2
        items:
          - const: firefly,rk3568-roc-pc
          - const: rockchip,rk3568

      - description: FriendlyElec NanoPi R2 series boards
        items:
          - enum:
              - friendlyarm,nanopi-r2c
              - friendlyarm,nanopi-r2c-plus
              - friendlyarm,nanopi-r2s
          - const: rockchip,rk3328

      - description: FriendlyElec NanoPi4 series boards
        items:
          - enum:
              - friendlyarm,nanopc-t4
              - friendlyarm,nanopi-m4
              - friendlyarm,nanopi-m4b
              - friendlyarm,nanopi-neo4
              - friendlyarm,nanopi-r4s
              - friendlyarm,nanopi-r4s-enterprise
          - const: rockchip,rk3399

      - description: FriendlyElec NanoPi R5 series boards
        items:
          - enum:
              - friendlyarm,nanopi-r5c
              - friendlyarm,nanopi-r5s
          - const: rockchip,rk3568

      - description: FriendlyElec NanoPC T6
        items:
          - const: friendlyarm,nanopc-t6
          - const: rockchip,rk3588

      - description: GeekBuying GeekBox
        items:
          - const: geekbuying,geekbox
          - const: rockchip,rk3368

      - description: Google Bob (Asus Chromebook Flip C101PA)
        items:
          - const: google,bob-rev13
          - const: google,bob-rev12
          - const: google,bob-rev11
          - const: google,bob-rev10
          - const: google,bob-rev9
          - const: google,bob-rev8
          - const: google,bob-rev7
          - const: google,bob-rev6
          - const: google,bob-rev5
          - const: google,bob-rev4
          - const: google,bob
          - const: google,gru
          - const: rockchip,rk3399

      - description: Google Brain (dev-board)
        items:
          - const: google,veyron-brain-rev0
          - const: google,veyron-brain
          - const: google,veyron
          - const: rockchip,rk3288

      - description: Google Fievel (AOPEN Chromebox Mini)
        items:
          - const: google,veyron-fievel-rev8
          - const: google,veyron-fievel-rev7
          - const: google,veyron-fievel-rev6
          - const: google,veyron-fievel-rev5
          - const: google,veyron-fievel-rev4
          - const: google,veyron-fievel-rev3
          - const: google,veyron-fievel-rev2
          - const: google,veyron-fievel-rev1
          - const: google,veyron-fievel-rev0
          - const: google,veyron-fievel
          - const: google,veyron
          - const: rockchip,rk3288

      - description: Google Gru (dev-board)
        items:
          - const: google,gru-rev15
          - const: google,gru-rev14
          - const: google,gru-rev13
          - const: google,gru-rev12
          - const: google,gru-rev11
          - const: google,gru-rev10
          - const: google,gru-rev9
          - const: google,gru-rev8
          - const: google,gru-rev7
          - const: google,gru-rev6
          - const: google,gru-rev5
          - const: google,gru-rev4
          - const: google,gru-rev3
          - const: google,gru-rev2
          - const: google,gru
          - const: rockchip,rk3399

      - description: Google Jaq (Haier Chromebook 11 and more w/ uSD)
        items:
          - const: google,veyron-jaq-rev5
          - const: google,veyron-jaq-rev4
          - const: google,veyron-jaq-rev3
          - const: google,veyron-jaq-rev2
          - const: google,veyron-jaq-rev1
          - const: google,veyron-jaq
          - const: google,veyron
          - const: rockchip,rk3288

      - description: Google Jerry (Hisense Chromebook C11 and more)
        items:
          - const: google,veyron-jerry-rev15
          - const: google,veyron-jerry-rev14
          - const: google,veyron-jerry-rev13
          - const: google,veyron-jerry-rev12
          - const: google,veyron-jerry-rev11
          - const: google,veyron-jerry-rev10
          - const: google,veyron-jerry-rev7
          - const: google,veyron-jerry-rev6
          - const: google,veyron-jerry-rev5
          - const: google,veyron-jerry-rev4
          - const: google,veyron-jerry-rev3
          - const: google,veyron-jerry
          - const: google,veyron
          - const: rockchip,rk3288

      - description: Google Kevin (Samsung Chromebook Plus)
        items:
          - const: google,kevin-rev15
          - const: google,kevin-rev14
          - const: google,kevin-rev13
          - const: google,kevin-rev12
          - const: google,kevin-rev11
          - const: google,kevin-rev10
          - const: google,kevin-rev9
          - const: google,kevin-rev8
          - const: google,kevin-rev7
          - const: google,kevin-rev6
          - const: google,kevin
          - const: google,gru
          - const: rockchip,rk3399

      - description: Google Mickey (Asus Chromebit CS10)
        items:
          - const: google,veyron-mickey-rev8
          - const: google,veyron-mickey-rev7
          - const: google,veyron-mickey-rev6
          - const: google,veyron-mickey-rev5
          - const: google,veyron-mickey-rev4
          - const: google,veyron-mickey-rev3
          - const: google,veyron-mickey-rev2
          - const: google,veyron-mickey-rev1
          - const: google,veyron-mickey-rev0
          - const: google,veyron-mickey
          - const: google,veyron
          - const: rockchip,rk3288

      - description: Google Mighty (Haier Chromebook 11 and more w/ SD)
        items:
          - const: google,veyron-mighty-rev5
          - const: google,veyron-mighty-rev4
          - const: google,veyron-mighty-rev3
          - const: google,veyron-mighty-rev2
          - const: google,veyron-mighty-rev1
          - const: google,veyron-mighty
          - const: google,veyron
          - const: rockchip,rk3288

      - description: Google Minnie (Asus Chromebook Flip C100P)
        items:
          - const: google,veyron-minnie-rev4
          - const: google,veyron-minnie-rev3
          - const: google,veyron-minnie-rev2
          - const: google,veyron-minnie-rev1
          - const: google,veyron-minnie-rev0
          - const: google,veyron-minnie
          - const: google,veyron
          - const: rockchip,rk3288

      - description: Google Pinky (dev-board)
        items:
          - const: google,veyron-pinky-rev2
          - const: google,veyron-pinky
          - const: google,veyron
          - const: rockchip,rk3288

      - description: Google Scarlet - Dumo (ASUS Chromebook Tablet CT100)
        items:
          - const: google,scarlet-rev15-sku0
          - const: google,scarlet-rev15
          - const: google,scarlet-rev14-sku0
          - const: google,scarlet-rev14
          - const: google,scarlet-rev13-sku0
          - const: google,scarlet-rev13
          - const: google,scarlet-rev12-sku0
          - const: google,scarlet-rev12
          - const: google,scarlet-rev11-sku0
          - const: google,scarlet-rev11
          - const: google,scarlet-rev10-sku0
          - const: google,scarlet-rev10
          - const: google,scarlet-rev9-sku0
          - const: google,scarlet-rev9
          - const: google,scarlet-rev8-sku0
          - const: google,scarlet-rev8
          - const: google,scarlet-rev7-sku0
          - const: google,scarlet-rev7
          - const: google,scarlet-rev6-sku0
          - const: google,scarlet-rev6
          - const: google,scarlet-rev5-sku0
          - const: google,scarlet-rev5
          - const: google,scarlet
          - const: google,gru
          - const: rockchip,rk3399

      - description: Google Scarlet - Kingdisplay (Acer Chromebook Tab 10)
        items:
          - const: google,scarlet-rev15-sku7
          - const: google,scarlet-rev15
          - const: google,scarlet-rev14-sku7
          - const: google,scarlet-rev14
          - const: google,scarlet-rev13-sku7
          - const: google,scarlet-rev13
          - const: google,scarlet-rev12-sku7
          - const: google,scarlet-rev12
          - const: google,scarlet-rev11-sku7
          - const: google,scarlet-rev11
          - const: google,scarlet-rev10-sku7
          - const: google,scarlet-rev10
          - const: google,scarlet-rev9-sku7
          - const: google,scarlet-rev9
          - const: google,scarlet-rev8-sku7
          - const: google,scarlet-rev8
          - const: google,scarlet-rev7-sku7
          - const: google,scarlet-rev7
          - const: google,scarlet-rev6-sku7
          - const: google,scarlet-rev6
          - const: google,scarlet-rev5-sku7
          - const: google,scarlet-rev5
          - const: google,scarlet-rev4-sku7
          - const: google,scarlet-rev4
          - const: google,scarlet-rev3-sku7
          - const: google,scarlet-rev3
          - const: google,scarlet
          - const: google,gru
          - const: rockchip,rk3399

      - description: |
          Google Scarlet - Innolux display (Acer Chromebook Tab 10 and more)
        items:
          - const: google,scarlet-rev15-sku2
          - const: google,scarlet-rev15-sku4
          - const: google,scarlet-rev15-sku6
          - const: google,scarlet-rev15
          - const: google,scarlet-rev14-sku2
          - const: google,scarlet-rev14-sku4
          - const: google,scarlet-rev14-sku6
          - const: google,scarlet-rev14
          - const: google,scarlet-rev13-sku2
          - const: google,scarlet-rev13-sku4
          - const: google,scarlet-rev13-sku6
          - const: google,scarlet-rev13
          - const: google,scarlet-rev12-sku2
          - const: google,scarlet-rev12-sku4
          - const: google,scarlet-rev12-sku6
          - const: google,scarlet-rev12
          - const: google,scarlet-rev11-sku2
          - const: google,scarlet-rev11-sku4
          - const: google,scarlet-rev11-sku6
          - const: google,scarlet-rev11
          - const: google,scarlet-rev10-sku2
          - const: google,scarlet-rev10-sku4
          - const: google,scarlet-rev10-sku6
          - const: google,scarlet-rev10
          - const: google,scarlet-rev9-sku2
          - const: google,scarlet-rev9-sku4
          - const: google,scarlet-rev9-sku6
          - const: google,scarlet-rev9
          - const: google,scarlet-rev8-sku2
          - const: google,scarlet-rev8-sku4
          - const: google,scarlet-rev8-sku6
          - const: google,scarlet-rev8
          - const: google,scarlet-rev7-sku2
          - const: google,scarlet-rev7-sku4
          - const: google,scarlet-rev7-sku6
          - const: google,scarlet-rev7
          - const: google,scarlet-rev6-sku2
          - const: google,scarlet-rev6-sku4
          - const: google,scarlet-rev6-sku6
          - const: google,scarlet-rev6
          - const: google,scarlet-rev5-sku2
          - const: google,scarlet-rev5-sku4
          - const: google,scarlet-rev5-sku6
          - const: google,scarlet-rev5
          - const: google,scarlet-rev4-sku2
          - const: google,scarlet-rev4-sku4
          - const: google,scarlet-rev4-sku6
          - const: google,scarlet-rev4
          - const: google,scarlet
          - const: google,gru
          - const: rockchip,rk3399

      - description: Google Speedy (Asus C201 Chromebook)
        items:
          - const: google,veyron-speedy-rev9
          - const: google,veyron-speedy-rev8
          - const: google,veyron-speedy-rev7
          - const: google,veyron-speedy-rev6
          - const: google,veyron-speedy-rev5
          - const: google,veyron-speedy-rev4
          - const: google,veyron-speedy-rev3
          - const: google,veyron-speedy-rev2
          - const: google,veyron-speedy
          - const: google,veyron
          - const: rockchip,rk3288

      - description: Google Tiger (AOpen Chromebase Mini)
        items:
          - const: google,veyron-tiger-rev8
          - const: google,veyron-tiger-rev7
          - const: google,veyron-tiger-rev6
          - const: google,veyron-tiger-rev5
          - const: google,veyron-tiger-rev4
          - const: google,veyron-tiger-rev3
          - const: google,veyron-tiger-rev2
          - const: google,veyron-tiger-rev1
          - const: google,veyron-tiger-rev0
          - const: google,veyron-tiger
          - const: google,veyron
          - const: rockchip,rk3288

      - description: Haoyu MarsBoard RK3066
        items:
          - const: haoyu,marsboard-rk3066
          - const: rockchip,rk3066a

      - description: Hardkernel Odroid Go Advance
        items:
          - const: hardkernel,rk3326-odroid-go2
          - const: rockchip,rk3326

      - description: Hardkernel Odroid Go Advance Black Edition
        items:
          - const: hardkernel,rk3326-odroid-go2-v11
          - const: rockchip,rk3326

      - description: Hardkernel Odroid Go Super
        items:
          - const: hardkernel,rk3326-odroid-go3
          - const: rockchip,rk3326

      - description: Hardkernel Odroid M1
        items:
          - const: rockchip,rk3568-odroid-m1
          - const: rockchip,rk3568

      - description: Hugsun X99 TV Box
        items:
          - const: hugsun,x99
          - const: rockchip,rk3399

      - description: Indiedroid Nova SBC
        items:
          - const: indiedroid,nova
          - const: rockchip,rk3588s

      - description: Khadas Edge series boards
        items:
          - enum:
              - khadas,edge
              - khadas,edge-captain
              - khadas,edge-v
          - const: rockchip,rk3399

      - description: Khadas Edge2 series boards
        items:
          - const: khadas,edge2
          - const: rockchip,rk3588s

      - description: Kobol Helios64
        items:
          - const: kobol,helios64
          - const: rockchip,rk3399

      - description: Mecer Xtreme Mini S6
        items:
          - const: mecer,xms6
          - const: rockchip,rk3229

      - description: Leez RK3399 P710
        items:
          - const: leez,p710
          - const: rockchip,rk3399

      - description: Lunzn FastRhino R66S / R68S
        items:
          - enum:
              - lunzn,fastrhino-r66s
              - lunzn,fastrhino-r68s
          - const: rockchip,rk3568

      - description: mqmaker MiQi
        items:
          - const: mqmaker,miqi
          - const: rockchip,rk3288

      - description: Netxeon R89 board
        items:
          - const: netxeon,r89
          - const: rockchip,rk3288

      - description: OPEN AI LAB EAIDK-610
        items:
          - const: openailab,eaidk-610
          - const: rockchip,rk3399

      - description: Orange Pi RK3399 board
        items:
          - const: rockchip,rk3399-orangepi
          - const: rockchip,rk3399

      - description: Phytec phyCORE-RK3288 Rapid Development Kit
        items:
          - const: phytec,rk3288-pcm-947
          - const: phytec,rk3288-phycore-som
          - const: rockchip,rk3288

      - description: Pine64 PinebookPro
        items:
          - const: pine64,pinebook-pro
          - const: rockchip,rk3399

      - description: Pine64 PineNote
        items:
          - enum:
              - pine64,pinenote-v1.1
              - pine64,pinenote-v1.2
          - const: pine64,pinenote
          - const: rockchip,rk3566

      - description: Pine64 PinePhonePro
        items:
          - const: pine64,pinephone-pro
          - const: rockchip,rk3399

      - description: Pine64 Rock64
        items:
          - const: pine64,rock64
          - const: rockchip,rk3328

      - description: Pine64 RockPro64
        items:
          - enum:
              - pine64,rockpro64-v2.1
              - pine64,rockpro64-v2.0
          - const: pine64,rockpro64
          - const: rockchip,rk3399

      - description: Pine64 Quartz64 Model A/B
        items:
          - enum:
              - pine64,quartz64-a
              - pine64,quartz64-b
          - const: rockchip,rk3566

      - description: Pine64 QuartzPro64
        items:
          - const: pine64,quartzpro64
          - const: rockchip,rk3588

      - description: Pine64 SoQuartz SoM
        items:
          - enum:
              - pine64,soquartz-blade
              - pine64,soquartz-cm4io
              - pine64,soquartz-model-a
          - const: pine64,soquartz
          - const: rockchip,rk3566

      - description: Powkiddy RGB30
        items:
          - const: powkiddy,rgb30
          - const: rockchip,rk3566

      - description: Radxa Compute Module 3(CM3)
        items:
          - enum:
              - radxa,cm3-io
          - const: radxa,cm3
          - const: rockchip,rk3566

      - description: Radxa CM3 Industrial
        items:
          - enum:
              - radxa,e25
          - const: radxa,cm3i
          - const: rockchip,rk3568

      - description: Radxa Rock
        items:
          - const: radxa,rock
          - const: rockchip,rk3188

      - description: Radxa ROCK Pi 4A/A+/B/B+/C
        items:
          - enum:
              - radxa,rockpi4a
              - radxa,rockpi4a-plus
              - radxa,rockpi4b
              - radxa,rockpi4b-plus
              - radxa,rockpi4c
          - const: radxa,rockpi4
          - const: rockchip,rk3399

      - description: Radxa ROCK 4C+
        items:
          - const: radxa,rock-4c-plus
          - const: rockchip,rk3399

      - description: Radxa ROCK 4SE
        items:
          - const: radxa,rock-4se
          - const: rockchip,rk3399

      - description: Radxa ROCK Pi E
        items:
          - const: radxa,rockpi-e
          - const: rockchip,rk3328

      - description: Radxa ROCK Pi N8
        items:
          - const: radxa,rockpi-n8
          - const: vamrs,rk3288-vmarc-som
          - const: rockchip,rk3288

      - description: Radxa ROCK Pi N10
        items:
          - const: radxa,rockpi-n10
          - const: vamrs,rk3399pro-vmarc-som
          - const: rockchip,rk3399pro

      - description: Radxa ROCK Pi S
        items:
          - const: radxa,rockpis
          - const: rockchip,rk3308

      - description: Radxa Rock2 Square
        items:
          - const: radxa,rock2-square
          - const: rockchip,rk3288

      - description: Radxa ROCK3 Model A
        items:
          - const: radxa,rock3a
          - const: rockchip,rk3568

      - description: Radxa ROCK 5 Model A
        items:
          - const: radxa,rock-5a
          - const: rockchip,rk3588s

      - description: Radxa ROCK 5 Model B
        items:
          - const: radxa,rock-5b
          - const: rockchip,rk3588

      - description: Rikomagic MK808 v1
        items:
          - const: rikomagic,mk808
          - const: rockchip,rk3066a

      - description: Rockchip Kylin
        items:
          - const: rockchip,rk3036-kylin
          - const: rockchip,rk3036

      - description: Rockchip PX3 Evaluation board
        items:
          - const: rockchip,px3-evb
          - const: rockchip,px3
          - const: rockchip,rk3188

      - description: Rockchip PX30 Evaluation board
        items:
          - const: rockchip,px30-evb
          - const: rockchip,px30

      - description: Rockchip PX5 Evaluation board
        items:
          - const: rockchip,px5-evb
          - const: rockchip,px5
          - const: rockchip,rk3368

      - description: Rockchip R88
        items:
          - const: rockchip,r88
          - const: rockchip,rk3368

      - description: Rockchip RK3036 Evaluation board
        items:
          - const: rockchip,rk3036-evb
          - const: rockchip,rk3036

      - description: Rockchip RK3128 Evaluation board
        items:
          - const: rockchip,rk3128-evb
          - const: rockchip,rk3128

      - description: Rockchip RK3228 Evaluation board
        items:
          - const: rockchip,rk3228-evb
          - const: rockchip,rk3228

      - description: Rockchip RK3229 Evaluation board
        items:
          - const: rockchip,rk3229-evb
          - const: rockchip,rk3229

      - description: Rockchip RK3288 Evaluation board
        items:
          - enum:
              - rockchip,rk3288-evb-act8846
              - rockchip,rk3288-evb-rk808
          - const: rockchip,rk3288

      - description: Rockchip RK3308 Evaluation board
        items:
          - const: rockchip,rk3308-evb
          - const: rockchip,rk3308

      - description: Rockchip RK3328 Evaluation board
        items:
          - const: rockchip,rk3328-evb
          - const: rockchip,rk3328

      - description: Rockchip RK3368 Evaluation board (act8846 pmic)
        items:
          - const: rockchip,rk3368-evb-act8846
          - const: rockchip,rk3368

      - description: Rockchip RK3399 Evaluation board
        items:
          - const: rockchip,rk3399-evb
          - const: rockchip,rk3399

      - description: Rockchip RK3399 Sapphire standalone
        items:
          - const: rockchip,rk3399-sapphire
          - const: rockchip,rk3399

      - description: Rockchip RK3399 Sapphire with Excavator Baseboard
        items:
          - const: rockchip,rk3399-sapphire-excavator
          - const: rockchip,rk3399

      - description: Rockchip RK3588 Evaluation board
        items:
          - const: rockchip,rk3588-evb1-v10
          - const: rockchip,rk3588

      - description: Rockchip RV1108 Evaluation board
        items:
          - const: rockchip,rv1108-evb
          - const: rockchip,rv1108

      - description: Theobroma Systems PX30-uQ7 with Haikou baseboard
        items:
          - const: tsd,px30-ringneck-haikou
          - const: rockchip,px30

      - description: Theobroma Systems RK3368-uQ7 with Haikou baseboard
        items:
          - const: tsd,rk3368-lion-haikou
          - const: rockchip,rk3368

      - description: Theobroma Systems RK3399-Q7 with Haikou baseboard
        items:
          - const: tsd,rk3399-puma-haikou
          - const: rockchip,rk3399

      - description: Tronsmart Orion R68 Meta
        items:
          - const: tronsmart,orion-r68-meta
          - const: rockchip,rk3368

      - description: Xunlong Orange Pi 5 Plus
        items:
          - const: xunlong,orangepi-5-plus
          - const: rockchip,rk3588

      - description: Xunlong Orange Pi R1 Plus / LTS
        items:
          - enum:
              - xunlong,orangepi-r1-plus
              - xunlong,orangepi-r1-plus-lts
          - const: rockchip,rk3328

      - description: Xunlong Orange Pi 5
        items:
          - const: xunlong,orangepi-5
          - const: rockchip,rk3588s

      - description: Zkmagic A95X Z2
        items:
          - const: zkmagic,a95x-z2
          - const: rockchip,rk3318

      - description: Rockchip RK3566 BOX Evaluation Demo board
        items:
          - const: rockchip,rk3566-box-demo
          - const: rockchip,rk3566

      - description: Rockchip RK3568 Evaluation board
        items:
          - const: rockchip,rk3568-evb1-v10
          - const: rockchip,rk3568

      - description: Rockchip RK3568 Banana Pi R2 Pro
        items:
          - const: rockchip,rk3568-bpi-r2pro
          - const: rockchip,rk3568

additionalProperties: true

...
```
