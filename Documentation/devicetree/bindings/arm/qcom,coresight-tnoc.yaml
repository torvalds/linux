## Documentation/devicetree/bindings/arm/qcom,coresight-tnoc.yaml
```yaml
# SPDX-License-Identifier: GPL-2.0-only OR BSD-2-Clause
%YAML 1.2
---
$id: http://devicetree.org/schemas/arm/qcom,coresight-tnoc.yaml#
$schema: http://devicetree.org/meta-schemas/core.yaml#

title: Qualcomm Trace Network On Chip - TNOC

maintainers:
  - Yuanfang Zhang <quic_yuanfang@quicinc.com>

description: >
  The Trace Network On Chip (TNOC) is an integration hierarchy hardware
  component that integrates the functionalities of TPDA and funnels.

  It sits in the different subsystem of SOC and aggregates the trace and
  transports it to Aggregation TNOC or to coresight trace sink eventually.
  TNOC embeds bridges for all the interfaces APB, ATB, TPDA and NTS (Narrow
  Time Stamp).

  TNOC can take inputs from different trace sources i.e. ATB, TPDM.

  Note this binding is specifically intended for Aggregator TNOC instances.

# Need a custom select here or 'arm,primecell' will match on lots of nodes
select:
  properties:
    compatible:
      contains:
        enum:
          - qcom,coresight-tnoc
  required:
    - compatible

properties:
  $nodename:
    pattern: "^tn(@[0-9a-f]+)$"

  compatible:
    items:
      - const: qcom,coresight-tnoc
      - const: arm,primecell

  reg:
    maxItems: 1

  clock-names:
    items:
      - const: apb_pclk

  clocks:
    items:
      - description: APB register access clock

  in-ports:
    $ref: /schemas/graph.yaml#/properties/ports

    patternProperties:
      '^port(@[0-9a-f]{1,2})?$':
        description: Input connections from CoreSight Trace Bus
        $ref: /schemas/graph.yaml#/properties/port

  out-ports:
    $ref: /schemas/graph.yaml#/properties/ports
    additionalProperties: false

    properties:
      port:
        description:
          Output connection to CoreSight Trace Bus
        $ref: /schemas/graph.yaml#/properties/port

required:
  - compatible
  - reg
  - clocks
  - clock-names
  - in-ports
  - out-ports

additionalProperties: false

examples:
  - |
    tn@109ab000  {
      compatible = "qcom,coresight-tnoc", "arm,primecell";
      reg = <0x109ab000 0x4200>;

      clocks = <&aoss_qmp>;
      clock-names = "apb_pclk";

      in-ports {
        #address-cells = <1>;
        #size-cells = <0>;

        port@0 {
          reg = <0>;

          tn_ag_in_tpdm_gcc: endpoint {
            remote-endpoint = <&tpdm_gcc_out_tn_ag>;
          };
        };
      };

      out-ports {
        port {
          tn_ag_out_funnel_in1: endpoint {
            remote-endpoint = <&funnel_in1_in_tn_ag>;
          };
        };
      };
    };
...
```

## Documentation/devicetree/bindings/arm/qcom,coresight-tpda.yaml
```yaml
# SPDX-License-Identifier: GPL-2.0-only or BSD-2-Clause
# Copyright (c) 2023 Qualcomm Innovation Center, Inc. All rights reserved.
%YAML 1.2
---
$id: http://devicetree.org/schemas/arm/qcom,coresight-tpda.yaml#
$schema: http://devicetree.org/meta-schemas/core.yaml#

title: Trace, Profiling and Diagnostics Aggregator - TPDA

description: |
  TPDAs are responsible for packetization and timestamping of data sets
  utilizing the MIPI STPv2 packet protocol. Pulling data sets from one or
  more attached TPDM and pushing the resultant (packetized) data out a
  master ATB interface. Performing an arbitrated ATB interleaving (funneling)
  task for free-flowing data from TPDM (i.e. CMB and DSB data set flows).

  There is no strict binding between TPDM and TPDA. TPDA can have multiple
  TPDMs connect to it. But There must be only one TPDA in the path from the
  TPDM source to TMC sink. TPDM can directly connect to TPDA's inport or
  connect to funnel which will connect to TPDA's inport.

  We can use the commands are similar to the below to validate TPDMs.
  Enable coresight sink first.

  echo 1 > /sys/bus/coresight/devices/tmc_etf0/enable_sink
  echo 1 > /sys/bus/coresight/devices/tpdm0/enable_source
  echo 1 > /sys/bus/coresight/devices/tpdm0/integration_test
  echo 2 > /sys/bus/coresight/devices/tpdm0/integration_test

  The test data will be collected in the coresight sink which is enabled.
  If rwp register of the sink is keeping updating when do integration_test
  (by cat tmc_etf0/mgmt/rwp), it means there is data generated from TPDM
  to sink.

maintainers:
  - Mao Jinlong <quic_jinlmao@quicinc.com>
  - Tao Zhang <quic_taozha@quicinc.com>

# Need a custom select here or 'arm,primecell' will match on lots of nodes
select:
  properties:
    compatible:
      contains:
        enum:
          - qcom,coresight-tpda
  required:
    - compatible

properties:
  $nodename:
    pattern: "^tpda(@[0-9a-f]+)$"
  compatible:
    items:
      - const: qcom,coresight-tpda
      - const: arm,primecell

  reg:
    minItems: 1
    maxItems: 2

  clocks:
    maxItems: 1

  clock-names:
    items:
      - const: apb_pclk

  in-ports:
    type: object
    description: |
      Input connections from TPDM to TPDA
    $ref: /schemas/graph.yaml#/properties/ports

  out-ports:
    type: object
    description: |
      Output connections from the TPDA to legacy CoreSight trace bus.
    $ref: /schemas/graph.yaml#/properties/ports

    properties:
      port:
        description:
          Output connection from the TPDA to legacy CoreSight Trace bus.
        $ref: /schemas/graph.yaml#/properties/port

required:
  - compatible
  - reg
  - clocks
  - clock-names
  - in-ports
  - out-ports

additionalProperties: false

examples:
  # minimum tpda definition.
  - |
    tpda@6004000 {
       compatible = "qcom,coresight-tpda", "arm,primecell";
       reg = <0x6004000 0x1000>;

       clocks = <&aoss_qmp>;
       clock-names = "apb_pclk";

       in-ports {
         #address-cells = <1>;
         #size-cells = <0>;

        port@0 {
          reg = <0>;
          tpda_qdss_0_in_tpdm_dcc: endpoint {
            remote-endpoint =
              <&tpdm_dcc_out_tpda_qdss_0>;
            };
        };
      };

       out-ports {
         port {
                 tpda_qdss_out_funnel_in0: endpoint {
                    remote-endpoint =
                    <&funnel_in0_in_tpda_qdss>;
                  };
          };
       };
    };

...
```

## Documentation/devicetree/bindings/arm/qcom,coresight-tpdm.yaml
```yaml
# SPDX-License-Identifier: GPL-2.0-only OR BSD-2-Clause
# Copyright (c) 2023 Qualcomm Innovation Center, Inc. All rights reserved.
%YAML 1.2
---
$id: http://devicetree.org/schemas/arm/qcom,coresight-tpdm.yaml#
$schema: http://devicetree.org/meta-schemas/core.yaml#

title: Trace, Profiling and Diagnostics Monitor - TPDM

description: |
  The TPDM or Monitor serves as data collection component for various dataset
  types specified in the QPMDA spec. It covers Implementation defined ((ImplDef),
  Basic Counts (BC), Tenure Counts (TC), Continuous Multi-Bit (CMB), and Discrete
  Single Bit (DSB). It performs data collection in the data producing clock
  domain and transfers it to the data collection time domain, generally ATB
  clock domain.

  The primary use case of the TPDM is to collect data from different data
  sources and send it to a TPDA for packetization, timestamping, and funneling.

maintainers:
  - Mao Jinlong <quic_jinlmao@quicinc.com>
  - Tao Zhang <quic_taozha@quicinc.com>

# Need a custom select here or 'arm,primecell' will match on lots of nodes
select:
  properties:
    compatible:
      contains:
        enum:
          - qcom,coresight-tpdm
  required:
    - compatible

properties:
  $nodename:
    pattern: "^tpdm(@[0-9a-f]+)$"
  compatible:
    items:
      - const: qcom,coresight-tpdm
      - const: arm,primecell

  reg:
    maxItems: 1

  qcom,dsb-element-bits:
    description:
      Specifies the DSB(Discrete Single Bit) element size supported by
      the monitor. The associated aggregator will read this size before it
      is enabled. DSB element size currently only supports 32-bit and 64-bit.
    enum: [32, 64]

  qcom,cmb-element-bits:
    description:
      Specifies the CMB(Continuous Multi-Bit) element size supported by
      the monitor. The associated aggregator will read this size before it
      is enabled. CMB element size currently only supports 8-bit, 32-bit
      and 64-bit.
    enum: [8, 32, 64]

  qcom,dsb-msrs-num:
    description:
      Specifies the number of DSB(Discrete Single Bit) MSR(mux select register)
      registers supported by the monitor. If this property is not configured
      or set to 0, it means this DSB TPDM doesn't support MSR.
    $ref: /schemas/types.yaml#/definitions/uint32
    minimum: 0
    maximum: 32

  qcom,cmb-msrs-num:
    description:
      Specifies the number of CMB MSR(mux select register) registers supported
      by the monitor. If this property is not configured or set to 0, it means
      this TPDM doesn't support CMB MSR.
    $ref: /schemas/types.yaml#/definitions/uint32
    minimum: 0
    maximum: 32

  label:
    description:
      Description of a coresight device.

  clocks:
    maxItems: 1

  clock-names:
    items:
      - const: apb_pclk

  out-ports:
    description: |
      Output connections from the TPDM to coresight funnel/TPDA.
    $ref: /schemas/graph.yaml#/properties/ports

    properties:
      port:
        description: Output connection from the TPDM to coresight
            funnel/TPDA.
        $ref: /schemas/graph.yaml#/properties/port

required:
  - compatible
  - reg
  - clocks
  - clock-names

additionalProperties: false

examples:
  # minimum TPDM definition. TPDM connect to coresight TPDA.
  - |
    tpdm@684c000 {
      compatible = "qcom,coresight-tpdm", "arm,primecell";
      reg = <0x0684c000 0x1000>;

      qcom,dsb-element-bits = <32>;
      qcom,dsb-msrs-num = <16>;

      clocks = <&aoss_qmp>;
      clock-names = "apb_pclk";

      out-ports {
        port {
          tpdm_prng_out_tpda_qdss: endpoint {
            remote-endpoint =
              <&tpda_qdss_in_tpdm_prng>;
          };
        };
      };
    };

    tpdm@6c29000 {
      compatible = "qcom,coresight-tpdm", "arm,primecell";
      reg = <0x06c29000 0x1000>;

      qcom,cmb-element-bits = <64>;
      qcom,cmb-msrs-num = <32>;

      clocks = <&aoss_qmp>;
      clock-names = "apb_pclk";

      out-ports {
        port {
          tpdm_ipcc_out_funnel_center: endpoint {
            remote-endpoint = <&funnel_center_in_tpdm_ipcc>;
          };
        };
      };
    };
...
```
