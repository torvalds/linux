## Documentation/devicetree/bindings/arm/rockchip.txt
```
Rockchip platforms device tree bindings
---------------------------------------

- 96boards RK3399 Ficus (ROCK960 Enterprise Edition)
    Required root node properties:
      - compatible = "vamrs,ficus", "rockchip,rk3399";

- Amarula Vyasa RK3288 board
    Required root node properties:
      - compatible = "amarula,vyasa-rk3288", "rockchip,rk3288";

- Asus Tinker board
    Required root node properties:
      - compatible = "asus,rk3288-tinker", "rockchip,rk3288";

- Kylin RK3036 board:
    Required root node properties:
      - compatible = "rockchip,kylin-rk3036", "rockchip,rk3036";

- MarsBoard RK3066 board:
    Required root node properties:
      - compatible = "haoyu,marsboard-rk3066", "rockchip,rk3066a";

- bq Curie 2 tablet:
    Required root node properties:
      - compatible = "mundoreader,bq-curie2", "rockchip,rk3066a";

- ChipSPARK Rayeager PX2 board:
    Required root node properties:
      - compatible = "chipspark,rayeager-px2", "rockchip,rk3066a";

- Radxa Rock board:
    Required root node properties:
      - compatible = "radxa,rock", "rockchip,rk3188";

- Radxa Rock2 Square board:
    Required root node properties:
      - compatible = "radxa,rock2-square", "rockchip,rk3288";

- Rikomagic MK808 v1 board:
    Required root node properties:
      - compatible = "rikomagic,mk808", "rockchip,rk3066a";

- Firefly Firefly-RK3288 board:
    Required root node properties:
      - compatible = "firefly,firefly-rk3288", "rockchip,rk3288";
    or
      - compatible = "firefly,firefly-rk3288-beta", "rockchip,rk3288";

- Firefly Firefly-RK3288 Reload board:
    Required root node properties:
      - compatible = "firefly,firefly-rk3288-reload", "rockchip,rk3288";

- Firefly Firefly-RK3399 board:
    Required root node properties:
      - compatible = "firefly,firefly-rk3399", "rockchip,rk3399";

- Firefly roc-rk3328-cc board:
    Required root node properties:
      - compatible = "firefly,roc-rk3328-cc", "rockchip,rk3328";

- ChipSPARK PopMetal-RK3288 board:
    Required root node properties:
      - compatible = "chipspark,popmetal-rk3288", "rockchip,rk3288";

- Netxeon R89 board:
    Required root node properties:
      - compatible = "netxeon,r89", "rockchip,rk3288";

- GeekBuying GeekBox:
    Required root node properties:
      - compatible = "geekbuying,geekbox", "rockchip,rk3368";

- Google Bob (Asus Chromebook Flip C101PA):
    Required root node properties:
	compatible = "google,bob-rev13", "google,bob-rev12",
		     "google,bob-rev11", "google,bob-rev10",
		     "google,bob-rev9", "google,bob-rev8",
		     "google,bob-rev7", "google,bob-rev6",
		     "google,bob-rev5", "google,bob-rev4",
		     "google,bob", "google,gru", "rockchip,rk3399";

- Google Brain (dev-board):
    Required root node properties:
      - compatible = "google,veyron-brain-rev0", "google,veyron-brain",
		     "google,veyron", "rockchip,rk3288";

- Google Gru (dev-board):
    Required root node properties:
      - compatible = "google,gru-rev15", "google,gru-rev14",
		     "google,gru-rev13", "google,gru-rev12",
		     "google,gru-rev11", "google,gru-rev10",
		     "google,gru-rev9", "google,gru-rev8",
		     "google,gru-rev7", "google,gru-rev6",
		     "google,gru-rev5", "google,gru-rev4",
		     "google,gru-rev3", "google,gru-rev2",
		     "google,gru", "rockchip,rk3399";

- Google Jaq (Haier Chromebook 11 and more):
    Required root node properties:
      - compatible = "google,veyron-jaq-rev5", "google,veyron-jaq-rev4",
		     "google,veyron-jaq-rev3", "google,veyron-jaq-rev2",
		     "google,veyron-jaq-rev1", "google,veyron-jaq",
		     "google,veyron", "rockchip,rk3288";

- Google Jerry (Hisense Chromebook C11 and more):
    Required root node properties:
      - compatible = "google,veyron-jerry-rev7", "google,veyron-jerry-rev6",
		     "google,veyron-jerry-rev5", "google,veyron-jerry-rev4",
		     "google,veyron-jerry-rev3", "google,veyron-jerry",
		     "google,veyron", "rockchip,rk3288";

- Google Kevin (Samsung Chromebook Plus):
    Required root node properties:
      - compatible = "google,kevin-rev15", "google,kevin-rev14",
		     "google,kevin-rev13", "google,kevin-rev12",
		     "google,kevin-rev11", "google,kevin-rev10",
		     "google,kevin-rev9", "google,kevin-rev8",
		     "google,kevin-rev7", "google,kevin-rev6",
		     "google,kevin", "google,gru", "rockchip,rk3399";

- Google Mickey (Asus Chromebit CS10):
    Required root node properties:
      - compatible = "google,veyron-mickey-rev8", "google,veyron-mickey-rev7",
		     "google,veyron-mickey-rev6", "google,veyron-mickey-rev5",
		     "google,veyron-mickey-rev4", "google,veyron-mickey-rev3",
		     "google,veyron-mickey-rev2", "google,veyron-mickey-rev1",
		     "google,veyron-mickey-rev0", "google,veyron-mickey",
		     "google,veyron", "rockchip,rk3288";

- Google Minnie (Asus Chromebook Flip C100P):
    Required root node properties:
      - compatible = "google,veyron-minnie-rev4", "google,veyron-minnie-rev3",
		     "google,veyron-minnie-rev2", "google,veyron-minnie-rev1",
		     "google,veyron-minnie-rev0", "google,veyron-minnie",
		     "google,veyron", "rockchip,rk3288";

- Google Pinky (dev-board):
    Required root node properties:
      - compatible = "google,veyron-pinky-rev2", "google,veyron-pinky",
		     "google,veyron", "rockchip,rk3288";

- Google Speedy (Asus C201 Chromebook):
    Required root node properties:
      - compatible = "google,veyron-speedy-rev9", "google,veyron-speedy-rev8",
		     "google,veyron-speedy-rev7", "google,veyron-speedy-rev6",
		     "google,veyron-speedy-rev5", "google,veyron-speedy-rev4",
		     "google,veyron-speedy-rev3", "google,veyron-speedy-rev2",
		     "google,veyron-speedy", "google,veyron", "rockchip,rk3288";

- mqmaker MiQi:
    Required root node properties:
      - compatible = "mqmaker,miqi", "rockchip,rk3288";

- Phytec phyCORE-RK3288: Rapid Development Kit
    Required root node properties:
     - compatible = "phytec,rk3288-pcm-947", "phytec,rk3288-phycore-som", "rockchip,rk3288";

- Pine64 Rock64 board:
    Required root node properties:
    - compatible = "pine64,rock64", "rockchip,rk3328";

- Rockchip PX3 Evaluation board:
    Required root node properties:
      - compatible = "rockchip,px3-evb", "rockchip,px3", "rockchip,rk3188";

- Rockchip PX5 Evaluation board:
    Required root node properties:
      - compatible = "rockchip,px5-evb", "rockchip,px5", "rockchip,rk3368";

- Rockchip RV1108 Evaluation board
    Required root node properties:
      - compatible = "rockchip,rv1108-evb", "rockchip,rv1108";

- Rockchip RK3368 evb:
    Required root node properties:
      - compatible = "rockchip,rk3368-evb-act8846", "rockchip,rk3368";

- Rockchip R88 board:
    Required root node properties:
      - compatible = "rockchip,r88", "rockchip,rk3368";

- Rockchip RK3228 Evaluation board:
    Required root node properties:
     - compatible = "rockchip,rk3228-evb", "rockchip,rk3228";

- Rockchip RK3229 Evaluation board:
     - compatible = "rockchip,rk3229-evb", "rockchip,rk3229";

- Rockchip RK3288 Fennec board:
    Required root node properties:
     - compatible = "rockchip,rk3288-fennec", "rockchip,rk3288";

- Rockchip RK3328 evb:
    Required root node properties:
      - compatible = "rockchip,rk3328-evb", "rockchip,rk3328";

- Rockchip RK3399 evb:
    Required root node properties:
      - compatible = "rockchip,rk3399-evb", "rockchip,rk3399";

- Rockchip RK3399 Sapphire board standalone:
    Required root node properties:
      - compatible = "rockchip,rk3399-sapphire", "rockchip,rk3399";

- Rockchip RK3399 Sapphire Excavator board:
    Required root node properties:
      - compatible = "rockchip,rk3399-sapphire-excavator", "rockchip,rk3399";

- Theobroma Systems RK3368-uQ7 Haikou Baseboard:
    Required root node properties:
      - compatible = "tsd,rk3368-uq7-haikou", "rockchip,rk3368";

- Theobroma Systems RK3399-Q7 Haikou Baseboard:
    Required root node properties:
      - compatible = "tsd,rk3399-q7-haikou", "rockchip,rk3399";

- Tronsmart Orion R68 Meta
    Required root node properties:
      - compatible = "tronsmart,orion-r68-meta", "rockchip,rk3368";
```
