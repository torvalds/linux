## Documentation/devicetree/bindings/hwmon/pmbus/isil,isl68137.yaml
```yaml
# SPDX-License-Identifier: (GPL-2.0 OR BSD-2-Clause)
%YAML 1.2
---

$id: http://devicetree.org/schemas/hwmon/pmbus/isil,isl68137.yaml#
$schema: http://devicetree.org/meta-schemas/core.yaml#

title: Renesas Digital Multiphase Voltage Regulators with PMBus

maintainers:
  - Grant Peltier <grant.peltier.jg@renesas.com>

description: |
  Renesas digital multiphase voltage regulators with PMBus.
  https://www.renesas.com/en/products/power-management/multiphase-power/multiphase-dcdc-switching-controllers

properties:
  compatible:
    enum:
      - isil,isl68137
      - renesas,isl68220
      - renesas,isl68221
      - renesas,isl68222
      - renesas,isl68223
      - renesas,isl68224
      - renesas,isl68225
      - renesas,isl68226
      - renesas,isl68227
      - renesas,isl68229
      - renesas,isl68233
      - renesas,isl68239
      - renesas,isl69222
      - renesas,isl69223
      - renesas,isl69224
      - renesas,isl69225
      - renesas,isl69227
      - renesas,isl69228
      - renesas,isl69234
      - renesas,isl69236
      - renesas,isl69239
      - renesas,isl69242
      - renesas,isl69243
      - renesas,isl69247
      - renesas,isl69248
      - renesas,isl69254
      - renesas,isl69255
      - renesas,isl69256
      - renesas,isl69259
      - isil,isl69260
      - renesas,isl69268
      - isil,isl69269
      - renesas,isl69298
      - renesas,raa228000
      - renesas,raa228004
      - renesas,raa228006
      - renesas,raa228228
      - renesas,raa229001
      - renesas,raa229004

  reg:
    maxItems: 1

  '#address-cells':
    const: 1

  '#size-cells':
    const: 0

patternProperties:
  "^channel@([0-3])$":
    type: object
    description:
      Container for properties specific to a particular channel (rail).

    properties:
      reg:
        description: The channel (rail) index.
        items:
          minimum: 0
          maximum: 3

      vout-voltage-divider:
        description: |
          Resistances of a voltage divider placed between Vout and the voltage
          sense (Vsense) pin for the given channel (rail). It has two numbers
          representing the resistances of the voltage divider provided as
          <Rout Rtotal> which yields an adjusted Vout as
          Vout_adj = Vout * Rtotal / Rout given the original Vout as reported
          by the Vsense pin. Given a circuit configuration similar to the one
          below, Rtotal = R1 + Rout.

            Vout ----.
                     |
                  .-----.
                  | R1  |
                  '-----'
                     |
                     +---- Vsense
                     |
                  .-----.
                  | Rout|
                  '-----'
                     |
                    GND

        $ref: /schemas/types.yaml#/definitions/uint32-array
        minItems: 2
        maxItems: 2

    required:
      - reg

    additionalProperties: false

required:
  - compatible
  - reg

additionalProperties: false

examples:
  - |
    i2c {
      #address-cells = <1>;
      #size-cells = <0>;

      isl68239@60 {
        compatible = "isil,isl68137";
        reg = <0x60>;
      };
    };
  - |
    i2c {
      #address-cells = <1>;
      #size-cells = <0>;

      isl68239@60 {
        compatible = "renesas,isl68239";
        reg = <0x60>;
        #address-cells = <1>;
        #size-cells = <0>;

        channel@0 {
          reg = <0>;
          vout-voltage-divider = <1000 2000>;  // Reported Vout/Pout would be scaled by 2
        };
      };
    };
```

## Documentation/devicetree/bindings/hwmon/pmbus/max31785.txt
```
Bindings for the Maxim MAX31785 Intelligent Fan Controller
==========================================================

Reference:

https://datasheets.maximintegrated.com/en/ds/MAX31785.pdf

Required properties:
- compatible     : One of "maxim,max31785" or "maxim,max31785a"
- reg            : I2C address, one of 0x52, 0x53, 0x54, 0x55.
- #address-cells : Must be 1
- #size-cells    : Must be 0
- #thermal-sensor-cells  : Should be 1. The device supports:
                           - One internal sensor
                           - Four external I2C digital sensors
                           - Six external thermal diodes

Optional properties:
- use-stored-presence    : Do not treat the devicetree description as canon for
                           fan presence (the 'installed' bit of FAN_CONFIG_*).
                           Instead, rely on the on the default value store of
                           the device to populate it.

Capabilities are configured through subnodes of the controller's node.

Fans
----

Only fans with subnodes present will be considered as installed. If
use-stored-presence is present in the parent node, then only fans that are both
defined in the devicetree and have their installed bit set are considered
installed.

Required subnode properties:
- compatible             : Must be "pmbus-fan"
- reg                    : The PMBus page the properties apply to.
- #cooling-cells         : Should be 2. See the thermal bindings at [1].
- maxim,fan-rotor-input  : The type of rotor measurement provided to the
                           controller. Must be either "tach" for tachometer
                           pulses or "lock" for a locked-rotor signal.
- maxim,fan-lock-polarity: Required iff maxim,fan-rotor-input is "lock". Valid
                           values are "low" for active low, "high" for active
                           high.

Optional subnode properties:
- fan-mode               : "rpm" or "pwm". Default value is "pwm".
- tach-pulses            : Tachometer pulses per revolution. Valid values are
                           1, 2, 3 or 4. The default is 1.
- cooling-min-level      : Smallest cooling state accepted. See [1].
- cooling-max-level      : Largest cooling state accepted. See [1].
- maxim,fan-no-fault-ramp: Do not ramp the fan to 100% PWM duty on detecting a
                           fan fault
- maxim,fan-startup      : The number of rotations required before taking
                           emergency action for an unresponsive fan and driving
                           it with 100% or 0% PWM duty, depending on the state
                           of maxim,fan-no-fault-ramp. Valid values are 0
                           (automatic spin-up disabled), 2, 4, or 8. Default
                           value is 0.
- maxim,fan-health       : Enable automated fan health check
- maxim,fan-ramp         : Configures how fast the device ramps the PWM duty
                           cycle from one value to another. Valid values are 0
                           to 7 inclusive, with values 0 - 2 configuring a
                           1000ms update rate and 1 - 3% duty respective duty
                           increase, and 3 - 7 a 200ms update rate with a 1 -
                           5% respective duty increase. Default value is 0.
- maxim,fan-no-watchdog  : Do not ramp fan to 100% PWM duty on failure to
                           update desired fan rate inside 10s. This implies
                           maxim,tmp-no-fault-ramp
- maxim,tmp-no-fault-ramp: Do not ramp fan to 100% PWM duty on temperature
                           sensor fault detection. This implies
                           maxim,fan-no-watchdog
- maxim,tmp-hysteresis   : The temperature hysteresis used to determine
                           transitions to lower fan speed bands in the
                           temperature/fan rate lookup table. Valid values are
                           2, 4, 6 or 8 (degrees celcius). Default value is 2.
- maxim,fan-dual-tach    : Enable dual tachometer functionality
- maxim,fan-pwm-freq     : The PWM frequency. Valid values are 30, 50, 100, 150
                           and 25000 (Hz). Default value is 30Hz.
- maxim,fan-lookup-table : A 16-element cell array of alternating temperature
                           and rate values representing the look up table. The
                           rate units are set through the fan-mode property.
- maxim,fan-fault-pin-mon: Ramp fans to 100% PWM duty when the FAULT pin is
                           asserted

Temperature
-----------

Required subnode properties:
- compatible    : Must be "pmbus-temperature"
- reg           : The PMBus page the properties apply to.

Optional subnode properties:
- maxim,tmp-offset      : Valid values are 0 - 30 (degrees celcius) inclusive.
                          Default value is 0.
- maxim,tmp-fans        : An array of phandles to fans controlled by the
                          current temperature sensor.

[1] Documentation/devicetree/bindings/thermal/thermal.txt

Example:
	fan-max31785: max31785@52 {
		reg = <0x52>;
		compatible = "maxim,max31785";
                #address-cells = <1>;
                #size-cells = <0>;
                #thermal-sensor-cells = <1>;

                fan@0 {
                        compatible = "pmbus-fan";
                        reg = <0>;
                        mode = "rpm";
                        tach-pulses = <1>;

                        #cooling-cells = <2>;
                        cooling-min-level = <0>;
                        cooling-max-level = <9>;

                        maxim,fan-rotor-input = "tach";
                        maxim,fan-dual-tach;
                };

                /*
                 * Hardware controlled fan: Fan speed is controlled by a
                 * temperature sensor feeding values into the lookup table. The
                 * fan association is done in the temperature sensor node. One
                 * sensor can drive multiple fans.
                 */
                cpu_fan: fan@1 {
                        compatible = "pmbus-fan";
                        reg = <1>;
                        mode = "rpm";
                        tach-pulses = <1>;

                        #cooling-cells = <2>;

                        maxim,fan-rotor-input = "tach";
                        maxim,tmp-hysteresis = <2>;
                        maxim,fan-lookup-table = <
                        /*  Temperature    RPM  */
                                 0        1000
                                10        2000
                                20        3000
                                30        4000
                                40        5000
                                50        6000
                                60        7000
                                70        8000
                        >;
                };

                cpu_temp: sensor@6 {
                        compatible = "pmbus-temperature";
                        reg = <6>;

                        maxim,tmp-offset = <0>;
                        maxim,tmp-fans = <&cpu_fan>;
                };
	};
```

## Documentation/devicetree/bindings/hwmon/pmbus/mps,mp2975.yaml
```yaml
# SPDX-License-Identifier: (GPL-2.0 OR BSD-2-Clause)
%YAML 1.2
---
$id: http://devicetree.org/schemas/hwmon/pmbus/mps,mp2975.yaml#
$schema: http://devicetree.org/meta-schemas/core.yaml#

title: MPS MP2975 Synchronous Buck Regulator

maintainers:
  - Naresh Solanki <naresh.solanki@9elements.com>

description:
  The MPS MP2971, MP2973 & MP2975 is a multi-phase voltage regulator
  designed for use in high-performance computing and server
  applications. It supports I2C/PMBus for control and monitoring.

properties:
  compatible:
    enum:
      - mps,mp2971
      - mps,mp2973
      - mps,mp2975

  reg:
    maxItems: 1

  interrupts:
    maxItems: 1

  regulators:
    type: object
    description:
      List of regulators provided by this controller.

    patternProperties:
      "^vout[0-1]$":
        $ref: /schemas/regulator/regulator.yaml#
        type: object
        unevaluatedProperties: false

    additionalProperties: false

required:
  - compatible
  - reg

additionalProperties: false

examples:
  - |
    #include <dt-bindings/interrupt-controller/irq.h>
    i2c {
        #address-cells = <1>;
        #size-cells = <0>;

        regulator@58 {
            compatible = "mps,mp2973";
            reg = <0x58>;

            interrupt-parent = <&smb_pex_cpu1_event>;
            interrupts = <12 IRQ_TYPE_LEVEL_LOW>;

            regulators {
                vout0 {
                    regulator-name = "pvccin_cpu1";
                    regulator-enable-ramp-delay = <200>;
                };
                vout1 {
                    regulator-name = "pvccfa_ehv_fivra_cpu1";
                    regulator-enable-ramp-delay = <200>;
                };
            };
        };
    };
```

## Documentation/devicetree/bindings/hwmon/pmbus/mps,mpq8785.yaml
```yaml
# SPDX-License-Identifier: (GPL-2.0 OR BSD-2-Clause)
%YAML 1.2
---
$id: http://devicetree.org/schemas/hwmon/pmbus/mps,mpq8785.yaml#
$schema: http://devicetree.org/meta-schemas/core.yaml#

title: Monolithic Power Systems Multiphase Voltage Regulators with PMBus

maintainers:
  - Charles Hsu <ythsu0511@gmail.com>

description:
  Monolithic Power Systems digital multiphase voltage regulators with PMBus.

properties:
  compatible:
    enum:
      - mps,mpm3695
      - mps,mpm3695-25
      - mps,mpm82504
      - mps,mpq8785

  reg:
    maxItems: 1

  mps,vout-fb-divider-ratio-permille:
    description:
      The feedback resistor divider ratio, expressed in permille
      (Vfb / Vout * 1000). This value is written to the PMBUS_VOUT_SCALE_LOOP
      register and is required for correct output voltage presentation.
    $ref: /schemas/types.yaml#/definitions/uint32
    minimum: 1
    maximum: 4095
    default: 706

required:
  - compatible
  - reg

allOf:
  - if:
      properties:
        compatible:
          enum:
            - mps,mpm3695
            - mps,mpm82504
    then:
      properties:
        mps,vout-fb-divider-ratio-permille:
          maximum: 1023

  - if:
      properties:
        compatible:
          const: mps,mpq8785
    then:
      properties:
        mps,vout-fb-divider-ratio-permille:
          maximum: 2047

additionalProperties: false

examples:
  - |
    i2c {
      #address-cells = <1>;
      #size-cells = <0>;

      pmic@30 {
        compatible = "mps,mpm82504";
        reg = <0x30>;
        mps,vout-fb-divider-ratio-permille = <600>;
      };
    };
```

## Documentation/devicetree/bindings/hwmon/pmbus/silergy,sq24860.yaml
```yaml
# SPDX-License-Identifier: (GPL-2.0 OR BSD-2-Clause)
%YAML 1.2
---

$id: http://devicetree.org/schemas/hwmon/pmbus/silergy,sq24860.yaml#
$schema: http://devicetree.org/meta-schemas/core.yaml#

title: Silergy SQ24860 eFuse

maintainers:
  - Ziming Zhu <ziming.zhu@silergycorp.com>

description:
  The Silergy SQ24860 is an integrated, high-current circuit protection and
  power management device with PMBus interface.

properties:
  compatible:
    const: silergy,sq24860

  reg:
    maxItems: 1

  silergy,rimon-micro-ohms:
    description:
      Micro-ohms value of the resistance installed between the IMON pin and
      the ground reference.

  interrupts:
    description: PMBus SMBAlert interrupt.
    maxItems: 1

  regulators:
    type: object
    description:
      List of regulators provided by this controller.

    properties:
      vout:
        $ref: /schemas/regulator/regulator.yaml#
        type: object
        unevaluatedProperties: false

    additionalProperties: false

required:
  - compatible
  - reg
  - silergy,rimon-micro-ohms

additionalProperties: false

examples:
  - |

    i2c {
        #address-cells = <1>;
        #size-cells = <0>;

        hw-monitor@40 {
            compatible = "silergy,sq24860";
            reg = <0x40>;

            interrupt-parent = <&gpio>;
            interrupts = <42 8>;
            silergy,rimon-micro-ohms = <1600000000>;

            regulators {
                cpu0_vout: vout {
                    regulator-name = "main_cpu0";
                };
            };
        };
    };
```
