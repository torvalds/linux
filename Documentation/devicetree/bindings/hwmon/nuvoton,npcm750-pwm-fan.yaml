## Documentation/devicetree/bindings/hwmon/pmbus/ti,lm25066.yaml
```yaml
# SPDX-License-Identifier: (GPL-2.0 OR BSD-2-Clause)
%YAML 1.2
---

$id: http://devicetree.org/schemas/hwmon/pmbus/ti,lm25066.yaml#
$schema: http://devicetree.org/meta-schemas/core.yaml#

title: National Semiconductor/Texas Instruments LM250x6/LM506x power-management ICs

maintainers:
  - Zev Weiss <zev@bewilderbeest.net>

description: |
  The LM25066 family of power-management ICs (a.k.a. hot-swap
  controllers or eFuses in various contexts) are PMBus devices that
  offer temperature, current, voltage, and power monitoring.

  Datasheet: https://www.ti.com/lit/ds/symlink/lm25066.pdf

properties:
  compatible:
    enum:
      - ti,lm25056
      - ti,lm25066
      - ti,lm5064
      - ti,lm5066
      - ti,lm5066i

  reg:
    maxItems: 1

  shunt-resistor-micro-ohms:
    description:
      Shunt (sense) resistor value in micro-Ohms
    default: 1000

  regulators:
    type: object

    properties:
      vout:
        $ref: /schemas/regulator/regulator.yaml#
        type: object

        unevaluatedProperties: false

    additionalProperties: false

required:
  - compatible
  - reg

allOf:
  - $ref: /schemas/hwmon/hwmon-common.yaml#

unevaluatedProperties: false

examples:
  - |
    i2c {
        #address-cells = <1>;
        #size-cells = <0>;

        pmic@40 {
            compatible = "ti,lm25066";
            reg = <0x40>;
            shunt-resistor-micro-ohms = <675>;
        };
    };
```

## Documentation/devicetree/bindings/hwmon/pmbus/ti,tps25990.yaml
```yaml
# SPDX-License-Identifier: (GPL-2.0 OR BSD-2-Clause)
%YAML 1.2
---

$id: http://devicetree.org/schemas/hwmon/pmbus/ti,tps25990.yaml#
$schema: http://devicetree.org/meta-schemas/core.yaml#

title: Texas Instruments TPS25990 Stackable eFuse

maintainers:
  - Jerome Brunet <jbrunet@baylibre.com>

description:
  The TI TPS25990 is an integrated, high-current circuit
  protection and power management device with PMBUS interface

properties:
  compatible:
    const: ti,tps25990

  reg:
    maxItems: 1

  ti,rimon-micro-ohms:
    description:
      micro Ohms value of the resistance installed between the Imon pin
      and the ground reference.

  interrupts:
    description: PMBUS SMB Alert Interrupt.
    maxItems: 1

  regulators:
    type: object
    description:
      list of regulators provided by this controller.

    properties:
      vout:
        $ref: /schemas/regulator/regulator.yaml#
        type: object
        unevaluatedProperties: false

      gpdac1:
        $ref: /schemas/regulator/regulator.yaml#
        type: object
        unevaluatedProperties: false

      gpdac2:
        $ref: /schemas/regulator/regulator.yaml#
        type: object
        unevaluatedProperties: false
    additionalProperties: false

required:
  - compatible
  - reg
  - ti,rimon-micro-ohms

additionalProperties: false

examples:
  - |
    #include <dt-bindings/interrupt-controller/irq.h>
    i2c {
        #address-cells = <1>;
        #size-cells = <0>;

        hw-monitor@46 {
            compatible = "ti,tps25990";
            reg = <0x46>;

            interrupt-parent = <&gpio>;
            interrupts = <42 IRQ_TYPE_LEVEL_LOW>;
            ti,rimon-micro-ohms = <1370000000>;

            regulators {
                cpu0_vout: vout {
                    regulator-name = "main_cpu0";
                };
            };
        };
    };
```

## Documentation/devicetree/bindings/hwmon/pmbus/ti,ucd90320.yaml
```yaml
# SPDX-License-Identifier: (GPL-2.0 OR BSD-2-Clause)
%YAML 1.2
---

$id: http://devicetree.org/schemas/hwmon/pmbus/ti,ucd90320.yaml#
$schema: http://devicetree.org/meta-schemas/core.yaml#

title: UCD90320 power sequencer

maintainers:
  - Jim Wright <wrightj@linux.vnet.ibm.com>

description: |
  The UCD90320 is a 32-rail PMBus/I2C addressable power-supply sequencer and
  monitor. The 24 integrated ADC channels (AMONx) monitor the power supply
  voltage, current, and temperature. Of the 84 GPIO pins, 8 can be used as
  digital monitors (DMONx), 32 to enable the power supply (ENx), 24 for
  margining (MARx), 16 for logical GPO, and 32 GPIs for cascading, and system
  function.

  http://focus.ti.com/lit/ds/symlink/ucd90320.pdf

properties:
  compatible:
    enum:
      - ti,ucd90320

  reg:
    maxItems: 1

required:
  - compatible
  - reg

examples:
  - |
    i2c {
        #address-cells = <1>;
        #size-cells = <0>;

        ucd90320@11 {
            compatible = "ti,ucd90320";
            reg = <0x11>;
        };
    };
```

## Documentation/devicetree/bindings/hwmon/pmbus/vicor,pli1209bc.yaml
```yaml
# SPDX-License-Identifier: (GPL-2.0 OR BSD-2-Clause)
%YAML 1.2
---
$id: http://devicetree.org/schemas/hwmon/pmbus/vicor,pli1209bc.yaml#
$schema: http://devicetree.org/meta-schemas/core.yaml#

title: Vicor PLI1209BC Power Regulator

maintainers:
  - Marcello Sylvester Bauer <sylv@sylv.io>
  - Naresh Solanki <naresh.solanki@9elements.com>

description:
  The Vicor PLI1209BC is a Digital Supervisor with Isolation for use
  with BCM Bus Converter Modules.

properties:
  compatible:
    enum:
      - vicor,pli1209bc

  reg:
    maxItems: 1

  regulators:
    type: object
    description:
      List of regulators provided by this controller.

    properties:
      vout2:
        $ref: /schemas/regulator/regulator.yaml#
        type: object
        unevaluatedProperties: false

    additionalProperties: false

required:
  - compatible
  - reg

additionalProperties: false

examples:
  - |
    i2c {
        #address-cells = <1>;
        #size-cells = <0>;

        regulator@5f {
            compatible = "vicor,pli1209bc";
            reg = <0x5f>;

            regulators {
                p12v_d: vout2 {
                    regulator-name = "bcm3";
                    regulator-boot-on;
                };
            };
        };
    };
```

## Documentation/devicetree/bindings/hwmon/pwm-fan.yaml
```yaml
# SPDX-License-Identifier: (GPL-2.0-only OR BSD-2-Clause)
%YAML 1.2
---
$id: http://devicetree.org/schemas/hwmon/pwm-fan.yaml#
$schema: http://devicetree.org/meta-schemas/core.yaml#

title: Fan connected to PWM lines

maintainers:
  - Jean Delvare <jdelvare@suse.com>
  - Guenter Roeck <linux@roeck-us.net>

properties:
  compatible:
    const: pwm-fan

  cooling-levels:
    description: PWM duty cycle values corresponding to thermal cooling states.
    $ref: /schemas/types.yaml#/definitions/uint32-array
    items:
      maximum: 255

  fan-supply:
    description: Phandle to the regulator that provides power to the fan.

  interrupts:
    description:
      This contains an interrupt specifier for each fan tachometer output
      connected to an interrupt source. The output signal must generate a
      defined number of interrupts per fan revolution, which require that
      it must be self resetting edge interrupts.
    maxItems: 1

  pulses-per-revolution:
    description:
      Define the number of pulses per fan revolution for each tachometer
      input as an integer.
    $ref: /schemas/types.yaml#/definitions/uint32
    minimum: 1
    maximum: 4
    default: 2

  pwms:
    description: The PWM that is used to control the fan.
    maxItems: 1

  "#cooling-cells": true

required:
  - compatible
  - pwms

additionalProperties: false

examples:
  - |
    pwm-fan {
      compatible = "pwm-fan";
      cooling-levels = <0 102 170 230>;
      pwms = <&pwm 0 10000 0>;
      #cooling-cells = <2>;
    };

    thermal-zones {
      cpu_thermal: cpu-thermal {
        thermal-sensors = <&tmu 0>;
        polling-delay-passive = <0>;
        polling-delay = <0>;

        trips {
          cpu_alert1: cpu-alert1 {
            temperature = <100000>; /* millicelsius */
            hysteresis = <2000>; /* millicelsius */
            type = "passive";
          };
        };

        cooling-maps {
          map0 {
            trip = <&cpu_alert1>;
            cooling-device = <&fan0 0 1>;
          };
        };
      };
    };

  - |
    #include <dt-bindings/interrupt-controller/irq.h>

    pwm-fan {
      compatible = "pwm-fan";
      pwms = <&pwm 0 40000 0>;
      fan-supply = <&reg_fan>;
      interrupt-parent = <&gpio5>;
      interrupts = <1 IRQ_TYPE_EDGE_FALLING>;
      pulses-per-revolution = <2>;
    };
```

## Documentation/devicetree/bindings/hwmon/renesas,isl28022.yaml
```yaml
# SPDX-License-Identifier: (GPL-2.0 OR BSD-2-Clause)
%YAML 1.2
---
$id: http://devicetree.org/schemas/hwmon/renesas,isl28022.yaml#
$schema: http://devicetree.org/meta-schemas/core.yaml#

title: Renesas ISL28022 power monitor

maintainers:
  - Carsten Spieß <mail@carsten-spiess.de>

description: |
  The ISL28022 is a power monitor with I2C interface. The device monitors
  voltage, current via shunt resistor and calculated power.

  Datasheets:
    https://www.renesas.com/us/en/www/doc/datasheet/isl28022.pdf

properties:
  compatible:
    const: renesas,isl28022

  reg:
    maxItems: 1

  shunt-resistor-micro-ohms:
    description:
      Shunt resistor value in micro-Ohm
    minimum: 800
    default: 10000

  renesas,shunt-range-microvolt:
    description:
      Maximal shunt voltage range of +/- 40 mV, 80 mV, 160 mV or 320 mV
    default: 320000
    enum: [40000, 80000, 160000, 320000]

  renesas,average-samples:
    description:
      Number of samples to be used to report voltage, current and power values.
    default: 1
    $ref: /schemas/types.yaml#/definitions/uint32
    enum: [1, 2, 4, 8, 16, 32, 64, 128]

required:
  - compatible
  - reg

additionalProperties: false

examples:
  - |
    i2c {
        #address-cells = <1>;
        #size-cells = <0>;

        power-monitor@40 {
            compatible = "renesas,isl28022";
            reg = <0x40>;
            shunt-resistor-micro-ohms = <8000>;
            renesas,shunt-range-microvolt = <40000>;
            renesas,average-samples = <128>;
        };
    };
```

## Documentation/devicetree/bindings/hwmon/sensirion,sht15.yaml
```yaml
# SPDX-License-Identifier: GPL-2.0-only OR BSD-2-Clause
%YAML 1.2
---
$id: http://devicetree.org/schemas/hwmon/sensirion,sht15.yaml#
$schema: http://devicetree.org/meta-schemas/core.yaml#

title: Sensirion SHT15 humidity and temperature sensor

maintainers:
  - Krzysztof Kozlowski <krzk@kernel.org>

properties:
  compatible:
    const: sensirion,sht15

  clk-gpios:
    maxItems: 1

  data-gpios:
    maxItems: 1

  vcc-supply:
    description: regulator that drives the VCC pin

required:
  - compatible
  - clk-gpios
  - data-gpios
  - vcc-supply

additionalProperties: false

examples:
  - |
    sensor {
        compatible = "sensirion,sht15";
        clk-gpios = <&gpio4 12 0>;
        data-gpios = <&gpio4 13 0>;
        vcc-supply = <&reg_sht15>;

        pinctrl-names = "default";
        pinctrl-0 = <&pinctrl_sensor>;
    };
```

## Documentation/devicetree/bindings/hwmon/sensirion,sht30.yaml
```yaml
# SPDX-License-Identifier: (GPL-2.0-only OR BSD-2-Clause)
%YAML 1.2
---
$id: http://devicetree.org/schemas/hwmon/sensirion,sht30.yaml#
$schema: http://devicetree.org/meta-schemas/core.yaml#

title: Sensirion SHT3x and GXCAS GXHT30 humidity and temperature sensors

maintainers:
  - Zaixiang Xu <zaixiang.xu.dev@gmail.com>

properties:
  compatible:
    oneOf:
      - enum:
          - sensirion,sht30
          - sensirion,sts30
      - items:
          - enum:
              - gxcas,gxht30
              - sensirion,sht31
              - sensirion,sht35
              - sensirion,sht85
          - const: sensirion,sht30
      - items:
          - enum:
              - sensirion,sts31
              - sensirion,sts32
              - sensirion,sts35
          - const: sensirion,sts30

  reg:
    maxItems: 1

  vdd-supply:
    description: Regulator that provides power to the VDD pin.

  reset-gpios:
    maxItems: 1
    description:
      GPIO connected to the nRESET pin. Active low.

  interrupts:
    maxItems: 1
    description:
      Interrupt connected to the ALERT pin.

required:
  - compatible
  - reg

additionalProperties: false

examples:
  - |
    #include <dt-bindings/gpio/gpio.h>
    #include <dt-bindings/interrupt-controller/irq.h>

    i2c {
        #address-cells = <1>;
        #size-cells = <0>;

        humidity-sensor@44 {
            compatible = "gxcas,gxht30", "sensirion,sht30";
            reg = <0x44>;
            vdd-supply = <&vcc_3v3_reg>;
            reset-gpios = <&gpio1 15 GPIO_ACTIVE_LOW>;
            interrupt-parent = <&gpio1>;
            interrupts = <16 IRQ_TYPE_LEVEL_HIGH>;
        };
    };
```

## Documentation/devicetree/bindings/hwmon/sensirion,shtc1.yaml
```yaml
# SPDX-License-Identifier: GPL-2.0-only OR BSD-2-Clause
%YAML 1.2
---
$id: http://devicetree.org/schemas/hwmon/sensirion,shtc1.yaml#
$schema: http://devicetree.org/meta-schemas/core.yaml#

title: Sensirion SHTC1 Humidity and Temperature Sensor IC

maintainers:
  - Christopher Ruehl chris.ruehl@gtsys.com.hk

description: |
  The SHTC1, SHTW1 and SHTC3 are digital humidity and temperature sensor
  designed especially for battery-driven high-volume consumer electronics
  applications.
  For further information refere to Documentation/hwmon/shtc1.rst

  This binding document describes the binding for the hardware monitor
  portion of the driver.

properties:
  compatible:
    enum:
      - sensirion,shtc1
      - sensirion,shtw1
      - sensirion,shtc3

  reg:
    const: 0x70

  sensirion,blocking-io:
    $ref: /schemas/types.yaml#/definitions/flag
    description:
      If set, the driver hold the i2c bus until measurement is finished.

  sensirion,low-precision:
    $ref: /schemas/types.yaml#/definitions/flag
    description:
      If set, the sensor aquire data with low precision (not recommended).
      The driver aquire data with high precision by default.

required:
  - compatible
  - reg

additionalProperties: false

examples:
  - |
    i2c {
      #address-cells = <1>;
      #size-cells = <0>;
      clock-frequency = <400000>;

      shtc3@70 {
        compatible = "sensirion,shtc3";
        reg = <0x70>;
        sensirion,blocking-io;
      };
    };
...
```

## Documentation/devicetree/bindings/hwmon/sht15.txt
```
Sensirion SHT15 Humidity and Temperature Sensor

Required properties:

 - "compatible": must be "sensirion,sht15".
 - "data-gpios": GPIO connected to the data line.
 - "clk-gpios": GPIO connected to the clock line.
 - "vcc-supply": regulator that drives the VCC pin.

Example:

	sensor {
		pinctrl-names = "default";
		pinctrl-0 = <&pinctrl_sensor>;
		compatible = "sensirion,sht15";
		clk-gpios = <&gpio4 12 0>;
		data-gpios = <&gpio4 13 0>;
		vcc-supply = <&reg_sht15>;
	};
```

## Documentation/devicetree/bindings/hwmon/sophgo,sg2042-hwmon-mcu.yaml
```yaml
# SPDX-License-Identifier: GPL-2.0-only OR BSD-2-Clause
%YAML 1.2
---
$id: http://devicetree.org/schemas/hwmon/sophgo,sg2042-hwmon-mcu.yaml#
$schema: http://devicetree.org/meta-schemas/core.yaml#

title: Sophgo SG2042 onboard MCU support

maintainers:
  - Inochi Amaoto <inochiama@outlook.com>

properties:
  compatible:
    const: sophgo,sg2042-hwmon-mcu

  reg:
    maxItems: 1

  "#thermal-sensor-cells":
    const: 1

required:
  - compatible
  - reg
  - "#thermal-sensor-cells"

allOf:
  - $ref: /schemas/thermal/thermal-sensor.yaml#

unevaluatedProperties: false

examples:
  - |
    i2c {
        #address-cells = <1>;
        #size-cells = <0>;

        hwmon@17 {
            compatible = "sophgo,sg2042-hwmon-mcu";
            reg = <0x17>;
            #thermal-sensor-cells = <1>;
        };
    };
```
