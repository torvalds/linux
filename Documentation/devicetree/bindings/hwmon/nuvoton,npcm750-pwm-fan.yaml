## Documentation/devicetree/bindings/hwmon/nuvoton,npcm750-pwm-fan.yaml
```yaml
# SPDX-License-Identifier: (GPL-2.0-only OR BSD-2-Clause)
%YAML 1.2
---
$id: http://devicetree.org/schemas/hwmon/nuvoton,npcm750-pwm-fan.yaml#
$schema: http://devicetree.org/meta-schemas/core.yaml#

title: Nuvoton NPCM7xx/NPCM8xx PWM and Fan Tach Controller

maintainers:
  - Tomer Maimon <tmaimon77@gmail.com>

description:
  The NPCM7xx/NPCM8xx family includes a PWM and Fan Tachometer controller.
  The controller provides up to 8 (NPCM7xx) or 12 (NPCM8xx) PWM channels and up
  to 16 tachometer inputs. It is used for fan speed control and monitoring.

properties:
  compatible:
    enum:
      - nuvoton,npcm750-pwm-fan
      - nuvoton,npcm845-pwm-fan

  reg:
    maxItems: 2
    description: Register addresses for PWM and Fan Tach units.

  reg-names:
    items:
      - const: pwm
      - const: fan

  clocks:
    maxItems: 2
    description: Clocks for the PWM and Fan Tach modules.

  clock-names:
    items:
      - const: pwm
      - const: fan

  interrupts:
    description:
      Contains the Fan interrupts with flags for falling edge.
      For NPCM7XX, 8 interrupt lines are expected (one per PWM channel).
      For NPCM8XX, 12 interrupt lines are expected (one per PWM channel).

    minItems: 8
    maxItems: 12

  "#address-cells":
    const: 1

  "#size-cells":
    const: 0

patternProperties:
  "^fan@[0-9a-f]+$":
    type: object
    $ref: fan-common.yaml#
    unevaluatedProperties: false

    properties:
      reg:
        description:
          Specify the PWM output channel. Integer value in the range 0-7 for
          NPCM7XX or 0-11 for NPCM8XX, representing the PWM channel number.

        maximum: 11

      fan-tach-ch:
        $ref: /schemas/types.yaml#/definitions/uint8-array
        description:
          The tach channel(s) used for the fan.
          Integer values in the range 0-15.

        items:
          maximum: 15

      cooling-levels:
        description:
          PWM duty cycle values in a range from 0 to 255 which
          correspond to thermal cooling states. This property enables
          thermal zone integration for automatic fan speed control
          based on temperature.

        items:
          maximum: 255

    required:
      - reg
      - fan-tach-ch

required:
  - compatible
  - reg
  - reg-names
  - clocks
  - clock-names
  - interrupts

additionalProperties: false

examples:
  - |
    #include <dt-bindings/clock/nuvoton,npcm7xx-clock.h>
    #include <dt-bindings/interrupt-controller/arm-gic.h>
    pwm_fan: pwm-fan@103000 {
        compatible = "nuvoton,npcm750-pwm-fan";
        #address-cells = <1>;
        #size-cells = <0>;

        reg = <0x103000 0x2000>, <0x180000 0x8000>;
        reg-names = "pwm", "fan";

        clocks = <&clk NPCM7XX_CLK_APB3>, <&clk NPCM7XX_CLK_APB4>;
        clock-names = "pwm", "fan";

        interrupts = <GIC_SPI 96 IRQ_TYPE_LEVEL_HIGH>,
                     <GIC_SPI 97 IRQ_TYPE_LEVEL_HIGH>,
                     <GIC_SPI 98 IRQ_TYPE_LEVEL_HIGH>,
                     <GIC_SPI 99 IRQ_TYPE_LEVEL_HIGH>,
                     <GIC_SPI 100 IRQ_TYPE_LEVEL_HIGH>,
                     <GIC_SPI 101 IRQ_TYPE_LEVEL_HIGH>,
                     <GIC_SPI 102 IRQ_TYPE_LEVEL_HIGH>,
                     <GIC_SPI 103 IRQ_TYPE_LEVEL_HIGH>;
        pinctrl-names = "default";
        pinctrl-0 = <&pwm0_pins &fanin0_pins>;

        fan@0 {
            reg = <0>;
            fan-tach-ch = <0 1>;
            cooling-levels = <64 128 192 255>;
        };

        fan@1 {
            reg = <1>;
            fan-tach-ch = <2>;
        };
    };
```

## Documentation/devicetree/bindings/hwmon/nxp,mc34vr500.yaml
```yaml
# SPDX-License-Identifier: GPL-2.0-only OR BSD-2-Clause
%YAML 1.2
---
$id: http://devicetree.org/schemas/hwmon/nxp,mc34vr500.yaml#
$schema: http://devicetree.org/meta-schemas/core.yaml#

title: NXP MC34VR500 hwmon sensor

maintainers:
  - Mario Kicherer <dev@kicherer.org>

properties:
  compatible:
    enum:
      - nxp,mc34vr500

  reg:
    maxItems: 1

required:
  - compatible
  - reg

additionalProperties: false

examples:
  - |
    i2c {
      #address-cells = <1>;
      #size-cells = <0>;

      pmic@8 {
        compatible = "nxp,mc34vr500";
        reg = <0x08>;
      };
    };
```

## Documentation/devicetree/bindings/hwmon/pmbus/adi,adp1050.yaml
```yaml
# SPDX-License-Identifier: (GPL-2.0 OR BSD-2-Clause)
%YAML 1.2
---
$id: http://devicetree.org/schemas/hwmon/pmbus/adi,adp1050.yaml#
$schema: http://devicetree.org/meta-schemas/core.yaml#

title: Analog Devices ADP1050 digital controller with PMBus interface

maintainers:
  - Radu Sabau <radu.sabau@analog.com>

description: |
   The ADP1050 and similar devices are used to monitor system voltages,
   currents, power, and temperatures.

   Through the PMBus interface, the ADP1050 targets isolated power supplies
   and has four individual monitors for input/output voltage, input current
   and temperature.
   Datasheet:
     https://www.analog.com/en/products/adp1050.html
     https://www.analog.com/en/products/adp1051.html
     https://www.analog.com/en/products/adp1055.html
     https://www.analog.com/en/products/ltp8800-1a.html
     https://www.analog.com/en/products/ltp8800-2.html
     https://www.analog.com/en/products/ltp8800-4a.html

properties:
  compatible:
    enum:
      - adi,adp1050
      - adi,adp1051
      - adi,adp1055
      - adi,ltp8800

  reg:
    maxItems: 1

  vcc-supply: true

required:
  - compatible
  - reg
  - vcc-supply

additionalProperties: false

examples:
  - |
    i2c {
        #address-cells = <1>;
        #size-cells = <0>;
        clock-frequency = <100000>;

        hwmon@70 {
            compatible = "adi,adp1050";
            reg = <0x70>;
            vcc-supply = <&vcc>;
        };
    };
...
```

## Documentation/devicetree/bindings/hwmon/pmbus/adi,lt3074.yaml
```yaml
# SPDX-License-Identifier: (GPL-2.0-only OR BSD-2-Clause)
%YAML 1.2
---
$id: http://devicetree.org/schemas/hwmon/pmbus/adi,lt3074.yaml#
$schema: http://devicetree.org/meta-schemas/core.yaml#

title: Analog Devices LT3074 voltage regulator

maintainers:
  - Cedric Encarnacion <cedricjustine.encarnacion@analog.com>

description: |
  The LT3074 is a low voltage, ultra-low noise and ultra-fast transient
  response linear regulator. It allows telemetry for input/output voltage,
  output current and temperature through the PMBus serial interface.

  Datasheet:
    https://www.analog.com/en/products/lt3074.html

allOf:
  - $ref: /schemas/regulator/regulator.yaml#

properties:
  compatible:
    enum:
      - adi,lt3074

  reg:
    maxItems: 1

required:
  - compatible
  - reg

unevaluatedProperties: false

examples:
  - |
    i2c {
        #address-cells = <1>;
        #size-cells = <0>;

        regulator@6d {
            compatible = "adi,lt3074";
            reg = <0x6d>;
            regulator-name = "vout";
            regulator-max-microvolt = <1250000>;
            regulator-min-microvolt = <1150000>;
        };
    };
```

## Documentation/devicetree/bindings/hwmon/pmbus/adi,max17616.yaml
```yaml
# SPDX-License-Identifier: (GPL-2.0-only OR BSD-2-Clause)
%YAML 1.2
---
$id: http://devicetree.org/schemas/hwmon/pmbus/adi,max17616.yaml#
$schema: http://devicetree.org/meta-schemas/core.yaml#

title: Analog Devices MAX17616/MAX17616A Current-Limiter with PMBus Interface

maintainers:
  - Kim Seer Paller <kimseer.paller@analog.com>

description: |
  The MAX17616/MAX17616A is a 3V to 80V, 7A current-limiter with overvoltage,
  surge, undervoltage, reverse polarity, and loss of ground protection. It allows
  monitoring of input/output voltage, output current and temperature through the
  PMBus serial interface.
  Datasheet:
    https://www.analog.com/en/products/max17616.html

properties:
  compatible:
    const: adi,max17616

  reg:
    maxItems: 1

  vcc-supply: true

  interrupts:
    description: Fault condition signal provided on SMBALERT pin.
    maxItems: 1

required:
  - compatible
  - reg
  - vcc-supply

additionalProperties: false

examples:
  - |
    i2c {
        #address-cells = <1>;
        #size-cells = <0>;

        hwmon@16 {
            compatible = "adi,max17616";
            reg = <0x16>;
            vcc-supply = <&vcc>;
        };
    };
...
```

## Documentation/devicetree/bindings/hwmon/pmbus/adi,max20860a.yaml
```yaml
# SPDX-License-Identifier: (GPL-2.0-only OR BSD-2-Clause)
%YAML 1.2
---
$id: http://devicetree.org/schemas/hwmon/pmbus/adi,max20860a.yaml#
$schema: http://devicetree.org/meta-schemas/core.yaml#

title: Analog Devices MAX20860A Step-Down Converter

maintainers:
  - Sanman Pradhan <psanman@juniper.net>

description: |
  The MAX20860A is a fully integrated step-down DC-DC switching regulator
  with PMBus interface for monitoring input/output voltage, output current
  and temperature.

  Datasheet: https://www.analog.com/en/products/max20860a.html

allOf:
  - $ref: /schemas/regulator/regulator.yaml#

properties:
  compatible:
    const: adi,max20860a

  reg:
    maxItems: 1

required:
  - compatible
  - reg

unevaluatedProperties: false

examples:
  - |
    i2c {
        #address-cells = <1>;
        #size-cells = <0>;

        regulator@40 {
            compatible = "adi,max20860a";
            reg = <0x40>;
        };
    };
```

## Documentation/devicetree/bindings/hwmon/pmbus/infineon,tda38640.yaml
```yaml
# SPDX-License-Identifier: (GPL-2.0 OR BSD-2-Clause)
%YAML 1.2
---

$id: http://devicetree.org/schemas/hwmon/pmbus/infineon,tda38640.yaml#
$schema: http://devicetree.org/meta-schemas/core.yaml#

title: Infineon TDA38640 Synchronous Buck Regulator with SVID and I2C

maintainers:
  - Naresh Solanki <naresh.solanki@9elements.com>

description: |
  The Infineon TDA38640 is a 40A Single-voltage Synchronous Buck
  Regulator with SVID and I2C designed for Industrial use.

  Datasheet: https://www.infineon.com/dgdl/Infineon-TDA38640-0000-DataSheet-v02_04-EN.pdf?fileId=8ac78c8c80027ecd018042f2337f00c9

properties:
  compatible:
    enum:
      - infineon,tda38640

  reg:
    maxItems: 1

  infineon,en-pin-fixed-level:
    description:
      Indicates that the chip EN pin is at fixed level or left
      unconnected(has internal pull-down).
    type: boolean

  interrupts:
    maxItems: 1

  regulators:
    type: object
    description:
      list of regulators provided by this controller.

    properties:
      vout:
        $ref: /schemas/regulator/regulator.yaml#
        type: object

        unevaluatedProperties: false

    additionalProperties: false

required:
  - compatible
  - reg

additionalProperties: false

examples:
  - |
    #include <dt-bindings/interrupt-controller/irq.h>
    i2c {
        #address-cells = <1>;
        #size-cells = <0>;

        tda38640@40 {
            compatible = "infineon,tda38640";
            reg = <0x40>;

            interrupt-parent = <&smb_pex_cpu0_event>;
            interrupts = <10 IRQ_TYPE_LEVEL_LOW>;

            regulators {
                pvnn_main_cpu0: vout {
                    regulator-name = "pvnn_main_cpu0";
                    regulator-enable-ramp-delay = <200>;
                };
            };
        };
    };
```

## Documentation/devicetree/bindings/hwmon/pmbus/infineon,xdp720.yaml
```yaml
# SPDX-License-Identifier: (GPL-2.0 OR BSD-2-Clause)
%YAML 1.2
---

$id: http://devicetree.org/schemas/hwmon/pmbus/infineon,xdp720.yaml#
$schema: http://devicetree.org/meta-schemas/core.yaml#

title: Infineon XDP720 / XDP730 Digital eFuse Controllers

maintainers:
  - Ashish Yadav <ashish.yadav@infineon.com>

description: |
  The XDP720 and XDP730 are PMBus-compliant digital eFuse controllers
  with an integrated current sensor.  They provide accurate system
  telemetry (V, I, P, T) and report analog current at the IMON pin for
  post-processing.

  Both parts share the same PMBus register map and direct-format
  coefficients; they differ in the GIMON gain step exposed via the
  TELEMETRY_AVG register (bit 10) and in the VDD_VIN pin number
  (XDP720: pin 9, XDP730: pin 20).

  Datasheets:
    - XDP720: https://www.infineon.com/assets/row/public/documents/24/49/infineon-xdp720-001-datasheet-en.pdf
    - XDP730: https://www.infineon.com/assets/row/public/documents/24/49/infineon-xdp730-001-datasheet-en.pdf

properties:
  compatible:
    enum:
      - infineon,xdp720
      - infineon,xdp730

  reg:
    maxItems: 1

  infineon,rimon-micro-ohms:
    description:
      The value of the RIMON resistor, in micro ohms, required to enable
      the system overcurrent protection.

  vdd-vin-supply:
    description:
      Supply for the VDD_VIN pin (XDP720 pin 9, XDP730 pin 20), the IC
      controller power supply.  Typically connected to the input bus
      (VIN) through a 100 ohm / 100 nF RC filter.

required:
  - compatible
  - reg
  - vdd-vin-supply

additionalProperties: false

examples:
  - |
    i2c {
        #address-cells = <1>;
        #size-cells = <0>;

        efuse@11 {
            compatible = "infineon,xdp720";
            reg = <0x11>;
            vdd-vin-supply = <&vdd_vin>;
            infineon,rimon-micro-ohms = <1098000000>;  /* 1.098k ohm */
        };
    };
```
