## Documentation/devicetree/bindings/hwmon/aspeed,ast2600-tach.yaml
```yaml
# SPDX-License-Identifier: (GPL-2.0-only OR BSD-2-Clause)
# Copyright (C) 2021 Aspeed, Inc.
%YAML 1.2
---
$id: http://devicetree.org/schemas/hwmon/aspeed,ast2600-tach.yaml#
$schema: http://devicetree.org/meta-schemas/core.yaml#

title: Aspeed Ast2600 Tach controller

maintainers:
  - Billy Tsai <billy_tsai@aspeedtech.com>

description: |
  The Aspeed Tach controller can support upto 16 fan input.
  This module is part of the ast2600-pwm-tach multi-function device. For more
  details see ../mfd/aspeed,ast2600-pwm-tach.yaml.

properties:
  compatible:
    enum:
      - aspeed,ast2600-tach

  "#address-cells":
    const: 1

  "#size-cells":
    const: 0

  pinctrl-0: true

  pinctrl-names:
    const: default

required:
  - compatible
  - "#address-cells"
  - "#size-cells"

additionalProperties:
  type: object
  properties:
    aspeed,tach-ch:
      description:
        The tach channel used for this node.
      maxItems: 1

    aspeed,min-rpm:
      description:
        define the minimal revolutions per minute of the measure fan
        used to calculate the sample period of tach
      default: 1000

    aspeed,pulse-pr:
      description:
        Value specifying the number of pulses per revolution of the
        monitored FAN.
      default: 2

    aspeed,tach-div:
      description:
        define the tachometer clock divider as an integer. Formula of
        tach clock = clock source / (2^tach-div)^2
      minimum: 0
      maximum: 15
      default: 5

  required:
    - reg
```

## Documentation/devicetree/bindings/hwmon/aspeed,g6-pwm-tach.yaml
```yaml
# SPDX-License-Identifier: (GPL-2.0-only OR BSD-2-Clause)
# Copyright (C) 2023 Aspeed, Inc.
%YAML 1.2
---
$id: http://devicetree.org/schemas/hwmon/aspeed,g6-pwm-tach.yaml#
$schema: http://devicetree.org/meta-schemas/core.yaml#

title: ASPEED G6 PWM and Fan Tach controller

maintainers:
  - Billy Tsai <billy_tsai@aspeedtech.com>

description: |
  The ASPEED PWM controller can support up to 16 PWM outputs.
  The ASPEED Fan Tacho controller can support up to 16 fan tach input.
  They are independent hardware blocks, which are different from the
  previous version of the ASPEED chip.

properties:
  compatible:
    enum:
      - aspeed,ast2600-pwm-tach

  reg:
    maxItems: 1

  clocks:
    maxItems: 1

  resets:
    maxItems: 1

  "#pwm-cells":
    const: 3

patternProperties:
  "^fan-[0-9]+$":
    $ref: fan-common.yaml#
    unevaluatedProperties: false
    required:
      - tach-ch

required:
  - reg
  - clocks
  - resets
  - "#pwm-cells"
  - compatible

additionalProperties: false

examples:
  - |
    #include <dt-bindings/clock/aspeed-clock.h>
    pwm_tach: pwm-tach-controller@1e610000 {
      compatible = "aspeed,ast2600-pwm-tach";
      reg = <0x1e610000 0x100>;
      clocks = <&syscon ASPEED_CLK_AHB>;
      resets = <&syscon ASPEED_RESET_PWM>;
      #pwm-cells = <3>;

      fan-0 {
        tach-ch = /bits/ 8 <0x0>;
        pwms = <&pwm_tach 0 40000 0>;
      };

      fan-1 {
        tach-ch = /bits/ 8 <0x1 0x2>;
        pwms = <&pwm_tach 1 40000 0>;
      };
    };
```

## Documentation/devicetree/bindings/hwmon/aspeed-pwm-tacho.txt
```
ASPEED AST2400/AST2500 PWM and Fan Tacho controller device driver

The ASPEED PWM controller can support upto 8 PWM outputs. The ASPEED Fan Tacho
controller can support upto 16 Fan tachometer inputs.

There can be upto 8 fans supported. Each fan can have one PWM output and
one/two Fan tach inputs.

Required properties for pwm-tacho node:
- #address-cells : should be 1.

- #size-cells : should be 1.

- #cooling-cells: should be 2.

- reg : address and length of the register set for the device.

- pinctrl-names : a pinctrl state named "default" must be defined.

- pinctrl-0 : phandle referencing pin configuration of the PWM ports.

- compatible : should be "aspeed,ast2400-pwm-tacho" for AST2400 and
	       "aspeed,ast2500-pwm-tacho" for AST2500.

- clocks : phandle to clock provider with the clock number in the second cell

- resets : phandle to reset controller with the reset number in the second cell

fan subnode format:
===================
Under fan subnode there can upto 8 child nodes, with each child node
representing a fan. If there are 8 fans each fan can have one PWM port and
one/two Fan tach inputs.
For PWM port can be configured cooling-levels to create cooling device.
Cooling device could be bound to a thermal zone for the thermal control.

Required properties for each child node:
- reg : should specify PWM source port.
	integer value in the range 0 to 7 with 0 indicating PWM port A and
	7 indicating PWM port H.

- cooling-levels: PWM duty cycle values in a range from 0 to 255
                  which correspond to thermal cooling states.

- aspeed,fan-tach-ch : should specify the Fan tach input channel.
                integer value in the range 0 through 15, with 0 indicating
		Fan tach channel 0 and 15 indicating Fan tach channel 15.
		At least one Fan tach input channel is required.

Examples:

pwm_tacho: pwmtachocontroller@1e786000 {
	#address-cells = <1>;
	#size-cells = <1>;
	#cooling-cells = <2>;
	reg = <0x1E786000 0x1000>;
	compatible = "aspeed,ast2500-pwm-tacho";
	clocks = <&syscon ASPEED_CLK_APB>;
	resets = <&syscon ASPEED_RESET_PWM>;
	pinctrl-names = "default";
	pinctrl-0 = <&pinctrl_pwm0_default &pinctrl_pwm1_default>;

	fan@0 {
		reg = <0x00>;
		cooling-levels = /bits/ 8 <125 151 177 203 229 255>;
		aspeed,fan-tach-ch = /bits/ 8 <0x00>;
	};

	fan@1 {
		reg = <0x01>;
		aspeed,fan-tach-ch = /bits/ 8 <0x01 0x02>;
	};
};
```

## Documentation/devicetree/bindings/hwmon/baikal,bt1-pvt.yaml
```yaml
# SPDX-License-Identifier: (GPL-2.0-only OR BSD-2-Clause)
# Copyright (C) 2020 BAIKAL ELECTRONICS, JSC
%YAML 1.2
---
$id: http://devicetree.org/schemas/hwmon/baikal,bt1-pvt.yaml#
$schema: http://devicetree.org/meta-schemas/core.yaml#

title: Baikal-T1 PVT Sensor

maintainers:
  - Serge Semin <fancer.lancer@gmail.com>

description: |
  Baikal-T1 SoC provides an embedded process, voltage and temperature
  sensor to monitor an internal SoC environment (chip temperature, supply
  voltage and process monitor) and on time detect critical situations,
  which may cause the system instability and even damages. The IP-block
  is based on the Analog Bits PVT sensor, but is equipped with a dedicated
  control wrapper, which provides a MMIO registers-based access to the
  sensor core functionality (APB3-bus based) and exposes an additional
  functions like thresholds/data ready interrupts, its status and masks,
  measurements timeout. Its internal structure is depicted on the next
  diagram:

     Analog Bits core                     Bakal-T1 PVT control block
  +--------------------+                  +------------------------+
  | Temperature sensor |-+         +------| Sensors control        |
  |--------------------| |<---En---|      |------------------------|
  | Voltage sensor     |-|<--Mode--| +--->| Sampled data           |
  |--------------------| |<--Trim--+ |    |------------------------|
  | Low-Vt sensor      |-|           | +--| Thresholds comparator  |
  |--------------------| |---Data----| |  |------------------------|
  | High-Vt sensor     |-|           | +->| Interrupts status      |
  |--------------------| |--Valid--+-+ |  |------------------------|
  | Standard-Vt sensor |-+         +---+--| Interrupts mask        |
  +--------------------+                  |------------------------|
           ^                              | Interrupts timeout     |
           |                              +------------------------+
           |                                        ^  ^
  Rclk-----+----------------------------------------+  |
  APB3-------------------------------------------------+

  This bindings describes the external Baikal-T1 PVT control interfaces
  like MMIO registers space, interrupt request number and clocks source.
  These are then used by the corresponding hwmon device driver to
  implement the sysfs files-based access to the sensors functionality.

properties:
  compatible:
    const: baikal,bt1-pvt

  reg:
    maxItems: 1

  interrupts:
    maxItems: 1

  clocks:
    items:
      - description: PVT reference clock
      - description: APB3 interface clock

  clock-names:
    items:
      - const: ref
      - const: pclk

  "#thermal-sensor-cells":
    description: Baikal-T1 can be referenced as the CPU thermal-sensor
    const: 0

  baikal,pvt-temp-offset-millicelsius:
    description: |
      Temperature sensor trimming factor. It can be used to manually adjust the
      temperature measurements within 7.130 degrees Celsius.
    default: 0
    minimum: 0
    maximum: 7130

additionalProperties: false

required:
  - compatible
  - reg
  - interrupts
  - clocks
  - clock-names

examples:
  - |
    #include <dt-bindings/interrupt-controller/mips-gic.h>

    pvt@1f200000 {
      compatible = "baikal,bt1-pvt";
      reg = <0x1f200000 0x1000>;
      #thermal-sensor-cells = <0>;

      interrupts = <GIC_SHARED 31 IRQ_TYPE_LEVEL_HIGH>;

      baikal,pvt-temp-offset-millicelsius = <1000>;

      clocks = <&ccu_sys>, <&ccu_sys>;
      clock-names = "ref", "pclk";
    };
...
```

## Documentation/devicetree/bindings/hwmon/cirrus,lochnagar.txt
```
Cirrus Logic Lochnagar Audio Development Board

Lochnagar is an evaluation and development board for Cirrus Logic
Smart CODEC and Amp devices. It allows the connection of most Cirrus
Logic devices on mini-cards, as well as allowing connection of
various application processor systems to provide a full evaluation
platform.  Audio system topology, clocking and power can all be
controlled through the Lochnagar, allowing the device under test
to be used in a variety of possible use cases.

This binding document describes the binding for the hardware monitor
portion of the driver.

This binding must be part of the Lochnagar MFD binding:
  [4] ../mfd/cirrus,lochnagar.txt

Required properties:

  - compatible : One of the following strings:
                 "cirrus,lochnagar2-hwmon"

Example:

lochnagar-hwmon {
	compatible = "cirrus,lochnagar2-hwmon";
};
```

## Documentation/devicetree/bindings/hwmon/cirrus,lochnagar.yaml
```yaml
# SPDX-License-Identifier: GPL-2.0-only OR BSD-2-Clause
%YAML 1.2
---
$id: http://devicetree.org/schemas/hwmon/cirrus,lochnagar.yaml#
$schema: http://devicetree.org/meta-schemas/core.yaml#

title: Cirrus Logic Lochnagar Audio Development Board

maintainers:
  - patches@opensource.cirrus.com

description: |
  Lochnagar is an evaluation and development board for Cirrus Logic
  Smart CODEC and Amp devices. It allows the connection of most Cirrus
  Logic devices on mini-cards, as well as allowing connection of various
  application processor systems to provide a full evaluation platform.
  Audio system topology, clocking and power can all be controlled through
  the Lochnagar, allowing the device under test to be used in a variety of
  possible use cases.

  This binding document describes the binding for the hardware monitor
  portion of the driver.

  This binding must be part of the Lochnagar MFD binding:
    [1] ../mfd/cirrus,lochnagar.yaml

properties:
  compatible:
    enum:
      - cirrus,lochnagar2-hwmon

required:
  - compatible

additionalProperties: false
```

## Documentation/devicetree/bindings/hwmon/dps650ab.txt
```
Bindings for Delta Electronics DPS-650-AB power supply

Required properties:
- compatible : "delta,dps650ab"
- reg        : I2C address, one of 0x58, 0x59.

Example:
	dps650ab@58 {
		    compatible = "delta,dps650ab";
		    reg = <0x58>;
	};
```

## Documentation/devicetree/bindings/hwmon/eswin,eic7700-pvt.yaml
```yaml
# SPDX-License-Identifier: (GPL-2.0-only OR BSD-2-Clause)
%YAML 1.2
---
$id: http://devicetree.org/schemas/hwmon/eswin,eic7700-pvt.yaml#
$schema: http://devicetree.org/meta-schemas/core.yaml#

title: ESWIN EIC7700 PVT Sensor

maintainers:
  - Yulin Lu <luyulin@eswincomputing.com>
  - Huan He <hehuan1@eswincomputing.com>

description:
  ESWIN EIC7700 SoC integrates embedded voltage and temperature sensors to
  monitor the internal SoC environment. The system includes two PVT sensor
  instances. The PVT0 monitors the main SoC power domain. The PVT1 sensor
  monitors the DDR core power domain.

allOf:
  - $ref: /schemas/hwmon/hwmon-common.yaml#

properties:
  compatible:
    const: eswin,eic7700-pvt

  reg:
    maxItems: 1

  clocks:
    items:
      - description: PVT enable clock
      - description: APB bus clock

  clock-names:
    items:
      - const: enable
      - const: apb

  interrupts:
    maxItems: 1

  resets:
    maxItems: 1

  '#thermal-sensor-cells':
    const: 0

required:
  - compatible
  - reg
  - clocks
  - clock-names
  - interrupts
  - resets
  - '#thermal-sensor-cells'

unevaluatedProperties: false

examples:
  - |
    sensor@50b00000 {
      compatible = "eswin,eic7700-pvt";
      reg = <0x50b00000 0x10000>;
      clocks = <&clocks 244>, <&clocks 234>;
      clock-names = "enable", "apb";
      interrupts = <349>;
      interrupt-parent = <&plic>;
      label = "pvt0";
      resets = <&reset 111>;
      #thermal-sensor-cells = <0>;
    };
...
```

## Documentation/devicetree/bindings/hwmon/fan-common.yaml
```yaml
# SPDX-License-Identifier: GPL-2.0-only OR BSD-2-Clause
%YAML 1.2
---
$id: http://devicetree.org/schemas/hwmon/fan-common.yaml#
$schema: http://devicetree.org/meta-schemas/core.yaml#

title: Common Fan Properties

maintainers:
  - Naresh Solanki <naresh.solanki@9elements.com>
  - Billy Tsai <billy_tsai@aspeedtech.com>

properties:
  max-rpm:
    description:
      Max RPM supported by fan.
    $ref: /schemas/types.yaml#/definitions/uint32
    maximum: 100000

  min-rpm:
    description:
      Min RPM supported by fan.
    $ref: /schemas/types.yaml#/definitions/uint32
    maximum: 1000

  pulses-per-revolution:
    description:
      The number of pulse from fan sensor per revolution.
    $ref: /schemas/types.yaml#/definitions/uint32
    maximum: 4

  tach-div:
    description:
      Divisor for the tach sampling clock, which determines the sensitivity of the tach pin.
    $ref: /schemas/types.yaml#/definitions/uint32

  target-rpm:
    description:
      The default desired fan speed in RPM.
    $ref: /schemas/types.yaml#/definitions/uint32

  fan-driving-mode:
    description:
      Select the driving mode of the fan.(DC, PWM and so on)
    $ref: /schemas/types.yaml#/definitions/string
    enum: [ dc, pwm ]

  pwms:
    description:
      PWM provider.
    maxItems: 1

  "#cooling-cells":
    const: 2

  cooling-levels:
    description:
      The control value which correspond to thermal cooling states.
    $ref: /schemas/types.yaml#/definitions/uint32-array

  tach-ch:
    description:
      The tach channel used for the fan.
    $ref: /schemas/types.yaml#/definitions/uint8-array

  label:
    description:
      Optional fan label

  fan-supply:
    description:
      Power supply for fan.

  reg:
    maxItems: 1

additionalProperties: true

...
```
