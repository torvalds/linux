## Documentation/devicetree/bindings/hwmon/g762.txt
```
GMT G762/G763 PWM Fan controller

Required node properties:

 - "compatible": must be either "gmt,g762" or "gmt,g763"
 - "reg": I2C bus address of the device
 - "clocks": a fixed clock providing input clock frequency
	     on CLK pin of the chip.

Optional properties:

 - "fan_startv": fan startup voltage. Accepted values are 0, 1, 2 and 3.
	       The higher the more.

 - "pwm_polarity": pwm polarity. Accepted values are 0 (positive duty)
	       and 1 (negative duty).

 - "fan_gear_mode": fan gear mode. Supported values are 0, 1 and 2.

If an optional property is not set in .dts file, then current value is kept
unmodified (e.g. u-boot installed value).

Additional information on operational parameters for the device is available
in Documentation/hwmon/g762.rst. A detailed datasheet for the device is available
at http://natisbad.org/NAS/refs/GMT_EDS-762_763-080710-0.2.pdf.

Example g762 node:

   clocks {
	#address-cells = <1>;
	#size-cells = <0>;

	g762_clk: fixedclk {
		 compatible = "fixed-clock";
		 #clock-cells = <0>;
		 clock-frequency = <8192>;
	}
   }

   g762: g762@3e {
	compatible = "gmt,g762";
	reg = <0x3e>;
	clocks = <&g762_clk>
	fan_gear_mode = <0>; /* chip default */
	fan_startv = <1>;    /* chip default */
	pwm_polarity = <0>;  /* chip default */
   };
```

## Documentation/devicetree/bindings/hwmon/gmt,g762.yaml
```yaml
# SPDX-License-Identifier: GPL-2.0-only OR BSD-2-Clause
%YAML 1.2
---
$id: http://devicetree.org/schemas/hwmon/gmt,g762.yaml#
$schema: http://devicetree.org/meta-schemas/core.yaml#

title: GMT G761/G762/G763 PWM Fan controller

maintainers:
  - Christian Marangi <ansuelsmth@gmail.com>

description: |
  GMT G761/G762/G763 PWM Fan controller.

  G761 supports an internal-clock hence the clocks property is optional.
  If not defined, internal-clock will be used. (31KHz is the clock of
  the internal crystal oscillator)

  If an optional property is not set in DT, then current value is kept
  unmodified (e.g. bootloader installed value).

  Additional information on operational parameters for the device is available
  in Documentation/hwmon/g762.rst. A detailed datasheet for the device is available
  at http://natisbad.org/NAS/refs/GMT_EDS-762_763-080710-0.2.pdf.

properties:
  compatible:
    enum:
      - gmt,g761
      - gmt,g762
      - gmt,g763

  reg:
    maxItems: 1

  clocks:
    description: a fixed clock providing input clock frequency on CLK
      pin of the chip.
    maxItems: 1

  fan_startv:
    description: Fan startup voltage step
    $ref: /schemas/types.yaml#/definitions/uint32
    enum: [0, 1, 2, 3]

  pwm_polarity:
    description: PWM polarity (positive or negative duty)
    $ref: /schemas/types.yaml#/definitions/uint32
    enum: [0, 1]

  fan_gear_mode:
    description: FAN gear mode. Configure High speed fan setting factor
    $ref: /schemas/types.yaml#/definitions/uint32
    enum: [0, 1, 2]

required:
  - compatible
  - reg

if:
  properties:
    compatible:
      contains:
        enum:
          - gmt,g762
          - gmt,g763
then:
  required:
    - clocks

additionalProperties: false

examples:
  - |
    i2c {
        #address-cells = <1>;
        #size-cells = <0>;

        g762@3e {
            compatible = "gmt,g762";
            reg = <0x3e>;
            clocks = <&g762_clk>;
            fan_gear_mode = <0>;
            fan_startv = <1>;
            pwm_polarity = <0>;
        };

        g761@1e {
            compatible = "gmt,g761";
            reg = <0x1e>;
            fan_gear_mode = <0>;
            fan_startv = <1>;
            pwm_polarity = <0>;
        };
    };
```

## Documentation/devicetree/bindings/hwmon/gpio-fan.txt
```
Bindings for fan connected to GPIO lines

Required properties:
- compatible : "gpio-fan"

Optional properties:
- gpios: Specifies the pins that map to bits in the control value,
  ordered MSB-->LSB.
- gpio-fan,speed-map: A mapping of possible fan RPM speeds and the
  control value that should be set to achieve them. This array
  must have the RPM values in ascending order.
- alarm-gpios: This pin going active indicates something is wrong with
  the fan, and a udev event will be fired.
- #cooling-cells: If used as a cooling device, must be <2>
  Also see: Documentation/devicetree/bindings/thermal/thermal.txt
  min and max states are derived from the speed-map of the fan.

Note: At least one the "gpios" or "alarm-gpios" properties must be set.

Examples:

	gpio_fan {
		compatible = "gpio-fan";
		gpios = <&gpio1 14 1
			 &gpio1 13 1>;
		gpio-fan,speed-map = <0    0
				      3000 1
				      6000 2>;
		alarm-gpios = <&gpio1 15 1>;
	};
	gpio_fan_cool: gpio_fan {
		compatible = "gpio-fan";
		gpios = <&gpio2 14 1
			 &gpio2 13 1>;
		gpio-fan,speed-map =	<0    0>,
					<3000 1>,
					<6000 2>;
		alarm-gpios = <&gpio2 15 1>;
		#cooling-cells = <2>; /* min followed by max */
	};
```

## Documentation/devicetree/bindings/hwmon/gpio-fan.yaml
```yaml
# SPDX-License-Identifier: (GPL-2.0 OR BSD-2-Clause)
%YAML 1.2
---
$id: http://devicetree.org/schemas/hwmon/gpio-fan.yaml#
$schema: http://devicetree.org/meta-schemas/core.yaml#

title: Fan connected to GPIO lines

maintainers:
  - Rob Herring <robh@kernel.org>

properties:
  compatible:
    const: gpio-fan

  gpios:
    description: |
      Specifies the pins that map to bits in the control value,
      ordered MSB-->LSB.
    minItems: 1
    maxItems: 7

  alarm-gpios:
    maxItems: 1

  gpio-fan,speed-map:
    $ref: /schemas/types.yaml#/definitions/uint32-matrix
    minItems: 2
    maxItems: 127
    items:
      items:
        - description: fan speed in RPMs
        - description: control value
    description: |
      A mapping of possible fan RPM speeds and the
      control value that should be set to achieve them. This array
      must have the RPM values in ascending order.

  '#cooling-cells':
    const: 2

required:
  - compatible
  - gpios
  - gpio-fan,speed-map

additionalProperties: false

examples:
  - |
    gpio-fan {
      compatible = "gpio-fan";
      gpios = <&gpio2 14 1
               &gpio2 13 1>;
      gpio-fan,speed-map = <   0 0>,
                           <3000 1>,
                           <6000 2>;
      alarm-gpios = <&gpio2 15 1>;
      #cooling-cells = <2>; /* min followed by max */
    };
```

## Documentation/devicetree/bindings/hwmon/hih6130.txt
```
Honeywell Humidicon HIH-6130 humidity/temperature sensor
--------------------------------------------------------

Requires node properties:
- compatible : "honeywell,hi6130"
- reg : the I2C address of the device. This is 0x27.

Example:
	hih6130@27 {
		compatible = "honeywell,hih6130";
		reg = <0x27>;
	};
```

## Documentation/devicetree/bindings/hwmon/hwmon-common.yaml
```yaml
# SPDX-License-Identifier: GPL-2.0 OR BSD-2-Clause
%YAML 1.2
---
$id: http://devicetree.org/schemas/hwmon/hwmon-common.yaml#
$schema: http://devicetree.org/meta-schemas/core.yaml#

title: Hardware Monitoring Devices Common Properties

maintainers:
  - Guenter Roeck <linux@roeck-us.net>

properties:
  label:
    description: A descriptive name for this device.

  shunt-resistor-micro-ohms:
    description: The value of current sense resistor.

additionalProperties: true
```
