## Documentation/devicetree/bindings/hwmon/ads7828.txt
```
ads7828 properties

Required properties:
- compatible: Should be one of
	       ti,ads7828
	       ti,ads7830
- reg: I2C address

Optional properties:

- ti,differential-input
  Set to use the device in differential mode.
- vref-supply
  The external reference on the device is set to this regulators output. If it
  does not exists the internal reference will be used and output by the ads78xx
  on the "external vref" pin.

  Example ADS7828 node:

  ads7828: ads@48 {
	   comatible = "ti,ads7828";
	   reg = <0x48>;
	   vref-supply = <&vref>;
	   ti,differential-input;
  };
```

## Documentation/devicetree/bindings/hwmon/adt7475.yaml
```yaml
# SPDX-License-Identifier: (GPL-2.0 OR BSD-2-Clause)
%YAML 1.2
---
$id: http://devicetree.org/schemas/hwmon/adt7475.yaml#
$schema: http://devicetree.org/meta-schemas/core.yaml#

title: ADT7475 hwmon sensor

maintainers:
  - Jean Delvare <jdelvare@suse.com>

description: |
  The ADT7473, ADT7475, ADT7476, and ADT7490 are thermal monitors and multiple
  PWN fan controllers.

  They support monitoring and controlling up to four fans (the ADT7490 can only
  control up to three). They support reading a single on chip temperature
  sensor and two off chip temperature sensors (the ADT7490 additionally
  supports measuring up to three current external temperature sensors with
  series resistance cancellation (SRC)).

  Datasheets:
  https://www.onsemi.com/pub/Collateral/ADT7473-D.PDF
  https://www.onsemi.com/pub/Collateral/ADT7475-D.PDF
  https://www.onsemi.com/pub/Collateral/ADT7476-D.PDF
  https://www.onsemi.com/pub/Collateral/ADT7490-D.PDF

  Description taken from onsemiconductors specification sheets, with minor
  rephrasing.

properties:
  compatible:
    enum:
      - adi,adt7473
      - adi,adt7475
      - adi,adt7476
      - adi,adt7490

  reg:
    maxItems: 1

  adi,pwm-active-state:
    description: |
      Integer array, represents the active state of the pwm outputs If set to 0
      the pwm uses a logic low output for 100% duty cycle. If set to 1 the pwm
      uses a logic high output for 100% duty cycle.
    $ref: /schemas/types.yaml#/definitions/uint32-array
    minItems: 3
    maxItems: 3
    items:
      enum: [0, 1]
      default: 1

patternProperties:
  "^adi,bypass-attenuator-in[0-4]$":
    description: |
      Configures bypassing the individual voltage input attenuator. If
      set to 1 the attenuator is bypassed if set to 0 the attenuator is
      not bypassed. If the property is absent then the attenuator
      retains its configuration from the bios/bootloader.
    $ref: /schemas/types.yaml#/definitions/uint32
    enum: [0, 1]

  "^adi,pin(5|10)-function$":
    description: |
      Configures the function for pin 5 on the adi,adt7473 and adi,adt7475. Or
      pin 10 on the adi,adt7476 and adi,adt7490.
    $ref: /schemas/types.yaml#/definitions/string
    enum:
      - pwm2
      - smbalert#

  "^adi,pin(9|14)-function$":
    description: |
      Configures the function for pin 9 on the adi,adt7473 and adi,adt7475. Or
      pin 14 on the adi,adt7476 and adi,adt7490
    $ref: /schemas/types.yaml#/definitions/string
    enum:
      - tach4
      - therm#
      - smbalert#
      - gpio

required:
  - compatible
  - reg

additionalProperties: false

examples:
  - |
    i2c {
      #address-cells = <1>;
      #size-cells = <0>;

      hwmon@2e {
        compatible = "adi,adt7476";
        reg = <0x2e>;
        adi,bypass-attenuator-in0 = <1>;
        adi,bypass-attenuator-in1 = <0>;
        adi,pwm-active-state = <1 0 1>;
        adi,pin10-function = "smbalert#";
        adi,pin14-function = "tach4";
      };
    };
```

## Documentation/devicetree/bindings/hwmon/amd,sbrmi.yaml
```yaml
# SPDX-License-Identifier: (GPL-2.0-only OR BSD-2-Clause)
%YAML 1.2
---
$id: http://devicetree.org/schemas/hwmon/amd,sbrmi.yaml#
$schema: http://devicetree.org/meta-schemas/core.yaml#

title: >
  Sideband Remote Management Interface (SB-RMI) compliant
  AMD SoC power device.

maintainers:
  - Akshay Gupta <Akshay.Gupta@amd.com>

description: |
  SB Remote Management Interface (SB-RMI) is an SMBus compatible
  interface that reports AMD SoC's Power (normalized Power) using,
  Mailbox Service Request and resembles a typical 8-pin remote power
  sensor's I2C interface to BMC. The power attributes in hwmon
  reports power in microwatts.

properties:
  compatible:
    enum:
      - amd,sbrmi

  reg:
    maxItems: 1
    description: |
      I2C bus address of the device as specified in Section SBI SMBus Address
      of the SoC register reference. The SB-RMI address is normally 78h for
      socket 0 and 70h for socket 1, but it could vary based on hardware
      address select pins.
      \[open source SoC register reference\]
        https://www.amd.com/en/support/tech-docs?keyword=55898

required:
  - compatible
  - reg

additionalProperties: false

examples:
  - |
    i2c0 {
        #address-cells = <1>;
        #size-cells = <0>;

        sbrmi@3c {
                compatible = "amd,sbrmi";
                reg = <0x3c>;
        };
    };
...
```

## Documentation/devicetree/bindings/hwmon/amd,sbtsi.yaml
```yaml
# SPDX-License-Identifier: (GPL-2.0-only OR BSD-2-Clause)
%YAML 1.2
---
$id: http://devicetree.org/schemas/hwmon/amd,sbtsi.yaml#
$schema: http://devicetree.org/meta-schemas/core.yaml#

title: >
  Sideband interface Temperature Sensor Interface (SB-TSI) compliant
  AMD SoC temperature device

maintainers:
  - Kun Yi <kunyi@google.com>
  - Supreeth Venkatesh <supreeth.venkatesh@amd.com>

description: |
  SB Temperature Sensor Interface (SB-TSI) is an SMBus compatible
  interface that reports AMD SoC's Ttcl (normalized temperature),
  and resembles a typical 8-pin remote temperature sensor's I2C interface
  to BMC. The emulated thermal sensor can report temperatures in increments
  of 0.125 degrees, ranging from 0 to 255.875.

properties:
  compatible:
    enum:
      - amd,sbtsi

  reg:
    maxItems: 1
    description: |
      I2C bus address of the device as specified in Section 6.3.1 of the
      SoC register reference. The SB-TSI address is normally 98h for socket
      0 and 90h for socket 1, but it could vary based on hardware address
      select pins.
      \[open source SoC register reference\]
        https://www.amd.com/system/files/TechDocs/56255_OSRR.pdf

required:
  - compatible
  - reg

additionalProperties: false

examples:
  - |
    i2c0 {
        #address-cells = <1>;
        #size-cells = <0>;

        sbtsi@4c {
                compatible = "amd,sbtsi";
                reg = <0x4c>;
        };
    };
...
```

## Documentation/devicetree/bindings/hwmon/amphenol,chipcap2.yaml
```yaml
# SPDX-License-Identifier: (GPL-2.0-only OR BSD-2-Clause)
%YAML 1.2
---
$id: http://devicetree.org/schemas/hwmon/amphenol,chipcap2.yaml#
$schema: http://devicetree.org/meta-schemas/core.yaml#

title: ChipCap 2 humidity and temperature iio sensor

maintainers:
  - Javier Carrasco <javier.carrasco.cruz@gmail.com>

description: |
  Relative humidity and temperature sensor on I2C bus.

  Datasheets:
    https://www.amphenol-sensors.com/en/telaire/humidity/527-humidity-sensors/3095-chipcap-2

properties:
  compatible:
    oneOf:
      - const: amphenol,cc2d23
      - items:
          - enum:
              - amphenol,cc2d23s
              - amphenol,cc2d25
              - amphenol,cc2d25s
              - amphenol,cc2d33
              - amphenol,cc2d33s
              - amphenol,cc2d35
              - amphenol,cc2d35s
          - const: amphenol,cc2d23

  reg:
    maxItems: 1

  interrupts:
    items:
      - description: measurement ready indicator
      - description: low humidity alarm
      - description: high humidity alarm

  interrupt-names:
    items:
      - const: ready
      - const: low
      - const: high

  vdd-supply:
    description:
      Dedicated, controllable supply-regulator to reset the device and
      enter in command mode.

required:
  - compatible
  - reg
  - vdd-supply

additionalProperties: false

examples:
  - |
    #include <dt-bindings/interrupt-controller/irq.h>
    i2c {
        #address-cells = <1>;
        #size-cells = <0>;

        humidity@28 {
            compatible = "amphenol,cc2d23s", "amphenol,cc2d23";
            reg = <0x28>;
            interrupt-parent = <&gpio>;
            interrupts = <4 IRQ_TYPE_EDGE_RISING>,
                         <5 IRQ_TYPE_EDGE_RISING>,
                         <6 IRQ_TYPE_EDGE_RISING>;
            interrupt-names = "ready", "low", "high";
            vdd-supply = <&reg_vdd>;
        };
    };
```

## Documentation/devicetree/bindings/hwmon/apm,xgene-slimpro-hwmon.yaml
```yaml
# SPDX-License-Identifier: (GPL-2.0-only OR BSD-2-Clause)
%YAML 1.2
---
$id: http://devicetree.org/schemas/hwmon/apm,xgene-slimpro-hwmon.yaml#
$schema: http://devicetree.org/meta-schemas/core.yaml#

title: APM X-Gene SLIMpro hwmon

maintainers:
  - Khuong Dinh <khuong@os.amperecomputing.com>

properties:
  compatible:
    const: apm,xgene-slimpro-hwmon

  mboxes:
    maxItems: 1

required:
  - compatible
  - mboxes

additionalProperties: false

examples:
  - |
    hwmon {
        compatible = "apm,xgene-slimpro-hwmon";
        mboxes = <&mailbox 7>;
    };
```

## Documentation/devicetree/bindings/hwmon/apm-xgene-hwmon.txt
```
APM X-Gene hwmon driver

APM X-Gene SOC sensors are accessed over the "SLIMpro" mailbox.

Required properties :
 - compatible : should be "apm,xgene-slimpro-hwmon"
 - mboxes : use the label reference for the mailbox as the first parameter.
	    The second parameter is the channel number.

Example :
	hwmonslimpro {
		compatible = "apm,xgene-slimpro-hwmon";
		mboxes = <&mailbox 7>;
	};
```

## Documentation/devicetree/bindings/hwmon/apple,smc-hwmon.yaml
```yaml
# SPDX-License-Identifier: (GPL-2.0-only OR BSD-2-Clause)
%YAML 1.2
---
$id: http://devicetree.org/schemas/hwmon/apple,smc-hwmon.yaml#
$schema: http://devicetree.org/meta-schemas/core.yaml#

title: Apple SMC Hardware Monitoring

description:
  Apple's System Management Controller (SMC) exposes a vast array of
  hardware monitoring sensors, including temperature probes, current and
  voltage sense, power meters, and fan speeds. It also provides endpoints
  to manually control the speed of each fan individually. Each Apple
  Silicon device exposes a different set of endpoints via SMC keys. This
  is true even when two machines share an SoC. The CPU core temperature
  sensor keys on an M1 Mac mini are different to those on an M1 MacBook
  Pro, for example.

maintainers:
  - James Calligeros <jcalligeros99@gmail.com>

$defs:
  sensor:
    type: object

    properties:
      apple,key-id:
        $ref: /schemas/types.yaml#/definitions/string
        pattern: "^[A-Za-z0-9]{4}$"
        description: The SMC FourCC key of the desired sensor.
          Must match the node's suffix.

      label:
        description: Human-readable name for the sensor

    required:
      - apple,key-id

properties:
  compatible:
    const: apple,smc-hwmon

patternProperties:
  "^current-[A-Za-z0-9]{4}$":
    $ref: "#/$defs/sensor"
    unevaluatedProperties: false

  "^fan-[A-Za-z0-9]{4}$":
    $ref: "#/$defs/sensor"
    unevaluatedProperties: false

    properties:
      apple,fan-minimum:
        $ref: /schemas/types.yaml#/definitions/string
        pattern: "^[A-Za-z0-9]{4}$"
        description: SMC key containing the fan's minimum speed

      apple,fan-maximum:
        $ref: /schemas/types.yaml#/definitions/string
        pattern: "^[A-Za-z0-9]{4}$"
        description: SMC key containing the fan's maximum speed

      apple,fan-target:
        $ref: /schemas/types.yaml#/definitions/string
        pattern: "^[A-Za-z0-9]{4}$"
        description: Writeable endpoint for setting desired fan speed

      apple,fan-mode:
        $ref: /schemas/types.yaml#/definitions/string
        pattern: "^[A-Za-z0-9]{4}$"
        description: Writeable key to enable/disable manual fan control

  "^power-[A-Za-z0-9]{4}$":
    $ref: "#/$defs/sensor"
    unevaluatedProperties: false

  "^temperature-[A-Za-z0-9]{4}$":
    $ref: "#/$defs/sensor"
    unevaluatedProperties: false

  "^voltage-[A-Za-z0-9]{4}$":
    $ref: "#/$defs/sensor"
    unevaluatedProperties: false

additionalProperties: false
```

## Documentation/devicetree/bindings/hwmon/as370.txt
```
Bindings for Synaptics AS370 PVT sensors

Required properties:
- compatible : "syna,as370-hwmon"
- reg        : address and length of the register set.

Example:
	hwmon@ea0810 {
		compatible = "syna,as370-hwmon";
		reg = <0xea0810 0xc>;
	};
```

## Documentation/devicetree/bindings/hwmon/aspeed,ast2400-pwm-tacho.yaml
```yaml
# SPDX-License-Identifier: (GPL-2.0-only OR BSD-2-Clause)
%YAML 1.2
---
$id: http://devicetree.org/schemas/hwmon/aspeed,ast2400-pwm-tacho.yaml#
$schema: http://devicetree.org/meta-schemas/core.yaml#

title: ASPEED AST2400/AST2500 PWM and Fan Tacho controller

maintainers:
  - Joel Stanley <joel@jms.id.au>
  - Andrew Jeffery <andrew@codeconstruct.com.au>

description: >
  The ASPEED PWM controller can support up to 8 PWM outputs. The ASPEED Fan
  Tacho controller can support up to 16 Fan tachometer inputs.

  There can be up to 8 fans supported. Each fan can have 1 PWM output and
  1-2 Fan tach inputs.

properties:
  compatible:
    enum:
      - aspeed,ast2400-pwm-tacho
      - aspeed,ast2500-pwm-tacho

  reg:
    maxItems: 1

  '#address-cells':
    const: 1

  '#size-cells':
    const: 0

  '#cooling-cells':
    const: 2

  clocks:
    maxItems: 1

  resets:
    maxItems: 1

patternProperties:
  '^fan@[0-7]$':
    description: Fan subnode
    type: object
    additionalProperties: false

    properties:
      reg:
        description: PWM source port index (0 = PWM A, ..., 7 = PWM H)
        maximum: 7

      cooling-levels:
        description: PWM duty cycle values for cooling states
        $ref: /schemas/types.yaml#/definitions/uint8-array
        minItems: 1
        maxItems: 16  # Should be enough

      aspeed,fan-tach-ch:
        description: Fan tachometer input channel
        $ref: /schemas/types.yaml#/definitions/uint8-array
        minItems: 1
        maxItems: 2
        items:
          maximum: 15

    required:
      - reg
      - aspeed,fan-tach-ch

required:
  - compatible
  - reg
  - '#address-cells'
  - '#size-cells'
  - clocks
  - resets

additionalProperties: false

examples:
  - |
    #include <dt-bindings/clock/aspeed-clock.h>

    fan-controller@1e786000 {
        compatible = "aspeed,ast2500-pwm-tacho";
        reg = <0x1e786000 0x1000>;
        #address-cells = <1>;
        #size-cells = <0>;
        #cooling-cells = <2>;
        clocks = <&syscon ASPEED_CLK_APB>;
        resets = <&syscon ASPEED_RESET_PWM>;

        fan@0 {
            reg = <0x00>;
            cooling-levels = /bits/ 8 <125 151 177 203 229 255>;
            aspeed,fan-tach-ch = /bits/ 8 <0x00>;
        };

        fan@1 {
            reg = <0x01>;
            aspeed,fan-tach-ch = /bits/ 8 <0x01 0x02>;
        };
    };
```
