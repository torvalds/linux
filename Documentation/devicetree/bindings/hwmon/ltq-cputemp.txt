## Documentation/devicetree/bindings/hwmon/microchip,emc1812.yaml
```yaml
# SPDX-License-Identifier: (GPL-2.0 OR BSD-2-Clause)
%YAML 1.2
---
$id: http://devicetree.org/schemas/hwmon/microchip,emc1812.yaml#
$schema: http://devicetree.org/meta-schemas/core.yaml#

title: Microchip EMC1812/13/14/15/33 multichannel temperature sensor

maintainers:
  - Marius Cristea <marius.cristea@microchip.com>

description: |
  The Microchip EMC1812/13/14/15/33 is a high-accuracy 2-wire multichannel
  low-voltage remote diode temperature monitor.

  The datasheet can be found here:
    https://ww1.microchip.com/downloads/aemDocuments/documents/MSLD/ProductDocuments/DataSheets/EMC1812-3-4-5-33-Data-Sheet-DS20005751.pdf

  EMC1812 has one external remote temperature monitoring channel
  EMC1813 has two external remote temperature monitoring channels
  EMC1814 has three external remote temperature monitoring channels and
    channels 2 and 3 support anti parallel diode
  EMC1815 has four external remote temperature monitoring channels and
    channels 1/2 and 3/4 support anti parallel diode
  EMC1833 has two external remote temperature monitoring channels and
    channels 1 and 2 support anti parallel diode

properties:
  compatible:
    enum:
      - microchip,emc1812
      - microchip,emc1813
      - microchip,emc1814
      - microchip,emc1815
      - microchip,emc1833

  reg:
    maxItems: 1

  interrupts:
    items:
      - description: alert-therm2 asserts when the ALERT limit is exceeded.
      - description: therm-addr asserts when the THERM limit is exceeded.
    minItems: 1

  interrupt-names:
    items:
      - const: alert-therm2
      - const: therm-addr
    minItems: 1

  "#address-cells":
    const: 1

  "#size-cells":
    const: 0

  microchip,enable-anti-parallel:
    description:
      Enable anti-parallel diode mode operation. EMC1814, EMC1815 and EMC1833
      support reading two external diodes in anti-parallel connection on the
      same set of pins. Disabling APD functionality to implement substrate
      diodes on devices that support APD eliminates the benefit of APD
      (two diodes on one channel).
    type: boolean

  microchip,parasitic-res-on-channel1-2:
    description:
      Indicates that the chip and the diodes/transistors are sufficiently
      far apart that a parasitic resistance is added to the wires, which can
      affect the measurements. Due to the availability of only a single
      configuration bit in hardware, channels 1 and 2 are affected together.
      If channel 2 is not available in hardware, this setting affects only
      channel 1.
    type: boolean

  microchip,parasitic-res-on-channel3-4:
    description:
      Indicates that the chip and the diodes/transistors are sufficiently
      far apart that a parasitic resistance is added to the wires, which can
      affect the measurements. Due to the availability of only a single
      configuration bit in hardware, channels 3 and 4 are affected together.
      If channel 4 is not available in hardware, this setting affects only
      channel 3.
    type: boolean

  vdd-supply: true

patternProperties:
  "^channel@[0-4]$":
    description: |
      Represents the temperature channels.
      0: Internal sensor
      1-4: External remote diodes
    type: object

    properties:
      reg:
        maxItems: 1

      label:
        description: Unique name to identify which channel this is.

    required:
      - reg

    additionalProperties: false

required:
  - compatible
  - reg
  - vdd-supply

allOf:
  # EMC1812: 1 Internal, 1 External Channels, No APD,
  # parasitic-res-on-channel1-2: for channel 1
  - if:
      properties:
        compatible:
          const: microchip,emc1812
    then:
      properties:
        microchip,enable-anti-parallel: false
        microchip,parasitic-res-on-channel3-4: false
      patternProperties:
        "^channel@[2-4]$": false

  # EMC1813: 1 Internal, 2 External Channels, No APD,
  # parasitic-res-on-channel1-2: on both channel 1 & 2
  - if:
      properties:
        compatible:
          const: microchip,emc1813
    then:
      properties:
        microchip,enable-anti-parallel: false
        microchip,parasitic-res-on-channel3-4: false
      patternProperties:
        "^channel@[3-4]$": false

  # EMC1833: 1 Internal, 2 External Channels, Supports APD,
  # parasitic-res-on-channel1-2: on both channel 1 & 2
  - if:
      properties:
        compatible:
          const: microchip,emc1833
    then:
      properties:
        microchip,parasitic-res-on-channel3-4: false
      patternProperties:
        "^channel@[3-4]$": false

  # EMC1814: 1 Internal, 3 External Channels, Supports APD,
  # parasitic-res-on-channel1-2: on both channel 1 & 2
  # parasitic-res-on-channel3-4: for channel 3
  - if:
      properties:
        compatible:
          const: microchip,emc1814
    then:
      properties:
        channel@4: false

unevaluatedProperties: false

examples:
  - |
    i2c {
        #address-cells = <1>;
        #size-cells = <0>;

        temperature-sensor@4c {
            compatible = "microchip,emc1813";
            reg = <0x4c>;

            #address-cells = <1>;
            #size-cells = <0>;

            microchip,parasitic-res-on-channel1-2;

            vdd-supply = <&vdd>;

            channel@1 {
                reg = <1>;
                label = "External CH1 Temperature";
            };

            channel@2 {
                reg = <2>;
                label = "External CH2 Temperature";
            };
        };
    };
```

## Documentation/devicetree/bindings/hwmon/microchip,emc2305.yaml
```yaml
# SPDX-License-Identifier: (GPL-2.0-only OR BSD-2-Clause)
%YAML 1.2
---
$id: http://devicetree.org/schemas/hwmon/microchip,emc2305.yaml#
$schema: http://devicetree.org/meta-schemas/core.yaml#

title: Microchip EMC2305 SMBus compliant PWM fan controller

maintainers:
  - Michael Shych <michaelsh@nvidia.com>

description:
  Microchip EMC2301/2/3/5 pwm controller which supports up to five programmable
  fan control circuits.

properties:
  compatible:
    oneOf:
      - enum:
          - microchip,emc2305
      - items:
          - enum:
              - microchip,emc2303
              - microchip,emc2302
              - microchip,emc2301
          - const: microchip,emc2305

  reg:
    maxItems: 1

  '#address-cells':
    const: 1

  '#size-cells':
    const: 0

  '#pwm-cells':
    const: 3
    description: |
      Number of cells in a PWM specifier.
      - cell 0: The PWM frequency
      - cell 1: The PWM polarity: 0 or PWM_POLARITY_INVERTED
      - cell 2: The PWM output config:
           - 0 (Open-Drain)
           - 1 (Push-Pull)

patternProperties:
  '^fan@[0-4]$':
    $ref: fan-common.yaml#
    unevaluatedProperties: false
    properties:
      reg:
        description:
          The fan number used to determine the associated PWM channel.
        maxItems: 1

    required:
      - reg

required:
  - compatible
  - reg

additionalProperties: false

examples:
  - |
    #include <dt-bindings/pwm/pwm.h>
    i2c {
        #address-cells = <1>;
        #size-cells = <0>;

        fan_controller: fan-controller@2f {
            compatible = "microchip,emc2305";
            reg = <0x2f>;
            #address-cells = <1>;
            #size-cells = <0>;
            #pwm-cells = <3>;

            fan@0 {
                reg = <0x0>;
                pwms = <&fan_controller 26000 PWM_POLARITY_INVERTED 1>;
                #cooling-cells = <2>;
            };

            fan@1 {
                reg = <0x1>;
                pwms = <&fan_controller 26000 0 1>;
                #cooling-cells = <2>;
            };

            fan@2 {
                reg = <0x2>;
                pwms = <&fan_controller 26000 0 1>;
                #cooling-cells = <2>;
            };

            fan@3 {
                reg = <0x3>;
                pwms = <&fan_controller 26000 0 1>;
                #cooling-cells = <2>;
            };

            fan@4 {
                reg = <0x4>;
                pwms = <&fan_controller 26000 0 1>;
                #cooling-cells = <2>;
            };
        };
    };
...
```

## Documentation/devicetree/bindings/hwmon/microchip,lan966x.yaml
```yaml
# SPDX-License-Identifier: (GPL-2.0-only OR BSD-2-Clause)
%YAML 1.2
---
$id: http://devicetree.org/schemas/hwmon/microchip,lan966x.yaml#
$schema: http://devicetree.org/meta-schemas/core.yaml#

title: Microchip LAN966x Hardware Monitor

maintainers:
  - Michael Walle <michael@walle.cc>

description: |
  Microchip LAN966x temperature monitor and fan controller

properties:
  compatible:
    enum:
      - microchip,lan9668-hwmon

  reg:
    items:
      - description: PVT registers
      - description: FAN registers

  reg-names:
    items:
      - const: pvt
      - const: fan

  clocks:
    maxItems: 1

  '#thermal-sensor-cells':
    const: 0

required:
  - compatible
  - reg
  - reg-names
  - clocks

additionalProperties: false

examples:
  - |
    hwmon: hwmon@e2010180 {
        compatible = "microchip,lan9668-hwmon";
        reg = <0xe2010180 0xc>,
              <0xe20042a8 0xc>;
        reg-names = "pvt", "fan";
        clocks = <&sys_clk>;
        #thermal-sensor-cells = <0>;
    };
```

## Documentation/devicetree/bindings/hwmon/microchip,mcp3021.yaml
```yaml
# SPDX-License-Identifier: GPL-2.0-only OR BSD-2-Clause
%YAML 1.2
---
$id: http://devicetree.org/schemas/hwmon/microchip,mcp3021.yaml#
$schema: http://devicetree.org/meta-schemas/core.yaml#

title: Microchip MCP3021 A/D converter

maintainers:
  - Krzysztof Kozlowski <krzk@kernel.org>

properties:
  compatible:
    enum:
      - microchip,mcp3021
      - microchip,mcp3221

  reg:
    maxItems: 1

  reference-voltage-microvolt:
    description:
      VDD supply power and reference voltage

required:
  - compatible
  - reg

additionalProperties: false

examples:
  - |
    i2c {
        #address-cells = <1>;
        #size-cells = <0>;

        adc@4d {
            compatible = "microchip,mcp3021";
            reg = <0x4d>;

            reference-voltage-microvolt = <4500000>; /* 4.5 V */
        };
    };
```
