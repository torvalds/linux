## Documentation/devicetree/bindings/hwmon/ltq-cputemp.txt
```
Lantiq cpu temperatur sensor

Requires node properties:
- compatible value :
	"lantiq,cputemp"

Example:
	cputemp@0 {
		compatible = "lantiq,cputemp";
	};
```

## Documentation/devicetree/bindings/hwmon/max1619.txt
```
Bindings for MAX1619 Temperature Sensor

Required properties:
- compatible : "maxim,max1619"
- reg        : I2C address, one of 0x18, 0x19, 0x1a, 0x29, 0x2a, 0x2b, 0x4c, or
               0x4d, 0x4e

Example:
	temp@4c {
		compatible = "maxim,max1619";
		reg = <0x4c>;
	};
```

## Documentation/devicetree/bindings/hwmon/max31785.txt
```
Bindings for the Maxim MAX31785 Intelligent Fan Controller
==========================================================

Reference:

https://datasheets.maximintegrated.com/en/ds/MAX31785.pdf

The Maxim MAX31785 is a PMBus device providing closed-loop, multi-channel fan
management with temperature and remote voltage sensing. Various fan control
features are provided, including PWM frequency control, temperature hysteresis,
dual tachometer measurements, and fan health monitoring.

Required properties:
- compatible     : One of "maxim,max31785" or "maxim,max31785a"
- reg            : I2C address, one of 0x52, 0x53, 0x54, 0x55.

Example:

        fans@52 {
                compatible = "maxim,max31785";
                reg = <0x52>;
        };
```

## Documentation/devicetree/bindings/hwmon/max6650.txt
```
Bindings for MAX6651 and MAX6650 I2C fan controllers

Reference:
[1]	https://datasheets.maximintegrated.com/en/ds/MAX6650-MAX6651.pdf

Required properties:
- compatible : One of "maxim,max6650" or "maxim,max6651"
- reg        : I2C address, one of 0x1b, 0x1f, 0x4b, 0x48.

Optional properties, default is to retain the chip's current setting:
- maxim,fan-microvolt : The supply voltage of the fan, either 5000000 uV or
			12000000 uV.
- maxim,fan-prescale  : Pre-scaling value, as per datasheet [1]. Lower values
			allow more fine-grained control of slower fans.
			Valid: 1, 2, 4, 8, 16.
- maxim,fan-target-rpm: Initial requested fan rotation speed. If specified, the
			driver selects closed-loop mode and the requested speed.
			This ensures the fan is already running before userspace
			takes over.

Example:
	fan-max6650: max6650@1b {
		reg = <0x1b>;
		compatible = "maxim,max6650";
		maxim,fan-microvolt = <12000000>;
		maxim,fan-prescale = <4>;
		maxim,fan-target-rpm = <1200>;
	};
```

## Documentation/devicetree/bindings/hwmon/max6697.txt
```
max6697 properties

Required properties:
- compatible:
	Should be one of
		maxim,max6581
		maxim,max6602
		maxim,max6622
		maxim,max6636
		maxim,max6689
		maxim,max6693
		maxim,max6694
		maxim,max6697
		maxim,max6698
		maxim,max6699
- reg: I2C address

Optional properties:

- smbus-timeout-disable
	Set to disable SMBus timeout. If not specified, SMBus timeout will be
	enabled.
- extended-range-enable
	Only valid for MAX6581. Set to enable extended temperature range.
	Extended temperature will be disabled if not specified.
- beta-compensation-enable
	Only valid for MAX6693 and MX6694. Set to enable beta compensation on
	remote temperature channel 1.
	Beta compensation will be disabled if not specified.
- alert-mask
	Alert bit mask. Alert disabled for bits set.
	Select bit 0 for local temperature, bit 1..7 for remote temperatures.
	If not specified, alert will be enabled for all channels.
- over-temperature-mask
	Over-temperature bit mask. Over-temperature reporting disabled for
	bits set.
	Select bit 0 for local temperature, bit 1..7 for remote temperatures.
	If not specified, over-temperature reporting will be enabled for all
	channels.
- resistance-cancellation
	Boolean for all chips other than MAX6581. Set to enable resistance
	cancellation on remote temperature channel 1.
	For MAX6581, resistance cancellation enabled for all channels if
	specified as boolean, otherwise as per bit mask specified.
	Only supported for remote temperatures (bit 1..7).
	If not specified, resistance cancellation will be disabled for all
	channels.
- transistor-ideality
	For MAX6581 only. Two values; first is bit mask, second is ideality
	select value as per MAX6581 data sheet. Select bit 1..7 for remote
	channels.
	Transistor ideality will be initialized to default (1.008) if not
	specified.

Example:

temp-sensor@1a {
	compatible = "maxim,max6697";
	reg = <0x1a>;
	smbus-timeout-disable;
	resistance-cancellation;
	alert-mask = <0x72>;
	over-temperature-mask = <0x7f>;
};
```

## Documentation/devicetree/bindings/hwmon/maxim,max20730.yaml
```yaml
# SPDX-License-Identifier: (GPL-2.0 OR BSD-2-Clause)
%YAML 1.2
---
$id: http://devicetree.org/schemas/hwmon/maxim,max20730.yaml#
$schema: http://devicetree.org/meta-schemas/core.yaml#

title: Maxim max20730

maintainers:
  - Jean Delvare <jdelvare@suse.com>
  - Guenter Roeck <linux@roeck-us.net>

description: |
  The MAX20730 is a fully integrated, highly efficient switching regulator
  with PMBus for applications operating from 4.5V to 16V and requiring
  up to 25A (max) load. This single-chip regulator provides extremely
  compact, high efficiency power-delivery solutions with high-precision
  output voltages and excellent transient response.

  Datasheets:
    https://datasheets.maximintegrated.com/en/ds/MAX20730.pdf
    https://datasheets.maximintegrated.com/en/ds/MAX20734.pdf
    https://datasheets.maximintegrated.com/en/ds/MAX20743.pdf

properties:
  compatible:
    enum:
      - maxim,max20730
      - maxim,max20734
      - maxim,max20743

  reg:
    maxItems: 1

  vout-voltage-divider:
    description: |
      If voltage divider present at vout, the voltage at voltage sensor pin
      will be scaled. The properties will convert the raw reading to a more
      meaningful number if voltage divider present. It has two numbers,
      the first number is the output resistor, the second number is the total
      resistance. Therefore, the adjusted vout is equal to
      Vout = Vout * output_resistance / total resistance.
    $ref: /schemas/types.yaml#/definitions/uint32-array
    minItems: 2
    maxItems: 2

required:
  - compatible
  - reg

additionalProperties: false

examples:
  - |
    i2c {
      #address-cells = <1>;
      #size-cells = <0>;

      max20730@10 {
        compatible = "maxim,max20730";
        reg = <0x10>;
        vout-voltage-divider = <1000 2000>; // vout would be scaled to 0.5
      };
    };
```

## Documentation/devicetree/bindings/hwmon/maxim,max31790.yaml
```yaml
# SPDX-License-Identifier: (GPL-2.0 OR BSD-2-Clause)
%YAML 1.2
---
$id: http://devicetree.org/schemas/hwmon/maxim,max31790.yaml#
$schema: http://devicetree.org/meta-schemas/core.yaml#

title: The Maxim MAX31790 Fan Controller

maintainers:
  - Guenter Roeck <linux@roeck-us.net>
  - Chanh Nguyen <chanh@os.amperecomputing.com>

description: >
  The MAX31790 controls the speeds of up to six fans using six
  independent PWM outputs. The desired fan speeds (or PWM duty cycles)
  are written through the I2C interface.

  Datasheets:
    https://datasheets.maximintegrated.com/en/ds/MAX31790.pdf

properties:
  compatible:
    const: maxim,max31790

  reg:
    maxItems: 1

  clocks:
    maxItems: 1

  resets:
    maxItems: 1

  "#pwm-cells":
    const: 1

patternProperties:
  "^fan-[0-9]+$":
    $ref: fan-common.yaml#
    unevaluatedProperties: false

required:
  - compatible
  - reg

additionalProperties: false

examples:
  - |
    i2c {
      #address-cells = <1>;
      #size-cells = <0>;

      pwm_provider: fan-controller@20 {
        compatible = "maxim,max31790";
        reg = <0x20>;
        clocks = <&sys_clk>;
        resets = <&reset 0>;
        #pwm-cells = <1>;

        fan-0 {
          pwms = <&pwm_provider 1>;
        };

        fan-1 {
          pwms = <&pwm_provider 2>;
        };
      };
    };
```

## Documentation/devicetree/bindings/hwmon/maxim,max6639.yaml
```yaml
# SPDX-License-Identifier: (GPL-2.0 OR BSD-2-Clause)
%YAML 1.2
---
$id: http://devicetree.org/schemas/hwmon/maxim,max6639.yaml#
$schema: http://devicetree.org/meta-schemas/core.yaml#

title: Maxim max6639

maintainers:
  - Naresh Solanki <naresh.solanki@9elements.com>

description: |
  The MAX6639 is a 2-channel temperature monitor with dual, automatic, PWM
  fan-speed controller.  It monitors its own temperature and one external
  diode-connected transistor or the temperatures of two external diode-connected
  transistors, typically available in CPUs, FPGAs, or GPUs.

  Datasheets:
    https://datasheets.maximintegrated.com/en/ds/MAX6639-MAX6639F.pdf

properties:
  compatible:
    enum:
      - maxim,max6639

  reg:
    maxItems: 1

  '#address-cells':
    const: 1

  '#size-cells':
    const: 0

  '#pwm-cells':
    const: 3

required:
  - compatible
  - reg

patternProperties:
  "^fan@[0-1]$":
    type: object
    description:
      Represents the two fans and their specific configuration.

    $ref: fan-common.yaml#

    unevaluatedProperties: false

    properties:
      reg:
        description:
          The fan number.

    required:
      - reg

additionalProperties: false

examples:
  - |
    i2c {
        #address-cells = <1>;
        #size-cells = <0>;

        fan1: fan-controller@10 {
            compatible = "maxim,max6639";
            reg = <0x10>;
            #address-cells = <1>;
            #size-cells = <0>;
            #pwm-cells = <3>;

            fan@0 {
                reg = <0x0>;
                pulses-per-revolution = <2>;
                max-rpm = <4000>;
                target-rpm = <1000>;
                pwms = <&fan1 0 25000 0>;
            };

            fan@1 {
                reg = <0x1>;
                pulses-per-revolution = <2>;
                max-rpm = <8000>;
                pwms = <&fan1 1 25000 0>;
            };
        };
    };
...
```

## Documentation/devicetree/bindings/hwmon/maxim,max6650.yaml
```yaml
# SPDX-License-Identifier: (GPL-2.0 OR BSD-2-Clause)
%YAML 1.2
---

$id: http://devicetree.org/schemas/hwmon/maxim,max6650.yaml#
$schema: http://devicetree.org/meta-schemas/core.yaml#

title: Maxim MAX6650 and MAX6651 I2C Fan Controllers

maintainers:
  - Javier Carrasco <javier.carrasco.cruz@gmail.com>

description: |
  The MAX6650 and MAX6651 regulate and monitor the speed
  of 5VDC/12VDC burshless fans with built-in tachometers.

  Datasheets:
    https://datasheets.maximintegrated.com/en/ds/MAX6650-MAX6651.pdf

properties:
  compatible:
    enum:
      - maxim,max6650
      - maxim,max6651

  reg:
    maxItems: 1

  maxim,fan-microvolt:
    description:
      The supply voltage of the fan, either 5000000 uV or
      12000000 uV.
    enum: [5000000, 12000000]

  maxim,fan-prescale:
    description:
      Pre-scaling value, as per datasheet. Lower values
      allow more fine-grained control of slower fans.
    $ref: /schemas/types.yaml#/definitions/uint32
    enum: [1, 2, 4, 8, 16]

  maxim,fan-target-rpm:
    description:
      Initial requested fan rotation speed. If specified, the
      driver selects closed-loop mode and the requested speed.
      This ensures the fan is already running before userspace
      takes over.
    $ref: /schemas/types.yaml#/definitions/uint32
    maximum: 30000

required:
  - compatible
  - reg

additionalProperties: false

examples:
  - |
    i2c {
        #address-cells = <1>;
        #size-cells = <0>;

        fan-controller@1b {
            compatible = "maxim,max6650";
            reg = <0x1b>;
            maxim,fan-microvolt = <12000000>;
            maxim,fan-prescale = <4>;
            maxim,fan-target-rpm = <1200>;
        };
    };
```

## Documentation/devicetree/bindings/hwmon/mcp3021.txt
```
mcp3021 properties

Required properties:
- compatible: Must be one of the following:
	- "microchip,mcp3021" for mcp3021
	- "microchip,mcp3221" for mcp3221
- reg: I2C address

Optional properties:

- reference-voltage-microvolt
	Reference voltage in microvolt (uV)

Example:

mcp3021@4d {
	compatible = "microchip,mcp3021";
	reg = <0x4d>;

	reference-voltage-microvolt = <4500000>; /* 4.5 V */
};
```
