## Documentation/devicetree/bindings/hwmon/microchip,mcp9982.yaml
```yaml
# SPDX-License-Identifier: (GPL-2.0 OR BSD-2-Clause)
%YAML 1.2
---
$id: http://devicetree.org/schemas/hwmon/microchip,mcp9982.yaml#
$schema: http://devicetree.org/meta-schemas/core.yaml#

title: Microchip MCP998X/33 and MCP998XD/33D Temperature Monitor

maintainers:
  - Victor Duicu <victor.duicu@microchip.com>

description: |
  The MCP998X/33 and MCP998XD/33D family is a high-accuracy 2-wire
  multichannel automotive temperature monitor.
  The datasheet can be found here:
    https://ww1.microchip.com/downloads/aemDocuments/documents/MSLD/ProductDocuments/DataSheets/MCP998X-Family-Data-Sheet-DS20006827.pdf

properties:
  compatible:
    enum:
      - microchip,mcp9933
      - microchip,mcp9933d
      - microchip,mcp9982
      - microchip,mcp9982d
      - microchip,mcp9983
      - microchip,mcp9983d
      - microchip,mcp9984
      - microchip,mcp9984d
      - microchip,mcp9985
      - microchip,mcp9985d

  reg:
    maxItems: 1

  interrupts:
    minItems: 1
    maxItems: 2

  interrupt-names:
    description:
      The chip family has three different interrupt pins divided among them.
      The chips without "D" have alert-therm and therm-addr.
      The chips with "D" have alert-therm and sys-shtdwn.
    minItems: 1
    items:
      - enum: [alert-therm, therm-addr, sys-shtdwn]
      - enum: [therm-addr, sys-shtdwn]

  "#address-cells":
    const: 1

  "#size-cells":
    const: 0

  microchip,enable-anti-parallel:
    description:
      Enable anti-parallel diode mode operation.
      MCP9984/84D/85/85D and MCP9933/33D support reading two external diodes
      in anti-parallel connection on the same set of pins.
    type: boolean

  microchip,parasitic-res-on-channel1-2:
    description:
      Indicates that the chip and the diodes/transistors are sufficiently far
      apart that a parasitic resistance is added to the wires, which can affect
      the measurements. Due to the anti-parallel diode connections, channels
      1 and 2 are affected together.
    type: boolean

  microchip,parasitic-res-on-channel3-4:
    description:
      Indicates that the chip and the diodes/transistors are sufficiently far
      apart that a parasitic resistance is added to the wires, which can affect
      the measurements. Due to the anti-parallel diode connections, channels
      3 and 4 are affected together.
    type: boolean

  microchip,power-state:
    description:
      The chip can be set in Run state or Standby state. In Run state the ADC
      is converting on all channels at the programmed conversion rate.
      In Standby state the host must initiate a conversion cycle by writing
      to the One-Shot register.
      True value sets Run state.
      Chips with "D" in the name can only be set in Run mode.
    type: boolean

  vdd-supply: true

patternProperties:
  "^channel@[1-4]$":
    description:
      Represents the external temperature channels to which
      a remote diode is connected.
    type: object

    properties:
      reg:
        items:
          maxItems: 1

      label:
        description: Unique name to identify which channel this is.

    required:
      - reg

    additionalProperties: false

required:
  - compatible
  - reg
  - vdd-supply

allOf:
  - if:
      properties:
        compatible:
          contains:
            enum:
              - microchip,mcp9982d
              - microchip,mcp9983d
              - microchip,mcp9984d
              - microchip,mcp9985d
              - microchip,mcp9933d
    then:
      properties:
        interrupt-names:
          items:
            enum:
              - alert-therm
              - sys-shtdwn
      required:
        - microchip,power-state
        - microchip,parasitic-res-on-channel1-2
    else:
      properties:
        microchip,power-state: true
        interrupt-names:
          items:
            enum:
              - alert-therm
              - therm-addr

  - if:
      properties:
        compatible:
          contains:
            enum:
              - microchip,mcp9983d
              - microchip,mcp9984d
              - microchip,mcp9985d
    then:
      required:
        - microchip,parasitic-res-on-channel3-4

  - if:
      properties:
        compatible:
          contains:
            enum:
              - microchip,mcp9982
              - microchip,mcp9982d
    then:
      properties:
        microchip,enable-anti-parallel: false
      patternProperties:
        "^channel@[2-4]$": false

  - if:
      properties:
        compatible:
          contains:
            enum:
              - microchip,mcp9983
              - microchip,mcp9983d
    then:
      properties:
        microchip,enable-anti-parallel: false
      patternProperties:
        "^channel@[3-4]$": false

  - if:
      properties:
        compatible:
          contains:
            enum:
              - microchip,mcp9933
              - microchip,mcp9933d
    then:
      patternProperties:
        "^channel@[3-4]$": false

  - if:
      properties:
        compatible:
          contains:
            enum:
              - microchip,mcp9984
              - microchip,mcp9984d
    then:
      properties:
        channel@4: false

additionalProperties: false

examples:
  - |
    i2c {
        #address-cells = <1>;
        #size-cells = <0>;

        temperature-sensor@4c {
            compatible = "microchip,mcp9985";
            reg = <0x4c>;

            #address-cells = <1>;
            #size-cells = <0>;

            microchip,enable-anti-parallel;
            microchip,parasitic-res-on-channel1-2;
            microchip,parasitic-res-on-channel3-4;
            vdd-supply = <&vdd>;

            channel@1 {
                reg = <1>;
                label = "Room Temperature";
            };

            channel@2 {
                reg = <2>;
                label = "GPU Temperature";
            };
        };
    };

...
```

## Documentation/devicetree/bindings/hwmon/microchip,sparx5-temp.yaml
```yaml
# SPDX-License-Identifier: (GPL-2.0-only OR BSD-2-Clause)
%YAML 1.2
---
$id: http://devicetree.org/schemas/hwmon/microchip,sparx5-temp.yaml#
$schema: http://devicetree.org/meta-schemas/core.yaml#

title: Microchip Sparx5 Temperature Monitor

maintainers:
  - Lars Povlsen <lars.povlsen@microchip.com>

description: |
  Microchip Sparx5 embedded temperature monitor

properties:
  compatible:
    enum:
      - microchip,sparx5-temp

  reg:
    maxItems: 1

  clocks:
    items:
      - description: System reference clock

  '#thermal-sensor-cells':
    const: 0

required:
  - compatible
  - reg
  - clocks

additionalProperties: false

examples:
  - |
    tmon0: tmon@610508110 {
        compatible = "microchip,sparx5-temp";
        reg = <0x10508110 0xc>;
        #thermal-sensor-cells = <0>;
        clocks = <&sys_clk>;
    };
```

## Documentation/devicetree/bindings/hwmon/moortec,mr75203.yaml
```yaml
# SPDX-License-Identifier: (GPL-2.0-only OR BSD-2-Clause)
%YAML 1.2
---
$id: http://devicetree.org/schemas/hwmon/moortec,mr75203.yaml#
$schema: http://devicetree.org/meta-schemas/core.yaml#

title: Moortec Semiconductor MR75203 PVT Controller

maintainers:
  - Rahul Tanwar <rtanwar@maxlinear.com>

description: |
  A Moortec PVT (Process, Voltage, Temperature) monitoring logic design can
  include many different units.
  Such a design will usually consists of several Moortec's embedded analog IPs,
  and a single Moortec controller (mr75203) to configure and control the IPs.

  Some of the Moortec's analog hard IPs that can be used in a design:
  *) Temperature Sensor (TS) - used to monitor core temperature (e.g. mr74137).
  *) Voltage Monitor (VM) - used to monitor voltage levels (e.g. mr74138).
  *) Process Detector (PD) - used to assess silicon speed (e.g. mr74139).
  *) Delay Chain - ring oscillator connected to the PD, used to measure IO
     based transistors (e.g. mr76008 ring oscillator at 1.1V, mr76007 ring
     oscillator at 1.8V).
  *) Pre Scaler - provides divide-by-X scaling of input voltage, which can then
     be presented for VM for measurement within its range (e.g. mr76006 -
     divide by 2 pre-scaler).

  TS, VM & PD also include a digital interface, which consists of configuration
  inputs and measurement outputs.

  Some of the units have number of series, each series can have slightly
  different characteristics.

  The mr75203 binding describes configuration for the controller unit, but also
  for some of the analog IPs.

properties:
  compatible:
    const: moortec,mr75203

  reg:
    items:
      - description: PVT common registers
      - description: PVT temperature sensor registers
      - description: PVT process detector registers
      - description: PVT voltage monitor registers

  reg-names:
    items:
      - const: common
      - const: ts
      - const: pd
      - const: vm

  intel,vm-map:
    description:
      PVT controller has 5 VM (voltage monitor) sensors.
      vm-map defines CPU core to VM instance mapping. A
      value of 0xff means that VM sensor is unused.
    $ref: /schemas/types.yaml#/definitions/uint8-array
    maxItems: 5

  clocks:
    maxItems: 1

  resets:
    maxItems: 1

  "#thermal-sensor-cells":
    const: 1

  moortec,vm-active-channels:
    description:
      Defines the number of channels per VM that are actually used and are
      connected to some input source.
      Maximum number of items - number of VMs.
      Maximum value of each item - number of channels.
      Minimum value of each item - 0 (which means entire VM sensor is not used).
    $ref: /schemas/types.yaml#/definitions/uint8-array

  moortec,vm-pre-scaler-x2:
    description:
      Defines the channels that use a mr76006 pre-scaler to divide the input
      source by 2.
      The pre-scaler is used for input sources that exceed the VM input range.
      The driver uses this information to present to the user with the actual
      value of the voltage source.
      For channels that are not listed, no pre-scaler is assumed.
      Maximum number of items - total number of channels in all VMs.
      Each channel should not appear more than once.
    $ref: /schemas/types.yaml#/definitions/uint8-array

  moortec,ts-series:
    description:
      Definition of the temperature equation and coefficients that shall be
      used to convert the digital output to value in milli-Celsius.
    minimum: 5
    maximum: 6
    default: 5
    $ref: /schemas/types.yaml#/definitions/uint32

  moortec,ts-coeff-g:
    description:
      G coefficient for temperature equation.
      Default for series 5 = 60000
      Default for series 6 = 57400
    multipleOf: 100
    minimum: 1000
    $ref: /schemas/types.yaml#/definitions/uint32

  moortec,ts-coeff-h:
    description:
      H coefficient for temperature equation.
      Default for series 5 = 200000
      Default for series 6 = 249400
    multipleOf: 100
    minimum: 1000
    $ref: /schemas/types.yaml#/definitions/uint32

  moortec,ts-coeff-cal5:
    description:
      cal5 coefficient for temperature equation.
      Default for series 5 = 4094
      Default for series 6 = 4096
    minimum: 1
    $ref: /schemas/types.yaml#/definitions/uint32

  moortec,ts-coeff-j:
    description:
      J coefficient for temperature equation.
      Default for series 5 = -100
      Default for series 6 = 0
    multipleOf: 100
    maximum: 0
    $ref: /schemas/types.yaml#/definitions/int32

required:
  - compatible
  - reg
  - reg-names
  - clocks
  - "#thermal-sensor-cells"

additionalProperties: false

examples:
  - |
    pvt: pvt@e0680000 {
        compatible = "moortec,mr75203";
        reg = <0xe0680000 0x80>,
              <0xe0680080 0x180>,
              <0xe0680200 0x200>,
              <0xe0680400 0xc00>;
        reg-names = "common", "ts", "pd", "vm";
        intel,vm-map = [03 01 04 ff ff];
        clocks = <&osc0>;
        resets = <&rcu0 0x40 7>;
        moortec,vm-active-channels = /bits/ 8 <0x10 0x05>;
        moortec,vm-pre-scaler-x2 = /bits/ 8 <5 6 20>;
        moortec,ts-coeff-g = <61400>;
        moortec,ts-coeff-h = <253700>;
        #thermal-sensor-cells = <1>;
    };
```
