## Documentation/devicetree/bindings/iio/dac/adi,ad5710r.yaml
```yaml
# SPDX-License-Identifier: (GPL-2.0-only OR BSD-2-Clause)
%YAML 1.2
---
$id: http://devicetree.org/schemas/iio/dac/adi,ad5710r.yaml#
$schema: http://devicetree.org/meta-schemas/core.yaml#

title: Analog Devices AD5710R/AD5711R 8-channel 12-/16-bit Configurable IDAC/VDAC

maintainers:
  - Kim Seer Paller <kimseer.paller@analog.com>

description: |
  The AD5710R (16-bit) and AD5711R (12-bit) are 8-channel, low-power,
  configurable current/voltage output digital-to-analog converters (DACs) with
  an on-chip 2.5V, 3ppm/°C reference. Each channel can be independently
  configured as a voltage output (0V to VREF or 0V to 2 x VREF) or a current
  output (0mA to 50mA). These devices operate from a single 2.7V to 5.5V
  supply and are guaranteed monotonic by design.

  Datasheet can be found here:
  https://www.analog.com/media/en/technical-documentation/data-sheets/ad5711r-ad5710r.pdf

properties:
  compatible:
    enum:
      - adi,ad5710r
      - adi,ad5711r

  reg:
    maxItems: 1

  spi-max-frequency:
    maximum: 20000000

  '#address-cells':
    const: 1

  '#size-cells':
    const: 0

  vdd-supply:
    description: Power Supply Input.

  iovdd-supply:
    description: Digital Power Supply Input.

  io-channels:
    description:
      ADC channel used to monitor internal die temperature, output voltages, and
      current of a selected channel via the MUXOUT pin.
    maxItems: 1

  ref-supply:
    description:
      Reference Input/Output. The voltage at the REF pin sets the full-scale
      range of all channels. If not provided the internal reference is used and
      also provided on the VREF pin.

  reset-gpios:
    description:
      Active low signal that is falling edge sensitive. When it is deasserted,
      the digital core initialization is performed and all DAC registers except
      the Interface Configuration A register are reset to their default values.
    maxItems: 1

  ldac-gpios:
    description:
      LDAC pin to be used as a hardware trigger to update the DAC channels. If
      not present, the DAC channels are updated by Software LDAC.
    maxItems: 1

  adi,range-double:
    description:
      Configure the output range for all channels. If the property is present,
      the output will range from 0V to 2 x Vref. If the property is not present,
      the output will range from 0V to Vref.
    type: boolean

patternProperties:
  "^channel@[0-7]$":
    $ref: /schemas/iio/dac/dac.yaml#
    type: object
    description:
      Represents the external channels which are connected to the DAC.

    properties:
      reg:
        description: Channel number
        minimum: 0
        maximum: 7

      adi,ch-func:
        description:
          Channel output type. The values are defined in
          <dt-bindings/iio/addac/adi,ad74413r.h>. Use
          CH_FUNC_VOLTAGE_OUTPUT (1) for voltage output or
          CH_FUNC_CURRENT_OUTPUT (2) for current output.
        $ref: /schemas/types.yaml#/definitions/uint32
        enum: [1, 2]

    required:
      - reg
      - adi,ch-func

    unevaluatedProperties: false

required:
  - compatible
  - reg
  - vdd-supply
  - iovdd-supply

allOf:
  - $ref: /schemas/spi/spi-peripheral-props.yaml#

unevaluatedProperties: false

examples:
  - |
    #include <dt-bindings/iio/addac/adi,ad74413r.h>

    spi {
        #address-cells = <1>;
        #size-cells = <0>;
        dac@0 {
            compatible = "adi,ad5710r";
            reg = <0>;
            spi-max-frequency = <1000000>;
            vdd-supply = <&vdd>;
            iovdd-supply = <&iovdd>;
            #address-cells = <1>;
            #size-cells = <0>;

            channel@0 {
                reg = <0>;
                adi,ch-func = <CH_FUNC_VOLTAGE_OUTPUT>;
            };

            channel@1 {
                reg = <1>;
                adi,ch-func = <CH_FUNC_CURRENT_OUTPUT>;
            };
        };
    };
...
```

## Documentation/devicetree/bindings/iio/dac/microchip,mcp47a1.yaml
```yaml
# SPDX-License-Identifier: (GPL-2.0-only OR BSD-2-Clause)
%YAML 1.2
---

$id: http://devicetree.org/schemas/iio/dac/microchip,mcp47a1.yaml#
$schema: http://devicetree.org/meta-schemas/core.yaml#

title: Microchip MCP47A1 DAC

maintainers:
  - Joshua Crofts <joshua.crofts1@gmail.com>

description: |
  The Microchip MCP47A1 is a 6-bit single output volatile DAC.
  This device can have different IDs (0x2e and 0x3e).
  https://ww1.microchip.com/downloads/aemDocuments/documents/OTH/ProductDocuments/DataSheets/25154A.pdf

properties:
  compatible:
    const: microchip,mcp47a1

  reg:
    items:
      - enum: [0x2e, 0x3e]

  vref-supply: true

  vdd-supply: true

required:
  - compatible
  - reg
  - vref-supply
  - vdd-supply

additionalProperties: false

examples:
  - |
    i2c {
          #address-cells = <1>;
          #size-cells = <0>;

          dac@2e {
              compatible = "microchip,mcp47a1";
              reg = <0x2e>;
              vref-supply = <&vref_regulator>;
              vdd-supply = <&vdd_regulator>;
          };
    };
```
