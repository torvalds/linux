## Documentation/devicetree/bindings/hwmon/pmbus/adi,max20830.yaml
```yaml
# SPDX-License-Identifier: (GPL-2.0-only OR BSD-2-Clause)
%YAML 1.2
---
$id: http://devicetree.org/schemas/hwmon/pmbus/adi,max20830.yaml#
$schema: http://devicetree.org/meta-schemas/core.yaml#

title: Analog Devices MAX20830 Step-Down Switching Regulator with PMBus

maintainers:
  - Alexis Czezar Torreno <alexisczezar.torreno@analog.com>

description: |
  The MAX20830 is a fully integrated step-down DC-DC switching regulator with
  PMBus interface. It provides 2.7V to 16V input, 0.4V to 5.8V adjustable
  output, and up to 30A output current. It allows monitoring of input/output
  voltage, output current and temperature through the PMBus serial interface.
  Datasheet:
    https://www.analog.com/en/products/max20830.html

allOf:
  - $ref: /schemas/regulator/regulator.yaml#

properties:
  compatible:
    const: adi,max20830

  reg:
    maxItems: 1

  vddh-supply:
    description:
      Phandle to the regulator that provides the VDDH power supply.

  avdd-supply:
    description:
      Phandle to the regulator that provides the AVDD power supply.

  ldoin-supply:
    description:
      Optional 2.5V to 5.5V LDO input supply.

  pwr-good-gpios:
    description:
      GPIO connected to the power-good status output pin.
    maxItems: 1

  adi,vout-rfb1-ohms:
    description:
      Top feedback resistor (RFB1) value in ohms for VOUT sensing divider.
      When the desired output voltage is higher than VREF, a resistor divider
      is required. VOUT = VREF × (1 + RFB1/RFB2)

  adi,vout-rfb2-ohms:
    description:
      Bottom feedback resistor (RFB2) value in ohms for VOUT sensing divider.
      Datasheet recommends that RFB2 does not exceed 2.5kΩ.

required:
  - compatible
  - reg
  - vddh-supply

dependencies:
  adi,vout-rfb1-ohms: ['adi,vout-rfb2-ohms']
  adi,vout-rfb2-ohms: ['adi,vout-rfb1-ohms']

unevaluatedProperties: false

examples:
  - |
    #include <dt-bindings/gpio/gpio.h>

    i2c {
        #address-cells = <1>;
        #size-cells = <0>;

        regulator@30 {
            compatible = "adi,max20830";
            reg = <0x30>;
            vddh-supply = <&vddh>;
            avdd-supply = <&avdd>;
            ldoin-supply = <&ldoin>;
            pwr-good-gpios = <&gpio 2 GPIO_ACTIVE_HIGH>;
            adi,vout-rfb1-ohms = <10000>;
            adi,vout-rfb2-ohms = <2000>;
        };
    };
...
```

## Documentation/devicetree/bindings/hwmon/pmbus/adi,vt7505.yaml
```yaml
# SPDX-License-Identifier: (GPL-2.0-only OR BSD-2-Clause)
%YAML 1.2
---
$id: http://devicetree.org/schemas/hwmon/pmbus/adi,vt7505.yaml#
$schema: http://devicetree.org/meta-schemas/core.yaml#

title: Analog Devices MAX16545/MAX16550 and Volterra VT7505 PMBus controllers

maintainers:
  - Sanman Pradhan <psanman@juniper.net>

description: |
  The Analog Devices MAX16545 and MAX16550, and the Volterra VT7505, are PMBus
  controllers that provide input/output voltage, input/output current,
  input power and temperature monitoring over the PMBus interface.

  The MAX16545 uses the same programming model as the VT7505.

  Datasheets:
  https://www.analog.com/media/en/technical-documentation/data-sheets/max16545b-max16545c.pdf
  https://www.analog.com/media/en/technical-documentation/data-sheets/max16550.pdf

properties:
  compatible:
    oneOf:
      - enum:
          - adi,max16550
          - adi,vt7505
      - items:
          - const: adi,max16545
          - const: adi,vt7505

  reg:
    maxItems: 1

  adi,rload-ohms:
    description:
      Resistance in ohms of the external telemetry load resistor connected
      between the ILOAD current-output pin and ground. This is not a
      current-path shunt resistor; it sets the scaling of the reported input
      current, output current and input power.
    minimum: 1
    maximum: 283383959
    default: 4750

  adi,ocp-severe-filter-us:
    description:
      Deglitch time, in microseconds, applied to the severe
      overcurrent-protection comparator, programmed into the
      MFR_CONFIG[15:14] field. The MAX16550 and VT7505 expose this field.
      On the MAX16545 the severe overcurrent delay is fixed and these bits
      are reserved. If omitted, the existing hardware setting is retained.
    enum: [0, 1, 2, 10]

required:
  - compatible
  - reg

allOf:
  # The severe OCP deglitch filter is fixed on the MAX16545, so the property
  # is only valid for the MAX16550 and VT7505.
  - if:
      properties:
        compatible:
          contains:
            const: adi,max16545
    then:
      properties:
        adi,ocp-severe-filter-us: false

additionalProperties: false

examples:
  - |
    i2c {
        #address-cells = <1>;
        #size-cells = <0>;

        regulator@40 {
            compatible = "adi,vt7505";
            reg = <0x40>;
            adi,rload-ohms = <4750>;
            adi,ocp-severe-filter-us = <10>;
        };
    };
```

## Documentation/devicetree/bindings/hwmon/pmbus/infineon,tda38740.yaml
```yaml
# SPDX-License-Identifier: (GPL-2.0 OR BSD-2-Clause)
%YAML 1.2
---
$id: http://devicetree.org/schemas/hwmon/pmbus/infineon,tda38740.yaml#
$schema: http://devicetree.org/meta-schemas/core.yaml#

title: Infineon TDA38740 and TDA38725 PMBus Synchronous Buck Regulator

maintainers:
  - Colin Huang <u8813345@gmail.com>

description: |
  The Infineon TDA38740/TDA38725 is a 40A/25A single-voltage synchronous
  buck regulator with a PMBus interface designed for industrial use.

  Datasheet:
  https://www.infineon.com/row/public/documents/24/49/infineon-tda38740-tda38725-datasheet-en.pdf

properties:
  compatible:
    oneOf:
      - const: infineon,tda38740
      - items:
          - const: infineon,tda38725
          - const: infineon,tda38740

  reg:
    maxItems: 1

  interrupts:
    maxItems: 1

required:
  - compatible
  - reg

additionalProperties: false

examples:
  - |
    #include <dt-bindings/interrupt-controller/irq.h>
    i2c {
        #address-cells = <1>;
        #size-cells = <0>;

        regulator@40 {
            compatible = "infineon,tda38725",
                         "infineon,tda38740";
            reg = <0x40>;

            interrupt-parent = <&sgpiom0>;
            interrupts = <10 IRQ_TYPE_LEVEL_LOW>;
        };
    };
```

## Documentation/devicetree/bindings/hwmon/smsc,emc1403.yaml
```yaml
# SPDX-License-Identifier: GPL-2.0-only OR BSD-2-Clause
%YAML 1.2
---
$id: http://devicetree.org/schemas/hwmon/smsc,emc1403.yaml#
$schema: http://devicetree.org/meta-schemas/core.yaml#

title: SMSC EMC1402/1403/1404/1428 thermal sensors

maintainers:
  - Svyatoslav Ryhel <clamor95@gmail.com>

properties:
  compatible:
    oneOf:
      - enum:
          - smsc,emc1402
          - smsc,emc1403
          - smsc,emc1404
          - smsc,emc1428

      - items:
          - enum:
              - smsc,emc1412
              - smsc,emc1422
              - smsc,emc1442
          - const: smsc,emc1402

      - items:
          - enum:
              - smsc,emc1413
              - smsc,emc1423
          - const: smsc,emc1403

      - items:
          - enum:
              - smsc,emc1414
              - smsc,emc1424
          - const: smsc,emc1404

      - items:
          - enum:
              - smsc,emc1438
          - const: smsc,emc1428

  interrupts:
    items:
      - description: Sensors "ALERT" pin output.

  reg:
    maxItems: 1

  "#thermal-sensor-cells":
    const: 1

  '#address-cells':
    const: 1

  '#size-cells':
    const: 0

  vdd-supply: true

required:
  - compatible
  - reg

patternProperties:
  "^channel@([0-7])$":
    type: object
    description: Represents channels of the device and their specific configuration.

    properties:
      reg:
        description: The channel number. 0 is local channel, 1-7 are remote channels.
        items:
          minimum: 0
          maximum: 7

      label:
        description: A descriptive name for this channel, like "ambient" or "psu".

    required:
      - reg

    additionalProperties: false

allOf:
  - if:
      properties:
        compatible:
          contains:
            enum:
              - smsc,emc1402
    then:
      patternProperties:
        "^channel@([0-7])$":
          properties:
            reg:
              items:
                maximum: 1

  - if:
      properties:
        compatible:
          contains:
            enum:
              - smsc,emc1403
    then:
      patternProperties:
        "^channel@([0-7])$":
          properties:
            reg:
              items:
                maximum: 2

  - if:
      properties:
        compatible:
          contains:
            enum:
              - smsc,emc1404
    then:
      patternProperties:
        "^channel@([0-7])$":
          properties:
            reg:
              items:
                maximum: 3

additionalProperties: false

examples:
  - |
    #include <dt-bindings/interrupt-controller/irq.h>

    i2c {
        #address-cells = <1>;
        #size-cells = <0>;

        sensor@4c {
            compatible = "smsc,emc1412", "smsc,emc1402";
            reg = <0x4c>;

            interrupt-parent = <&gpio>;
            interrupts = <4 IRQ_TYPE_LEVEL_LOW>;

            vdd-supply = <&vdd_3v3_sys>;
            #thermal-sensor-cells = <1>;
        };
    };
  - |
    i2c {
        #address-cells = <1>;
        #size-cells = <0>;

        sensor@29 {
            compatible = "smsc,emc1428";
            reg = <0x29>;

            #address-cells = <1>;
            #size-cells = <0>;

            channel@0 {
                reg = <0x0>;
                label = "local";
            };

            channel@1 {
                reg = <0x1>;
                label = "chan1";
            };

            channel@2 {
                reg = <0x2>;
                label = "chan2";
            };

            channel@3 {
                reg = <0x3>;
                label = "chan3";
            };

            channel@4 {
                reg = <0x4>;
                label = "chan4";
            };

            channel@5 {
                reg = <0x5>;
                label = "chan5";
            };

            channel@6 {
                reg = <0x6>;
                label = "chan6";
            };

            channel@7 {
                reg = <0x7>;
                label = "chan7";
            };
        };
    };
```

## Documentation/devicetree/bindings/hwmon/ti,tmp102.yaml
```yaml
# SPDX-License-Identifier: GPL-2.0-only OR BSD-2-Clause
%YAML 1.2
---
$id: http://devicetree.org/schemas/hwmon/ti,tmp102.yaml#
$schema: http://devicetree.org/meta-schemas/core.yaml#

title: TMP102/TMP103/TMP110 temperature sensor

maintainers:
  - Krzysztof Kozlowski <krzk@kernel.org>

properties:
  compatible:
    oneOf:
      - items:
          - const: ti,tmp110
          - const: ti,tmp102
      - const: ti,tmp102
      - const: ti,tmp103

  interrupts:
    maxItems: 1

  reg:
    maxItems: 1

  label:
    description:
      A descriptive name for this channel, like "ambient" or "psu".

  "#thermal-sensor-cells":
    enum: [0, 1]

  vcc-supply:
    description: Power supply for the sensor

required:
  - compatible
  - reg

additionalProperties: false

examples:
  - |
    #include <dt-bindings/interrupt-controller/irq.h>

    i2c {
        #address-cells = <1>;
        #size-cells = <0>;

        sensor@48 {
            compatible = "ti,tmp102";
            reg = <0x48>;
            interrupt-parent = <&gpio7>;
            interrupts = <16 IRQ_TYPE_LEVEL_LOW>;
            label = "somelabel";
            vcc-supply = <&supply>;
            #thermal-sensor-cells = <1>;
        };
    };
```

## Documentation/devicetree/bindings/i2c/novatek,nt72676-i2c.yaml
```yaml
# SPDX-License-Identifier: (GPL-2.0-only OR BSD-2-Clause)
%YAML 1.2
---
$id: http://devicetree.org/schemas/i2c/novatek,nt72676-i2c.yaml#
$schema: http://devicetree.org/meta-schemas/core.yaml#

title: Novatek NT72676 I2C Controller

maintainers:
  - Ben Huang <ben_huang@novatek.com.tw>
  - Jason JJ Wu <jason_jj_wu@novatek.com.tw>

description: >
  Novatek NT72676 SoC provides multiple I2C controller instances that share
  the same register layout and transfer programming model.

  Generic I2C controllers are directly accessible by the host CPU and driven
  by a 96 MHz AHB clock.

  STBC I2C controllers are driven by a 12 MHz clock from the STBC (Standby
  Controller, an 8051-based microcontroller). Before accessing an STBC I2C
  controller, the host CPU must authenticate with the STBC and switch
  ownership of the controller to the host CPU. The presence of the
  novatek,stbc-syscon property identifies an STBC I2C controller requiring
  this initialization sequence.

properties:
  compatible:
    const: novatek,nt72676-i2c

  reg:
    maxItems: 1

  interrupts:
    maxItems: 1

  clocks:
    maxItems: 1

  clock-frequency:
    default: 100000
    enum: [ 100000, 400000 ]

  novatek,stbc-syscon:
    $ref: /schemas/types.yaml#/definitions/phandle
    description: >
      Phandle to the STBC system controller used to authenticate host
      access and switch ownership of the STBC I2C controller to the host
      CPU during initialization.

required:
  - compatible
  - reg
  - interrupts
  - clocks

allOf:
  - $ref: /schemas/i2c/i2c-controller.yaml#

unevaluatedProperties: false

examples:
  - |
    #include <dt-bindings/interrupt-controller/arm-gic.h>
    #include <dt-bindings/interrupt-controller/irq.h>

    i2c@fc040a00 {
      compatible = "novatek,nt72676-i2c";
      reg = <0xfc040a00 0x40>;
      interrupts = <GIC_SPI 77 IRQ_TYPE_LEVEL_HIGH>;
      clocks = <&stbc_i2c_clock>;
      clock-frequency = <400000>;
      novatek,stbc-syscon = <&stbc>;
      #address-cells = <1>;
      #size-cells = <0>;
    };
```
