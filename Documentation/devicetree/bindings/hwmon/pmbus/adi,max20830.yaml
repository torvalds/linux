## Documentation/devicetree/bindings/iio/adc/adi,ad7768.yaml
```yaml
# SPDX-License-Identifier: (GPL-2.0-only OR BSD-2-Clause)
%YAML 1.2
---
$id: http://devicetree.org/schemas/iio/adc/adi,ad7768.yaml#
$schema: http://devicetree.org/meta-schemas/core.yaml#

title: Analog Devices AD7768 and AD7768-4 ADC

maintainers:
  - Janani Sunil <janani.sunil@analog.com>

description: |
  The AD7768 is an 8-channel, 24-bit simultaneous sampling ADC with configurable
  power and performance modes. The AD7768-4 is a 4-channel version.

  This binding covers SPI mode only (register access via SPI). Pin control mode,
  where configuration is set via hardware pins rather than SPI registers, is not
  supported.

  The io-backend represents the high-speed data output interface, consuming the
  DOUTx data lines, DCLK (data clock), and DRDY (data ready) signals.

  Datasheet at:
    https://www.analog.com/media/en/technical-documentation/data-sheets/ad7768-ad7768-4.pdf

  HDL reference design:
    https://github.com/analogdevicesinc/hdl/tree/main/projects/ad7768evb

properties:
  compatible:
    enum:
      - adi,ad7768
      - adi,ad7768-4

  reg:
    maxItems: 1

  clocks:
    maxItems: 1

  clock-names:
    description:
      Describes the type of master clock (MCLK) attached to the XTAL1 and
      XTAL2/MCLK pins. A CMOS clock is supplied on the XTAL2/MCLK pin, a
      crystal oscillator is connected between the XTAL1 and XTAL2 pins, and an
      LVDS differential clock is supplied on the XTAL1/XTAL2 pin pair. CMOS and
      LVDS clocks must operate from 1.15 MHz to 34 MHz. Crystals must operate
      from 8 MHz to 34 MHz.
    enum:
      - mclk
      - xtal
      - lvds

  avdd1-supply:
    description:
      Analog supply. Its voltage is used to derive the supply-dependent VCM
      output level, so it must be a regulator that can report its voltage.

  avss-supply:
    description:
      Negative analog supply. If omitted, AVSS is assumed to be at system
      ground.

  avdd2-supply: true

  iovdd-supply: true

  ref1p-supply: true

  ref1n-supply:
    description:
      Negative reference input supply for REF1. If omitted, REF1- is assumed
      to be connected to ground.

  ref2p-supply: true

  ref2n-supply:
    description:
      Negative reference input supply for REF2. If omitted, REF2- is assumed
      to be connected to ground.

  reset-gpios:
    maxItems: 1
    description: GPIO connected to the active-low RESET pin

  start-gpios:
    maxItems: 1
    description:
      GPIO connected to the START pin. An active-low pulse on this pin
      synchronizes the device to other AD7768 devices. When not used, this
      pin must be tied to a logic high level through a pull-up resistor.
      When used, SYNC_OUT must be wired back to SYNC_IN on all devices in
      the synchronization chain.

  sync-in-gpios:
    maxItems: 1
    description:
      GPIO connected to the SYNC_IN pin. Receives the synchronization pulse
      generated on SYNC_OUT in response to a START pulse. Must be synchronous
      to the MCLK clock domain. In multi-device or daisy-chained systems,
      two successive synchronization pulses must be applied to guarantee all
      ADCs are synchronized.

  gpio-controller: true

  '#gpio-cells':
    const: 2

  adi,data-lines-number:
    $ref: /schemas/types.yaml#/definitions/uint32
    enum: [1, 2, 4, 8]
    description:
      Number of DOUTx lines used for the high-speed data output interface
      (distinct from the SPI control interface). AD7768 supports 1, 2, or 8
      lines; AD7768-4 supports 1 or 4 lines. Defaults to the maximum number
      of lines for the selected variant if omitted.

  regulators:
    type: object
    description: Container for the on-chip VCM regulator.
    additionalProperties: false

    properties:
      vcm-output:
        type: object
        description:
          Buffered common-mode voltage output on the VCM pin. Use
          regulator-always-on when no consumer node references this output.
          Channel 0 must be present and enabled while VCM is used, since
          putting channel 0 in standby disables the VCM output.
        $ref: /schemas/regulator/regulator.yaml#
        unevaluatedProperties: false

  io-backends:
    maxItems: 1

  '#address-cells':
    const: 1

  '#size-cells':
    const: 0

patternProperties:
  "^channel@[0-7]$":
    type: object
    description:
      Represents the external channels which are connected to the device.
      AD7768 supports channels 0-7, AD7768-4 supports channels 0-3.

    properties:
      reg:
        minimum: 0
        maximum: 7
        description: The channel number

      adi,prechargebuf-pos-enable:
        type: boolean
        description: Enable positive input precharge buffer

      adi,prechargebuf-neg-enable:
        type: boolean
        description: Enable negative input precharge buffer

      adi,refbuf-pos-enable:
        type: boolean
        description: Enable positive reference buffer

      adi,refbuf-neg-enable:
        type: boolean
        description: Enable negative reference buffer

    required:
      - reg

    additionalProperties: false

required:
  - compatible
  - reg
  - clocks
  - clock-names
  - avdd1-supply
  - avdd2-supply
  - iovdd-supply
  - ref1p-supply
  - ref2p-supply
  - io-backends

allOf:
  - $ref: /schemas/spi/spi-peripheral-props.yaml#
  - if:
      properties:
        compatible:
          contains:
            const: adi,ad7768-4
    then:
      properties:
        adi,data-lines-number:
          enum: [1, 4]
      patternProperties:
        "^channel@[0-3]$":
          properties:
            reg:
              maximum: 3
        "^channel@[4-7]$": false
    else:
      properties:
        adi,data-lines-number:
          enum: [1, 2, 8]

unevaluatedProperties: false

examples:
  - |
    #include <dt-bindings/gpio/gpio.h>

    spi {
        #address-cells = <1>;
        #size-cells = <0>;

        adc@0 {
            compatible = "adi,ad7768";
            reg = <0>;
            spi-max-frequency = <1000000>;

            avdd1-supply = <&avdd1_regulator>;
            avss-supply = <&avss_regulator>;
            avdd2-supply = <&avdd2_regulator>;
            iovdd-supply = <&iovdd_regulator>;
            ref1p-supply = <&ref1p_regulator>;
            ref1n-supply = <&ref1n_regulator>;
            ref2p-supply = <&ref2p_regulator>;
            ref2n-supply = <&ref2n_regulator>;
            reset-gpios = <&gpio0 86 GPIO_ACTIVE_LOW>;

            clocks = <&ad7768_mclk>;
            clock-names = "mclk";

            adi,data-lines-number = <8>;
            gpio-controller;
            #gpio-cells = <2>;

            io-backends = <&iio_backend>;

            #address-cells = <1>;
            #size-cells = <0>;

            channel@0 {
                reg = <0>;
                adi,prechargebuf-pos-enable;
                adi,refbuf-pos-enable;
            };

            channel@1 {
                reg = <1>;
                adi,prechargebuf-pos-enable;
                adi,prechargebuf-neg-enable;
                adi,refbuf-pos-enable;
                adi,refbuf-neg-enable;
            };

            channel@7 {
                reg = <7>;
                adi,prechargebuf-pos-enable;
                adi,refbuf-pos-enable;
            };
        };
    };

...
```

## Documentation/devicetree/bindings/iio/adc/adi,ltc2378.yaml
```yaml
# SPDX-License-Identifier: (GPL-2.0-only OR BSD-2-Clause)
%YAML 1.2
---
$id: http://devicetree.org/schemas/iio/adc/adi,ltc2378.yaml#
$schema: http://devicetree.org/meta-schemas/core.yaml#

title: Analog Devices LTC2378 and similar Analog to Digital Converters

maintainers:
  - Marcelo Schmitt <marcelo.schmitt@analog.com>

description: |
  Analog Devices LTC2378 series of ADCs.
  Specifications can be found at:
    https://www.analog.com/media/en/technical-documentation/data-sheets/233818fa.pdf
    https://www.analog.com/media/en/technical-documentation/data-sheets/236416fa.pdf
    https://www.analog.com/media/en/technical-documentation/data-sheets/236418f.pdf
    https://www.analog.com/media/en/technical-documentation/data-sheets/236716fa.pdf
    https://www.analog.com/media/en/technical-documentation/data-sheets/236718f.pdf
    https://www.analog.com/media/en/technical-documentation/data-sheets/236816f.pdf
    https://www.analog.com/media/en/technical-documentation/data-sheets/236818f.pdf
    https://www.analog.com/media/en/technical-documentation/data-sheets/236918fa.pdf
    https://www.analog.com/media/en/technical-documentation/data-sheets/237016fa.pdf
    https://www.analog.com/media/en/technical-documentation/data-sheets/237616fa.pdf
    https://www.analog.com/media/en/technical-documentation/data-sheets/237618fa.pdf
    https://www.analog.com/media/en/technical-documentation/data-sheets/237620fb.pdf
    https://www.analog.com/media/en/technical-documentation/data-sheets/237716fa.pdf
    https://www.analog.com/media/en/technical-documentation/data-sheets/237718fa.pdf
    https://www.analog.com/media/en/technical-documentation/data-sheets/237720fb.pdf
    https://www.analog.com/media/en/technical-documentation/data-sheets/237816fa.pdf
    https://www.analog.com/media/en/technical-documentation/data-sheets/237818fa.pdf
    https://www.analog.com/media/en/technical-documentation/data-sheets/237820fb.pdf
    https://www.analog.com/media/en/technical-documentation/data-sheets/237918fb.pdf
    https://www.analog.com/media/en/technical-documentation/data-sheets/238016fb.pdf

$ref: /schemas/spi/spi-peripheral-props.yaml#

properties:
  compatible:
    oneOf:
      # Single compatible string match.
      - enum:
          - adi,ltc2338-18
          - adi,ltc2364-16
          - adi,ltc2364-18
          - adi,ltc2376-16
          - adi,ltc2376-18
          - adi,ltc2376-20

      # Low sample rate fallback for 16-bit unipolar sensors.
      - items:
          - enum:
              - adi,ltc2370-16 # 2 MSPS
              - adi,ltc2368-16 # 1 MSPS
              - adi,ltc2367-16 # 500 kSPS
          - const: adi,ltc2364-16 # fallback (250 kSPS)

      # Low sample rate fallback for 18-bit unipolar sensors.
      - items:
          - enum:
              - adi,ltc2369-18 # 1.6 MSPS
              - adi,ltc2368-18 # 1 MSPS
              - adi,ltc2367-18 # 500 kSPS
          - const: adi,ltc2364-18 # fallback (250 kSPS)

      # Low sample rate fallback for 16-bit bipolar sensors.
      - items:
          - enum:
              - adi,ltc2380-16 # 2 MSPS
              - adi,ltc2378-16 # 1 MSPS
              - adi,ltc2377-16 # 500 kSPS
          - const: adi,ltc2376-16 # fallback (250 kSPS)

      # Low sample rate fallback for 18-bit bipolar sensors.
      - items:
          - enum:
              - adi,ltc2379-18 # 1.6 MSPS
              - adi,ltc2378-18 # 1 MSPS
              - adi,ltc2377-18 # 500 kSPS
          - const: adi,ltc2376-18 # fallback (250 kSPS)

      # Low sample rate fallback for 20-bit bipolar sensors.
      - items:
          - enum:
              - adi,ltc2378-20 # 1 MSPS
              - adi,ltc2377-20 # 500 kSPS
          - const: adi,ltc2376-20 # fallback (250 kSPS)

  reg:
    maxItems: 1

  spi-max-frequency:
    maximum: 100000000

  vdd-supply:
    description: A 2.5V supply that powers the chip (VDD).

  ovdd-supply:
    description:
      A 1.71V to 5.25V supply that sets the logic level for digital interface.

  ref-supply:
    description:
      Voltage reference input that determines the scale of ADC conversions.

  refin-supply:
    description:
      Alternative voltage reference input.

  cnv-gpios:
    description:
      When provided, this property indicates the GPIO that is connected to the
      CNV pin.
    maxItems: 1

  pwms:
    description: PWM signal connected to the CNV pin.
    maxItems: 1

  interrupts:
    description:
      Interrupt for signaling the completion of conversion results. The active
      low signal provided on the BUSY pin asserts when ADC conversions finish.
    maxItems: 1

required:
  - compatible
  - reg
  - vdd-supply
  - ovdd-supply

allOf:
  # Except for LTC2338, all designs require a voltage reference input
  - if:
      properties:
        compatible:
          not:
            contains:
              enum:
                - adi,ltc2338-18
    then:
      required:
        - ref-supply
      properties:
        refin-supply: false
    else:
      properties:
        ref-supply: false

unevaluatedProperties: false

examples:
  - |
    #include <dt-bindings/gpio/gpio.h>
    #include <dt-bindings/interrupt-controller/irq.h>
    spi {
        #address-cells = <1>;
        #size-cells = <0>;
        adc@0 {
            compatible = "adi,ltc2378-20", "adi,ltc2376-20";
            reg = <0>;
            spi-max-frequency = <71000000>;
            vdd-supply = <&supply_2_5V>;
            ovdd-supply = <&supply_3_3V>;
            ref-supply = <&supply_5V>;
            cnv-gpios = <&gpio0 88 GPIO_ACTIVE_HIGH>;
            interrupts = <7 IRQ_TYPE_EDGE_FALLING>;
            interrupt-parent = <&gpio>;
        };
    };
```

## Documentation/devicetree/bindings/iio/adc/adi,max40080.yaml
```yaml
# SPDX-License-Identifier: (GPL-2.0 OR BSD-2-Clause)
%YAML 1.2
---
$id: http://devicetree.org/schemas/iio/adc/adi,max40080.yaml#
$schema: http://devicetree.org/meta-schemas/core.yaml#

title: Analog Devices MAX40080 bidirectional current-sense amplifier

maintainers:
  - Ciprian Hegbeli <ciprian.hegbeli@analog.com>
  - Stefan Popa <stefan.popa@analog.com>

description: |
  The MAX40080 is a high-precision, bidirectional current-sense amplifier with
  an integrated 12-bit ADC and an I2C/SMBus interface. It measures the voltage
  across an external shunt resistor and the input bus voltage, and stores the
  results in an internal FIFO.

  Datasheet:
    https://www.analog.com/max40080

properties:
  compatible:
    const: adi,max40080

  reg:
    maxItems: 1

  "#io-channel-cells":
    const: 1

  vdd-supply:
    description: Power supply for the device.

  interrupts:
    maxItems: 1
    description: ALERT_ output for overcurrent/undervoltage threshold events.

  shunt-resistor-micro-ohms:
    description:
      Value of the current-sense shunt resistor connected between the RS+ and
      RS- inputs. Used to scale the reported current.

required:
  - compatible
  - reg
  - shunt-resistor-micro-ohms
  - vdd-supply

additionalProperties: false

examples:
  - |
    i2c {
        #address-cells = <1>;
        #size-cells = <0>;

        adc@20 {
            compatible = "adi,max40080";
            reg = <0x20>;
            #io-channel-cells = <1>;
            vdd-supply = <&vdd>;
            shunt-resistor-micro-ohms = <100000>;
        };
    };
```
