## Documentation/devicetree/bindings/iio/adc/axiado,ax3000-saradc.yaml
```yaml
# SPDX-License-Identifier: (GPL-2.0-only OR BSD-2-Clause)
%YAML 1.2
---
$id: http://devicetree.org/schemas/iio/adc/axiado,ax3000-saradc.yaml#
$schema: http://devicetree.org/meta-schemas/core.yaml#

title: Axiado AX3000/AX3005 Successive Approximation Register ADC

description:
  The Axiado AX3000/AX3005 SAR ADC is a 10-bit ADC with sixteen input
  channels on AX3000 and eight input channels on AX3005.

maintainers:
  - Petar Stepanovic <pstepanovic@axiado.com>
  - Akhila Kavi <akavi@axiado.com>
  - Prasad Bolisetty <pbolisetty@axiado.com>

properties:
  compatible:
    enum:
      - axiado,ax3000-saradc
      - axiado,ax3005-saradc

  reg:
    maxItems: 1

  clocks:
    maxItems: 1

  clock-names:
    const: saradc

  '#io-channel-cells':
    const: 1

  vref-supply:
    description: Reference voltage regulator supplying the ADC

required:
  - compatible
  - reg
  - clocks
  - clock-names
  - '#io-channel-cells'
  - vref-supply

additionalProperties: false

examples:
  - |
    soc {
      #address-cells = <2>;
      #size-cells = <2>;

      adc@806a0000 {
        compatible = "axiado,ax3000-saradc";
        reg = <0x0 0x806a0000 0x0 0x400>;
        clocks = <&pclk>;
        clock-names = "saradc";
        vref-supply = <&vref_reg>;
        #io-channel-cells = <1>;
      };
    };
```

## Documentation/devicetree/bindings/iio/adc/ti,ads1100.yaml
```yaml
# SPDX-License-Identifier: (GPL-2.0 OR BSD-2-Clause)
%YAML 1.2
---
$id: http://devicetree.org/schemas/iio/adc/ti,ads1100.yaml#
$schema: http://devicetree.org/meta-schemas/core.yaml#

title: TI ADS1100 and similar single channel I2C Analog to Digital Converters

maintainers:
  - Mike Looijmans <mike.looijmans@topic.nl>

description: |
  Datasheets:
    - https://www.ti.com/lit/gpn/ads1000
    - https://www.ti.com/lit/gpn/ads1100
    - https://www.ti.com/lit/gpn/ads1110

properties:
  compatible:
    enum:
      - ti,ads1000
      - ti,ads1100
      - ti,ads1110

  reg:
    maxItems: 1

  vdd-supply: true

  "#io-channel-cells":
    const: 0

required:
  - compatible
  - reg

additionalProperties: false

examples:
  - |
    i2c {
        #address-cells = <1>;
        #size-cells = <0>;

        adc@49 {
            compatible = "ti,ads1100";
            reg = <0x49>;
        };
    };
...
```

## Documentation/devicetree/bindings/iio/adc/ti,ads112c04.yaml
```yaml
# SPDX-License-Identifier: (GPL-2.0-only OR BSD-2-Clause)
%YAML 1.2
---
$id: http://devicetree.org/schemas/iio/adc/ti,ads112c04.yaml#
$schema: http://devicetree.org/meta-schemas/core.yaml#

title: Texas Instruments ADS112C04 ADC

maintainers:
  - Kyle Hsieh <kylehsieh1995@gmail.com>

description:
  The ADS112C04 (16-bit) are precision analog-to-digital converters (ADCs)
  with an I2C interface. They feature a flexible input multiplexer, a
  low-noise programmable gain amplifier (PGA), two programmable excitation
  current sources, a voltage reference, and a precision temperature sensor.

properties:
  compatible:
    enum:
      - ti,ads112c04

  reg:
    maxItems: 1
    description: I2C address of the device.

  interrupts:
    maxItems: 1
    description:
      Data ready (DRDY) interrupt output. DRDY pulses low when a conversion
      result is ready and returns high once the result is latched, so an
      edge trigger should be used.

  "#address-cells":
    const: 1

  "#size-cells":
    const: 0

  reset-gpios:
    maxItems: 1
    description: GPIO connected to the RESET pin. Active low.

  avdd-supply: true
  dvdd-supply: true

  refp-supply: true
  refn-supply: true

  ti,refp-refn-resistor-ohms:
    description: Resistance of the external resistor between REFP and REFN.

patternProperties:
  "^channel@[0-9a-b]$":
    $ref: adc.yaml
    unevaluatedProperties: false
    properties:
      reg:
        items:
          - maximum: 11

      single-channel:
        maximum: 3

      diff-channels:
        items:
          maximum: 3

      excitation-channels:
        maxItems: 2
        items:
          maximum: 5
        description:
          Additionally to AIN0-AIN3, IDAC1/IDAC2 can also be routed to
          REFP0 (4) and REFN0 (5).

      excitation-current-nanoamp:
        enum: [10000, 50000, 100000, 250000, 500000, 1000000, 1500000]

      burn-out-current-nanoamp:
        const: 10000

      reference-sources:
        items:
          - enum: [internal, external, avdd]
        default: [ internal ]

    dependencies:
      excitation-channels: [ excitation-current-nanoamp ]
      excitation-current-nanoamp: [ excitation-channels ]

    oneOf:
      - required: [ single-channel ]
      - required: [ diff-channels ]

required:
  - compatible
  - reg
  - avdd-supply
  - dvdd-supply

dependencies:
  refn-supply: [ refp-supply ]

oneOf:
  - required:
      - refp-supply
  - required:
      - ti,refp-refn-resistor-ohms
  - properties:
      refp-supply: false
      refn-supply: false
      ti,refp-refn-resistor-ohms: false

unevaluatedProperties: false

examples:
  - |
    #include <dt-bindings/interrupt-controller/irq.h>
    #include <dt-bindings/gpio/gpio.h>
    i2c {
        #address-cells = <1>;
        #size-cells = <0>;

        adc@40 {
            compatible = "ti,ads112c04";
            reg = <0x40>;
            interrupt-parent = <&gpio>;
            interrupts = <12 IRQ_TYPE_EDGE_FALLING>;

            reset-gpios = <&gpio 13 GPIO_ACTIVE_LOW>;
            avdd-supply = <&vdd_3v3_reg>;
            dvdd-supply = <&vdd_3v3_reg>;
            refp-supply = <&vref_reg>;

            #address-cells = <1>;
            #size-cells = <0>;

            channel@0 {
                reg = <0>;
                diff-channels = <0>, <1>;
            };

            channel@1 {
                reg = <1>;
                single-channel = <2>;
            };
        };
    };
```

## Documentation/devicetree/bindings/iio/adc/ti,ads112c14.yaml
```yaml
# SPDX-License-Identifier: (GPL-2.0-only OR BSD-2-Clause)
%YAML 1.2
---
$id: http://devicetree.org/schemas/iio/adc/ti,ads112c14.yaml#
$schema: http://devicetree.org/meta-schemas/core.yaml#

title: Texas Instruments' ADS112C14 and similar ADC chips

description: |
  Supports the following Texas Instruments' ADC chips:
  - ADS112C14 (16-bit)
  - ADS122C14 (24-bit)

  https://www.ti.com/lit/ds/symlink/ads122c14.pdf

  These chips are primarily designed for use with resistive sensors such as
  RTDs, thermocouples, Wheatstone bridges, etc. The channel bindings reflect
  this in that each channel represents the conditions required to make a
  measurement rather than strictly just the physical input channels.

maintainers:
  - David Lechner <dlechner@baylibre.com>

properties:
  compatible:
    enum:
      - ti,ads112c14
      - ti,ads122c14

  reg:
    items:
      - minimum: 0x40
        maximum: 0x47

  clocks:
    maxItems: 1
    description: Optional external clock connected to GPIO3 pin.

  avdd-supply: true
  dvdd-supply: true

  refp-supply: true
  refn-supply: true

  ti,refp-refn-resistor-ohms:
    description:
      The resistance of the external resistor between REFP and REFN when using
      resistor bridge driven by current outputs for RTD measurements.

  interrupts:
    minItems: 1
    items:
      - description: /FAULT interrupt (GPIO2 pin)
      - description: /DRDY interrupt (GPIO3 pin)

  interrupt-names:
    minItems: 1
    maxItems: 2
    items:
      enum: [fault, drdy]

  gpio-controller: true
  '#gpio-cells':
    const: 2

  '#address-cells':
    const: 1

  '#size-cells':
    const: 0

patternProperties:
  ^channel@[0-9a-f]$:
    $ref: adc.yaml

    unevaluatedProperties: false

    properties:
      reg:
        items:
          - maximum: 15 # arbitrary limit, channel@ can be any combination of AIN0-AIN7

      single-channel:
        maximum: 7

      diff-channels:
        items:
          maximum: 7

      bipolar: true

      input-chopping: true

      excitation-channels:
        maxItems: 2
        items:
          maximum: 7

      excitation-current-nanoamp:
        maxItems: 2
        items:
          enum: [1000, 10000, 20000, 30000, 40000, 50000, 60000, 70000, 80000,
                 90000, 100000, 200000, 300000, 400000, 500000, 600000, 700000,
                 800000, 900000, 1000000]

      burn-out-current-nanoamp:
        items:
          - enum: [200, 1000, 10000]

      reference-sources:
        items:
          - enum: [internal-2.5v, internal-1.25v, external, avdd]
            default: internal-2.5v

    dependencies:
      excitation-channels: [ excitation-current-nanoamp ]
      excitation-current-nanoamp: [ excitation-channels ]

    oneOf:
      - required: [ single-channel ]
      - required: [ diff-channels ]

unevaluatedProperties: false

required:
  - compatible
  - reg
  - avdd-supply
  - dvdd-supply

dependencies:
  refn-supply: [ refp-supply ]

oneOf:
  - required: [ refp-supply ]
  - required: [ "ti,refp-refn-resistor-ohms" ]
  - properties:
      refp-supply: false
      refn-supply: false
      ti,refp-refn-resistor-ohms: false

# /DRDY out and CLK in use the same AIN7/GPIO3 pin.
if:
  required:
    - interrupt-names
  properties:
    interrupt-names:
      contains:
        const: drdy
then:
  properties:
    clocks: false

examples:
  - |
    i2c {
        #address-cells = <1>;
        #size-cells = <0>;

        adc@40 {
            compatible = "ti,ads112c14";
            reg = <0x40>;

            avdd-supply = <&avdd>;
            dvdd-supply = <&dvdd>;

            /* 3-Wire RTD: Two IDACs, One Measurement (AIN1-AIN2) */

            ti,refp-refn-resistor-ohms = <500>;

            #address-cells = <1>;
            #size-cells = <0>;

            channel@0 {
                reg = <0>;
                diff-channels = <1>, <2>;
                input-chopping;
                excitation-channels = <0>, <3>;
                excitation-current-nanoamp = <500000>, <500000>;
                reference-sources = "external";
                label = "rtd";
            };
        };
    };
  - |
    i2c {
        #address-cells = <1>;
        #size-cells = <0>;

        adc@40 {
            compatible = "ti,ads112c14";
            reg = <0x40>;

            avdd-supply = <&avdd>;
            dvdd-supply = <&dvdd>;

            /* Resistive Bridge Measurement With a Thermistor for Temperature Compensation */

            refp-supply = <&avdd>;

            #address-cells = <1>;
            #size-cells = <0>;

            channel@0 {
                reg = <0>;
                diff-channels = <6>, <7>;
                bipolar;
                reference-sources = "external";
                label = "bridge";
            };

            channel@1 {
                reg = <1>;
                diff-channels = <1>, <2>;
                reference-sources = "internal-2.5v";
                label = "thermistor";
            };
        };
    };
```
