## Documentation/devicetree/bindings/hwmon/ibm,cffps1.txt
```
Device-tree bindings for IBM Common Form Factor Power Supply Versions 1 and 2
-----------------------------------------------------------------------------

Required properties:
 - compatible				: Must be one of the following:
						"ibm,cffps1"
						"ibm,cffps2"
						or "ibm,cffps" if the system
						must support any version of the
						power supply
 - reg = < I2C bus address >;		: Address of the power supply on the
					  I2C bus.

Example:

    i2c-bus@100 {
        #address-cells = <1>;
        #size-cells = <0>;
        #interrupt-cells = <1>;
        < more properties >

        power-supply@68 {
            compatible = "ibm,cffps1";
            reg = <0x68>;
        };
    };
```

## Documentation/devicetree/bindings/hwmon/ibm,occ-hwmon.yaml
```yaml
# SPDX-License-Identifier: GPL-2.0-only OR BSD-2-Clause
%YAML 1.2
---
$id: http://devicetree.org/schemas/hwmon/ibm,occ-hwmon.yaml#
$schema: http://devicetree.org/meta-schemas/core.yaml#

title: IBM On-Chip Controller (OCC) accessed from a service processor

maintainers:
  - Eddie James <eajames@linux.ibm.com>

description: |
  The POWER processor On-Chip Controller (OCC) helps manage power and
  thermals for the system. A service processor or baseboard management
  controller can query the OCC for it's power and thermal data to report
  through hwmon.

properties:
  compatible:
    enum:
      - ibm,p9-occ-hwmon
      - ibm,p10-occ-hwmon

  ibm,no-poll-on-init:
    description: This property describes whether or not the OCC should
      be polled during driver initialization.
    type: boolean

required:
  - compatible

additionalProperties: false

examples:
  - |
    hwmon {
        compatible = "ibm,p10-occ-hwmon";
        ibm,no-poll-on-init;
    };
```

## Documentation/devicetree/bindings/hwmon/ibm,opal-sensor.yaml
```yaml
# SPDX-License-Identifier: GPL-2.0-only OR BSD-2-Clause
%YAML 1.2
---
$id: http://devicetree.org/schemas/hwmon/ibm,opal-sensor.yaml#
$schema: http://devicetree.org/meta-schemas/core.yaml#

title: IBM POWERNV platform sensors

maintainers:
  - Javier Carrasco <javier.carrasco.cruz@gmail.com>

properties:
  compatible:
    enum:
      - ibm,opal-sensor-cooling-fan
      - ibm,opal-sensor-amb-temp
      - ibm,opal-sensor-power-supply
      - ibm,opal-sensor-power

  sensor-id:
    description:
      An opaque id provided by the firmware to the kernel, identifies a
      given sensor and its attribute data.
    $ref: /schemas/types.yaml#/definitions/uint32

required:
  - compatible
  - sensor-id

additionalProperties: false

examples:
  - |
    sensor {
        compatible = "ibm,opal-sensor-cooling-fan";
        sensor-id = <0x7052107>;
    };
```

## Documentation/devicetree/bindings/hwmon/ibm,p8-occ-hwmon.txt
```
Device-tree bindings for I2C-based On-Chip Controller hwmon device
------------------------------------------------------------------

Required properties:
 - compatible = "ibm,p8-occ-hwmon";
 - reg = <I2C address>;			: I2C bus address

Examples:

    i2c-bus@100 {
        #address-cells = <1>;
        #size-cells = <0>;
        clock-frequency = <100000>;
        < more properties >

        occ-hwmon@1 {
            compatible = "ibm,p8-occ-hwmon";
            reg = <0x50>;
        };

        occ-hwmon@2 {
            compatible = "ibm,p8-occ-hwmon";
            reg = <0x51>;
        };
    };
```

## Documentation/devicetree/bindings/hwmon/ibmpowernv.txt
```
IBM POWERNV platform sensors
----------------------------

Required node properties:
- compatible: must be one of
		"ibm,opal-sensor-cooling-fan"
		"ibm,opal-sensor-amb-temp"
		"ibm,opal-sensor-power-supply"
		"ibm,opal-sensor-power"
- sensor-id: an opaque id provided by the firmware to the kernel, identifies a
	     given sensor and its attribute data

Example sensors node:

cooling-fan#8-data {
	sensor-id = <0x7052107>;
	compatible = "ibm,opal-sensor-cooling-fan";
};

amb-temp#1-thrs {
	sensor-id = <0x5096000>;
	compatible = "ibm,opal-sensor-amb-temp";
};
```

## Documentation/devicetree/bindings/hwmon/iei,wt61p803-puzzle-hwmon.yaml
```yaml
# SPDX-License-Identifier: GPL-2.0-only OR BSD-2-Clause
%YAML 1.2
---
$id: http://devicetree.org/schemas/hwmon/iei,wt61p803-puzzle-hwmon.yaml#
$schema: http://devicetree.org/meta-schemas/core.yaml#

title: IEI WT61P803 PUZZLE MCU HWMON module from IEI Integration Corp.

maintainers:
  - Luka Kovacic <luka.kovacic@sartura.hr>

description: |
  This module is a part of the IEI WT61P803 PUZZLE MFD device. For more details
  see Documentation/devicetree/bindings/mfd/iei,wt61p803-puzzle.yaml.

  The HWMON module is a sub-node of the MCU node in the Device Tree.

properties:
  compatible:
    const: iei,wt61p803-puzzle-hwmon

  '#address-cells':
    const: 1

  '#size-cells':
    const: 0

patternProperties:
  '^fan-group@[0-1]$':
    type: object
    additionalProperties: false

    properties:
      reg:
        minimum: 0
        maximum: 1
        description:
          Fan group ID

      '#cooling-cells':
        const: 2

      cooling-levels:
        minItems: 1
        maxItems: 255
        description:
          Cooling levels for the fans (PWM value mapping)

    required:
      - reg
      - '#cooling-cells'
      - cooling-levels

required:
  - compatible
  - '#address-cells'
  - '#size-cells'

additionalProperties: false
```

## Documentation/devicetree/bindings/hwmon/iio-hwmon.yaml
```yaml
# SPDX-License-Identifier: (GPL-2.0 OR BSD-2-Clause)
%YAML 1.2
---
$id: "http://devicetree.org/schemas/hwmon/iio-hwmon.yaml#"
$schema: "http://devicetree.org/meta-schemas/core.yaml#"

title: ADC-attached Hardware Sensor

maintainers:
  - Jonathan Cameron <jic23@kernel.org>

description: >
  Bindings for hardware monitoring devices connected to ADC controllers
  supporting the Industrial I/O bindings.

properties:
  compatible:
    const: iio-hwmon

  io-channels:
    minItems: 1
    maxItems: 8 # Should be enough
    description: >
      List of phandles to ADC channels to read the monitoring values

required:
  - compatible
  - io-channels

additionalProperties: false

examples:
  - |
      iio-hwmon {
          compatible = "iio-hwmon";
          io-channels = <&adc 1>, <&adc 2>;
      };
```

## Documentation/devicetree/bindings/hwmon/ina209.txt
```
ina209 properties

Required properties:
- compatible: Must be "ti,ina209"
- reg: I2C address

Optional properties:

- shunt-resistor
	Shunt resistor value in micro-Ohm

Example:

temp-sensor@4c {
	compatible = "ti,ina209";
	reg = <0x4c>;
	shunt-resistor = <5000>;
};
```

## Documentation/devicetree/bindings/hwmon/ina2xx.txt
```
ina2xx properties

Required properties:
- compatible: Must be one of the following:
	- "ti,ina209" for ina209
	- "ti,ina219" for ina219
	- "ti,ina220" for ina220
	- "ti,ina226" for ina226
	- "ti,ina230" for ina230
	- "ti,ina231" for ina231
- reg: I2C address

Optional properties:

- shunt-resistor
	Shunt resistor value in micro-Ohm

Example:

ina220@44 {
	compatible = "ti,ina220";
	reg = <0x44>;
	shunt-resistor = <1000>;
};
```

## Documentation/devicetree/bindings/hwmon/ina3221.txt
```
Texas Instruments INA3221 Device Tree Bindings

1) ina3221 node
  Required properties:
  - compatible: Must be "ti,ina3221"
  - reg: I2C address

  Optional properties:
  - ti,single-shot: This chip has two power modes: single-shot (chip takes one
                    measurement and then shuts itself down) and continuous (
                    chip takes continuous measurements). The continuous mode is
                    more reliable and suitable for hardware monitor type device,
                    but the single-shot mode is more power-friendly and useful
                    for battery-powered device which cares power consumptions
                    while still needs some measurements occasionally.
                    If this property is present, the single-shot mode will be
                    used, instead of the default continuous one for monitoring.

  = The node contains optional child nodes for three channels =
  = Each child node describes the information of input source =

  - #address-cells: Required only if a child node is present. Must be 1.
  - #size-cells: Required only if a child node is present. Must be 0.

2) child nodes
  Required properties:
  - reg: Must be 0, 1 or 2, corresponding to IN1, IN2 or IN3 port of INA3221

  Optional properties:
  - label: Name of the input source
  - shunt-resistor-micro-ohms: Shunt resistor value in micro-Ohm

Example:

ina3221@40 {
	compatible = "ti,ina3221";
	reg = <0x40>;
	#address-cells = <1>;
	#size-cells = <0>;

	input@0 {
		reg = <0x0>;
		status = "disabled";
	};
	input@1 {
		reg = <0x1>;
		shunt-resistor-micro-ohms = <5000>;
	};
	input@2 {
		reg = <0x2>;
		label = "VDD_5V";
		shunt-resistor-micro-ohms = <5000>;
	};
};
```

## Documentation/devicetree/bindings/hwmon/jc42.txt
```
Properties for Jedec JC-42.4 compatible temperature sensors

Required properties:
- compatible: May include a device-specific string consisting of the
	      manufacturer and the name of the chip. A list of supported
	      chip names follows.
	      Must include "jedec,jc-42.4-temp" for any Jedec JC-42.4
	      compatible temperature sensor.

	      Supported chip names:
		adi,adt7408
		atmel,at30ts00
		atmel,at30tse004
		onnn,cat6095
		onnn,cat34ts02
		maxim,max6604
		microchip,mcp9804
		microchip,mcp9805
		microchip,mcp9808
		microchip,mcp98243
		microchip,mcp98244
		microchip,mcp9843
		nxp,se97
		nxp,se98
		st,stts2002
		st,stts2004
		st,stts3000
		st,stts424
		st,stts424e
		idt,tse2002
		idt,tse2004
		idt,ts3000
		idt,ts3001

- reg: I2C address

Example:

temp-sensor@1a {
	compatible = "jedec,jc-42.4-temp";
	reg = <0x1a>;
};
```

## Documentation/devicetree/bindings/hwmon/jedec,jc42.yaml
```yaml
# SPDX-License-Identifier: GPL-2.0-only OR BSD-2-Clause
%YAML 1.2
---
$id: http://devicetree.org/schemas/hwmon/jedec,jc42.yaml#
$schema: http://devicetree.org/meta-schemas/core.yaml#

title: Jedec JC-42.4 compatible temperature sensors

maintainers:
  - Jean Delvare <jdelvare@suse.com>
  - Guenter Roeck <linux@roeck-us.net>

select:
  properties:
    compatible:
      const: jedec,jc-42.4-temp

  required:
    - compatible

properties:
  compatible:
    oneOf:
      - const: jedec,jc-42.4-temp
      - items:
          - enum:
              - adi,adt7408
              - atmel,at30ts00
              - atmel,at30tse004
              - idt,tse2002
              - idt,tse2004
              - idt,ts3000
              - idt,ts3001
              - maxim,max6604
              - microchip,mcp9804
              - microchip,mcp9805
              - microchip,mcp9808
              - microchip,mcp98243
              - microchip,mcp98244
              - microchip,mcp9843
              - nxp,se97
              - nxp,se97b
              - nxp,se98
              - onnn,cat6095
              - onnn,cat34ts02
              - st,stts2002
              - st,stts2004
              - st,stts3000
              - st,stts424
              - st,stts424e
          - const: jedec,jc-42.4-temp

  reg:
    maxItems: 1

  smbus-timeout-disable:
    description: |
      When set, the smbus timeout function will be disabled. This is not
      supported on all chips.
    type: boolean

required:
  - compatible
  - reg

additionalProperties: false

examples:
  - |
    i2c {
        #address-cells = <1>;
        #size-cells = <0>;

        temp-sensor@1a {
            compatible = "jedec,jc-42.4-temp";
            reg = <0x1a>;
        };
    };
```

## Documentation/devicetree/bindings/hwmon/kontron,sl28cpld-hwmon.yaml
```yaml
# SPDX-License-Identifier: (GPL-2.0-only OR BSD-2-Clause)
%YAML 1.2
---
$id: http://devicetree.org/schemas/hwmon/kontron,sl28cpld-hwmon.yaml#
$schema: http://devicetree.org/meta-schemas/core.yaml#

title: Hardware monitoring driver for the sl28cpld board management controller

maintainers:
  - Michael Walle <michael@walle.cc>

description: |
  This module is part of the sl28cpld multi-function device. For more
  details see ../embedded-controller/kontron,sl28cpld.yaml.

properties:
  compatible:
    enum:
      - kontron,sa67mcu-hwmon
      - kontron,sl28cpld-fan

  reg:
    maxItems: 1

required:
  - compatible

additionalProperties: false
```

## Documentation/devicetree/bindings/hwmon/lantiq,cputemp.yaml
```yaml
# SPDX-License-Identifier: GPL-2.0-only OR BSD-2-Clause
%YAML 1.2
---
$id: http://devicetree.org/schemas/hwmon/lantiq,cputemp.yaml#
$schema: http://devicetree.org/meta-schemas/core.yaml#

title: Lantiq cpu temperature sensor

maintainers:
  - Florian Eckert <fe@dev.tdt.de>

properties:
  compatible:
    const: lantiq,cputemp

  reg:
    maxItems: 1

required:
  - compatible
  - reg

additionalProperties: false

examples:
  - |
    cputemp@103040 {
        compatible = "lantiq,cputemp";
        reg = <0x103040 0x4>;
    };
```

## Documentation/devicetree/bindings/hwmon/lltc,ltc2978.yaml
```yaml
# SPDX-License-Identifier: (GPL-2.0-only OR BSD-2-Clause)
%YAML 1.2
---
$id: http://devicetree.org/schemas/hwmon/lltc,ltc2978.yaml#
$schema: http://devicetree.org/meta-schemas/core.yaml#

title: Octal Digital Power-supply monitor/supervisor/sequencer/margin controller.

maintainers:
  - Frank Li <Frank.Li@nxp.com>

properties:
  compatible:
    enum:
      - lltc,lt7170
      - lltc,lt7171
      - lltc,ltc2972
      - lltc,ltc2974
      - lltc,ltc2975
      - lltc,ltc2977
      - lltc,ltc2978
      - lltc,ltc2979
      - lltc,ltc2980
      - lltc,ltc3880
      - lltc,ltc3882
      - lltc,ltc3883
      - lltc,ltc3884
      - lltc,ltc3886
      - lltc,ltc3887
      - lltc,ltc3889
      - lltc,ltc7841
      - lltc,ltc7880
      - lltc,ltm2987
      - lltc,ltm4664
      - lltc,ltm4673
      - lltc,ltm4675
      - lltc,ltm4676
      - lltc,ltm4677
      - lltc,ltm4678
      - lltc,ltm4680
      - lltc,ltm4686
      - lltc,ltm4700

  reg:
    maxItems: 1

  regulators:
    type: object
    description: |
      list of regulators provided by this controller.
      Valid names of regulators depend on number of supplies supported per device:
      * lt7170, lt7171 : vout0
      * ltc2972 vout0 - vout1
      * ltc2974, ltc2975 : vout0 - vout3
      * ltc2977, ltc2979, ltc2980, ltm2987 : vout0 - vout7
      * ltc2978 : vout0 - vout7
      * ltc3880, ltc3882, ltc3884, ltc3886, ltc3887, ltc3889 : vout0 - vout1
      * ltc7841 : vout0
      * ltc7880 : vout0 - vout1
      * ltc3883 : vout0
      * ltm4664 : vout0 - vout1
      * ltm4673 : vout0 - vout3
      * ltm4675, ltm4676, ltm4677, ltm4678 : vout0 - vout1
      * ltm4680, ltm4686 : vout0 - vout1
      * ltm4700 : vout0 - vout1

    patternProperties:
      "^vout[0-7]$":
        $ref: /schemas/regulator/regulator.yaml#
        type: object
        unevaluatedProperties: false

    additionalProperties: false

required:
  - compatible
  - reg

additionalProperties: false

examples:
  - |
    i2c {
        #address-cells = <1>;
        #size-cells = <0>;

        regulator@5e {
            compatible = "lltc,ltc2978";
            reg = <0x5e>;

            regulators {
                vout0 {
                     regulator-name = "FPGA-2.5V";
                };
                vout2 {
                     regulator-name = "FPGA-1.5V";
                };
            };
        };
    };
```
