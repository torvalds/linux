## Documentation/devicetree/bindings/hwmon/lltc,ltc4151.yaml
```yaml
# SPDX-License-Identifier: GPL-2.0-only OR BSD-2-Clause
%YAML 1.2
---
$id: http://devicetree.org/schemas/hwmon/lltc,ltc4151.yaml#
$schema: http://devicetree.org/meta-schemas/core.yaml#

title: LTC4151 High Voltage I2C Current and Voltage Monitor

maintainers:
  - Krzysztof Kozlowski <krzk@kernel.org>

properties:
  compatible:
    const: lltc,ltc4151

  reg:
    maxItems: 1

  shunt-resistor-micro-ohms:
    description:
      Shunt resistor value in micro-Ohms
    default: 1000

required:
  - compatible
  - reg

allOf:
  - $ref: hwmon-common.yaml#

unevaluatedProperties: false

examples:
  - |
    i2c {
        #address-cells = <1>;
        #size-cells = <0>;

        sensor@6e {
            compatible = "lltc,ltc4151";
            reg = <0x6e>;
            shunt-resistor-micro-ohms = <1500>;
        };
    };
```

## Documentation/devicetree/bindings/hwmon/lltc,ltc4286.yaml
```yaml
# SPDX-License-Identifier: (GPL-2.0-only OR BSD-2-Clause)
%YAML 1.2
---
$id: http://devicetree.org/schemas/hwmon/lltc,ltc4286.yaml#
$schema: http://devicetree.org/meta-schemas/core.yaml#

title: LTC4286 power monitors

maintainers:
  - Delphine CC Chiu <Delphine_CC_Chiu@Wiwynn.com>

properties:
  compatible:
    enum:
      - lltc,ltc4286
      - lltc,ltc4287

  reg:
    maxItems: 1

  adi,vrange-low-enable:
    description:
      This property is a bool parameter to represent the
      voltage range is 25.6 volts or 102.4 volts for this chip.
      The default is 102.4 volts.
    type: boolean

required:
  - compatible
  - reg

allOf:
  - $ref: hwmon-common.yaml#

unevaluatedProperties: false

examples:
  - |
    i2c {
        #address-cells = <1>;
        #size-cells = <0>;

        power-monitor@40 {
            compatible = "lltc,ltc4286";
            reg = <0x40>;
            adi,vrange-low-enable;
            shunt-resistor-micro-ohms = <300>;
        };
    };
```

## Documentation/devicetree/bindings/hwmon/lm70.txt
```
* LM70/TMP121/LM71/LM74 thermometer.

Required properties:
- compatible: one of
		"ti,lm70"
		"ti,tmp121"
		"ti,lm71"
		"ti,lm74"

See Documentation/devicetree/bindings/spi/spi-bus.txt for more required and
optional properties.

Example:

spi_master {
	temperature-sensor@0 {
		compatible = "ti,lm70";
		reg = <0>;
		spi-max-frequency = <1000000>;
	};
};
```

## Documentation/devicetree/bindings/hwmon/lm75.txt
```
*LM75 hwmon sensor.

Required properties:
- compatible: manufacturer and chip name, one of
		"adi,adt75",
		"dallas,ds1775",
		"dallas,ds75",
		"dallas,ds7505",
		"gmt,g751",
		"national,lm75",
		"national,lm75a",
		"national,lm75b",
		"maxim,max6625",
		"maxim,max6626",
		"maxim,max31725",
		"maxim,max31726",
		"maxim,mcp980x",
		"st,stds75",
		"st,stlm75",
		"microchip,tcn75",
		"ti,tmp100",
		"ti,tmp101",
		"ti,tmp105",
		"ti,tmp112",
		"ti,tmp175",
		"ti,tmp275",
		"ti,tmp75",
		"ti,tmp75b",
		"ti,tmp75c",

- reg: I2C bus address of the device

Example:

sensor@48 {
	compatible = "st,stlm75";
	reg = <0x48>;
};
```

## Documentation/devicetree/bindings/hwmon/lm75.yaml
```yaml
# SPDX-License-Identifier: GPL-2.0-only or BSD-2-Clause
%YAML 1.2
---
$id: http://devicetree.org/schemas/hwmon/lm75.yaml#
$schema: http://devicetree.org/meta-schemas/core.yaml#

title: LM75 hwmon sensor

maintainers:
  - Jean Delvare <jdelvare@suse.com>
  - Guenter Roeck <linux@roeck-us.net>

properties:
  compatible:
    enum:
      - adi,adt75
      - dallas,ds1775
      - dallas,ds75
      - dallas,ds7505
      - gmt,g751
      - national,lm75
      - national,lm75a
      - national,lm75b
      - maxim,max6625
      - maxim,max6626
      - maxim,max31725
      - maxim,max31726
      - maxim,mcp980x
      - nxp,pct2075
      - st,stds75
      - st,stlm75
      - microchip,tcn75
      - ti,tmp100
      - ti,tmp101
      - ti,tmp105
      - ti,tmp112
      - ti,tmp175
      - ti,tmp275
      - ti,tmp75
      - ti,tmp75b
      - ti,tmp75c

  reg:
    maxItems: 1

  vs-supply:
    description: phandle to the regulator that provides the +VS supply

required:
  - compatible
  - reg

additionalProperties: false

examples:
  - |
    i2c {
      #address-cells = <1>;
      #size-cells = <0>;

      sensor@48 {
        compatible = "st,stlm75";
        reg = <0x48>;
        vs-supply = <&vs>;
      };
    };
```

## Documentation/devicetree/bindings/hwmon/lm87.txt
```
*LM87 hwmon sensor.

Required properties:
- compatible: Should be
	"ti,lm87"

- reg: I2C address

optional properties:
- has-temp3: This configures pins 18 and 19 to be used as a second
             remote temperature sensing channel. By default the pins
             are configured as voltage input pins in0 and in5.

- has-in6: When set, pin 5 is configured to be used as voltage input
           in6. Otherwise the pin is set as FAN1 input.

- has-in7: When set, pin 6 is configured to be used as voltage input
           in7. Otherwise the pin is set as FAN2 input.

- vcc-supply: a Phandle for the regulator supplying power, can be
              cofigured to measure 5.0V power supply. Default is 3.3V.

Example:

lm87@2e {
	compatible = "ti,lm87";
	reg = <0x2e>;
	has-temp3;
	vcc-supply = <&reg_5v0>;
};
```

## Documentation/devicetree/bindings/hwmon/lm90.txt
```
* LM90 series thermometer.

Required node properties:
- compatible: manufacturer and chip name, one of
		"adi,adm1032"
		"adi,adt7461"
		"adi,adt7461a"
		"gmt,g781"
		"national,lm90"
		"national,lm86"
		"national,lm89"
		"national,lm99"
		"dallas,max6646"
		"dallas,max6647"
		"dallas,max6649"
		"dallas,max6657"
		"dallas,max6658"
		"dallas,max6659"
		"dallas,max6680"
		"dallas,max6681"
		"dallas,max6695"
		"dallas,max6696"
		"onnn,nct1008"
		"winbond,w83l771"
		"nxp,sa56004"

- reg: I2C bus address of the device

- vcc-supply: vcc regulator for the supply voltage.

Optional properties:
- interrupts: Contains a single interrupt specifier which describes the
              LM90 "-ALERT" pin output.
              See interrupt-controller/interrupts.txt for the format.

Example LM90 node:

temp-sensor {
	compatible = "onnn,nct1008";
	reg = <0x4c>;
	vcc-supply = <&palmas_ldo6_reg>;
	interrupt-parent = <&gpio>;
	interrupts = <TEGRA_GPIO(O, 4) IRQ_TYPE_LEVEL_LOW>;
}
```

## Documentation/devicetree/bindings/hwmon/ltc2978.txt
```
ltc2978

Required properties:
- compatible: should contain one of:
  * "lltc,ltc2972"
  * "lltc,ltc2974"
  * "lltc,ltc2975"
  * "lltc,ltc2977"
  * "lltc,ltc2978"
  * "lltc,ltc2979"
  * "lltc,ltc2980"
  * "lltc,ltc3880"
  * "lltc,ltc3882"
  * "lltc,ltc3883"
  * "lltc,ltc3884"
  * "lltc,ltc3886"
  * "lltc,ltc3887"
  * "lltc,ltc3889"
  * "lltc,ltc7880"
  * "lltc,ltm2987"
  * "lltc,ltm4664"
  * "lltc,ltm4675"
  * "lltc,ltm4676"
  * "lltc,ltm4677"
  * "lltc,ltm4678"
  * "lltc,ltm4680"
  * "lltc,ltm4686"
  * "lltc,ltm4700"
- reg: I2C slave address

Optional properties:
- regulators: A node that houses a sub-node for each regulator controlled by
  the device. Each sub-node is identified using the node's name, with valid
  values listed below. The content of each sub-node is defined by the
  standard binding for regulators; see regulator.txt.

Valid names of regulators depend on number of supplies supported per device:
  * ltc2972 vout0 - vout1
  * ltc2974, ltc2975 : vout0 - vout3
  * ltc2977, ltc2979, ltc2980, ltm2987 : vout0 - vout7
  * ltc2978 : vout0 - vout7
  * ltc3880, ltc3882, ltc3884, ltc3886, ltc3887, ltc3889 : vout0 - vout1
  * ltc7880 : vout0 - vout1
  * ltc3883 : vout0
  * ltm4664 : vout0 - vout1
  * ltm4675, ltm4676, ltm4677, ltm4678 : vout0 - vout1
  * ltm4680, ltm4686 : vout0 - vout1
  * ltm4700 : vout0 - vout1

Example:
ltc2978@5e {
	compatible = "lltc,ltc2978";
	reg = <0x5e>;
	regulators {
		vout0 {
			regulator-name = "FPGA-2.5V";
		};
		vout2 {
			regulator-name = "FPGA-1.5V";
		};
	};
};
```

## Documentation/devicetree/bindings/hwmon/ltc2990.txt
```
ltc2990: Linear Technology LTC2990 power monitor

Required properties:
- compatible: Must be "lltc,ltc2990"
- reg: I2C slave address
- lltc,meas-mode:
	An array of two integers for configuring the chip measurement mode.

	The first integer defines the bits 2..0 in the control register. In all
	cases the internal temperature and supply voltage are measured. In
	addition the following input measurements are enabled per mode:

		0: V1, V2, TR2
		1: V1-V2, TR2
		2: V1-V2, V3, V4
		3: TR1, V3, V4
		4: TR1, V3-V4
		5: TR1, TR2
		6: V1-V2, V3-V4
		7: V1, V2, V3, V4

	The second integer defines the bits 4..3 in the control register. This
	allows a subset of the measurements to be enabled:

		0: Internal temperature and supply voltage only
		1: TR1, V1 or V1-V2 only per mode
		2: TR2, V3 or V3-V4 only per mode
		3: All measurements per mode

Example:

ltc2990@4c {
	compatible = "lltc,ltc2990";
	reg = <0x4c>;
	lltc,meas-mode = <7 3>;	/* V1, V2, V3, V4 */
};
```

## Documentation/devicetree/bindings/hwmon/ltc4151.txt
```
LTC4151 High Voltage I2C Current and Voltage Monitor

Required properties:
- compatible: Must be "lltc,ltc4151"
- reg: I2C address

Optional properties:
- shunt-resistor-micro-ohms
	Shunt resistor value in micro-Ohms
	Defaults to <1000> if unset.

Example:

ltc4151@6e {
	compatible = "lltc,ltc4151";
	reg = <0x6e>;
	shunt-resistor-micro-ohms = <1500>;
};
```
