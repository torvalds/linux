## Documentation/devicetree/bindings/hwmon/ti,ina3221.yaml
```yaml
# SPDX-License-Identifier: (GPL-2.0-only OR BSD-2-Clause)
%YAML 1.2
---
$id: http://devicetree.org/schemas/hwmon/ti,ina3221.yaml#
$schema: http://devicetree.org/meta-schemas/core.yaml#

title: Texas Instruments INA3221 Current and Voltage Monitor

maintainers:
  - Jean Delvare <jdelvare@suse.com>
  - Guenter Roeck <linux@roeck-us.net>

properties:
  compatible:
    const: ti,ina3221

  reg:
    maxItems: 1

  ti,single-shot:
    description: |
      This chip has two power modes: single-shot (chip takes one measurement
      and then shuts itself down) and continuous (chip takes continuous
      measurements). The continuous mode is more reliable and suitable for
      hardware monitor type device, but the single-shot mode is more power-
      friendly and useful for battery-powered device which cares power
      consumptions while still needs some measurements occasionally.

      If this property is present, the single-shot mode will be used, instead
      of the default continuous one for monitoring.
    $ref: /schemas/types.yaml#/definitions/flag

  "#address-cells":
    description: Required only if a child node is present.
    const: 1

  "#size-cells":
    description: Required only if a child node is present.
    const: 0

patternProperties:
  "^input@[0-2]$":
    description: The node contains optional child nodes for three channels.
      Each child node describes the information of input source. Input channels
      default to enabled in the chip. Unless channels are explicitly disabled
      in device-tree, input channels will be enabled.
    type: object
    additionalProperties: false
    properties:
      reg:
        description: Must be 0, 1 and 2, corresponding to the IN1, IN2 or IN3
          ports of the INA3221, respectively.
        enum: [ 0, 1, 2 ]

      label:
        description: name of the input source

      shunt-resistor-micro-ohms:
        description: shunt resistor value in micro-Ohm

      ti,summation-disable:
        description: |
          The INA3221 has a critical alert pin that can be controlled by the
          summation control function. This function adds the single
          shunt-voltage conversions for the desired channels in order to
          compare the combined sum to the programmed limit. The Shunt-Voltage
          Sum Limit register contains the programmed value that is compared
          to the value in the Shunt-Voltage Sum register in order to
          determine if the total summed limit is exceeded. If the
          shunt-voltage sum limit value is exceeded, the critical alert pin
          is asserted.

          For the summation limit to have a meaningful value, it is necessary
          to use the same shunt-resistor value on all enabled channels. If
          this is not the case or if a channel should not be used for
          triggering the critical alert pin, then this property can be used
          exclude specific channels from the summation control function.
        type: boolean

    required:
      - reg

required:
  - compatible
  - reg

additionalProperties: false

examples:
  - |
    i2c {
        #address-cells = <1>;
        #size-cells = <0>;

        power-sensor@40 {
            compatible = "ti,ina3221";
            reg = <0x40>;
            #address-cells = <1>;
            #size-cells = <0>;

            input@0 {
                reg = <0x0>;
                /*
                 * Input channels are enabled by default in the device and so
                 * to disable, must be explicitly disabled in device-tree.
                 */
                status = "disabled";
            };

            input@1 {
                reg = <0x1>;
                shunt-resistor-micro-ohms = <5000>;
            };

            input@2 {
                reg = <0x2>;
                label = "VDD_5V";
                shunt-resistor-micro-ohms = <5000>;
            };
        };
    };
```

## Documentation/devicetree/bindings/hwmon/ti,lm87.yaml
```yaml
# SPDX-License-Identifier: (GPL-2.0 OR BSD-2-Clause)
%YAML 1.2
---

$id: http://devicetree.org/schemas/hwmon/ti,lm87.yaml#
$schema: http://devicetree.org/meta-schemas/core.yaml#

title: Texas Instruments LM87 Hardware Monitor

maintainers:
  - Javier Carrasco <javier.carrasco.cruz@gmail.com>

description: |
  The LM87 is a serial interface system hardware monitor
  with remote diode temperature sensing.

  Datasheets:
    https://www.ti.com/product/LM87

properties:
  compatible:
    const: ti,lm87

  reg:
    maxItems: 1

  has-temp3:
    $ref: /schemas/types.yaml#/definitions/flag
    description:
      This configures pins 18 and 19 to be used as a second
      remote temperature sensing channel. By default the pins
      are configured as voltage input pins in0 and in5.

  has-in6:
    $ref: /schemas/types.yaml#/definitions/flag
    description:
      When set, pin 5 is configured to be used as voltage input
      in6. Otherwise the pin is set as FAN1 input.

  has-in7:
    $ref: /schemas/types.yaml#/definitions/flag
    description:
      When set, pin 6 is configured to be used as voltage input
      in7. Otherwise the pin is set as FAN2 input.

  vcc-supply:
    description:
      Regulator supplying power, can be configured to measure
      5.0V power supply. Default is 3.3V.

required:
  - compatible
  - reg

additionalProperties: false

examples:
  - |
    i2c {
        #address-cells = <1>;
        #size-cells = <0>;

        hwmon@2e {
            compatible = "ti,lm87";
            reg = <0x2e>;
            has-temp3;
            vcc-supply = <&reg_5v0>;
        };
    };
```

## Documentation/devicetree/bindings/hwmon/ti,tmp108.yaml
```yaml
# SPDX-License-Identifier: GPL-2.0-only OR BSD-2-Clause
%YAML 1.2
---
$id: http://devicetree.org/schemas/hwmon/ti,tmp108.yaml#
$schema: http://devicetree.org/meta-schemas/core.yaml#

title: TMP108/P3T1035/P3T1085/P3T2030 temperature sensor

maintainers:
  - Krzysztof Kozlowski <krzk@kernel.org>

description: |
  The TMP108 or NXP P3T Family (P3T1035, P3T1085 and P3T2030) is a digital-
  output temperature sensor with a dynamically-programmable limit window,
  and under- and over-temperature alert functions.

  NXP P3T Family (P3T1035, P3T1085 and P3T2030) supports I3C.

  Datasheets:
    https://www.ti.com/product/TMP108
    https://www.nxp.com/docs/en/data-sheet/P3T1085UK.pdf
    https://www.nxp.com/docs/en/data-sheet/P3T1035XUK_P3T2030XUK.pdf

properties:
  compatible:
    oneOf:
      - items:
          - const: nxp,p3t2030
          - const: nxp,p3t1035
      - const: nxp,p3t1035
      - const: nxp,p3t1085
      - const: ti,tmp108

  interrupts:
    items:
      - description: alert interrupt

  reg:
    maxItems: 1

  "#thermal-sensor-cells":
    const: 0

  vcc-supply:
    description: phandle to the regulator that provides the V+ supply

required:
  - compatible
  - reg

additionalProperties: false

examples:
  - |
    #include <dt-bindings/interrupt-controller/irq.h>

    i2c {
        #address-cells = <1>;
        #size-cells = <0>;

        sensor@48 {
            compatible = "ti,tmp108";
            reg = <0x48>;
            interrupt-parent = <&gpio1>;
            interrupts = <7 IRQ_TYPE_LEVEL_LOW>;
            pinctrl-names = "default";
            pinctrl-0 = <&tmp_alrt>;
            vcc-supply = <&supply>;
            #thermal-sensor-cells = <0>;
        };
    };
```

## Documentation/devicetree/bindings/hwmon/ti,tmp401.yaml
```yaml
# SPDX-License-Identifier: (GPL-2.0 OR BSD-2-Clause)
%YAML 1.2
---
$id: http://devicetree.org/schemas/hwmon/ti,tmp401.yaml#
$schema: http://devicetree.org/meta-schemas/core.yaml#

title: TMP401, TPM411 and TMP43x temperature sensor

maintainers:
  - Guenter Roeck <linux@roeck-us.net>

description: |
  ±1°C Remote and Local temperature sensor

  Datasheets:
  https://www.ti.com/lit/ds/symlink/tmp401.pdf
  https://www.ti.com/lit/ds/symlink/tmp411.pdf
  https://www.ti.com/lit/ds/symlink/tmp431.pdf
  https://www.ti.com/lit/ds/symlink/tmp435.pdf

properties:
  compatible:
    enum:
      - ti,tmp401
      - ti,tmp411
      - ti,tmp431
      - ti,tmp432
      - ti,tmp435

  reg:
    maxItems: 1

  ti,extended-range-enable:
    description:
      When set, this sensor measures over extended temperature range.
    type: boolean

  ti,n-factor:
    description:
      value to be used for converting remote channel measurements to
      temperature.
    $ref: /schemas/types.yaml#/definitions/int32
    minimum: -128
    maximum: 127

  ti,beta-compensation:
    description:
      value to select beta correction range.
    $ref: /schemas/types.yaml#/definitions/uint32
    minimum: 0
    maximum: 15

allOf:
  - if:
      properties:
        compatible:
          contains:
            enum:
              - ti,tmp401
    then:
      properties:
        ti,n-factor: false

  - if:
      properties:
        compatible:
          contains:
            enum:
              - ti,tmp401
              - ti,tmp411
    then:
      properties:
        ti,beta-compensation: false

required:
  - compatible
  - reg

additionalProperties: false

examples:
  - |
    i2c {
      #address-cells = <1>;
      #size-cells = <0>;

      sensor@4c {
        compatible = "ti,tmp401";
        reg = <0x4c>;
      };
    };
  - |
    i2c {
      #address-cells = <1>;
      #size-cells = <0>;

      sensor@4c {
        compatible = "ti,tmp431";
        reg = <0x4c>;
        ti,extended-range-enable;
        ti,n-factor = <0x3b>;
        ti,beta-compensation = <0x7>;
      };
    };
```

## Documentation/devicetree/bindings/hwmon/ti,tmp421.yaml
```yaml
# SPDX-License-Identifier: (GPL-2.0 OR BSD-2-Clause)
%YAML 1.2
---
$id: http://devicetree.org/schemas/hwmon/ti,tmp421.yaml#
$schema: http://devicetree.org/meta-schemas/core.yaml#

title: TMP42x/TMP44x temperature sensor

maintainers:
  - Guenter Roeck <linux@roeck-us.net>

description: |
  ±1°C Remote and Local temperature sensor
  https://www.ti.com/lit/ds/symlink/tmp422.pdf

properties:
  compatible:
    enum:
      - ti,tmp421
      - ti,tmp422
      - ti,tmp423
      - ti,tmp441
      - ti,tmp442
  reg:
    maxItems: 1

  '#address-cells':
    const: 1

  '#size-cells':
    const: 0

required:
  - compatible
  - reg

additionalProperties: false

patternProperties:
  "^channel@([0-3])$":
    type: object
    description: |
      Represents channels of the device and their specific configuration.

    properties:
      reg:
        description: |
          The channel number. 0 is local channel, 1-3 are remote channels
        items:
          minimum: 0
          maximum: 3

      label:
        description: |
          A descriptive name for this channel, like "ambient" or "psu".

      ti,n-factor:
        description: |
          The value (two's complement) to be programmed in the channel specific N correction register.
          For remote channels only.
        $ref: /schemas/types.yaml#/definitions/uint32
        items:
          minimum: 0
          maximum: 255

    required:
      - reg

    additionalProperties: false

examples:
  - |
    i2c {
      #address-cells = <1>;
      #size-cells = <0>;

      sensor@4c {
        compatible = "ti,tmp422";
        reg = <0x4c>;
      };
    };
  - |
    i2c {
      #address-cells = <1>;
      #size-cells = <0>;

      sensor@4c {
        compatible = "ti,tmp422";
        reg = <0x4c>;
        #address-cells = <1>;
        #size-cells = <0>;

        channel@0 {
          reg = <0x0>;
          ti,n-factor = <0x1>;
          label = "local";
        };

        channel@1 {
          reg = <0x1>;
          ti,n-factor = <0x0>;
          label = "somelabel";
        };

        channel@2 {
          reg = <0x2>;
          status = "disabled";
        };
      };
    };
```

## Documentation/devicetree/bindings/hwmon/ti,tmp464.yaml
```yaml
# SPDX-License-Identifier: (GPL-2.0 OR BSD-2-Clause)
%YAML 1.2
---
$id: http://devicetree.org/schemas/hwmon/ti,tmp464.yaml#
$schema: http://devicetree.org/meta-schemas/core.yaml#

title: TMP464 and TMP468 temperature sensors

maintainers:
  - Agathe Porte <agathe.porte@nokia.com>

description: |
  ±0.0625°C Remote and Local temperature sensor
  https://www.ti.com/lit/ds/symlink/tmp464.pdf
  https://www.ti.com/lit/ds/symlink/tmp468.pdf

properties:
  compatible:
    enum:
      - ti,tmp464
      - ti,tmp468

  reg:
    maxItems: 1

  '#address-cells':
    const: 1

  '#size-cells':
    const: 0

required:
  - compatible
  - reg

additionalProperties: false

patternProperties:
  "^channel@([0-8])$":
    type: object
    description: |
      Represents channels of the device and their specific configuration.

    properties:
      reg:
        description: |
          The channel number. 0 is local channel, 1-8 are remote channels.
        items:
          minimum: 0
          maximum: 8

      label:
        description: |
          A descriptive name for this channel, like "ambient" or "psu".

      ti,n-factor:
        description: |
          The value (two's complement) to be programmed in the channel specific N correction register.
          For remote channels only.
        $ref: /schemas/types.yaml#/definitions/int32
        items:
          minimum: -128
          maximum: 127

    required:
      - reg

    additionalProperties: false

examples:
  - |
    i2c {
      #address-cells = <1>;
      #size-cells = <0>;

      sensor@4b {
        compatible = "ti,tmp464";
        reg = <0x4b>;
      };
    };
  - |
    i2c {
      #address-cells = <1>;
      #size-cells = <0>;

      sensor@4b {
        compatible = "ti,tmp464";
        reg = <0x4b>;
        #address-cells = <1>;
        #size-cells = <0>;

        channel@0 {
          reg = <0x0>;
          label = "local";
        };

        channel@1 {
          reg = <0x1>;
          ti,n-factor = <(-10)>;
          label = "external";
        };

        channel@2 {
          reg = <0x2>;
          ti,n-factor = <0x10>;
          label = "somelabel";
        };

        channel@3 {
          reg = <0x3>;
          status = "disabled";
        };
      };
    };
```
