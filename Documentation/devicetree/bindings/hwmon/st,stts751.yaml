## Documentation/devicetree/bindings/hwmon/st,stts751.yaml
```yaml
# SPDX-License-Identifier: GPL-2.0-only OR BSD-2-Clause
%YAML 1.2
---
$id: http://devicetree.org/schemas/hwmon/st,stts751.yaml#
$schema: http://devicetree.org/meta-schemas/core.yaml#

title: STTS751 Thermometer

maintainers:
  - Javier Carrasco <javier.carrasco.cruz@gmail.com>

properties:
  compatible:
    const: st,stts751

  reg:
    maxItems: 1

  smbus-timeout-disable:
    description:
      When set, the smbus timeout function will be disabled.
    $ref: /schemas/types.yaml#/definitions/flag

required:
  - compatible
  - reg

additionalProperties: false

examples:
  - |
    i2c {
        #address-cells = <1>;
        #size-cells = <0>;

        thermometer@48 {
            compatible = "st,stts751";
            reg = <0x48>;
            smbus-timeout-disable;
        };
    };
```

## Documentation/devicetree/bindings/hwmon/st,tsc1641.yaml
```yaml
# SPDX-License-Identifier: (GPL-2.0 OR BSD-2-Clause)
%YAML 1.2
---
$id: http://devicetree.org/schemas/hwmon/st,tsc1641.yaml#
$schema: http://devicetree.org/meta-schemas/core.yaml#

title: ST Microelectronics TSC1641 I2C power monitor

maintainers:
  - Igor Reznichenko <igor@reznichenko.net>

description: |
  TSC1641 is a 60 V, 16-bit high-precision power monitor with I2C and
  MIPI I3C interface

  Datasheets:
    https://www.st.com/resource/en/datasheet/tsc1641.pdf

properties:
  compatible:
    const: st,tsc1641

  reg:
    maxItems: 1

  interrupts:
    description: Optional alert interrupt.
    maxItems: 1

  shunt-resistor-micro-ohms:
    description: Shunt resistor value in micro-ohms. Since device has internal
      16-bit RSHUNT register with 10 uOhm LSB, the maximum value is capped at
      655.35 mOhm.
    minimum: 100
    default: 1000
    maximum: 655350

  st,alert-polarity-active-high:
    $ref: /schemas/types.yaml#/definitions/flag
    description: Default value is 0 which configures the normal polarity of the
      ALERT pin, being active low open-drain. Setting this to 1 configures the
      polarity of the ALERT pin to be inverted and active high open-drain.
      Specify this property to set the alert polarity to active-high.

required:
  - compatible
  - reg

additionalProperties: false

examples:
  - |
    i2c {
        #address-cells = <1>;
        #size-cells = <0>;

        power-sensor@40 {
            compatible = "st,tsc1641";
            reg = <0x40>;
            shunt-resistor-micro-ohms = <1000>;
            st,alert-polarity-active-high;
        };
    };
```

## Documentation/devicetree/bindings/hwmon/starfive,jh7100-temp.yaml
```yaml
# SPDX-License-Identifier: (GPL-2.0-only OR BSD-2-Clause)
%YAML 1.2
---
$id: http://devicetree.org/schemas/hwmon/starfive,jh7100-temp.yaml#
$schema: http://devicetree.org/meta-schemas/core.yaml#

title: StarFive JH7100 Temperature Sensor

maintainers:
  - Emil Renner Berthing <kernel@esmil.dk>

description: |
  StarFive Technology Co. JH7100 embedded temperature sensor

properties:
  compatible:
    enum:
      - starfive,jh7100-temp

  reg:
    maxItems: 1

  clocks:
    minItems: 2
    maxItems: 2

  clock-names:
    items:
      - const: "sense"
      - const: "bus"

  '#thermal-sensor-cells':
    const: 0

  interrupts:
    maxItems: 1

  resets:
    minItems: 2
    maxItems: 2

  reset-names:
    items:
      - const: "sense"
      - const: "bus"

required:
  - compatible
  - reg
  - clocks
  - clock-names
  - interrupts
  - resets
  - reset-names

additionalProperties: false

examples:
  - |
    #include <dt-bindings/clock/starfive-jh7100.h>
    #include <dt-bindings/reset/starfive-jh7100.h>

    tmon: tmon@124a0000 {
        compatible = "starfive,jh7100-temp";
        reg = <0x124a0000 0x10000>;
        clocks = <&clkgen JH7100_CLK_TEMP_SENSE>,
                 <&clkgen JH7100_CLK_TEMP_APB>;
        clock-names = "sense", "bus";
        #thermal-sensor-cells = <0>;
        interrupts = <122>;
        resets = <&rstgen JH7100_RSTN_TEMP_SENSE>,
                 <&rstgen JH7100_RSTN_TEMP_APB>;
        reset-names = "sense", "bus";
    };
```

## Documentation/devicetree/bindings/hwmon/starfive,jh71x0-temp.yaml
```yaml
# SPDX-License-Identifier: (GPL-2.0-only OR BSD-2-Clause)
%YAML 1.2
---
$id: http://devicetree.org/schemas/hwmon/starfive,jh71x0-temp.yaml#
$schema: http://devicetree.org/meta-schemas/core.yaml#

title: StarFive JH71x0 Temperature Sensor

maintainers:
  - Emil Renner Berthing <kernel@esmil.dk>

description: |
  StarFive Technology Co. JH71x0 embedded temperature sensor

properties:
  compatible:
    enum:
      - starfive,jh7100-temp
      - starfive,jh7110-temp

  reg:
    maxItems: 1

  clocks:
    minItems: 2
    maxItems: 2

  clock-names:
    items:
      - const: sense
      - const: bus

  '#thermal-sensor-cells':
    const: 0

  resets:
    minItems: 2
    maxItems: 2

  reset-names:
    items:
      - const: sense
      - const: bus

required:
  - compatible
  - reg
  - clocks
  - clock-names
  - resets
  - reset-names

additionalProperties: false

examples:
  - |
    #include <dt-bindings/clock/starfive-jh7100.h>
    #include <dt-bindings/reset/starfive-jh7100.h>

    temperature-sensor@124a0000 {
        compatible = "starfive,jh7100-temp";
        reg = <0x124a0000 0x10000>;
        clocks = <&clkgen JH7100_CLK_TEMP_SENSE>,
                 <&clkgen JH7100_CLK_TEMP_APB>;
        clock-names = "sense", "bus";
        #thermal-sensor-cells = <0>;
        resets = <&rstgen JH7100_RSTN_TEMP_SENSE>,
                 <&rstgen JH7100_RSTN_TEMP_APB>;
        reset-names = "sense", "bus";
    };
```

## Documentation/devicetree/bindings/hwmon/stts751.txt
```
* STTS751 thermometer.

Required analde properties:
- compatible: "stts751"
- reg: I2C bus address of the device

Optional properties:
- smbus-timeout-disable: when set, the smbus timeout function will be disabled

Example stts751 analde:

temp-sensor {
	compatible = "stts751";
	reg = <0x48>;
}
```

## Documentation/devicetree/bindings/hwmon/syna,as370.yaml
```yaml
# SPDX-License-Identifier: GPL-2.0-only OR BSD-2-Clause
%YAML 1.2
---
$id: http://devicetree.org/schemas/hwmon/syna,as370.yaml#
$schema: http://devicetree.org/meta-schemas/core.yaml#

title: Synaptics AS370 PVT sensors

maintainers:
  - Javier Carrasco <javier.carrasco.cruz@gmail.com>

properties:
  compatible:
    const: syna,as370-hwmon

  reg:
    description:
      Address and length of the register set.
    maxItems: 1

required:
  - compatible
  - reg

additionalProperties: false

examples:
  - |
    sensor@ea0810 {
        compatible = "syna,as370-hwmon";
        reg = <0xea0810 0xc>;
    };
```

## Documentation/devicetree/bindings/hwmon/ti,adc128d818.yaml
```yaml
# SPDX-License-Identifier: (GPL-2.0 OR BSD-2-Clause)
%YAML 1.2
---

$id: http://devicetree.org/schemas/hwmon/ti,adc128d818.yaml#
$schema: http://devicetree.org/meta-schemas/core.yaml#

title: Texas Instruments ADC128D818 ADC System Monitor With Temperature Sensor

maintainers:
  - Javier Carrasco <javier.carrasco.cruz@gmail.com>

description: |
  The ADC128D818 is a 12-Bit, 8-Channel Analog to Digital Converter (ADC)
  with a temperature sensor and an I2C interface.

  Datasheets:
    https://www.ti.com/product/ADC128D818

properties:
  compatible:
    const: ti,adc128d818

  reg:
    maxItems: 1

  ti,mode:
    $ref: /schemas/types.yaml#/definitions/uint8
    description: |
      Operation mode.
      Mode 0  - 7 single-ended voltage readings (IN0-IN6), 1 temperature
      reading (internal).
      Mode 1 - 8 single-ended voltage readings (IN0-IN7), no temperature.
      Mode 2 - 4 pseudo-differential voltage readings
      (IN0-IN1, IN3-IN2, IN4-IN5, IN7-IN6), 1 temperature reading (internal).
      Mode 3 - 4 single-ended voltage readings (IN0-IN3), 2 pseudo-differential
      voltage readings (IN4-IN5, IN7-IN6), 1 temperature reading (internal).
    default: 0

  vref-supply:
    description:
      The regulator to use as an external reference. If it does not exist, the
      internal reference will be used.

required:
  - compatible
  - reg

additionalProperties: false

examples:
  - |
    i2c {
        #address-cells = <1>;
        #size-cells = <0>;

        adc@1d {
            compatible = "ti,adc128d818";
            reg = <0x1d>;
            vref-supply = <&vref>;
            ti,mode = /bits/ 8 <2>;
        };
    };
```

## Documentation/devicetree/bindings/hwmon/ti,ads7828.yaml
```yaml
# SPDX-License-Identifier: (GPL-2.0 OR BSD-2-Clause)
%YAML 1.2
---

$id: http://devicetree.org/schemas/hwmon/ti,ads7828.yaml#
$schema: http://devicetree.org/meta-schemas/core.yaml#

title: Texas Instruments ADS7828/ADS7830 Analog to Digital Converter (ADC)

maintainers:
  - Krzysztof Kozlowski <krzk@kernel.org>

description: |
  The ADS7828 is 12-Bit, 8-Channel Sampling Analog to Digital Converter (ADC)
  with an I2C interface.

  Datasheets:
    https://www.ti.com/product/ADS7828

properties:
  compatible:
    enum:
      - ti,ads7828
      - ti,ads7830

  reg:
    maxItems: 1

  ti,differential-input:
    description:
      Set to use the device in differential mode.
    type: boolean

  vref-supply:
    description:
      The regulator to use as an external reference. If it does not exists the
      internal reference will be used.

required:
  - compatible
  - reg

additionalProperties: false

examples:
  - |
    i2c {
        #address-cells = <1>;
        #size-cells = <0>;

        adc@48 {
            comatible = "ti,ads7828";
            reg = <0x48>;
            vref-supply = <&vref>;
            ti,differential-input;
        };
    };
```

## Documentation/devicetree/bindings/hwmon/ti,amc6821.yaml
```yaml
# SPDX-License-Identifier: (GPL-2.0-only OR BSD-2-Clause)
%YAML 1.2
---
$id: http://devicetree.org/schemas/hwmon/ti,amc6821.yaml#
$schema: http://devicetree.org/meta-schemas/core.yaml#

title: AMC6821 Intelligent Temperature Monitor and PWM Fan Controller

maintainers:
  - Farouk Bouabid <farouk.bouabid@cherry.de>
  - Quentin Schulz <quentin.schulz@cherry.de>

description:
  Intelligent temperature monitor and pulse-width modulation (PWM) fan
  controller.

properties:
  compatible:
    oneOf:
      - items:
          - const: tsd,mule
          - const: ti,amc6821
      - const: ti,amc6821

  reg:
    maxItems: 1

  i2c-mux:
    type: object

  fan:
    $ref: fan-common.yaml#
    unevaluatedProperties: false

    properties:
      cooling-levels:
        description: PWM duty cycle values corresponding to thermal cooling states.
        items:
          maximum: 255

  "#pwm-cells":
    const: 2
    description: |
      Number of cells in a PWM specifier.
      - cell 0: PWM period in nanoseconds
      - cell 1: PWM polarity: 0 or PWM_POLARITY_INVERTED

required:
  - compatible
  - reg

if:
  properties:
    compatible:
      contains:
        const: tsd,mule

then:
  required:
    - i2c-mux

additionalProperties: false

examples:
  - |
    i2c {
        #address-cells = <1>;
        #size-cells = <0>;

        fan_controller: fan@18 {
            compatible = "ti,amc6821";
            reg = <0x18>;
            #pwm-cells = <2>;

            fan {
                pwms = <&fan_controller 40000 0>;
            };
        };
    };

  - |
    i2c {
        #address-cells = <1>;
        #size-cells = <0>;

        fan@18 {
            compatible = "tsd,mule", "ti,amc6821";
            reg = <0x18>;

            i2c-mux {
                compatible = "tsd,mule-i2c-mux";
                #address-cells = <1>;
                #size-cells = <0>;

                i2c@0 {
                    reg = <0x0>;
                    #address-cells = <1>;
                    #size-cells = <0>;

                    rtc@6f {
                        compatible = "isil,isl1208";
                        reg = <0x6f>;
                    };
                };
            };
        };
    };
...
```

## Documentation/devicetree/bindings/hwmon/ti,ina2xx.yaml
```yaml
# SPDX-License-Identifier: (GPL-2.0 OR BSD-2-Clause)
%YAML 1.2
---
$id: http://devicetree.org/schemas/hwmon/ti,ina2xx.yaml#
$schema: http://devicetree.org/meta-schemas/core.yaml#

title: Texas Instruments INA209 family of power/voltage monitors

maintainers:
  - Krzysztof Kozlowski <krzk@kernel.org>

description: |
  The INA209 is a high-side current shunt and power monitor with
  an I2C interface.

  Datasheets:
    https://www.ti.com/product/INA209

properties:
  compatible:
    enum:
      - silergy,sy24655
      - ti,ina209
      - ti,ina219
      - ti,ina220
      - ti,ina226
      - ti,ina230
      - ti,ina231
      - ti,ina233
      - ti,ina237
      - ti,ina238
      - ti,ina260

  reg:
    maxItems: 1

  "#io-channel-cells":
    const: 1

  shunt-resistor:
    description:
      Shunt resistor value in micro-Ohm.
    $ref: /schemas/types.yaml#/definitions/uint32

  ti,shunt-gain:
    description: |
      Programmable gain divisor for the shunt voltage accuracy and range. This
      property only applies to devices that have configurable PGA/ADCRANGE. The
      gain value is used configure the gain and to convert the shunt voltage,
      current and power register values when reading measurements from the
      device.

      For devices that have a configurable PGA (e.g. INA209, INA219, INA220),
      the gain value maps directly with the PG bits of the config register.

      For devices that have ADCRANGE configuration (e.g. INA238) a shunt-gain
      value of 1 maps to ADCRANGE=1 where no gain divisor is applied to the
      shunt voltage, and a value of 4 maps to ADCRANGE=0 such that a wider
      voltage range is used.

      The default value is device dependent, and is defined by the reset value
      of PGA/ADCRANGE in the respective configuration registers.
    $ref: /schemas/types.yaml#/definitions/uint32
    enum: [1, 2, 4, 8]

  vs-supply:
    description: phandle to the regulator that provides the VS supply typically
      in range from 2.7 V to 5.5 V.

  ti,alert-polarity-active-high:
    description: Alert pin is asserted based on the value of Alert polarity Bit
      of Mask/Enable register. Default value is Normal (0 which maps to
      active-low open collector). The other value is Inverted
      (1 which maps to active-high open collector). Specify this property to set
      the alert polarity to active-high.
    $ref: /schemas/types.yaml#/definitions/flag

  ti,maximum-expected-current-microamp:
    description: |
      This value indicates the maximum current in microamps that you can
      expect to measure with ina233 in your circuit.

      This value will be used to calculate the Current_LSB and current/power
      coefficient for the pmbus and to calibrate the IC.
    minimum: 32768
    maximum: 4294967295
    default: 32768000

required:
  - compatible
  - reg

allOf:
  - $ref: hwmon-common.yaml#
  - if:
      properties:
        compatible:
          contains:
            enum:
              - silergy,sy24655
              - ti,ina209
              - ti,ina219
              - ti,ina220
              - ti,ina226
              - ti,ina230
              - ti,ina231
              - ti,ina237
              - ti,ina238
              - ti,ina260
    then:
      properties:
        ti,maximum-expected-current-microamp: false

unevaluatedProperties: false

examples:
  - |
    i2c {
        #address-cells = <1>;
        #size-cells = <0>;

        power-sensor@44 {
            compatible = "ti,ina220";
            reg = <0x44>;
            #io-channel-cells = <1>;
            label = "vdd_3v0";
            shunt-resistor = <1000>;
            vs-supply = <&vdd_3v0>;
            ti,alert-polarity-active-high;
        };
    };
```
