## Documentation/devicetree/bindings/hwmon/ti,tmp513.yaml
```yaml
# SPDX-License-Identifier: (GPL-2.0 OR BSD-2-Clause)
%YAML 1.2
---

$id: http://devicetree.org/schemas/hwmon/ti,tmp513.yaml#
$schema: http://devicetree.org/meta-schemas/core.yaml#

title: TMP513/512 system monitor sensor

maintainers:
  - Eric Tremblay <etremblay@distech-controls.com>

description: |
  The TMP512 (dual-channel) and TMP513 (triple-channel) are system monitors
  that include remote sensors, a local temperature sensor, and a high-side
  current shunt monitor. These system monitors have the capability of measuring
  remote temperatures, on-chip temperatures, and system voltage/power/current
  consumption.

  Datasheets:
  https://www.ti.com/lit/gpn/tmp513
  https://www.ti.com/lit/gpn/tmp512


properties:
  compatible:
    enum:
      - ti,tmp512
      - ti,tmp513

  reg:
    maxItems: 1

  shunt-resistor-micro-ohms:
    description: |
      If 0, the calibration process will be skiped and the current and power
      measurement engine will not work. Temperature and voltage measurement
      will continue to work. The shunt value also need to respect:
      rshunt <= pga-gain * 40 * 1000 * 1000.
      If not, it's not possible to compute a valid calibration value.
    default: 1000

  ti,pga-gain:
    description: |
      The gain value for the PGA function. This is 8, 4, 2 or 1.
      The PGA gain affect the shunt voltage range.
      The range will be equal to: pga-gain * 40mV
    $ref: /schemas/types.yaml#/definitions/uint32
    enum: [1, 2, 4, 8]
    default: 8

  ti,bus-range-microvolt:
    description: |
      This is the operating range of the bus voltage in microvolt
    enum: [16000000, 32000000]
    default: 32000000

  ti,nfactor:
    description: |
      Array of three(TMP513) or two(TMP512) n-Factor value for each remote
      temperature channel.
      See datasheet Table 11 for n-Factor range list and value interpretation.
    $ref: /schemas/types.yaml#/definitions/uint32-array
    minItems: 2
    maxItems: 3
    items:
      default: 0x00
      minimum: 0x00
      maximum: 0xFF

required:
  - compatible
  - reg

additionalProperties: false

examples:
  - |
    i2c {
          #address-cells = <1>;
          #size-cells = <0>;

          tmp513@5c {
              compatible = "ti,tmp513";
              reg = <0x5C>;
              shunt-resistor-micro-ohms = <330000>;
              ti,bus-range-microvolt = <32000000>;
              ti,pga-gain = <8>;
              ti,nfactor = <0x1 0xF3 0x00>;
          };
    };
```

## Documentation/devicetree/bindings/hwmon/ti,tps23861.yaml
```yaml
# SPDX-License-Identifier: (GPL-2.0 OR BSD-2-Clause)
%YAML 1.2
---
$id: http://devicetree.org/schemas/hwmon/ti,tps23861.yaml#
$schema: http://devicetree.org/meta-schemas/core.yaml#

title: TI TPS23861 PoE PSE

maintainers:
  - Robert Marko <robert.marko@sartura.hr>

description: |
  The TPS23861 is a IEEE 802.3at Quad Port Power-over-Ethernet PSE Controller.

  Datasheets:
  https://www.ti.com/lit/gpn/tps23861


properties:
  compatible:
    enum:
      - ti,tps23861

  reg:
    maxItems: 1

  shunt-resistor-micro-ohms:
    description: The value of current sense resistor in microohms.
    default: 255000
    minimum: 250000
    maximum: 255000

required:
  - compatible
  - reg

allOf:
  - $ref: hwmon-common.yaml#

unevaluatedProperties: false

examples:
  - |
    i2c {
        #address-cells = <1>;
        #size-cells = <0>;

        tps23861@30 {
            compatible = "ti,tps23861";
            reg = <0x30>;
            shunt-resistor-micro-ohms = <255000>;
        };
    };
```

## Documentation/devicetree/bindings/hwmon/tmp108.txt
```
TMP108 temperature sensor
-------------------------

This device supports I2C only.

Requires node properties:
- compatible : "ti,tmp108"
- reg : the I2C address of the device. This is 0x48, 0x49, 0x4a, or 0x4b.

Example:
	tmp108@48 {
		compatible = "ti,tmp108";
		reg = <0x48>;
	};
```

## Documentation/devicetree/bindings/hwmon/vexpress.txt
```
Versatile Express hwmon sensors
-------------------------------

Requires yesde properties:
- "compatible" value : one of
	"arm,vexpress-volt"
	"arm,vexpress-amp"
	"arm,vexpress-temp"
	"arm,vexpress-power"
	"arm,vexpress-energy"
- "arm,vexpress-sysreg,func" when controlled via vexpress-sysreg
  (see Documentation/devicetree/bindings/arm/vexpress-sysreg.txt
  for more details)

Optional yesde properties:
- label : string describing the monitored value

Example:
	energy@0 {
		compatible = "arm,vexpress-energy";
		arm,vexpress-sysreg,func = <13 0>;
		label = "A15 Jcore";
	};
```

## Documentation/devicetree/bindings/hwmon/winbond,w83781d.yaml
```yaml
# SPDX-License-Identifier: (GPL-2.0 OR BSD-2-Clause)
%YAML 1.2
---
$id: http://devicetree.org/schemas/hwmon/winbond,w83781d.yaml#
$schema: http://devicetree.org/meta-schemas/core.yaml#

title: Winbond W83781 and compatible hardware monitor IC

maintainers:
  - Linus Walleij <linus.walleij@linaro.org>

properties:
  compatible:
    enum:
      - winbond,w83781d
      - winbond,w83781g
      - winbond,w83782d
      - winbond,w83783s
      - asus,as99127f

  reg:
    maxItems: 1

required:
  - compatible
  - reg

additionalProperties: false

examples:
  - |
    i2c {
        #address-cells = <1>;
        #size-cells = <0>;

        temperature-sensor@28 {
            compatible = "winbond,w83781d";
            reg = <0x28>;
        };
    };
```

## Documentation/devicetree/bindings/hwmon/zyxel,nsa320-mcu.yaml
```yaml
# SPDX-License-Identifier: (GPL-2.0-only OR BSD-2-Clause)
%YAML 1.2
---
$id: http://devicetree.org/schemas/hwmon/zyxel,nsa320-mcu.yaml#
$schema: http://devicetree.org/meta-schemas/core.yaml#

title: ZyXEL NSA320 MCU

maintainers:
  - Adam Baker <linux@baker-net.org.uk>
  - Guenter Roeck <linux@roeck-us.net>

description:
  The ZyXEL NSA320 uses a dedicated microcontroller to manage system-critical
  functions like fan speed and power monitoring. It is connected to the SoC
  via a GPIO-based serial protocol.

properties:
  compatible:
    const: zyxel,nsa320-mcu

  data-gpios:
    maxItems: 1
    description: GPIO pin connected to the data line on the MCU.

  clk-gpios:
    maxItems: 1
    description: GPIO pin connected to the clock line on the MCU.

  act-gpios:
    maxItems: 1
    description: GPIO pin connected to the active line on the MCU.

required:
  - compatible
  - data-gpios
  - clk-gpios
  - act-gpios

additionalProperties: false

examples:
  - |
    #include <dt-bindings/gpio/gpio.h>

    hwmon {
        compatible = "zyxel,nsa320-mcu";
        pinctrl-0 = <&pmx_mcu_data &pmx_mcu_clk &pmx_mcu_act>;
        pinctrl-names = "default";

        data-gpios = <&gpio0 14 GPIO_ACTIVE_HIGH>;
        clk-gpios = <&gpio0 16 GPIO_ACTIVE_HIGH>;
        act-gpios = <&gpio0 17 GPIO_ACTIVE_LOW>;
    };
```

## Documentation/devicetree/bindings/hwrng/brcm,iproc-rng200.txt
```
HWRNG support for the iproc-rng200 driver

Required properties:
- compatible : "brcm,iproc-rng200"
- reg : base address and size of control register block

Example:

rng {
        compatible = "brcm,iproc-rng200";
        reg = <0x18032000 0x28>;
};
```

## Documentation/devicetree/bindings/hwrng/omap_rng.txt
```
OMAP SoC HWRNG Module

Required properties:

- compatible : Should contain entries for this and backward compatible
  RNG versions:
  - "ti,omap2-rng" for OMAP2.
  - "ti,omap4-rng" for OMAP4, OMAP5 and AM33XX.
  Note that these two versions are incompatible.
- ti,hwmods: Name of the hwmod associated with the RNG module
- reg : Offset and length of the register set for the module
- interrupts : the interrupt number for the RNG module.
		Only used for "ti,omap4-rng".

Example:
/* AM335x */
rng: rng@48310000 {
	compatible = "ti,omap4-rng";
	ti,hwmods = "rng";
	reg = <0x48310000 0x2000>;
	interrupts = <111>;
};
```

## Documentation/devicetree/bindings/hwrng/timeriomem_rng.txt
```
HWRNG support for the timeriomem_rng driver

Required properties:
- compatible : "timeriomem_rng"
- reg : base address to sample from
- period : wait time in microseconds to use between samples

N.B. currently 'reg' must be four bytes wide and aligned

Example:

hwrng@44 {
	#address-cells = <1>;
	#size-cells = <1>;
	compatible = "timeriomem_rng";
	reg = <0x44 0x04>;
	period = <1000000>;
};
```
