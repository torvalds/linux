## Documentation/devicetree/bindings/watchdog/arm,sp805.txt
```
ARM AMBA Primecell SP805 Watchdog

SP805 WDT is a ARM Primecell Peripheral and has a standard-id register that
can be used to identify the peripheral type, vendor, and revision.
This value can be used for driver matching.

As SP805 WDT is a primecell IP, it follows the base bindings specified in
'arm/primecell.txt'

Required properties:
- compatible:  Should be "arm,sp805" & "arm,primecell"
- reg:         Should contain location and length for watchdog timer register
- clocks:      Clocks driving the watchdog timer hardware. This list should be
               2 clocks. With 2 clocks, the order is wdog_clk, apb_pclk
               wdog_clk can be equal to or be a sub-multiple of the apb_pclk
               frequency
- clock-names: Shall be "wdog_clk" for first clock and "apb_pclk" for the
               second one

Optional properties:
- interrupts:  Should specify WDT interrupt number
- timeout-sec: Should specify default WDT timeout in seconds. If unset, the
               default timeout is determined by the driver

Example:
	watchdog@66090000 {
		compatible = "arm,sp805", "arm,primecell";
		reg = <0x66090000 0x1000>;
		interrupts = <GIC_SPI 406 IRQ_TYPE_LEVEL_HIGH>;
		clocks = <&wdt_clk>, <&apb_pclk>;
		clock-names = "wdog_clk", "apb_pclk";
	};
```

## Documentation/devicetree/bindings/watchdog/arm,sp805.yaml
```yaml
# SPDX-License-Identifier: GPL-2.0
%YAML 1.2
---
$id: http://devicetree.org/schemas/watchdog/arm,sp805.yaml#
$schema: http://devicetree.org/meta-schemas/core.yaml#

title: ARM AMBA Primecell SP805 Watchdog

maintainers:
  - Viresh Kumar <vireshk@kernel.org>

description: |+
  The Arm SP805 IP implements a watchdog device, which triggers an interrupt
  after a configurable time period. If that interrupt has not been serviced
  when the next interrupt would be triggered, the reset signal is asserted.

allOf:
  - $ref: /schemas/watchdog/watchdog.yaml#

# Need a custom select here or 'arm,primecell' will match on lots of nodes
select:
  properties:
    compatible:
      contains:
        const: arm,sp805
  required:
    - compatible

properties:
  compatible:
    items:
      - const: arm,sp805
      - const: arm,primecell

  interrupts:
    maxItems: 1

  reg:
    maxItems: 1

  clocks:
    description: |
      Clocks driving the watchdog timer hardware. The first clock is used
      for the actual watchdog counter. The second clock drives the register
      interface.
    minItems: 2
    maxItems: 2

  clock-names:
    items:
      - const: wdog_clk
      - const: apb_pclk

required:
  - compatible
  - reg
  - clocks
  - clock-names

unevaluatedProperties: false

examples:
  - |
    #include <dt-bindings/interrupt-controller/arm-gic.h>
    watchdog@66090000 {
        compatible = "arm,sp805", "arm,primecell";
        reg = <0x66090000 0x1000>;
        interrupts = <GIC_SPI 406 IRQ_TYPE_LEVEL_HIGH>;
        clocks = <&wdt_clk>, <&apb_pclk>;
        clock-names = "wdog_clk", "apb_pclk";
    };
```

## Documentation/devicetree/bindings/watchdog/arm,twd-wdt.yaml
```yaml
# SPDX-License-Identifier: (GPL-2.0-only OR BSD-2-Clause)
%YAML 1.2
---
$id: http://devicetree.org/schemas/watchdog/arm,twd-wdt.yaml#
$schema: http://devicetree.org/meta-schemas/core.yaml#

title: ARM Timer-Watchdog Watchdog

maintainers:
  - Rob Herring <robh@kernel.org>

description:
  ARM 11MP, Cortex-A5 and Cortex-A9 are often associated with a per-core
  Timer-Watchdog (aka TWD), which provides both a per-cpu local timer
  and watchdog.

  The TWD is usually attached to a GIC to deliver its two per-processor
  interrupts.

properties:
  compatible:
    enum:
      - arm,cortex-a9-twd-wdt
      - arm,cortex-a5-twd-wdt
      - arm,arm11mp-twd-wdt

  reg:
    maxItems: 1

  interrupts:
    maxItems: 1

  clocks:
    maxItems: 1

required:
  - compatible
  - reg

additionalProperties: false

examples:
  - |
    #include <dt-bindings/interrupt-controller/arm-gic.h>

    watchdog@2c000620 {
            compatible = "arm,arm11mp-twd-wdt";
            reg = <0x2c000620 0x20>;
            interrupts = <GIC_PPI 14 0xf01>;
    };
```

## Documentation/devicetree/bindings/watchdog/arm-smc-wdt.yaml
```yaml
# SPDX-License-Identifier: (GPL-2.0-only OR BSD-2-Clause)
%YAML 1.2
---
$id: http://devicetree.org/schemas/watchdog/arm-smc-wdt.yaml#
$schema: http://devicetree.org/meta-schemas/core.yaml#

title: ARM Secure Monitor Call based watchdog

maintainers:
  - Julius Werner <jwerner@chromium.org>

allOf:
  - $ref: watchdog.yaml#

properties:
  compatible:
    enum:
      - arm,smc-wdt

  arm,smc-id:
    $ref: /schemas/types.yaml#/definitions/uint32
    description: |
      The ATF smc function id used by the firmware.
      Defaults to 0x82003D06 if unset.

required:
  - compatible

unevaluatedProperties: false

examples:
  - |
    watchdog {
        compatible = "arm,smc-wdt";
        arm,smc-id = <0x82003D06>;
        timeout-sec = <15>;
    };

...
```

## Documentation/devicetree/bindings/watchdog/armada-37xx-wdt.txt
```
* Armada 37xx CPU Watchdog Timer Controller

Required properties:
- compatible : must be "marvell,armada-3700-wdt"
- reg : base physical address of the controller and length of memory mapped
	region.
- clocks : the clock feeding the watchdog timer. See clock-bindings.txt
- marvell,system-controller : reference to syscon node for the CPU Miscellaneous
	Registers

Example:

	cpu_misc: system-controller@d000 {
		compatible = "marvell,armada-3700-cpu-misc", "syscon";
		reg = <0xd000 0x1000>;
	};

	wdt: watchdog@8300 {
		compatible = "marvell,armada-3700-wdt";
		reg = <0x8300 0x40>;
		marvell,system-controller = <&cpu_misc>;
		clocks = <&xtalclk>;
	};
```

## Documentation/devicetree/bindings/watchdog/aspeed,ast2400-wdt.yaml
```yaml
# SPDX-License-Identifier: (GPL-2.0-only OR BSD-2-Clause)
%YAML 1.2
---
$id: http://devicetree.org/schemas/watchdog/aspeed,ast2400-wdt.yaml#
$schema: http://devicetree.org/meta-schemas/core.yaml#

title: Aspeed watchdog timer controllers

maintainers:
  - Andrew Jeffery <andrew@codeconstruct.com.au>

properties:
  compatible:
    enum:
      - aspeed,ast2400-wdt
      - aspeed,ast2500-wdt
      - aspeed,ast2600-wdt

  reg:
    maxItems: 1

  clocks:
    maxItems: 1
    description: >
      The clock used to drive the watchdog counter. From the AST2500 no source
      other than the 1MHz clock can be selected, so the clocks property is
      optional.

  aspeed,reset-type:
    $ref: /schemas/types.yaml#/definitions/string
    enum:
      - cpu
      - soc
      - system
      - none
    default: system
    description: >
      The watchdog can be programmed to generate one of three different types of
      reset when a timeout occcurs.

      Specifying 'cpu' will only reset the processor on a timeout event.

      Specifying 'soc' will reset a configurable subset of the SoC's controllers
      on a timeout event. Controllers critical to the SoC's operation may remain
      untouched. The set of SoC controllers to reset may be specified via the
      aspeed,reset-mask property if the node has the aspeed,ast2500-wdt or
      aspeed,ast2600-wdt compatible.

      Specifying 'system' will reset all controllers on a timeout event, as if
      EXTRST had been asserted.

      Specifying 'none' will cause the timeout event to have no reset effect.
      Another watchdog engine on the chip must be used for chip reset operations.

  aspeed,alt-boot:
    $ref: /schemas/types.yaml#/definitions/flag
    description: >
      Direct the watchdog to configure the SoC to boot from the alternative boot
      region if a timeout occurs.

  aspeed,external-signal:
    $ref: /schemas/types.yaml#/definitions/flag
    description: >
      Assert the timeout event on an external signal pin associated with the
      watchdog controller instance. The pin must be muxed appropriately.

  aspeed,ext-pulse-duration:
    $ref: /schemas/types.yaml#/definitions/uint32
    description: >
      The duration, in microseconds, of the pulse emitted on the external signal
      pin.

  aspeed,ext-push-pull:
    $ref: /schemas/types.yaml#/definitions/flag
    description: >
      If aspeed,external-signal is specified in the node, set the external
      signal pin's drive type to push-pull. If aspeed,ext-push-pull is not
      specified then the pin is configured as open-drain.

  aspeed,ext-active-high:
    $ref: /schemas/types.yaml#/definitions/flag
    description: >
      If both aspeed,external-signal and aspeed,ext-push-pull are specified in
      the node, set the pulse polarity to active-high. If aspeed,ext-active-high
      is not specified then the pin is configured as active-low.

  aspeed,reset-mask:
    $ref: /schemas/types.yaml#/definitions/uint32-array
    minItems: 1
    maxItems: 2
    description: >
      A bitmask indicating which peripherals will be reset if the watchdog
      timer expires. On AST2500 SoCs this should be a single word defined using
      the AST2500_WDT_RESET_* macros; on AST2600 SoCs this should be a two-word
      array with the first word defined using the AST2600_WDT_RESET1_* macros,
      and the second word defined using the AST2600_WDT_RESET2_* macros.

required:
  - compatible
  - reg

allOf:
  - if:
      anyOf:
        - required:
            - aspeed,ext-push-pull
        - required:
            - aspeed,ext-active-high
        - required:
            - aspeed,reset-mask
    then:
      properties:
        compatible:
          enum:
            - aspeed,ast2500-wdt
            - aspeed,ast2600-wdt
  - if:
      required:
        - aspeed,ext-active-high
    then:
      required:
        - aspeed,ext-push-pull

additionalProperties: false

examples:
  - |
    watchdog@1e785000 {
        compatible = "aspeed,ast2400-wdt";
        reg = <0x1e785000 0x1c>;
        aspeed,reset-type = "system";
        aspeed,external-signal;
    };
  - |
    #include <dt-bindings/watchdog/aspeed-wdt.h>
    watchdog@1e785040 {
        compatible = "aspeed,ast2600-wdt";
        reg = <0x1e785040 0x40>;
        aspeed,reset-type = "soc";
        aspeed,reset-mask = <AST2600_WDT_RESET1_DEFAULT
                            (AST2600_WDT_RESET2_DEFAULT & ~AST2600_WDT_RESET2_LPC)>;
    };
```

## Documentation/devicetree/bindings/watchdog/aspeed-wdt.txt
```
Aspeed Watchdog Timer

Required properties:
 - compatible: must be one of:
	- "aspeed,ast2400-wdt"
	- "aspeed,ast2500-wdt"
	- "aspeed,ast2600-wdt"

 - reg: physical base address of the controller and length of memory mapped
   region

Optional properties:

 - aspeed,reset-type = "cpu|soc|system|none"

   Reset behavior - Whenever a timeout occurs the watchdog can be programmed
   to generate one of three different, mutually exclusive, types of resets.

   Type "none" can be specified to indicate that no resets are to be done.
   This is useful in situations where another watchdog engine on chip is
   to perform the reset.

   If 'aspeed,reset-type=' is not specified the default is to enable system
   reset.

   Reset types:

        - cpu: Reset CPU on watchdog timeout

        - soc: Reset 'System on Chip' on watchdog timeout

        - system: Reset system on watchdog timeout

        - none: No reset is performed on timeout. Assumes another watchdog
                engine is responsible for this.

 - aspeed,alt-boot:    If property is present then boot from alternate block.
 - aspeed,external-signal: If property is present then signal is sent to
			external reset counter (only WDT1 and WDT2). If not
			specified no external signal is sent.
 - aspeed,ext-pulse-duration: External signal pulse duration in microseconds

Optional properties for AST2500-compatible watchdogs:
 - aspeed,ext-push-pull: If aspeed,external-signal is present, set the pin's
			 drive type to push-pull. The default is open-drain.
 - aspeed,ext-active-high: If aspeed,external-signal is present and and the pin
			   is configured as push-pull, then set the pulse
			   polarity to active-high. The default is active-low.

Optional properties for AST2500- and AST2600-compatible watchdogs:
 - aspeed,reset-mask: A bitmask indicating which peripherals will be reset if
		      the watchdog timer expires.  On AST2500 this should be a
		      single word defined using the AST2500_WDT_RESET_* macros;
		      on AST2600 this should be a two-word array with the first
		      word defined using the AST2600_WDT_RESET1_* macros and the
		      second word defined using the AST2600_WDT_RESET2_* macros.

Examples:

	wdt1: watchdog@1e785000 {
		compatible = "aspeed,ast2400-wdt";
		reg = <0x1e785000 0x1c>;
		aspeed,reset-type = "system";
		aspeed,external-signal;
	};

	#include <dt-bindings/watchdog/aspeed-wdt.h>
	wdt2: watchdog@1e785040 {
		compatible = "aspeed,ast2600-wdt";
		reg = <0x1e785040 0x40>;
		aspeed,reset-mask = <AST2600_WDT_RESET1_DEFAULT
				     (AST2600_WDT_RESET2_DEFAULT & ~AST2600_WDT_RESET2_LPC)>;
	};
```

## Documentation/devicetree/bindings/watchdog/atmel,at91rm9200-wdt.yaml
```yaml
# SPDX-License-Identifier: (GPL-2.0-only OR BSD-2-Clause)
%YAML 1.2
---
$id: http://devicetree.org/schemas/watchdog/atmel,at91rm9200-wdt.yaml#
$schema: http://devicetree.org/meta-schemas/core.yaml#

title: Atmel AT91RM9200 System Timer Watchdog

maintainers:
  - Nicolas Ferre <nicolas.ferre@microchip.com>

allOf:
  - $ref: watchdog.yaml#

properties:
  compatible:
    const: atmel,at91rm9200-wdt

  reg:
    maxItems: 1

required:
  - compatible
  - reg

unevaluatedProperties: false

examples:
  - |
    watchdog@fffffd00 {
        compatible = "atmel,at91rm9200-wdt";
        reg = <0xfffffd00 0x10>;
    };
```
