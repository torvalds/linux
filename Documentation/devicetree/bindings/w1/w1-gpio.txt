## Documentation/devicetree/bindings/w1/w1-gpio.txt
```
w1-gpio devicetree bindings

Required properties:

 - compatible: "w1-gpio"
 - gpios: one or two GPIO specs:
		- the first one is used as data I/O pin
		- the second one is optional. If specified, it is used as
		  enable pin for an external pin pullup.

Optional properties:

 - linux,open-drain: if specified, the data pin is considered in
		     open-drain mode.

Also refer to the generic w1.txt document.

Examples:

	onewire {
		compatible = "w1-gpio";
		gpios = <&gpio 0 GPIO_ACTIVE_HIGH>;

		battery {
			// ...
		};
	};
```

## Documentation/devicetree/bindings/w1/w1-gpio.yaml
```yaml
# SPDX-License-Identifier: GPL-2.0
%YAML 1.2
---
$id: http://devicetree.org/schemas/w1/w1-gpio.yaml#
$schema: http://devicetree.org/meta-schemas/core.yaml#

title: Bitbanged GPIO 1-Wire Bus

maintainers:
  - Daniel Mack <zonque@gmail.com>

properties:
  compatible:
    const: w1-gpio

  gpios:
    minItems: 1
    items:
      - description: Data I/O pin
      - description: Enable pin for an external pull-up resistor

  linux,open-drain:
    type: boolean
    description: >
      If specified, the data pin is considered in open-drain mode.

required:
  - compatible
  - gpios

additionalProperties:
  type: object

examples:
  - |
    #include <dt-bindings/gpio/gpio.h>

    onewire {
        compatible = "w1-gpio";
        gpios = <&gpio 0 GPIO_ACTIVE_HIGH>;
    };

...
```

## Documentation/devicetree/bindings/w1/w1-uart.yaml
```yaml
# SPDX-License-Identifier: GPL-2.0-only OR BSD-2-Clause
%YAML 1.2
---
$id: http://devicetree.org/schemas/w1/w1-uart.yaml#
$schema: http://devicetree.org/meta-schemas/core.yaml#

title: UART 1-Wire Bus

maintainers:
  - Christoph Winklhofer <cj.winklhofer@gmail.com>

description: |
  UART 1-wire bus. Utilizes the UART interface via the Serial Device Bus
  to create the 1-Wire timing patterns.

  The UART peripheral must support full-duplex and operate in open-drain
  mode. The timing patterns are generated by a specific combination of
  baud-rate and transmitted byte, which corresponds to a 1-Wire read bit,
  write bit or reset pulse.

  The default baud-rate for reset and presence detection is 9600 and for
  a 1-Wire read or write operation 115200. In case the actual baud-rate
  is different from the requested one, the transmitted byte is adapted
  to generate the 1-Wire timing patterns.

  https://www.analog.com/en/technical-articles/using-a-uart-to-implement-a-1wire-bus-master.html

properties:
  compatible:
    const: w1-uart

  reset-bps:
    default: 9600
    description:
      The baud rate for the 1-Wire reset and presence detect.

  write-0-bps:
    default: 115200
    description:
      The baud rate for the 1-Wire write-0 cycle.

  write-1-bps:
    default: 115200
    description:
      The baud rate for the 1-Wire write-1 and read cycle.

required:
  - compatible

additionalProperties:
  type: object

examples:
  - |
    serial {
        onewire {
            compatible = "w1-uart";
        };
    };
```

## Documentation/devicetree/bindings/w1/w1.txt
```
Generic devicetree bindings for onewire (w1) busses
===================================================

Onewire busses are described through analdes of their master bus controller.
Slave devices are listed as sub-analdes of such master devices. For analw, only
one slave is allowed per bus master.


Example:

	charger: charger {
		compatible = "gpio-charger";
		charger-type = "mains";
		gpios = <&gpio 1 GPIO_ACTIVE_LOW>;
	};

	onewire {
		compatible = "w1-gpio";
		gpios = <&gpio 100 0>, <&gpio 101 0>;

		battery {
			compatible = "maxim,ds2760";
			power-supplies = <&charger>;
		};
	};
```

## Documentation/devicetree/bindings/watchdog/airoha,en7581-wdt.yaml
```yaml
# SPDX-License-Identifier: (GPL-2.0-only OR BSD-2-Clause)
%YAML 1.2
---
$id: http://devicetree.org/schemas/watchdog/airoha,en7581-wdt.yaml#
$schema: http://devicetree.org/meta-schemas/core.yaml#

title: Airoha EN7581 Watchdog Timer

maintainers:
  - Christian Marangi <ansuelsmth@gmail.com>

allOf:
  - $ref: watchdog.yaml#

properties:
  compatible:
    const: airoha,en7581-wdt

  reg:
    maxItems: 1

  clocks:
    description: BUS clock (timer ticks at half the BUS clock)
    maxItems: 1

  clock-names:
    const: bus

required:
  - compatible
  - reg
  - clocks
  - clock-names

unevaluatedProperties: false

examples:
  - |
    #include <dt-bindings/clock/en7523-clk.h>

    watchdog@1fbf0100 {
        compatible = "airoha,en7581-wdt";
        reg = <0x1fbf0100 0x3c>;

        clocks = <&scuclk EN7523_CLK_BUS>;
        clock-names = "bus";
    };
```

## Documentation/devicetree/bindings/watchdog/allwinner,sun4i-a10-wdt.yaml
```yaml
# SPDX-License-Identifier: GPL-2.0
%YAML 1.2
---
$id: http://devicetree.org/schemas/watchdog/allwinner,sun4i-a10-wdt.yaml#
$schema: http://devicetree.org/meta-schemas/core.yaml#

title: Allwinner A10 Watchdog

maintainers:
  - Chen-Yu Tsai <wens@csie.org>
  - Maxime Ripard <mripard@kernel.org>

allOf:
  - $ref: watchdog.yaml#

properties:
  compatible:
    oneOf:
      - const: allwinner,sun4i-a10-wdt
      - const: allwinner,sun6i-a31-wdt
      - items:
          - enum:
              - allwinner,sun50i-a64-wdt
              - allwinner,sun50i-a100-wdt
              - allwinner,sun50i-h6-wdt
              - allwinner,sun50i-h616-wdt
              - allwinner,sun50i-r329-wdt
              - allwinner,sun50i-r329-wdt-reset
              - allwinner,suniv-f1c100s-wdt
          - const: allwinner,sun6i-a31-wdt
      - const: allwinner,sun20i-d1-wdt
      - items:
          - const: allwinner,sun20i-d1-wdt-reset
          - const: allwinner,sun20i-d1-wdt
      - const: allwinner,sun55i-a523-wdt

  reg:
    maxItems: 1

  clocks:
    minItems: 1
    items:
      - description: 32 KHz input clock
      - description: secondary clock source

  interrupts:
    maxItems: 1

required:
  - compatible
  - reg
  - clocks
  - interrupts

if:
  properties:
    compatible:
      contains:
        enum:
          - allwinner,sun20i-d1-wdt
          - allwinner,sun20i-d1-wdt-reset
          - allwinner,sun50i-r329-wdt
          - allwinner,sun50i-r329-wdt-reset
          - allwinner,sun55i-a523-wdt

then:
  properties:
    clocks:
      items:
        - description: High-frequency oscillator input, divided internally
        - description: Low-frequency oscillator input

    clock-names:
      items:
        - const: hosc
        - const: losc

  required:
    - clock-names

else:
  properties:
    clocks:
      maxItems: 1

unevaluatedProperties: false

examples:
  - |
    wdt: watchdog@1c20c90 {
        compatible = "allwinner,sun4i-a10-wdt";
        reg = <0x01c20c90 0x10>;
        interrupts = <24>;
        clocks = <&osc24M>;
        timeout-sec = <10>;
    };

...
```

## Documentation/devicetree/bindings/watchdog/alphascale,asm9260-wdt.yaml
```yaml
# SPDX-License-Identifier: GPL-2.0-only OR BSD-2-Clause
%YAML 1.2
---
$id: http://devicetree.org/schemas/watchdog/alphascale,asm9260-wdt.yaml#
$schema: http://devicetree.org/meta-schemas/core.yaml#

title: Alphascale asm9260 Watchdog timer

maintainers:
  - Oleksij Rempel <linux@rempel-privat.de>

allOf:
  - $ref: watchdog.yaml#

properties:
  compatible:
    const: alphascale,asm9260-wdt

  reg:
    maxItems: 1

  clocks:
    items:
      - description: source clock, used for tick counter
      - description: ahb gate

  clock-names:
    items:
      - const: mod
      - const: ahb

  interrupts:
    maxItems: 1

  resets:
    maxItems: 1

  reset-names:
    items:
      - const: wdt_rst

  alphascale,mode:
    description: |
      Specifies the reset mode of operation. If set to sw, then reset is handled
      via interrupt request, if set to debug, then it does nothing and logs.
    $ref: /schemas/types.yaml#/definitions/string
    enum: [hw, sw, debug]
    default: hw

required:
  - compatible
  - reg
  - clocks
  - clock-names
  - interrupts

unevaluatedProperties: false

examples:
  - |
    #include <dt-bindings/clock/alphascale,asm9260.h>
    watchdog0: watchdog@80048000 {
      compatible = "alphascale,asm9260-wdt";
      reg = <0x80048000 0x10>;
      clocks = <&acc CLKID_SYS_WDT>, <&acc CLKID_AHB_WDT>;
      clock-names = "mod", "ahb";
      interrupts = <55>;
      timeout-sec = <30>;
      alphascale,mode = "hw";
    };
```

## Documentation/devicetree/bindings/watchdog/alphascale-asm9260.txt
```
Alphascale asm9260 Watchdog timer

Required properties:

- compatible : should be "alphascale,asm9260-wdt".
- reg : Specifies base physical address and size of the registers.
- clocks : the clocks feeding the watchdog timer. See clock-bindings.txt
- clock-names : should be set to
	"mod" - source for tick counter.
	"ahb" - ahb gate.
- resets : phandle pointing to the system reset controller with
	line index for the watchdog.
- reset-names : should be set to "wdt_rst".

Optional properties:
- timeout-sec : shall contain the default watchdog timeout in seconds,
	if unset, the default timeout is 30 seconds.
- alphascale,mode : three modes are supported
	"hw" - hw reset (default).
	"sw" - sw reset.
	"debug" - no action is taken.

Example:

watchdog0: watchdog@80048000 {
	compatible = "alphascale,asm9260-wdt";
	reg = <0x80048000 0x10>;
	clocks = <&acc CLKID_SYS_WDT>, <&acc CLKID_AHB_WDT>;
	clock-names = "mod", "ahb";
	interrupts = <55>;
	resets = <&rst WDT_RESET>;
	reset-names = "wdt_rst";
	timeout-sec = <30>;
	alphascale,mode = "hw";
};
```

## Documentation/devicetree/bindings/watchdog/amlogic,meson-gxbb-wdt.yaml
```yaml
# SPDX-License-Identifier: (GPL-2.0 OR BSD-2-Clause)
# Copyright 2019 BayLibre, SAS
%YAML 1.2
---
$id: http://devicetree.org/schemas/watchdog/amlogic,meson-gxbb-wdt.yaml#
$schema: http://devicetree.org/meta-schemas/core.yaml#

title: Meson GXBB SoCs Watchdog timer

maintainers:
  - Neil Armstrong <neil.armstrong@linaro.org>

allOf:
  - $ref: watchdog.yaml#

properties:
  compatible:
    oneOf:
      - enum:
          - amlogic,meson-gxbb-wdt
          - amlogic,t7-wdt
      - items:
          - enum:
              - amlogic,c3-wdt
              - amlogic,s4-wdt
          - const: amlogic,t7-wdt

  reg:
    maxItems: 1

  clocks:
    maxItems: 1
    description:
      A phandle to the clock of this PHY

required:
  - compatible
  - reg
  - clocks

unevaluatedProperties: false

examples:
  - |
    watchdog@98d0 {
        compatible = "amlogic,meson-gxbb-wdt";
        reg = <0x98d0 0x10>;
        clocks = <&xtal>;
    };
```

## Documentation/devicetree/bindings/watchdog/amlogic,meson6-wdt.yaml
```yaml
# SPDX-License-Identifier: (GPL-2.0-only OR BSD-2-Clause)
%YAML 1.2
---
$id: http://devicetree.org/schemas/watchdog/amlogic,meson6-wdt.yaml#
$schema: http://devicetree.org/meta-schemas/core.yaml#

title: Amlogic Meson6 SoCs Watchdog timer

maintainers:
  - Neil Armstrong <neil.armstrong@linaro.org>
  - Martin Blumenstingl <martin.blumenstingl@googlemail.com>

allOf:
  - $ref: watchdog.yaml#

properties:
  compatible:
    oneOf:
      - enum:
          - amlogic,meson6-wdt
          - amlogic,meson8-wdt
          - amlogic,meson8b-wdt
      - items:
          - const: amlogic,meson8m2-wdt
          - const: amlogic,meson8b-wdt

  interrupts:
    maxItems: 1

  reg:
    maxItems: 1

required:
  - compatible
  - interrupts
  - reg

unevaluatedProperties: false

examples:
  - |
    #include <dt-bindings/interrupt-controller/irq.h>
    #include <dt-bindings/interrupt-controller/arm-gic.h>

    wdt: watchdog@c1109900 {
        compatible = "amlogic,meson6-wdt";
        reg = <0xc1109900 0x8>;
        interrupts = <GIC_SPI 0 IRQ_TYPE_EDGE_RISING>;
        timeout-sec = <10>;
    };
```

## Documentation/devicetree/bindings/watchdog/andestech,ae350-wdt.yaml
```yaml
# SPDX-License-Identifier: GPL-2.0-only OR BSD-2-Clause
%YAML 1.2
---
$id: http://devicetree.org/schemas/watchdog/andestech,ae350-wdt.yaml#
$schema: http://devicetree.org/meta-schemas/core.yaml#

title: Andes ATCWDT200 Watchdog Timer

maintainers:
  - CL Wang <cl634@andestech.com>

allOf:
  - $ref: watchdog.yaml#

properties:
  compatible:
    oneOf:
      - items:
          - enum:
              - andestech,qilai-wdt
          - const: andestech,ae350-wdt
      - const: andestech,ae350-wdt

  reg:
    maxItems: 1

  clocks:
    maxItems: 1

  andestech,clock-source:
    $ref: /schemas/types.yaml#/definitions/uint32
    enum: [0, 1]
    description: |
      Select the clock source for the watchdog timer.
      0 - External clock
      1 - P clock

required:
  - compatible
  - reg
  - clocks
  - andestech,clock-source

unevaluatedProperties: false

examples:
  - |
    watchdog@f0500000 {
        compatible = "andestech,ae350-wdt";
        reg = <0xf0500000 0x20>;
        clocks = <&clk_wdt>;
        andestech,clock-source = <0>;
    };
```

## Documentation/devicetree/bindings/watchdog/apple,wdt.yaml
```yaml
# SPDX-License-Identifier: (GPL-2.0-only OR BSD-2-Clause)
%YAML 1.2
---
$id: http://devicetree.org/schemas/watchdog/apple,wdt.yaml#
$schema: http://devicetree.org/meta-schemas/core.yaml#

title: Apple SoC Watchdog

maintainers:
  - Sven Peter <sven@svenpeter.dev>

allOf:
  - $ref: watchdog.yaml#

properties:
  compatible:
    items:
      - enum:
          - apple,t8103-wdt
          - apple,t8112-wdt
          - apple,t6000-wdt
      - const: apple,wdt

  reg:
    maxItems: 1

  clocks:
    maxItems: 1

  interrupts:
    maxItems: 1

required:
  - compatible
  - reg
  - clocks
  - interrupts

unevaluatedProperties: false

examples:
  - |
    #include <dt-bindings/interrupt-controller/apple-aic.h>
    #include <dt-bindings/interrupt-controller/irq.h>

    wdt: watchdog@50000000 {
        compatible = "apple,t8103-wdt", "apple,wdt";
        reg = <0x50000000 0x4000>;
        clocks = <&clk>;
        interrupts = <AIC_IRQ 123 IRQ_TYPE_LEVEL_HIGH>;
    };

...
```

## Documentation/devicetree/bindings/watchdog/arm,sbsa-gwdt.yaml
```yaml
# SPDX-License-Identifier: (GPL-2.0-only OR BSD-2-Clause)
%YAML 1.2
---
$id: http://devicetree.org/schemas/watchdog/arm,sbsa-gwdt.yaml#
$schema: http://devicetree.org/meta-schemas/core.yaml#

title: SBSA (Server Base System Architecture) Generic Watchdog

maintainers:
  - Fu Wei <fu.wei@linaro.org>

description: |
  The SBSA Generic Watchdog Timer is used to force a reset of the system after
  two stages of timeout have elapsed. A detailed definition of the watchdog
  timer can be found in the ARM document: ARM-DEN-0029 - Server Base System
  Architecture (SBSA)

allOf:
  - $ref: watchdog.yaml#

properties:
  compatible:
    const: arm,sbsa-gwdt

  reg:
    items:
      - description: Watchdog control frame
      - description: Refresh frame

  interrupts:
    description: The Watchdog Signal 0 (WS0) SPI (Shared Peripheral Interrupt)
    maxItems: 1

required:
  - compatible
  - reg
  - interrupts

unevaluatedProperties: false

examples:
  - |

    watchdog@2a440000 {
        compatible = "arm,sbsa-gwdt";
        reg = <0x2a440000 0x1000>,
              <0x2a450000 0x1000>;
        interrupts = <0 27 4>;
        timeout-sec = <30>;
    };
...
```
