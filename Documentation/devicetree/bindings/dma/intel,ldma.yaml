## Documentation/devicetree/bindings/dma/marvell,orion-xor.yaml
```yaml
# SPDX-License-Identifier: (GPL-2.0-only OR BSD-2-Clause)
%YAML 1.2
---
$id: http://devicetree.org/schemas/dma/marvell,orion-xor.yaml#
$schema: http://devicetree.org/meta-schemas/core.yaml#

title: Marvell XOR engine

maintainers:
  - Andrew Lunn <andrew@lunn.ch>
  - Gregory Clement <gregory.clement@bootlin.com>

properties:
  compatible:
    oneOf:
      - items:
          - const: marvell,armada-380-xor
          - const: marvell,orion-xor
      - enum:
          - marvell,armada-3700-xor
          - marvell,orion-xor

  reg:
    items:
      - description: Low registers for the XOR engine
      - description: High registers for the XOR engine

  clocks:
    maxItems: 1

patternProperties:
  "^(channel|xor)[0-9]+$":
    description: XOR channel sub-node
    type: object
    additionalProperties: false

    properties:
      interrupts:
        description: Interrupt specifier for the XOR channel
        items:
          - description: Interrupt for this channel

      dmacap,memcpy:
        type: boolean
        deprecated: true
        description:
          Indicates that the XOR channel is capable of memcpy operations

      dmacap,memset:
        type: boolean
        deprecated: true
        description:
          Indicates that the XOR channel is capable of memset operations

      dmacap,xor:
        type: boolean
        deprecated: true
        description:
          Indicates that the XOR channel is capable of xor operations

    required:
      - interrupts

required:
  - compatible
  - reg

additionalProperties: false

examples:
  - |
    xor@d0060900 {
        compatible = "marvell,orion-xor";
        reg = <0xd0060900 0x100>,
              <0xd0060b00 0x100>;
        clocks = <&coreclk 0>;

        xor00 {
            interrupts = <51>;
        };
        xor01 {
            interrupts = <52>;
        };
    };
```

## Documentation/devicetree/bindings/dma/marvell,xor-v2.yaml
```yaml
# SPDX-License-Identifier: GPL-2.0
%YAML 1.2
---
$id: http://devicetree.org/schemas/dma/marvell,xor-v2.yaml#
$schema: http://devicetree.org/meta-schemas/core.yaml#

title: Marvell XOR v2 engines

maintainers:
  - Andrew Lunn <andrew@lunn.ch>

properties:
  compatible:
    oneOf:
      - const: marvell,xor-v2
      - items:
          - enum:
              - marvell,armada-7k-xor
          - const: marvell,xor-v2

  reg:
    items:
      - description: DMA registers
      - description: global registers

  clocks:
    minItems: 1
    maxItems: 2

  clock-names:
    minItems: 1
    items:
      - const: core
      - const: reg

  msi-parent:
    description:
      Phandle to the MSI-capable interrupt controller used for
      interrupts.
    maxItems: 1

  dma-coherent: true

required:
  - compatible
  - reg
  - msi-parent
  - dma-coherent

additionalProperties: false

examples:
  - |
    xor0@6a0000 {
        compatible = "marvell,armada-7k-xor", "marvell,xor-v2";
        reg = <0x6a0000 0x1000>, <0x6b0000 0x1000>;
        clocks = <&ap_clk 0>, <&ap_clk 1>;
        clock-names = "core", "reg";
        msi-parent = <&gic_v2m0>;
        dma-coherent;
    };
```

## Documentation/devicetree/bindings/dma/mediatek,mt7622-hsdma.yaml
```yaml
# SPDX-License-Identifier: GPL-2.0-only OR BSD-2-Clause
%YAML 1.2
---
$id: http://devicetree.org/schemas/dma/mediatek,mt7622-hsdma.yaml#
$schema: http://devicetree.org/meta-schemas/core.yaml#

title: MediaTek High-Speed DMA Controller

maintainers:
  - Sean Wang <sean.wang@mediatek.com>

allOf:
  - $ref: dma-controller.yaml#

properties:
  compatible:
    enum:
      - mediatek,mt7622-hsdma
      - mediatek,mt7623-hsdma

  reg:
    maxItems: 1

  interrupts:
    maxItems: 1

  clocks:
    maxItems: 1

  clock-names:
    const: hsdma

  power-domains:
    maxItems: 1

  "#dma-cells":
    description: Channel number
    const: 1

required:
  - reg
  - interrupts
  - clocks
  - clock-names
  - power-domains

unevaluatedProperties: false

examples:
  - |
    #include <dt-bindings/clock/mt2701-clk.h>
    #include <dt-bindings/interrupt-controller/arm-gic.h>
    #include <dt-bindings/power/mt2701-power.h>

    dma-controller@1b007000 {
        compatible = "mediatek,mt7623-hsdma";
        reg = <0x1b007000 0x1000>;
        interrupts = <GIC_SPI 98 IRQ_TYPE_LEVEL_LOW>;
        clocks = <&ethsys CLK_ETHSYS_HSDMA>;
        clock-names = "hsdma";
        power-domains = <&scpsys MT2701_POWER_DOMAIN_ETH>;
        #dma-cells = <1>;
    };
```

## Documentation/devicetree/bindings/dma/mediatek,uart-dma.yaml
```yaml
# SPDX-License-Identifier: (GPL-2.0-only OR BSD-2-Clause)
%YAML 1.2
---
$id: http://devicetree.org/schemas/dma/mediatek,uart-dma.yaml#
$schema: http://devicetree.org/meta-schemas/core.yaml#

title: MediaTek UART APDMA controller

maintainers:
  - Long Cheng <long.cheng@mediatek.com>

description: |
  The MediaTek UART APDMA controller provides DMA capabilities
  for the UART peripheral bus.

allOf:
  - $ref: "dma-controller.yaml#"

properties:
  compatible:
    oneOf:
      - items:
          - enum:
              - mediatek,mt2712-uart-dma
              - mediatek,mt6795-uart-dma
              - mediatek,mt8365-uart-dma
              - mediatek,mt8516-uart-dma
          - const: mediatek,mt6577-uart-dma
      - enum:
          - mediatek,mt6577-uart-dma

  reg:
    minItems: 1
    maxItems: 16

  interrupts:
    description: |
      TX, RX interrupt lines for each UART APDMA channel
    minItems: 1
    maxItems: 16

  clocks:
    description: Must contain one entry for the APDMA main clock
    maxItems: 1

  clock-names:
    const: apdma

  "#dma-cells":
    const: 1
    description: |
      The first cell specifies the UART APDMA channel number

  dma-requests:
    description: |
      Number of virtual channels of the UART APDMA controller
    maximum: 16

  mediatek,dma-33bits:
    type: boolean
    description: Enable 33-bits UART APDMA support

required:
  - compatible
  - reg
  - interrupts

additionalProperties: false

if:
  not:
    required:
      - dma-requests
then:
  properties:
    interrupts:
      maxItems: 8
    reg:
      maxItems: 8

examples:
  - |
    #include <dt-bindings/interrupt-controller/arm-gic.h>
    #include <dt-bindings/clock/mt2712-clk.h>
    soc {
        #address-cells = <2>;
        #size-cells = <2>;

        apdma: dma-controller@11000400 {
            compatible = "mediatek,mt2712-uart-dma",
                         "mediatek,mt6577-uart-dma";
            reg = <0 0x11000400 0 0x80>,
                  <0 0x11000480 0 0x80>,
                  <0 0x11000500 0 0x80>,
                  <0 0x11000580 0 0x80>,
                  <0 0x11000600 0 0x80>,
                  <0 0x11000680 0 0x80>,
                  <0 0x11000700 0 0x80>,
                  <0 0x11000780 0 0x80>,
                  <0 0x11000800 0 0x80>,
                  <0 0x11000880 0 0x80>,
                  <0 0x11000900 0 0x80>,
                  <0 0x11000980 0 0x80>;
            interrupts = <GIC_SPI 103 IRQ_TYPE_LEVEL_LOW>,
                         <GIC_SPI 104 IRQ_TYPE_LEVEL_LOW>,
                         <GIC_SPI 105 IRQ_TYPE_LEVEL_LOW>,
                         <GIC_SPI 106 IRQ_TYPE_LEVEL_LOW>,
                         <GIC_SPI 107 IRQ_TYPE_LEVEL_LOW>,
                         <GIC_SPI 108 IRQ_TYPE_LEVEL_LOW>,
                         <GIC_SPI 109 IRQ_TYPE_LEVEL_LOW>,
                         <GIC_SPI 110 IRQ_TYPE_LEVEL_LOW>,
                         <GIC_SPI 111 IRQ_TYPE_LEVEL_LOW>,
                         <GIC_SPI 112 IRQ_TYPE_LEVEL_LOW>,
                         <GIC_SPI 113 IRQ_TYPE_LEVEL_LOW>,
                         <GIC_SPI 114 IRQ_TYPE_LEVEL_LOW>;
            dma-requests = <12>;
            clocks = <&pericfg CLK_PERI_AP_DMA>;
            clock-names = "apdma";
            mediatek,dma-33bits;
            #dma-cells = <1>;
        };
    };

...
```

## Documentation/devicetree/bindings/dma/milbeaut-m10v-hdmac.txt
```
* Milbeaut AHB DMA Controller

Milbeaut AHB DMA controller has transfer capability below.
 - device to memory transfer
 - memory to device transfer

Required property:
- compatible:       Should be  "socionext,milbeaut-m10v-hdmac"
- reg:              Should contain DMA registers location and length.
- interrupts:       Should contain all of the per-channel DMA interrupts.
                     Number of channels is configurable - 2, 4 or 8, so
                     the number of interrupts specified should be {2,4,8}.
- #dma-cells:       Should be 1. Specify the ID of the slave.
- clocks:           Phandle to the clock used by the HDMAC module.


Example:

	hdmac1: dma-controller@1e110000 {
		compatible = "socionext,milbeaut-m10v-hdmac";
		reg = <0x1e110000 0x10000>;
		interrupts = <0 132 4>,
			     <0 133 4>,
			     <0 134 4>,
			     <0 135 4>,
			     <0 136 4>,
			     <0 137 4>,
			     <0 138 4>,
			     <0 139 4>;
		#dma-cells = <1>;
		clocks = <&dummy_clk>;
	};
```

## Documentation/devicetree/bindings/dma/milbeaut-m10v-xdmac.txt
```
* Milbeaut AXI DMA Controller

Milbeaut AXI DMA controller has only memory to memory transfer capability.

* DMA controller

Required property:
- compatible: 	Should be  "socionext,milbeaut-m10v-xdmac"
- reg:		Should contain DMA registers location and length.
- interrupts: 	Should contain all of the per-channel DMA interrupts.
                Number of channels is configurable - 2, 4 or 8, so
                the number of interrupts specified should be {2,4,8}.
- #dma-cells: 	Should be 1.

Example:
	xdmac0: dma-controller@1c250000 {
		compatible = "socionext,milbeaut-m10v-xdmac";
		reg = <0x1c250000 0x1000>;
		interrupts = <0 17 0x4>,
			     <0 18 0x4>,
			     <0 19 0x4>,
			     <0 20 0x4>;
		#dma-cells = <1>;
	};
```

## Documentation/devicetree/bindings/dma/mmp-dma.txt
```
* MARVELL MMP DMA controller

Marvell Peripheral DMA Controller
Used platfroms: pxa688, pxa910, pxa3xx, etc

Required properties:
- compatible: Should be "marvell,pdma-1.0"
- reg: Should contain DMA registers location and length.
- interrupts: Either contain all of the per-channel DMA interrupts
		or one irq for pdma device
- #dma-channels: Number of DMA channels supported by the controller.

"marvell,pdma-1.0"
Used platfroms: pxa25x, pxa27x, pxa3xx, pxa93x, pxa168, pxa910, pxa688.

Examples:

/*
 * Each channel has specific irq
 * ICU parse out irq channel from ICU register,
 * while DMA controller may not able to distinguish the irq channel
 * Using this method, interrupt-parent is required as demuxer
 * For example, pxa688 icu register 0x128, bit 0~15 is PDMA channel irq,
 * 18~21 is ADMA irq
 */
pdma: dma-controller@d4000000 {
	      compatible = "marvell,pdma-1.0";
	      reg = <0xd4000000 0x10000>;
	      interrupts = <0 1 2 3 4 5 6 7 8 9 10 11 12 13 14 15>;
	      interrupt-parent = <&intcmux32>;
	      #dma-channels = <16>;
      };

/*
 * One irq for all channels
 * Dmaengine driver (DMA controller) distinguish irq channel via
 * parsing internal register
 */
pdma: dma-controller@d4000000 {
	      compatible = "marvell,pdma-1.0";
	      reg = <0xd4000000 0x10000>;
	      interrupts = <47>;
	      #dma-channels = <16>;
      };


Marvell Two Channel DMA Controller used specifically for audio
Used platfroms: pxa688, pxa910

Required properties:
- compatible: Should be "marvell,adma-1.0" or "marvell,pxa910-squ"
- reg: Should contain DMA registers location and length.
- interrupts: Either contain all of the per-channel DMA interrupts
		or one irq for dma device

"marvell,adma-1.0" used on pxa688
"marvell,pxa910-squ" used on pxa910

Examples:

/* each channel has specific irq */
adma0: dma-controller@d42a0800 {
	      compatible = "marvell,adma-1.0";
	      reg = <0xd42a0800 0x100>;
	      interrupts = <18 19>;
	      interrupt-parent = <&intcmux32>;
      };

/* One irq for all channels */
squ: dma-controller@d42a0800 {
	      compatible = "marvell,pxa910-squ";
	      reg = <0xd42a0800 0x100>;
	      interrupts = <46>;
      };
```

## Documentation/devicetree/bindings/dma/moxa,moxart-dma.txt
```
MOXA ART DMA Controller

See dma.txt first

Required properties:

- compatible :	Must be "moxa,moxart-dma"
- reg :		Should contain registers location and length
- interrupts :	Should contain an interrupt-specifier for the sole
		interrupt generated by the device
- #dma-cells :	Should be 1, a single cell holding a line request number

Example:

	dma: dma@90500000 {
		compatible = "moxa,moxart-dma";
		reg = <0x90500080 0x40>;
		interrupts = <24 0>;
		#dma-cells = <1>;
	};


Clients:

DMA clients connected to the MOXA ART DMA controller must use the format
described in the dma.txt file, using a two-cell specifier for each channel:
a phandle plus one integer cells.
The two cells in order are:

1. A phandle pointing to the DMA controller.
2. Peripheral identifier for the hardware handshaking interface.

Example:
Use specific request line passing from dma
For example, MMC request line is 5

	mmc: mmc@98e00000 {
		compatible = "moxa,moxart-mmc";
		reg = <0x98e00000 0x5C>;
		interrupts = <5 0>;
		clocks = <&clk_apb>;
		dmas =  <&dma 5>,
			<&dma 5>;
		dma-names = "tx", "rx";
	};
```

## Documentation/devicetree/bindings/dma/mpc512x-dma.txt
```
* Freescale MPC512x and MPC8308 DMA Controller

The DMA controller in Freescale MPC512x and MPC8308 SoCs can move
blocks of memory contents between memory and peripherals or
from memory to memory.

Refer to "Generic DMA Controller and DMA request bindings" in
the dma/dma.txt file for a more detailed description of binding.

Required properties:
- compatible: should be "fsl,mpc5121-dma" or "fsl,mpc8308-dma";
- reg: should contain the DMA controller registers location and length;
- interrupt for the DMA controller: syntax of interrupt client node
	is described in interrupt-controller/interrupts.txt file.
- #dma-cells: the length of the DMA specifier, must be <1>.
	Each channel of this DMA controller has a peripheral request line,
	the assignment is fixed in hardware. This one cell
	in dmas property of a client device represents the channel number.

Example:

	dma0: dma@14000 {
		compatible = "fsl,mpc5121-dma";
		reg = <0x14000 0x1800>;
		interrupts = <65 0x8>;
		#dma-cells = <1>;
	};

DMA clients must use the format described in dma/dma.txt file.
```

## Documentation/devicetree/bindings/dma/mtk-hsdma.txt
```
MediaTek High-Speed DMA Controller
==================================

This device follows the generic DMA bindings defined in dma/dma.txt.

Required properties:

- compatible:	Must be one of
		  "mediatek,mt7622-hsdma": for MT7622 SoC
		  "mediatek,mt7623-hsdma": for MT7623 SoC
- reg:		Should contain the register's base address and length.
- interrupts:	Should contain a reference to the interrupt used by this
		device.
- clocks:	Should be the clock specifiers corresponding to the entry in
		clock-names property.
- clock-names:	Should contain "hsdma" entries.
- power-domains: Phandle to the power domain that the device is part of
- #dma-cells: 	The length of the DMA specifier, must be <1>. This one cell
		in dmas property of a client device represents the channel
		number.
Example:

        hsdma: dma-controller@1b007000 {
		compatible = "mediatek,mt7623-hsdma";
		reg = <0 0x1b007000 0 0x1000>;
		interrupts = <GIC_SPI 98 IRQ_TYPE_LEVEL_LOW>;
		clocks = <&ethsys CLK_ETHSYS_HSDMA>;
		clock-names = "hsdma";
		power-domains = <&scpsys MT2701_POWER_DOMAIN_ETH>;
		#dma-cells = <1>;
	};

DMA clients must use the format described in dma/dma.txt file.
```
