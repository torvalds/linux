## Documentation/devicetree/bindings/dma/intel,ldma.yaml
```yaml
# SPDX-License-Identifier: (GPL-2.0-only OR BSD-2-Clause)
%YAML 1.2
---
$id: http://devicetree.org/schemas/dma/intel,ldma.yaml#
$schema: http://devicetree.org/meta-schemas/core.yaml#

title: Lightning Mountain centralized DMA controllers.

maintainers:
  - chuanhua.lei@intel.com
  - mallikarjunax.reddy@intel.com

allOf:
  - $ref: dma-controller.yaml#

properties:
  compatible:
    enum:
      - intel,lgm-cdma
      - intel,lgm-dma2tx
      - intel,lgm-dma1rx
      - intel,lgm-dma1tx
      - intel,lgm-dma0tx
      - intel,lgm-dma3
      - intel,lgm-toe-dma30
      - intel,lgm-toe-dma31

  reg:
    maxItems: 1

  "#dma-cells":
    const: 3
    description:
      The first cell is the peripheral's DMA request line.
      The second cell is the peripheral's (port) number corresponding to the channel.
      The third cell is the burst length of the channel.

  dma-channels:
    minimum: 1
    maximum: 16

  dma-channel-mask:
    maxItems: 1

  clocks:
    maxItems: 1

  resets:
    maxItems: 1

  reset-names:
    items:
      - const: ctrl

  interrupts:
    maxItems: 1

  intel,dma-poll-cnt:
    $ref: /schemas/types.yaml#/definitions/uint32
    description:
      DMA descriptor polling counter is used to control the poling mechanism
      for the descriptor fetching for all channels.

  intel,dma-byte-en:
    type: boolean
    description:
      DMA byte enable is only valid for DMA write(RX).
      Byte enable(1) means DMA write will be based on the number of dwords
      instead of the whole burst.

  intel,dma-drb:
    type: boolean
    description:
      DMA descriptor read back to make sure data and desc synchronization.

  intel,dma-dburst-wr:
    type: boolean
    description:
      Enable RX dynamic burst write. When it is enabled, the DMA does RX dynamic burst;
      if it is disabled, the DMA RX will still support programmable fixed burst size of 2,4,8,16.
      It only applies to RX DMA and memcopy DMA.

required:
  - compatible
  - reg

additionalProperties: false

examples:
  - |
    dma0: dma-controller@e0e00000 {
      compatible = "intel,lgm-cdma";
      reg = <0xe0e00000 0x1000>;
      #dma-cells = <3>;
      dma-channels = <16>;
      dma-channel-mask = <0xFFFF>;
      interrupt-parent = <&ioapic1>;
      interrupts = <82 1>;
      resets = <&rcu0 0x30 0>;
      reset-names = "ctrl";
      clocks = <&cgu0 80>;
      intel,dma-poll-cnt = <4>;
      intel,dma-byte-en;
      intel,dma-drb;
    };
  - |
    dma3: dma-controller@ec800000 {
      compatible = "intel,lgm-dma3";
      reg = <0xec800000 0x1000>;
      clocks = <&cgu0 71>;
      resets = <&rcu0 0x10 9>;
      #dma-cells = <3>;
      intel,dma-poll-cnt = <16>;
      intel,dma-byte-en;
      intel,dma-dburst-wr;
    };
```

## Documentation/devicetree/bindings/dma/jz4780-dma.txt
```
* Ingenic JZ4780 DMA Controller

Required properties:

- compatible: Should be one of:
  * ingenic,jz4740-dma
  * ingenic,jz4725b-dma
  * ingenic,jz4770-dma
  * ingenic,jz4780-dma
  * ingenic,x1000-dma
- reg: Should contain the DMA channel registers location and length, followed
  by the DMA controller registers location and length.
- interrupts: Should contain the interrupt specifier of the DMA controller.
- clocks: Should contain a clock specifier for the JZ4780/X1000 PDMA clock.
- #dma-cells: Must be <2>. Number of integer cells in the dmas property of
  DMA clients (see below).

Optional properties:

- ingenic,reserved-channels: Bitmask of channels to reserve for devices that
  need a specific channel. These channels will only be assigned when explicitly
  requested by a client. The primary use for this is channels 0 and 1, which
  can be configured to have special behaviour for NAND/BCH when using
  programmable firmware.

Example:

dma: dma-controller@13420000 {
	compatible = "ingenic,jz4780-dma";
	reg = <0x13420000 0x400
	       0x13421000 0x40>;

	interrupt-parent = <&intc>;
	interrupts = <10>;

	clocks = <&cgu JZ4780_CLK_PDMA>;

	#dma-cells = <2>;

	ingenic,reserved-channels = <0x3>;
};

DMA clients must use the format described in dma.txt, giving a phandle to the
DMA controller plus the following 2 integer cells:

1. Request type: The DMA request type for transfers to/from the device on
   the allocated channel, as defined in the SoC documentation.

2. Channel: If set to 0xffffffff, any available channel will be allocated for
   the client. Otherwise, the exact channel specified will be used. The channel
   should be reserved on the DMA controller using the ingenic,reserved-channels
   property.

Example:

uart0: serial@10030000 {
	...
	dmas = <&dma 0x14 0xffffffff
		&dma 0x15 0xffffffff>;
	dma-names = "tx", "rx";
	...
};
```

## Documentation/devicetree/bindings/dma/k3dma.txt
```
* Hisilicon K3 DMA controller

See dma.txt first

Required properties:
- compatible: Should be "hisilicon,k3-dma-1.0"
- reg: Should contain DMA registers location and length.
- interrupts: Should contain one interrupt shared by all channel
- #dma-cells: see dma.txt, should be 1, para number
- dma-channels: physical channels supported
- dma-requests: virtual channels supported, each virtual channel
		have specific request line
- clocks: clock required

Example:

Controller:
		dma0: dma@fcd02000 {
			compatible = "hisilicon,k3-dma-1.0";
			reg = <0xfcd02000 0x1000>;
			#dma-cells = <1>;
			dma-channels = <16>;
			dma-requests = <27>;
			interrupts = <0 12 4>;
			clocks = <&pclk>;
			status = "disable";
		};

Client:
Use specific request line passing from dmax
For example, i2c0 read channel request line is 18, while write channel use 19

		i2c0: i2c@fcb08000 {
			compatible = "snps,designware-i2c";
			dmas =	<&dma0 18          /* read channel */
				 &dma0 19>;        /* write channel */
			dma-names = "rx", "tx";
		};

		i2c1: i2c@fcb09000 {
			compatible = "snps,designware-i2c";
			dmas =	<&dma0 20          /* read channel */
				 &dma0 21>;        /* write channel */
			dma-names = "rx", "tx";
		};
```

## Documentation/devicetree/bindings/dma/loongson,ls1b-apbdma.yaml
```yaml
# SPDX-License-Identifier: (GPL-2.0-only OR BSD-2-Clause)
%YAML 1.2
---
$id: http://devicetree.org/schemas/dma/loongson,ls1b-apbdma.yaml#
$schema: http://devicetree.org/meta-schemas/core.yaml#

title: Loongson-1 APB DMA Controller

maintainers:
  - Keguang Zhang <keguang.zhang@gmail.com>

description:
  Loongson-1 APB DMA controller provides 3 independent channels for
  peripherals such as NAND, audio playback and capture.

properties:
  compatible:
    oneOf:
      - const: loongson,ls1b-apbdma
      - items:
          - enum:
              - loongson,ls1a-apbdma
              - loongson,ls1c-apbdma
          - const: loongson,ls1b-apbdma

  reg:
    maxItems: 1

  interrupts:
    items:
      - description: NAND interrupt
      - description: Audio playback interrupt
      - description: Audio capture interrupt

  interrupt-names:
    items:
      - const: ch0
      - const: ch1
      - const: ch2

  '#dma-cells':
    const: 1

required:
  - compatible
  - reg
  - interrupts
  - interrupt-names
  - '#dma-cells'

additionalProperties: false

examples:
  - |
    #include <dt-bindings/interrupt-controller/irq.h>
    dma-controller@1fd01160 {
        compatible = "loongson,ls1b-apbdma";
        reg = <0x1fd01160 0x4>;
        interrupt-parent = <&intc0>;
        interrupts = <13 IRQ_TYPE_EDGE_RISING>,
                     <14 IRQ_TYPE_EDGE_RISING>,
                     <15 IRQ_TYPE_EDGE_RISING>;
        interrupt-names = "ch0", "ch1", "ch2";
        #dma-cells = <1>;
    };
```

## Documentation/devicetree/bindings/dma/loongson,ls2k0300-dma.yaml
```yaml
# SPDX-License-Identifier: (GPL-2.0-only OR BSD-2-Clause)
%YAML 1.2
---
$id: http://devicetree.org/schemas/dma/loongson,ls2k0300-dma.yaml#
$schema: http://devicetree.org/meta-schemas/core.yaml#

title: Loongson-2 Multi-Channel DMA controller

description:
  The Loongson-2 Multi-Channel DMA controller is used for transferring data
  between system memory and the peripherals on the APB bus.

maintainers:
  - Binbin Zhou <zhoubinbin@loongson.cn>

allOf:
  - $ref: dma-controller.yaml#

properties:
  compatible:
    enum:
      - loongson,ls2k0300-dma
      - loongson,ls2k3000-dma

  reg:
    maxItems: 1

  interrupts:
    description:
      Should contain all of the per-channel DMA interrupts in ascending order
      with respect to the DMA channel index.
    minItems: 4
    maxItems: 8

  clocks:
    maxItems: 1

  '#dma-cells':
    const: 2
    description: |
      DMA request from clients consists of 2 cells:
        1. Channel index
        2. Transfer request factor number, If no transfer factor, use 0.
           The number is SoC-specific, and this should be specified with
           relation to the device to use the DMA controller.

  dma-channels:
    enum: [4, 8]

required:
  - compatible
  - reg
  - interrupts
  - clocks
  - '#dma-cells'
  - dma-channels

unevaluatedProperties: false

examples:
  - |
    #include <dt-bindings/interrupt-controller/irq.h>
    #include <dt-bindings/clock/loongson,ls2k-clk.h>

    dma-controller@1612c000 {
        compatible = "loongson,ls2k0300-dma";
        reg = <0x1612c000 0xff>;
        interrupt-parent = <&liointc0>;
        interrupts = <23 IRQ_TYPE_LEVEL_HIGH>,
                     <24 IRQ_TYPE_LEVEL_HIGH>,
                     <25 IRQ_TYPE_LEVEL_HIGH>,
                     <26 IRQ_TYPE_LEVEL_HIGH>,
                     <27 IRQ_TYPE_LEVEL_HIGH>,
                     <28 IRQ_TYPE_LEVEL_HIGH>,
                     <29 IRQ_TYPE_LEVEL_HIGH>,
                     <30 IRQ_TYPE_LEVEL_HIGH>;
        clocks = <&clk LS2K0300_CLK_APB_GATE>;
        #dma-cells = <2>;
        dma-channels = <8>;
    };
...
```

## Documentation/devicetree/bindings/dma/loongson,ls2x-apbdma.yaml
```yaml
# SPDX-License-Identifier: (GPL-2.0-only OR BSD-2-Clause)
%YAML 1.2
---
$id: http://devicetree.org/schemas/dma/loongson,ls2x-apbdma.yaml#
$schema: http://devicetree.org/meta-schemas/core.yaml#

title: Loongson LS2X APB DMA controller

description:
  The Loongson LS2X APB DMA controller is used for transferring data
  between system memory and the peripherals on the APB bus.

maintainers:
  - Binbin Zhou <zhoubinbin@loongson.cn>

allOf:
  - $ref: dma-controller.yaml#

properties:
  compatible:
    oneOf:
      - const: loongson,ls2k1000-apbdma
      - items:
          - const: loongson,ls2k0500-apbdma
          - const: loongson,ls2k1000-apbdma

  reg:
    maxItems: 1

  interrupts:
    maxItems: 1

  clocks:
    maxItems: 1

  '#dma-cells':
    const: 1

required:
  - compatible
  - reg
  - interrupts
  - clocks
  - '#dma-cells'

additionalProperties: false

examples:
  - |
    #include <dt-bindings/interrupt-controller/irq.h>
    #include <dt-bindings/clock/loongson,ls2k-clk.h>

    dma-controller@1fe00c00 {
        compatible = "loongson,ls2k1000-apbdma";
        reg = <0x1fe00c00 0x8>;
        interrupt-parent = <&liointc1>;
        interrupts = <12 IRQ_TYPE_LEVEL_HIGH>;
        clocks = <&clk LOONGSON2_APB_CLK>;
        #dma-cells = <1>;
    };

...
```

## Documentation/devicetree/bindings/dma/lpc1850-dmamux.txt
```
NXP LPC18xx/43xx DMA MUX (DMA request router)

Required properties:
- compatible:	"nxp,lpc1850-dmamux"
- reg:		Memory map for accessing module
- #dma-cells:	Should be set to <3>.
		* 1st cell contain the master dma request signal
		* 2nd cell contain the mux value (0-3) for the peripheral
		* 3rd cell contain either 1 or 2 depending on the AHB
		  master used.
- dma-requests:	Number of DMA requests for the mux
- dma-masters:	phandle pointing to the DMA controller

The DMA controller node need to have the following poroperties:
- dma-requests:	Number of DMA requests the controller can handle

Example:

dmac: dma@40002000 {
	compatible = "nxp,lpc1850-gpdma", "arm,pl080", "arm,primecell";
	arm,primecell-periphid = <0x00041080>;
	reg = <0x40002000 0x1000>;
	interrupts = <2>;
	clocks = <&ccu1 CLK_CPU_DMA>;
	clock-names = "apb_pclk";
	#dma-cells = <2>;
	dma-channels = <8>;
	dma-requests = <16>;
	lli-bus-interface-ahb1;
	lli-bus-interface-ahb2;
	mem-bus-interface-ahb1;
	mem-bus-interface-ahb2;
	memcpy-burst-size = <256>;
	memcpy-bus-width = <32>;
};

dmamux: dma-mux {
	compatible = "nxp,lpc1850-dmamux";
	#dma-cells = <3>;
	dma-requests = <64>;
	dma-masters = <&dmac>;
};

uart0: serial@40081000 {
	compatible = "nxp,lpc1850-uart", "ns16550a";
	reg = <0x40081000 0x1000>;
	reg-shift = <2>;
	interrupts = <24>;
	clocks = <&ccu2 CLK_APB0_UART0>, <&ccu1 CLK_CPU_UART0>;
	clock-names = "uartclk", "reg";
	dmas = <&dmamux 1 1 2
		&dmamux 2 1 2>;
	dma-names = "tx", "rx";
};
```

## Documentation/devicetree/bindings/dma/marvell,mmp-dma.yaml
```yaml
# SPDX-License-Identifier: (GPL-2.0-only OR BSD-2-Clause)
%YAML 1.2
---
$id: http://devicetree.org/schemas/dma/marvell,mmp-dma.yaml#
$schema: http://devicetree.org/meta-schemas/core.yaml#

title: Marvell MMP DMA controller

maintainers:
  - Duje Mihanović <duje.mihanovic@skole.hr>

description:
  Marvell MMP SoCs may have two types of DMA controllers, peripheral and audio.

properties:
  compatible:
    enum:
      - marvell,pdma-1.0
      - marvell,adma-1.0
      - marvell,pxa910-squ

  reg:
    maxItems: 1

  interrupts:
    description:
      Interrupt lines for the controller, may be shared or one per DMA channel
    minItems: 1

  asram:
    description:
      A phandle to the SRAM pool
    $ref: /schemas/types.yaml#/definitions/phandle

  '#dma-channels':
    deprecated: true

  '#dma-requests':
    deprecated: true

required:
  - compatible
  - reg
  - interrupts
  - '#dma-cells'

allOf:
  - $ref: dma-controller.yaml#
  - if:
      properties:
        compatible:
          contains:
            enum:
              - marvell,pdma-1.0
    then:
      properties:
        asram: false
    else:
      required:
        - asram

unevaluatedProperties: false

examples:
  - |
    dma-controller@d4000000 {
        compatible = "marvell,pdma-1.0";
        reg = <0xd4000000 0x10000>;
        interrupts = <47>;
        #dma-cells = <2>;
        dma-channels = <16>;
    };
```
