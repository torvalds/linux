## Documentation/devicetree/bindings/dma/mtk-uart-apdma.txt
```
* Mediatek UART APDMA Controller

Required properties:
- compatible should contain:
  * "mediatek,mt2712-uart-dma" for MT2712 compatible APDMA
  * "mediatek,mt6577-uart-dma" for MT6577 and all of the above
  * "mediatek,mt8516-uart-dma", "mediatek,mt6577" for MT8516 SoC

- reg: The base address of the APDMA register bank.

- interrupts: A single interrupt specifier.
 One interrupt per dma-requests, or 8 if no dma-requests property is present

- dma-requests: The number of DMA channels

- clocks : Must contain an entry for each entry in clock-names.
  See ../clocks/clock-bindings.txt for details.
- clock-names: The APDMA clock for register accesses

- mediatek,dma-33bits: Present if the DMA requires support

Examples:

	apdma: dma-controller@11000400 {
		compatible = "mediatek,mt2712-uart-dma",
			     "mediatek,mt6577-uart-dma";
		reg = <0 0x11000400 0 0x80>,
		      <0 0x11000480 0 0x80>,
		      <0 0x11000500 0 0x80>,
		      <0 0x11000580 0 0x80>,
		      <0 0x11000600 0 0x80>,
		      <0 0x11000680 0 0x80>,
		      <0 0x11000700 0 0x80>,
		      <0 0x11000780 0 0x80>,
		      <0 0x11000800 0 0x80>,
		      <0 0x11000880 0 0x80>,
		      <0 0x11000900 0 0x80>,
		      <0 0x11000980 0 0x80>;
		interrupts = <GIC_SPI 103 IRQ_TYPE_LEVEL_LOW>,
			     <GIC_SPI 104 IRQ_TYPE_LEVEL_LOW>,
			     <GIC_SPI 105 IRQ_TYPE_LEVEL_LOW>,
			     <GIC_SPI 106 IRQ_TYPE_LEVEL_LOW>,
			     <GIC_SPI 107 IRQ_TYPE_LEVEL_LOW>,
			     <GIC_SPI 108 IRQ_TYPE_LEVEL_LOW>,
			     <GIC_SPI 109 IRQ_TYPE_LEVEL_LOW>,
			     <GIC_SPI 110 IRQ_TYPE_LEVEL_LOW>,
			     <GIC_SPI 111 IRQ_TYPE_LEVEL_LOW>,
			     <GIC_SPI 112 IRQ_TYPE_LEVEL_LOW>,
			     <GIC_SPI 113 IRQ_TYPE_LEVEL_LOW>,
			     <GIC_SPI 114 IRQ_TYPE_LEVEL_LOW>;
		dma-requests = <12>;
		clocks = <&pericfg CLK_PERI_AP_DMA>;
		clock-names = "apdma";
		mediatek,dma-33bits;
		#dma-cells = <1>;
	};
```

## Documentation/devicetree/bindings/dma/mv-xor-v2.txt
```
* Marvell XOR v2 engines

Required properties:
- compatible: one of the following values:
    "marvell,armada-7k-xor"
    "marvell,xor-v2"
- reg: Should contain registers location and length (two sets)
    the first set is the DMA registers
    the second set is the global registers
- msi-parent: Phandle to the MSI-capable interrupt controller used for
  interrupts.

Optional properties:
- clocks: Optional reference to the clocks used by the XOR engine.
- clock-names: mandatory if there is a second clock, in this case the
   name must be "core" for the first clock and "reg" for the second
   one


Example:

	xor0@400000 {
		compatible = "marvell,xor-v2";
		reg = <0x400000 0x1000>,
		      <0x410000 0x1000>;
		msi-parent = <&gic_v2m0>;
		dma-coherent;
	};
```

## Documentation/devicetree/bindings/dma/mv-xor.txt
```
* Marvell XOR engines

Required properties:
- compatible: Should be one of the following:
  - "marvell,orion-xor"
  - "marvell,armada-380-xor"
  - "marvell,armada-3700-xor".
- reg: Should contain registers location and length (two sets)
    the first set is the low registers, the second set the high
    registers for the XOR engine.
- clocks: pointer to the reference clock

The DT node must also contains sub-nodes for each XOR channel that the
XOR engine has. Those sub-nodes have the following required
properties:
- interrupts: interrupt of the XOR channel

The sub-nodes used to contain one or several of the following
properties, but they are now deprecated:
- dmacap,memcpy to indicate that the XOR channel is capable of memcpy operations
- dmacap,memset to indicate that the XOR channel is capable of memset operations
- dmacap,xor to indicate that the XOR channel is capable of xor operations
- dmacap,interrupt to indicate that the XOR channel is capable of
  generating interrupts

Example:

xor@d0060900 {
	compatible = "marvell,orion-xor";
	reg = <0xd0060900 0x100
	       0xd0060b00 0x100>;
	clocks = <&coreclk 0>;

	xor00 {
	      interrupts = <51>;
	};
	xor01 {
	      interrupts = <52>;
	};
};
```

## Documentation/devicetree/bindings/dma/nvidia,tegra186-gpc-dma.yaml
```yaml
# SPDX-License-Identifier: (GPL-2.0-only OR BSD-2-Clause)
%YAML 1.2
---
$id: http://devicetree.org/schemas/dma/nvidia,tegra186-gpc-dma.yaml#
$schema: http://devicetree.org/meta-schemas/core.yaml#

title: NVIDIA Tegra GPC DMA Controller Device Tree Bindings

description: |
  The Tegra General Purpose Central (GPC) DMA controller is used for faster
  data transfers between memory to memory, memory to device and device to
  memory.

maintainers:
  - Jon Hunter <jonathanh@nvidia.com>
  - Rajesh Gumasta <rgumasta@nvidia.com>

allOf:
  - $ref: "dma-controller.yaml#"

properties:
  compatible:
    oneOf:
      - const: nvidia,tegra186-gpcdma
      - items:
          - enum:
              - nvidia,tegra234-gpcdma
              - nvidia,tegra194-gpcdma
          - const: nvidia,tegra186-gpcdma

  "#dma-cells":
    const: 1

  reg:
    maxItems: 1

  interrupts:
    description:
      Should contain all of the per-channel DMA interrupts in
      ascending order with respect to the DMA channel index.
    minItems: 1
    maxItems: 31

  resets:
    maxItems: 1

  reset-names:
    const: gpcdma

  iommus:
    maxItems: 1

  dma-coherent: true

required:
  - compatible
  - reg
  - interrupts
  - resets
  - reset-names
  - "#dma-cells"
  - iommus

additionalProperties: false

examples:
  - |
    #include <dt-bindings/interrupt-controller/arm-gic.h>
    #include <dt-bindings/memory/tegra186-mc.h>
    #include <dt-bindings/reset/tegra186-reset.h>

    dma-controller@2600000 {
        compatible = "nvidia,tegra186-gpcdma";
        reg = <0x2600000 0x210000>;
        resets = <&bpmp TEGRA186_RESET_GPCDMA>;
        reset-names = "gpcdma";
        interrupts = <GIC_SPI 76 IRQ_TYPE_LEVEL_HIGH>,
                     <GIC_SPI 77 IRQ_TYPE_LEVEL_HIGH>,
                     <GIC_SPI 78 IRQ_TYPE_LEVEL_HIGH>,
                     <GIC_SPI 79 IRQ_TYPE_LEVEL_HIGH>,
                     <GIC_SPI 80 IRQ_TYPE_LEVEL_HIGH>,
                     <GIC_SPI 81 IRQ_TYPE_LEVEL_HIGH>,
                     <GIC_SPI 82 IRQ_TYPE_LEVEL_HIGH>,
                     <GIC_SPI 83 IRQ_TYPE_LEVEL_HIGH>,
                     <GIC_SPI 84 IRQ_TYPE_LEVEL_HIGH>,
                     <GIC_SPI 85 IRQ_TYPE_LEVEL_HIGH>,
                     <GIC_SPI 86 IRQ_TYPE_LEVEL_HIGH>,
                     <GIC_SPI 87 IRQ_TYPE_LEVEL_HIGH>,
                     <GIC_SPI 88 IRQ_TYPE_LEVEL_HIGH>,
                     <GIC_SPI 89 IRQ_TYPE_LEVEL_HIGH>,
                     <GIC_SPI 90 IRQ_TYPE_LEVEL_HIGH>,
                     <GIC_SPI 91 IRQ_TYPE_LEVEL_HIGH>,
                     <GIC_SPI 92 IRQ_TYPE_LEVEL_HIGH>,
                     <GIC_SPI 93 IRQ_TYPE_LEVEL_HIGH>,
                     <GIC_SPI 94 IRQ_TYPE_LEVEL_HIGH>,
                     <GIC_SPI 95 IRQ_TYPE_LEVEL_HIGH>,
                     <GIC_SPI 96 IRQ_TYPE_LEVEL_HIGH>,
                     <GIC_SPI 97 IRQ_TYPE_LEVEL_HIGH>,
                     <GIC_SPI 98 IRQ_TYPE_LEVEL_HIGH>,
                     <GIC_SPI 99 IRQ_TYPE_LEVEL_HIGH>,
                     <GIC_SPI 100 IRQ_TYPE_LEVEL_HIGH>,
                     <GIC_SPI 101 IRQ_TYPE_LEVEL_HIGH>,
                     <GIC_SPI 102 IRQ_TYPE_LEVEL_HIGH>,
                     <GIC_SPI 103 IRQ_TYPE_LEVEL_HIGH>,
                     <GIC_SPI 104 IRQ_TYPE_LEVEL_HIGH>,
                     <GIC_SPI 105 IRQ_TYPE_LEVEL_HIGH>,
                     <GIC_SPI 106 IRQ_TYPE_LEVEL_HIGH>;
        #dma-cells = <1>;
        iommus = <&smmu TEGRA186_SID_GPCDMA_0>;
        dma-coherent;
    };
...
```

## Documentation/devicetree/bindings/dma/nvidia,tegra20-apbdma.txt
```
* NVIDIA Tegra APB DMA controller

Required properties:
- compatible: Should be "nvidia,<chip>-apbdma"
- reg: Should contain DMA registers location and length. This shuld include
  all of the per-channel registers.
- interrupts: Should contain all of the per-channel DMA interrupts.
- clocks: Must contain one entry, for the module clock.
  See ../clocks/clock-bindings.txt for details.
- resets : Must contain an entry for each entry in reset-names.
  See ../reset/reset.txt for details.
- reset-names : Must include the following entries:
  - dma
- #dma-cells : Must be <1>. This dictates the length of DMA specifiers in
  client nodes' dmas properties. The specifier represents the DMA request
  select value for the peripheral. For more details, consult the Tegra TRM's
  documentation of the APB DMA channel control register REQ_SEL field.

Examples:

apbdma: dma@6000a000 {
	compatible = "nvidia,tegra20-apbdma";
	reg = <0x6000a000 0x1200>;
	interrupts = < 0 136 0x04
		       0 137 0x04
		       0 138 0x04
		       0 139 0x04
		       0 140 0x04
		       0 141 0x04
		       0 142 0x04
		       0 143 0x04
		       0 144 0x04
		       0 145 0x04
		       0 146 0x04
		       0 147 0x04
		       0 148 0x04
		       0 149 0x04
		       0 150 0x04
		       0 151 0x04 >;
	clocks = <&tegra_car 34>;
	resets = <&tegra_car 34>;
	reset-names = "dma";
	#dma-cells = <1>;
};
```

## Documentation/devicetree/bindings/dma/nvidia,tegra20-apbdma.yaml
```yaml
# SPDX-License-Identifier: (GPL-2.0-only OR BSD-2-Clause)
%YAML 1.2
---
$id: http://devicetree.org/schemas/dma/nvidia,tegra20-apbdma.yaml#
$schema: http://devicetree.org/meta-schemas/core.yaml#

title: NVIDIA Tegra APB DMA Controller

description:
  The NVIDIA Tegra APB DMA controller is a hardware component that
  enables direct memory access (DMA) on Tegra systems. It facilitates
  data transfer between I/O devices and main memory without constant
  CPU intervention.

maintainers:
  - Jonathan Hunter <jonathanh@nvidia.com>

properties:
  compatible:
    oneOf:
      - enum:
          - nvidia,tegra114-apbdma
          - nvidia,tegra20-apbdma
      - items:
          - const: nvidia,tegra30-apbdma
          - const: nvidia,tegra20-apbdma
      - items:
          - enum:
              - nvidia,tegra124-apbdma
              - nvidia,tegra210-apbdma
          - const: nvidia,tegra148-apbdma

  reg:
    maxItems: 1

  "#dma-cells":
    const: 1

  clocks:
    maxItems: 1

  clock-names:
    const: dma

  interrupts:
    description:
      Should contain all of the per-channel DMA interrupts in
      ascending order with respect to the DMA channel index.
    minItems: 1
    maxItems: 32

  resets:
    maxItems: 1

  reset-names:
    const: dma

required:
  - compatible
  - reg
  - "#dma-cells"
  - clocks
  - interrupts
  - resets
  - reset-names

allOf:
  - $ref: dma-controller.yaml#

unevaluatedProperties: false

examples:
  - |
    #include <dt-bindings/interrupt-controller/arm-gic.h>
    #include <dt-bindings/reset/tegra186-reset.h>
    dma-controller@6000a000 {
        compatible = "nvidia,tegra30-apbdma", "nvidia,tegra20-apbdma";
        reg = <0x6000a000 0x1200>;
        interrupts = <GIC_SPI 136 IRQ_TYPE_LEVEL_HIGH>,
                     <GIC_SPI 137 IRQ_TYPE_LEVEL_HIGH>,
                     <GIC_SPI 138 IRQ_TYPE_LEVEL_HIGH>,
                     <GIC_SPI 139 IRQ_TYPE_LEVEL_HIGH>,
                     <GIC_SPI 140 IRQ_TYPE_LEVEL_HIGH>,
                     <GIC_SPI 141 IRQ_TYPE_LEVEL_HIGH>,
                     <GIC_SPI 142 IRQ_TYPE_LEVEL_HIGH>,
                     <GIC_SPI 143 IRQ_TYPE_LEVEL_HIGH>,
                     <GIC_SPI 144 IRQ_TYPE_LEVEL_HIGH>,
                     <GIC_SPI 145 IRQ_TYPE_LEVEL_HIGH>,
                     <GIC_SPI 146 IRQ_TYPE_LEVEL_HIGH>,
                     <GIC_SPI 147 IRQ_TYPE_LEVEL_HIGH>,
                     <GIC_SPI 148 IRQ_TYPE_LEVEL_HIGH>,
                     <GIC_SPI 149 IRQ_TYPE_LEVEL_HIGH>,
                     <GIC_SPI 150 IRQ_TYPE_LEVEL_HIGH>,
                     <GIC_SPI 151 IRQ_TYPE_LEVEL_HIGH>;
        clocks = <&tegra_car 34>;
        resets = <&tegra_car 34>;
        reset-names = "dma";
        #dma-cells = <1>;
    };
...
```

## Documentation/devicetree/bindings/dma/nvidia,tegra210-adma.txt
```
* NVIDIA Tegra Audio DMA (ADMA) controller

The Tegra Audio DMA controller that is used for transferring data
between system memory and the Audio Processing Engine (APE).

Required properties:
- compatible: Should contain one of the following:
  - "nvidia,tegra210-adma": for Tegra210
  - "nvidia,tegra186-adma": for Tegra186 and Tegra194
- reg: Should contain DMA registers location and length. This should be
  a single entry that includes all of the per-channel registers in one
  contiguous bank.
- interrupts: Should contain all of the per-channel DMA interrupts in
  ascending order with respect to the DMA channel index.
- clocks: Must contain one entry for the ADMA module clock
  (TEGRA210_CLK_D_AUDIO).
- clock-names: Must contain the name "d_audio" for the corresponding
  'clocks' entry.
- #dma-cells : Must be 1. The first cell denotes the receive/transmit
  request number and should be between 1 and the maximum number of
  requests supported. This value corresponds to the RX/TX_REQUEST_SELECT
  fields in the ADMA_CHn_CTRL register.


Example:

adma: dma@702e2000 {
	compatible = "nvidia,tegra210-adma";
	reg = <0x0 0x702e2000 0x0 0x2000>;
	interrupt-parent = <&tegra_agic>;
	interrupts = <GIC_SPI 24 IRQ_TYPE_LEVEL_HIGH>,
		     <GIC_SPI 25 IRQ_TYPE_LEVEL_HIGH>,
		     <GIC_SPI 26 IRQ_TYPE_LEVEL_HIGH>,
		     <GIC_SPI 27 IRQ_TYPE_LEVEL_HIGH>,
		     <GIC_SPI 28 IRQ_TYPE_LEVEL_HIGH>,
		     <GIC_SPI 29 IRQ_TYPE_LEVEL_HIGH>,
		     <GIC_SPI 30 IRQ_TYPE_LEVEL_HIGH>,
		     <GIC_SPI 31 IRQ_TYPE_LEVEL_HIGH>,
		     <GIC_SPI 32 IRQ_TYPE_LEVEL_HIGH>,
		     <GIC_SPI 33 IRQ_TYPE_LEVEL_HIGH>,
		     <GIC_SPI 34 IRQ_TYPE_LEVEL_HIGH>,
		     <GIC_SPI 35 IRQ_TYPE_LEVEL_HIGH>,
		     <GIC_SPI 36 IRQ_TYPE_LEVEL_HIGH>,
		     <GIC_SPI 37 IRQ_TYPE_LEVEL_HIGH>,
		     <GIC_SPI 38 IRQ_TYPE_LEVEL_HIGH>,
		     <GIC_SPI 39 IRQ_TYPE_LEVEL_HIGH>,
		     <GIC_SPI 40 IRQ_TYPE_LEVEL_HIGH>,
		     <GIC_SPI 41 IRQ_TYPE_LEVEL_HIGH>,
		     <GIC_SPI 42 IRQ_TYPE_LEVEL_HIGH>,
		     <GIC_SPI 43 IRQ_TYPE_LEVEL_HIGH>,
		     <GIC_SPI 44 IRQ_TYPE_LEVEL_HIGH>,
		     <GIC_SPI 45 IRQ_TYPE_LEVEL_HIGH>;
	clocks = <&tegra_car TEGRA210_CLK_D_AUDIO>;
	clock-names = "d_audio";
	#dma-cells = <1>;
};
```
