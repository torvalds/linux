## Documentation/devicetree/bindings/dma/img-mdc-dma.txt
```
* IMG Multi-threaded DMA Controller (MDC)

Required properties:
- compatible: Must be "img,pistachio-mdc-dma".
- reg: Must contain the base address and length of the MDC registers.
- interrupts: Must contain all the per-channel DMA interrupts.
- clocks: Must contain an entry for each entry in clock-names.
  See ../clock/clock-bindings.txt for details.
- clock-names: Must include the following entries:
  - sys: MDC system interface clock.
- img,cr-periph: Must contain a phandle to the peripheral control syscon
  node which contains the DMA request to channel mapping registers.
- img,max-burst-multiplier: Must be the maximum supported burst size multiplier.
  The maximum burst size is this value multiplied by the hardware-reported bus
  width.
- #dma-cells: Must be 3:
  - The first cell is the peripheral's DMA request line.
  - The second cell is a bitmap specifying to which channels the DMA request
    line may be mapped (i.e. bit N set indicates channel N is usable).
  - The third cell is the thread ID to be used by the channel.

Optional properties:
- dma-channels: Number of supported DMA channels, up to 32.  If not specified
  the number reported by the hardware is used.

Example:

mdc: dma-controller@18143000 {
	compatible = "img,pistachio-mdc-dma";
	reg = <0x18143000 0x1000>;
	interrupts = <GIC_SHARED 27 IRQ_TYPE_LEVEL_HIGH>,
		     <GIC_SHARED 28 IRQ_TYPE_LEVEL_HIGH>,
		     <GIC_SHARED 29 IRQ_TYPE_LEVEL_HIGH>,
		     <GIC_SHARED 30 IRQ_TYPE_LEVEL_HIGH>,
		     <GIC_SHARED 31 IRQ_TYPE_LEVEL_HIGH>,
		     <GIC_SHARED 32 IRQ_TYPE_LEVEL_HIGH>,
		     <GIC_SHARED 33 IRQ_TYPE_LEVEL_HIGH>,
		     <GIC_SHARED 34 IRQ_TYPE_LEVEL_HIGH>,
		     <GIC_SHARED 35 IRQ_TYPE_LEVEL_HIGH>,
		     <GIC_SHARED 36 IRQ_TYPE_LEVEL_HIGH>,
		     <GIC_SHARED 37 IRQ_TYPE_LEVEL_HIGH>,
		     <GIC_SHARED 38 IRQ_TYPE_LEVEL_HIGH>;
	clocks = <&system_clk>;
	clock-names = "sys";

	img,max-burst-multiplier = <16>;
	img,cr-periph = <&cr_periph>;

	#dma-cells = <3>;
};

spi@18100f00 {
	...
	dmas = <&mdc 9 0xffffffff 0>, <&mdc 10 0xffffffff 0>;
	dma-names = "tx", "rx";
	...
};
```

## Documentation/devicetree/bindings/dma/ingenic,dma.yaml
```yaml
# SPDX-License-Identifier: (GPL-2.0-only OR BSD-2-Clause)
%YAML 1.2
---
$id: http://devicetree.org/schemas/dma/ingenic,dma.yaml#
$schema: http://devicetree.org/meta-schemas/core.yaml#

title: Ingenic SoCs DMA Controller DT bindings

maintainers:
  - Paul Cercueil <paul@crapouillou.net>

allOf:
  - $ref: "dma-controller.yaml#"

properties:
  compatible:
    oneOf:
      - enum:
          - ingenic,jz4740-dma
          - ingenic,jz4725b-dma
          - ingenic,jz4760-dma
          - ingenic,jz4760-bdma
          - ingenic,jz4760-mdma
          - ingenic,jz4760b-dma
          - ingenic,jz4760b-bdma
          - ingenic,jz4760b-mdma
          - ingenic,jz4770-dma
          - ingenic,jz4780-dma
          - ingenic,x1000-dma
          - ingenic,x1830-dma
      - items:
          - const: ingenic,jz4770-bdma
          - const: ingenic,jz4760b-bdma

  reg:
    items:
      - description: Channel-specific registers
      - description: System control registers

  interrupts:
    maxItems: 1

  clocks:
    maxItems: 1

  "#dma-cells":
    enum: [2, 3]
    description: >
      DMA clients must use the format described in dma.txt, giving a phandle
      to the DMA controller plus the following integer cells:

      - Request type: The DMA request type specifies the device endpoint that
        will be the source or destination of the DMA transfer.
        If "#dma-cells" is 2, the request type is a single cell, and the
        direction will be unidirectional (either RX or TX but not both).
        If "#dma-cells" is 3, the request type has two cells; the first
        one corresponds to the host to device direction (TX), the second one
        corresponds to the device to host direction (RX). The DMA channel is
        then bidirectional.

      - Channel: If set to 0xffffffff, any available channel will be allocated
        for the client. Otherwise, the exact channel specified will be used.
        The channel should be reserved on the DMA controller using the
        ingenic,reserved-channels property.

  ingenic,reserved-channels:
    $ref: /schemas/types.yaml#/definitions/uint32
    description: >
      Bitmask of channels to reserve for devices that need a specific
      channel. These channels will only be assigned when explicitely
      requested by a client. The primary use for this is channels 0 and
      1, which can be configured to have special behaviour for NAND/BCH
      when using programmable firmware.

required:
  - compatible
  - reg
  - interrupts
  - clocks

unevaluatedProperties: false

examples:
  - |
    #include <dt-bindings/clock/ingenic,jz4780-cgu.h>
    dma: dma-controller@13420000 {
      compatible = "ingenic,jz4780-dma";
      reg = <0x13420000 0x400>, <0x13421000 0x40>;

      interrupt-parent = <&intc>;
      interrupts = <10>;

      clocks = <&cgu JZ4780_CLK_PDMA>;

      #dma-cells = <2>;

      ingenic,reserved-channels = <0x3>;
    };
```
