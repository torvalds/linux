## Documentation/devicetree/bindings/dma/brcm,bcm2835-dma.txt
```
* BCM2835 DMA controller

The BCM2835 DMA controller has 16 channels in total.
Only the lower 13 channels have an associated IRQ.
Some arbitrary channels are used by the firmware
(1,3,6,7 in the current firmware version).
The channels 0,2 and 3 have special functionality
and should not be used by the driver.

Required properties:
- compatible: Should be "brcm,bcm2835-dma".
- reg: Should contain DMA registers location and length.
- interrupts: Should contain the DMA interrupts associated
		to the DMA channels in ascending order.
- interrupt-names: Should contain the names of the interrupt
		   in the form "dmaXX".
		   Use "dma-shared-all" for the common interrupt line
		   that is shared by all dma channels.
- #dma-cells: Must be <1>, the cell in the dmas property of the
		client device represents the DREQ number.
- brcm,dma-channel-mask: Bit mask representing the channels
			 not used by the firmware in ascending order,
			 i.e. first channel corresponds to LSB.

Example:

dma: dma@7e007000 {
	compatible = "brcm,bcm2835-dma";
	reg = <0x7e007000 0xf00>;
	interrupts = <1 16>,
		     <1 17>,
		     <1 18>,
		     <1 19>,
		     <1 20>,
		     <1 21>,
		     <1 22>,
		     <1 23>,
		     <1 24>,
		     <1 25>,
		     <1 26>,
		     /* dma channel 11-14 share one irq */
		     <1 27>,
		     <1 27>,
		     <1 27>,
		     <1 27>,
		     /* unused shared irq for all channels */
		     <1 28>;
	interrupt-names = "dma0",
			  "dma1",
			  "dma2",
			  "dma3",
			  "dma4",
			  "dma5",
			  "dma6",
			  "dma7",
			  "dma8",
			  "dma9",
			  "dma10",
			  "dma11",
			  "dma12",
			  "dma13",
			  "dma14",
			  "dma-shared-all";

	#dma-cells = <1>;
	brcm,dma-channel-mask = <0x7f35>;
};


DMA clients connected to the BCM2835 DMA controller must use the format
described in the dma.txt file, using a two-cell specifier for each channel.

Example:

bcm2835_i2s: i2s@7e203000 {
	compatible = "brcm,bcm2835-i2s";
	reg = <	0x7e203000 0x20>,
	      < 0x7e101098 0x02>;

	dmas = <&dma 2>,
	       <&dma 3>;
	dma-names = "tx", "rx";
};
```

## Documentation/devicetree/bindings/dma/brcm,bcm2835-dma.yaml
```yaml
# SPDX-License-Identifier: (GPL-2.0-only OR BSD-2-Clause)
%YAML 1.2
---
$id: http://devicetree.org/schemas/dma/brcm,bcm2835-dma.yaml#
$schema: http://devicetree.org/meta-schemas/core.yaml#

title: BCM2835 DMA controller

maintainers:
  - Nicolas Saenz Julienne <nsaenz@kernel.org>

description:
  The BCM2835 DMA controller has 16 channels in total. Only the lower
  13 channels have an associated IRQ. Some arbitrary channels are used by the
  VideoCore firmware (1,3,6,7 in the current firmware version). The channels
  0, 2 and 3 have special functionality and should not be used by the driver.

allOf:
  - $ref: dma-controller.yaml#

properties:
  compatible:
    const: brcm,bcm2835-dma

  reg:
    maxItems: 1

  interrupts:
    description:
      Should contain the DMA interrupts associated to the DMA channels in
      ascending order.
    minItems: 1
    maxItems: 16

  interrupt-names:
    minItems: 1
    maxItems: 16

  '#dma-cells':
    description: The single cell represents the DREQ number.
    const: 1

  brcm,dma-channel-mask:
    $ref: /schemas/types.yaml#/definitions/uint32
    description:
      Bitmask of available DMA channels in ascending order that are
      not reserved by firmware and are available to the
      kernel. i.e. first channel corresponds to LSB.

unevaluatedProperties: false

required:
  - compatible
  - reg
  - interrupts
  - "#dma-cells"
  - brcm,dma-channel-mask

examples:
  - |
    dma-controller@7e007000 {
      compatible = "brcm,bcm2835-dma";
      reg = <0x7e007000 0xf00>;
      interrupts = <1 16>,
                   <1 17>,
                   <1 18>,
                   <1 19>,
                   <1 20>,
                   <1 21>,
                   <1 22>,
                   <1 23>,
                   <1 24>,
                   <1 25>,
                   <1 26>,
                   /* dma channel 11-14 share one irq */
                   <1 27>,
                   <1 27>,
                   <1 27>,
                   <1 27>,
                   /* unused shared irq for all channels */
                   <1 28>;
      interrupt-names = "dma0",
                        "dma1",
                        "dma2",
                        "dma3",
                        "dma4",
                        "dma5",
                        "dma6",
                        "dma7",
                        "dma8",
                        "dma9",
                        "dma10",
                        "dma11",
                        "dma12",
                        "dma13",
                        "dma14",
                        "dma-shared-all";
        #dma-cells = <1>;
        brcm,dma-channel-mask = <0x7f35>;
    };

...
```

## Documentation/devicetree/bindings/dma/brcm,iproc-sba.txt
```
* Broadcom SBA RAID engine

Required properties:
- compatible: Should be one of the following
	      "brcm,iproc-sba"
	      "brcm,iproc-sba-v2"
  The "brcm,iproc-sba" has support for only 6 PQ coefficients
  The "brcm,iproc-sba-v2" has support for only 30 PQ coefficients
- mboxes: List of phandle and mailbox channel specifiers

Example:

raid_mbox: mbox@67400000 {
	...
	#mbox-cells = <3>;
	...
};

raid0 {
	compatible = "brcm,iproc-sba-v2";
	mboxes = <&raid_mbox 0 0x1 0xffff>,
		 <&raid_mbox 1 0x1 0xffff>,
		 <&raid_mbox 2 0x1 0xffff>,
		 <&raid_mbox 3 0x1 0xffff>,
		 <&raid_mbox 4 0x1 0xffff>,
		 <&raid_mbox 5 0x1 0xffff>,
		 <&raid_mbox 6 0x1 0xffff>,
		 <&raid_mbox 7 0x1 0xffff>;
};
```

## Documentation/devicetree/bindings/dma/brcm,iproc-sba.yaml
```yaml
# SPDX-License-Identifier: (GPL-2.0-only OR BSD-2-Clause)
%YAML 1.2
---
$id: http://devicetree.org/schemas/dma/brcm,iproc-sba.yaml#
$schema: http://devicetree.org/meta-schemas/core.yaml#

title: Broadcom SBA RAID engine

maintainers:
  - Ray Jui <rjui@broadcom.com>
  - Scott Branden <sbranden@broadcom.com>

properties:
  compatible:
    enum:
      - brcm,iproc-sba
      - brcm,iproc-sba-v2

  mboxes:
    minItems: 1
    maxItems: 8

required:
  - compatible
  - mboxes

additionalProperties: false

examples:
  - |
    raid0 {
      compatible = "brcm,iproc-sba-v2";
      mboxes = <&raid_mbox 0 0x1 0xffff>,
               <&raid_mbox 1 0x1 0xffff>,
               <&raid_mbox 2 0x1 0xffff>,
               <&raid_mbox 3 0x1 0xffff>,
               <&raid_mbox 4 0x1 0xffff>,
               <&raid_mbox 5 0x1 0xffff>,
               <&raid_mbox 6 0x1 0xffff>,
               <&raid_mbox 7 0x1 0xffff>;
    };
```

## Documentation/devicetree/bindings/dma/cirrus,ep9301-dma-m2m.yaml
```yaml
# SPDX-License-Identifier: (GPL-2.0-only OR BSD-2-Clause)
%YAML 1.2
---
$id: http://devicetree.org/schemas/dma/cirrus,ep9301-dma-m2m.yaml#
$schema: http://devicetree.org/meta-schemas/core.yaml#

title: Cirrus Logic ep93xx SoC DMA controller

maintainers:
  - Alexander Sverdlin <alexander.sverdlin@gmail.com>
  - Nikita Shubin <nikita.shubin@maquefel.me>

allOf:
  - $ref: dma-controller.yaml#

properties:
  compatible:
    oneOf:
      - const: cirrus,ep9301-dma-m2m
      - items:
          - enum:
              - cirrus,ep9302-dma-m2m
              - cirrus,ep9307-dma-m2m
              - cirrus,ep9312-dma-m2m
              - cirrus,ep9315-dma-m2m
          - const: cirrus,ep9301-dma-m2m

  reg:
    items:
      - description: m2m0 channel registers
      - description: m2m1 channel registers

  clocks:
    items:
      - description: m2m0 channel gate clock
      - description: m2m1 channel gate clock

  clock-names:
    items:
      - const: m2m0
      - const: m2m1

  interrupts:
    items:
      - description: m2m0 channel interrupt
      - description: m2m1 channel interrupt

  '#dma-cells':
    const: 2
    description: |
      The first cell is the unique device channel number as indicated by this
      table for ep93xx:

      10: SPI controller
      11: IDE controller

      The second cell is the DMA direction line number:

      1: Memory to device
      2: Device to memory

required:
  - compatible
  - reg
  - clocks
  - clock-names
  - interrupts

additionalProperties: false

examples:
  - |
    #include <dt-bindings/clock/cirrus,ep9301-syscon.h>
    dma-controller@80000100 {
        compatible = "cirrus,ep9301-dma-m2m";
        reg = <0x80000100 0x0040>,
              <0x80000140 0x0040>;
        clocks = <&syscon EP93XX_CLK_M2M0>,
                 <&syscon EP93XX_CLK_M2M1>;
        clock-names = "m2m0", "m2m1";
        interrupt-parent = <&vic0>;
        interrupts = <17>, <18>;
        #dma-cells = <2>;
    };
```

## Documentation/devicetree/bindings/dma/cirrus,ep9301-dma-m2p.yaml
```yaml
# SPDX-License-Identifier: (GPL-2.0-only OR BSD-2-Clause)
%YAML 1.2
---
$id: http://devicetree.org/schemas/dma/cirrus,ep9301-dma-m2p.yaml#
$schema: http://devicetree.org/meta-schemas/core.yaml#

title: Cirrus Logic ep93xx SoC M2P DMA controller

maintainers:
  - Alexander Sverdlin <alexander.sverdlin@gmail.com>
  - Nikita Shubin <nikita.shubin@maquefel.me>

allOf:
  - $ref: dma-controller.yaml#

properties:
  compatible:
    oneOf:
      - const: cirrus,ep9301-dma-m2p
      - items:
          - enum:
              - cirrus,ep9302-dma-m2p
              - cirrus,ep9307-dma-m2p
              - cirrus,ep9312-dma-m2p
              - cirrus,ep9315-dma-m2p
          - const: cirrus,ep9301-dma-m2p

  reg:
    items:
      - description: m2p0 channel registers
      - description: m2p1 channel registers
      - description: m2p2 channel registers
      - description: m2p3 channel registers
      - description: m2p4 channel registers
      - description: m2p5 channel registers
      - description: m2p6 channel registers
      - description: m2p7 channel registers
      - description: m2p8 channel registers
      - description: m2p9 channel registers

  clocks:
    items:
      - description: m2p0 channel gate clock
      - description: m2p1 channel gate clock
      - description: m2p2 channel gate clock
      - description: m2p3 channel gate clock
      - description: m2p4 channel gate clock
      - description: m2p5 channel gate clock
      - description: m2p6 channel gate clock
      - description: m2p7 channel gate clock
      - description: m2p8 channel gate clock
      - description: m2p9 channel gate clock

  clock-names:
    items:
      - const: m2p0
      - const: m2p1
      - const: m2p2
      - const: m2p3
      - const: m2p4
      - const: m2p5
      - const: m2p6
      - const: m2p7
      - const: m2p8
      - const: m2p9

  interrupts:
    items:
      - description: m2p0 channel interrupt
      - description: m2p1 channel interrupt
      - description: m2p2 channel interrupt
      - description: m2p3 channel interrupt
      - description: m2p4 channel interrupt
      - description: m2p5 channel interrupt
      - description: m2p6 channel interrupt
      - description: m2p7 channel interrupt
      - description: m2p8 channel interrupt
      - description: m2p9 channel interrupt

  '#dma-cells':
    const: 2
    description: |
      The first cell is the unique device channel number as indicated by this
      table for ep93xx:

      0: I2S channel 1
      1: I2S channel 2 (unused)
      2: AC97 channel 1 (unused)
      3: AC97 channel 2 (unused)
      4: AC97 channel 3 (unused)
      5: I2S channel 3 (unused)
      6: UART1 (unused)
      7: UART2 (unused)
      8: UART3 (unused)
      9: IRDA (unused)

      The second cell is the DMA direction line number:

      1: Memory to device
      2: Device to memory

required:
  - compatible
  - reg
  - clocks
  - clock-names
  - interrupts

additionalProperties: false

examples:
  - |
    #include <dt-bindings/clock/cirrus,ep9301-syscon.h>
    dma-controller@80000000 {
        compatible = "cirrus,ep9301-dma-m2p";
        reg = <0x80000000 0x0040>,
              <0x80000040 0x0040>,
              <0x80000080 0x0040>,
              <0x800000c0 0x0040>,
              <0x80000240 0x0040>,
              <0x80000200 0x0040>,
              <0x800002c0 0x0040>,
              <0x80000280 0x0040>,
              <0x80000340 0x0040>,
              <0x80000300 0x0040>;
        clocks = <&syscon EP93XX_CLK_M2P0>,
                 <&syscon EP93XX_CLK_M2P1>,
                 <&syscon EP93XX_CLK_M2P2>,
                 <&syscon EP93XX_CLK_M2P3>,
                 <&syscon EP93XX_CLK_M2P4>,
                 <&syscon EP93XX_CLK_M2P5>,
                 <&syscon EP93XX_CLK_M2P6>,
                 <&syscon EP93XX_CLK_M2P7>,
                 <&syscon EP93XX_CLK_M2P8>,
                 <&syscon EP93XX_CLK_M2P9>;
        clock-names = "m2p0", "m2p1",
                      "m2p2", "m2p3",
                      "m2p4", "m2p5",
                      "m2p6", "m2p7",
                      "m2p8", "m2p9";
        interrupt-parent = <&vic0>;
        interrupts = <7>, <8>, <9>, <10>, <11>, <12>, <13>, <14>, <15>, <16>;
        #dma-cells = <2>;
    };
```

## Documentation/devicetree/bindings/dma/dma-common.yaml
```yaml
# SPDX-License-Identifier: GPL-2.0
%YAML 1.2
---
$id: http://devicetree.org/schemas/dma/dma-common.yaml#
$schema: http://devicetree.org/meta-schemas/core.yaml#

title: DMA Engine Generic Binding

maintainers:
  - Vinod Koul <vkoul@kernel.org>

description:
  Generic binding to provide a way for a driver using DMA Engine to
  retrieve the DMA request or channel information that goes from a
  hardware device to a DMA controller.

select: false

properties:
  "#dma-cells":
    minimum: 1
    # Should be enough
    maximum: 255
    description:
      Used to provide DMA controller specific information.

  dma-channel-mask:
    description:
      Bitmask of available DMA channels in ascending order that are
      not reserved by firmware and are available to the
      kernel. i.e. first channel corresponds to LSB.
      The first item in the array is for channels 0-31, the second is for
      channels 32-63, etc.
    $ref: /schemas/types.yaml#/definitions/uint32-array
    items:
      minItems: 1
      # Should be enough
      maxItems: 255

  dma-channels:
    $ref: /schemas/types.yaml#definitions/uint32
    description:
      Number of DMA channels supported by the controller.

  dma-requests:
    $ref: /schemas/types.yaml#definitions/uint32
    description:
      Number of DMA request signals supported by the controller.

required:
  - "#dma-cells"

additionalProperties: true
```

## Documentation/devicetree/bindings/dma/dma-controller.yaml
```yaml
# SPDX-License-Identifier: GPL-2.0
%YAML 1.2
---
$id: http://devicetree.org/schemas/dma/dma-controller.yaml#
$schema: http://devicetree.org/meta-schemas/core.yaml#

title: DMA Controller Common Properties

maintainers:
  - Vinod Koul <vkoul@kernel.org>

allOf:
  - $ref: dma-common.yaml#

# Everything else is described in the common file
properties:
  $nodename:
    pattern: "^dma-controller(@.*)?$"

additionalProperties: true

...
```
