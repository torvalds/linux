## Documentation/devicetree/bindings/dma/fsl,elo3-dma.yaml
```yaml
# SPDX-License-Identifier: (GPL-2.0-only OR BSD-2-Clause)
%YAML 1.2
---
$id: http://devicetree.org/schemas/dma/fsl,elo3-dma.yaml#
$schema: http://devicetree.org/meta-schemas/core.yaml#

title: Freescale Elo3 DMA Controller

maintainers:
  - J. Neuschäfer <j.ne@posteo.net>

description:
  DMA controller which has same function as EloPlus except that Elo3 has 8
  channels while EloPlus has only 4, it is used in Freescale Txxx and Bxxx
  series chips, such as t1040, t4240, b4860.

properties:
  compatible:
    const: fsl,elo3-dma

  reg:
    items:
      - description:
          DMA General Status Registers starting from DGSR0, for channel 1~4
      - description:
          DMA General Status Registers starting from DGSR1, for channel 5~8

  ranges: true

  "#address-cells":
    const: 1

  "#size-cells":
    const: 1

  interrupts:
    maxItems: 1

patternProperties:
  "^dma-channel@[0-9a-f]+$":
    type: object
    additionalProperties: false

    properties:
      compatible:
        enum:
          # native DMA channel
          - fsl,eloplus-dma-channel

          # audio DMA channel, see fsl,ssi.yaml
          - fsl,ssi-dma-channel

      reg:
        maxItems: 1

      interrupts:
        maxItems: 1
        description:
          Per-channel interrupt. Only necessary if no controller interrupt has
          been provided.

additionalProperties: false

examples:
  - |
    #include <dt-bindings/interrupt-controller/irq.h>

    dma@100300 {
        compatible = "fsl,elo3-dma";
        reg = <0x100300 0x4>,
              <0x100600 0x4>;
        #address-cells = <1>;
        #size-cells = <1>;
        ranges = <0x0 0x100100 0x500>;

        dma-channel@0 {
            compatible = "fsl,eloplus-dma-channel";
            reg = <0x0 0x80>;
            interrupts = <28 IRQ_TYPE_EDGE_FALLING 0 0>;
        };

        dma-channel@80 {
            compatible = "fsl,eloplus-dma-channel";
            reg = <0x80 0x80>;
            interrupts = <29 IRQ_TYPE_EDGE_FALLING 0 0>;
        };

        dma-channel@100 {
            compatible = "fsl,eloplus-dma-channel";
            reg = <0x100 0x80>;
            interrupts = <30 IRQ_TYPE_EDGE_FALLING 0 0>;
        };

        dma-channel@180 {
            compatible = "fsl,eloplus-dma-channel";
            reg = <0x180 0x80>;
            interrupts = <31 IRQ_TYPE_EDGE_FALLING 0 0>;
        };

        dma-channel@300 {
            compatible = "fsl,eloplus-dma-channel";
            reg = <0x300 0x80>;
            interrupts = <76 IRQ_TYPE_EDGE_FALLING 0 0>;
        };

        dma-channel@380 {
            compatible = "fsl,eloplus-dma-channel";
            reg = <0x380 0x80>;
            interrupts = <77 IRQ_TYPE_EDGE_FALLING 0 0>;
        };

        dma-channel@400 {
            compatible = "fsl,eloplus-dma-channel";
            reg = <0x400 0x80>;
            interrupts = <78 IRQ_TYPE_EDGE_FALLING 0 0>;
        };

        dma-channel@480 {
            compatible = "fsl,eloplus-dma-channel";
            reg = <0x480 0x80>;
            interrupts = <79 IRQ_TYPE_EDGE_FALLING 0 0>;
        };
    };

...
```

## Documentation/devicetree/bindings/dma/fsl,eloplus-dma.yaml
```yaml
# SPDX-License-Identifier: (GPL-2.0-only OR BSD-2-Clause)
%YAML 1.2
---
$id: http://devicetree.org/schemas/dma/fsl,eloplus-dma.yaml#
$schema: http://devicetree.org/meta-schemas/core.yaml#

title: Freescale EloPlus DMA Controller

maintainers:
  - J. Neuschäfer <j.ne@posteo.net>

description:
  This is a 4-channel DMA controller with extended addresses and chaining,
  mainly used in Freescale mpc85xx/86xx, Pxxx and BSC series chips, such as
  mpc8540, mpc8641 p4080, bsc9131 etc.

properties:
  compatible:
    oneOf:
      - items:
          - enum:
              - fsl,mpc8540-dma
              - fsl,mpc8541-dma
              - fsl,mpc8548-dma
              - fsl,mpc8555-dma
              - fsl,mpc8560-dma
              - fsl,mpc8572-dma
              - fsl,mpc8641-dma
          - const: fsl,eloplus-dma
      - const: fsl,eloplus-dma

  reg:
    items:
      - description:
          DMA General Status Register, i.e. DGSR which contains
          status for all the 4 DMA channels

  cell-index:
    $ref: /schemas/types.yaml#/definitions/uint32
    description:
      controller index.  0 for controller @ 0x21000, 1 for controller @ 0xc000

  ranges: true

  "#address-cells":
    const: 1

  "#size-cells":
    const: 1

  interrupts:
    maxItems: 1
    description: Controller interrupt.

patternProperties:
  "^dma-channel@[0-9a-f]+$":
    type: object
    additionalProperties: false

    properties:
      compatible:
        oneOf:
          # native DMA channel
          - items:
              - enum:
                  - fsl,mpc8540-dma-channel
                  - fsl,mpc8541-dma-channel
                  - fsl,mpc8548-dma-channel
                  - fsl,mpc8555-dma-channel
                  - fsl,mpc8560-dma-channel
                  - fsl,mpc8572-dma-channel
              - const: fsl,eloplus-dma-channel

          # audio DMA channel, see fsl,ssi.yaml
          - const: fsl,ssi-dma-channel

      reg:
        maxItems: 1

      cell-index:
        description: DMA channel index starts at 0.

      interrupts:
        maxItems: 1
        description:
          Per-channel interrupt. Only necessary if no controller interrupt has
          been provided.

additionalProperties: false

examples:
  - |
    #include <dt-bindings/interrupt-controller/irq.h>

    dma@21300 {
        compatible = "fsl,mpc8540-dma", "fsl,eloplus-dma";
        reg = <0x21300 4>;
        #address-cells = <1>;
        #size-cells = <1>;
        ranges = <0 0x21100 0x200>;
        cell-index = <0>;

        dma-channel@0 {
            compatible = "fsl,mpc8540-dma-channel", "fsl,eloplus-dma-channel";
            reg = <0 0x80>;
            cell-index = <0>;
            interrupts = <20 IRQ_TYPE_EDGE_FALLING>;
        };

        dma-channel@80 {
            compatible = "fsl,mpc8540-dma-channel", "fsl,eloplus-dma-channel";
            reg = <0x80 0x80>;
            cell-index = <1>;
            interrupts = <21 IRQ_TYPE_EDGE_FALLING>;
        };

        dma-channel@100 {
            compatible = "fsl,mpc8540-dma-channel", "fsl,eloplus-dma-channel";
            reg = <0x100 0x80>;
            cell-index = <2>;
            interrupts = <22 IRQ_TYPE_EDGE_FALLING>;
        };

        dma-channel@180 {
            compatible = "fsl,mpc8540-dma-channel", "fsl,eloplus-dma-channel";
            reg = <0x180 0x80>;
            cell-index = <3>;
            interrupts = <23 IRQ_TYPE_EDGE_FALLING>;
        };
    };

...
```

## Documentation/devicetree/bindings/dma/fsl,imx-dma.yaml
```yaml
# SPDX-License-Identifier: GPL-2.0-only OR BSD-2-Clause
%YAML 1.2
---
$id: http://devicetree.org/schemas/dma/fsl,imx-dma.yaml#
$schema: http://devicetree.org/meta-schemas/core.yaml#

title: Freescale Direct Memory Access (DMA) Controller for i.MX

maintainers:
  - Animesh Agarwal <animeshagarwal28@gmail.com>

allOf:
  - $ref: dma-controller.yaml#

properties:
  compatible:
    enum:
      - fsl,imx1-dma
      - fsl,imx21-dma
      - fsl,imx27-dma

  reg:
    maxItems: 1

  interrupts:
    items:
      - description: DMA complete interrupt
      - description: DMA Error interrupt
    minItems: 1

  clocks:
    maxItems: 2

  clock-names:
    items:
      - const: ipg
      - const: ahb

  "#dma-cells":
    const: 1

  dma-channels:
    const: 16

  dma-requests:
    description: Number of DMA requests supported.

required:
  - compatible
  - reg
  - interrupts
  - "#dma-cells"
  - clocks
  - clock-names

additionalProperties: false

examples:
  - |
    #include <dt-bindings/clock/imx27-clock.h>

    dma-controller@10001000 {
      compatible = "fsl,imx27-dma";
      reg = <0x10001000 0x1000>;
      interrupts = <32 33>;
      #dma-cells = <1>;
      dma-channels = <16>;
      clocks = <&clks IMX27_CLK_DMA_IPG_GATE>, <&clks IMX27_CLK_DMA_AHB_GATE>;
      clock-names = "ipg", "ahb";
    };
```

## Documentation/devicetree/bindings/dma/fsl,imx-sdma.yaml
```yaml
# SPDX-License-Identifier: GPL-2.0-only OR BSD-2-Clause
%YAML 1.2
---
$id: http://devicetree.org/schemas/dma/fsl,imx-sdma.yaml#
$schema: http://devicetree.org/meta-schemas/core.yaml#

title: Freescale Smart Direct Memory Access (SDMA) Controller for i.MX

maintainers:
  - Joy Zou <joy.zou@nxp.com>

allOf:
  - $ref: dma-controller.yaml#

properties:
  compatible:
    oneOf:
      - items:
          - enum:
              - fsl,imx50-sdma
              - fsl,imx51-sdma
              - fsl,imx53-sdma
              - fsl,imx6q-sdma
              - fsl,imx7d-sdma
          - const: fsl,imx35-sdma
      - items:
          - enum:
              - fsl,imx6sx-sdma
              - fsl,imx6sl-sdma
          - const: fsl,imx6q-sdma
      - items:
          - const: fsl,imx6ul-sdma
          - const: fsl,imx6q-sdma
          - const: fsl,imx35-sdma
      - items:
          - const: fsl,imx6sll-sdma
          - const: fsl,imx6ul-sdma
      - items:
          - const: fsl,imx8mq-sdma
          - const: fsl,imx7d-sdma
      - items:
          - enum:
              - fsl,imx8mp-sdma
              - fsl,imx8mn-sdma
              - fsl,imx8mm-sdma
          - const: fsl,imx8mq-sdma
      - items:
          - enum:
              - fsl,imx25-sdma
              - fsl,imx31-sdma
              - fsl,imx35-sdma
  reg:
    maxItems: 1

  interrupts:
    maxItems: 1

  fsl,sdma-ram-script-name:
    $ref: /schemas/types.yaml#/definitions/string
    description: Should contain the full path of SDMA RAM scripts firmware.

  "#dma-cells":
    const: 3
    description: |
      The first cell: request/event ID

      The second cell: peripheral types ID
        enum:
          - MCU domain SSI: 0
          - Shared SSI: 1
          - MMC: 2
          - SDHC: 3
          - MCU domain UART: 4
          - Shared UART: 5
          - FIRI: 6
          - MCU domain CSPI: 7
          - Shared CSPI: 8
          - SIM: 9
          - ATA: 10
          - CCM: 11
          - External peripheral: 12
          - Memory Stick Host Controller: 13
          - Shared Memory Stick Host Controller: 14
          - DSP: 15
          - Memory: 16
          - FIFO type Memory: 17
          - SPDIF: 18
          - IPU Memory: 19
          - ASRC: 20
          - ESAI: 21
          - SSI Dual FIFO: 22
              description: needs firmware more than ver 2
          - Shared ASRC: 23
          - SAI: 24
          - Multi SAI: 25
          - HDMI Audio: 26

       The third cell: transfer priority ID
         enum:
           - High: 0
           - Medium: 1
           - Low: 2

  gpr:
    $ref: /schemas/types.yaml#/definitions/phandle
    description: The phandle to the General Purpose Register (GPR) node

  fsl,sdma-event-remap:
    $ref: /schemas/types.yaml#/definitions/uint32-matrix
    maxItems: 2
    items:
      items:
        - description: GPR register offset
        - description: GPR register shift
        - description: GPR register value
    description: |
      Register bits of sdma event remap, the format is <reg shift val>.
      The order is <RX>, <TX>.

  clocks:
    maxItems: 2

  clock-names:
    items:
      - const: ipg
      - const: ahb

  iram:
    $ref: /schemas/types.yaml#/definitions/phandle
    description: The phandle to the On-chip RAM (OCRAM) node.

required:
  - compatible
  - reg
  - interrupts
  - fsl,sdma-ram-script-name

additionalProperties: false

examples:
  - |
    sdma: dma-controller@83fb0000 {
      compatible = "fsl,imx51-sdma", "fsl,imx35-sdma";
      reg = <0x83fb0000 0x4000>;
      interrupts = <6>;
      #dma-cells = <3>;
      fsl,sdma-ram-script-name = "sdma-imx51.bin";
    };

...
```

## Documentation/devicetree/bindings/dma/fsl,mxs-dma.yaml
```yaml
# SPDX-License-Identifier: GPL-2.0-only OR BSD-2-Clause
%YAML 1.2
---
$id: http://devicetree.org/schemas/dma/fsl,mxs-dma.yaml#
$schema: http://devicetree.org/meta-schemas/core.yaml#

title: Freescale Direct Memory Access (DMA) Controller from i.MX23/i.MX28

maintainers:
  - Marek Vasut <marex@denx.de>

allOf:
  - $ref: dma-controller.yaml#
  - if:
      properties:
        compatible:
          contains:
            const: fsl,imx8qxp-dma-apbh
    then:
      required:
        - power-domains
    else:
      properties:
        power-domains: false

  - if:
      properties:
        compatible:
          contains:
            const: fsl,imx23-dma-apbx
    then:
      properties:
        interrupt-names:
          items:
            - const: audio-adc
            - const: audio-dac
            - const: spdif-tx
            - const: i2c
            - const: saif0
            - const: empty0
            - const: auart0-rx
            - const: auart0-tx
            - const: auart1-rx
            - const: auart1-tx
            - const: saif1
            - const: empty1
            - const: empty2
            - const: empty3
            - const: empty4
            - const: empty5
    else:
      properties:
        interrupt-names: false

properties:
  compatible:
    oneOf:
      - items:
          - enum:
              - fsl,imx6q-dma-apbh
              - fsl,imx6sx-dma-apbh
              - fsl,imx7d-dma-apbh
              - fsl,imx8dxl-dma-apbh
              - fsl,imx8mm-dma-apbh
              - fsl,imx8mn-dma-apbh
              - fsl,imx8mp-dma-apbh
              - fsl,imx8mq-dma-apbh
              - fsl,imx8qm-dma-apbh
              - fsl,imx8qxp-dma-apbh
          - const: fsl,imx28-dma-apbh
      - enum:
          - fsl,imx23-dma-apbh
          - fsl,imx23-dma-apbx
          - fsl,imx28-dma-apbh
          - fsl,imx28-dma-apbx
  reg:
    maxItems: 1

  clocks:
    maxItems: 1

  interrupts:
    minItems: 4
    maxItems: 16

  interrupt-names:
    minItems: 4
    maxItems: 16

  "#dma-cells":
    const: 1

  dma-channels:
    enum: [4, 8, 16]

  power-domains:
    maxItems: 1

required:
  - compatible
  - reg
  - "#dma-cells"
  - dma-channels
  - interrupts

additionalProperties: false

examples:
  - |
    interrupt-parent = <&irqc>;

    dma-controller@80004000 {
      compatible = "fsl,imx28-dma-apbh";
      reg = <0x80004000 0x2000>;
      interrupts = <82 83 84 85
                    88 88 88 88
                    88 88 88 88
                    87 86 0 0>;
      #dma-cells = <1>;
      dma-channels = <16>;
    };

    dma-controller@80024000 {
      compatible = "fsl,imx28-dma-apbx";
      reg = <0x80024000 0x2000>;
      interrupts = <78 79 66 0
                    80 81 68 69
                    70 71 72 73
                    74 75 76 77>;
      #dma-cells = <1>;
      dma-channels = <16>;
    };

...
```
