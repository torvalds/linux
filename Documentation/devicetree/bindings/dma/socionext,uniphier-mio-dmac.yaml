## Documentation/devicetree/bindings/dma/stm32/st,stm32-dma3.yaml
```yaml
# SPDX-License-Identifier: (GPL-2.0-only OR BSD-2-Clause)
%YAML 1.2
---
$id: http://devicetree.org/schemas/dma/stm32/st,stm32-dma3.yaml#
$schema: http://devicetree.org/meta-schemas/core.yaml#

title: STMicroelectronics STM32 DMA3 Controller

description: |
  The STM32 DMA3 is a direct memory access controller with different features
  depending on its hardware configuration.
  It is either called LPDMA (Low Power), GPDMA (General Purpose) or HPDMA (High
  Performance).
  Its hardware configuration registers allow to dynamically expose its features.

  GPDMA and HPDMA support 16 independent DMA channels, while only 4 for LPDMA.
  GPDMA and HPDMA support 256 DMA requests from peripherals, 8 for LPDMA.

  Bindings are generic for these 3 STM32 DMA3 configurations.

  DMA clients connected to the STM32 DMA3 controller must use the format
  described in "#dma-cells" property description below, using a three-cell
  specifier for each channel.

maintainers:
  - Amelie Delaunay <amelie.delaunay@foss.st.com>

allOf:
  - $ref: /schemas/dma/dma-controller.yaml#

properties:
  compatible:
    const: st,stm32mp25-dma3

  reg:
    maxItems: 1

  interrupts:
    minItems: 4
    maxItems: 16
    description:
      Should contain all of the per-channel DMA interrupts in ascending order
      with respect to the DMA channel index.

  clocks:
    maxItems: 1

  resets:
    maxItems: 1

  power-domains:
    maxItems: 1

  "#dma-cells":
    const: 3
    description: |
      Specifies the number of cells needed to provide DMA controller specific
      information.
      The first cell is the request line number.
      The second cell is a 32-bit mask specifying the DMA channel requirements:
        -bit 0-1: The priority level
          0x0: low priority, low weight
          0x1: low priority, mid weight
          0x2: low priority, high weight
          0x3: high priority
        -bit 4-7: The FIFO requirement for queuing source/destination transfers
          0x0: no FIFO requirement/any channel can fit
          0x2: FIFO of 8 bytes (2^2+1)
          0x4: FIFO of 32 bytes (2^4+1)
          0x6: FIFO of 128 bytes (2^6+1)
          0x7: FIFO of 256 bytes (2^7+1)
      The third cell is a 32-bit mask specifying the DMA transfer requirements:
        -bit 0: The source incrementing burst
          0x0: fixed burst
          0x1: contiguously incremented burst
        -bit 1: The source allocated port
          0x0: port 0 is allocated to the source transfer
          0x1: port 1 is allocated to the source transfer
        -bit 4: The destination incrementing burst
          0x0: fixed burst
          0x1: contiguously incremented burst
        -bit 5: The destination allocated port
          0x0: port 0 is allocated to the destination transfer
          0x1: port 1 is allocated to the destination transfer
        -bit 8: The type of hardware request
          0x0: burst
          0x1: block
        -bit 9: The control mode
          0x0: DMA controller control mode
          0x1: peripheral control mode
        -bit 12-13: The transfer complete event mode
          0x0: at block level, transfer complete event is generated at the end
               of a block
          0x2: at LLI level, the transfer complete event is generated at the end
               of the LLI transfer
               including the update of the LLI if any
          0x3: at channel level, the transfer complete event is generated at the
               end of the last LLI
        -bit 16: Prevent packing/unpacking mode
          0x0: pack/unpack enabled when source data width/burst != destination data width/burst
          0x1: memory data width/burst forced to peripheral data width/burst to prevent pack/unpack
        -bit 17: Prevent additional transfers due to linked-list refactoring
          0x0: don't prevent additional transfers for optimal performance
          0x1: prevent additional transfer to accommodate user constraints such as single transfer

required:
  - compatible
  - reg
  - interrupts
  - clocks
  - "#dma-cells"

unevaluatedProperties: false

examples:
  - |
    #include <dt-bindings/interrupt-controller/arm-gic.h>
    #include <dt-bindings/clock/st,stm32mp25-rcc.h>
    dma-controller@40400000 {
      compatible = "st,stm32mp25-dma3";
      reg = <0x40400000 0x1000>;
      interrupts = <GIC_SPI 33 IRQ_TYPE_LEVEL_HIGH>,
                   <GIC_SPI 34 IRQ_TYPE_LEVEL_HIGH>,
                   <GIC_SPI 35 IRQ_TYPE_LEVEL_HIGH>,
                   <GIC_SPI 36 IRQ_TYPE_LEVEL_HIGH>,
                   <GIC_SPI 37 IRQ_TYPE_LEVEL_HIGH>,
                   <GIC_SPI 38 IRQ_TYPE_LEVEL_HIGH>,
                   <GIC_SPI 39 IRQ_TYPE_LEVEL_HIGH>,
                   <GIC_SPI 40 IRQ_TYPE_LEVEL_HIGH>,
                   <GIC_SPI 41 IRQ_TYPE_LEVEL_HIGH>,
                   <GIC_SPI 42 IRQ_TYPE_LEVEL_HIGH>,
                   <GIC_SPI 43 IRQ_TYPE_LEVEL_HIGH>,
                   <GIC_SPI 44 IRQ_TYPE_LEVEL_HIGH>,
                   <GIC_SPI 45 IRQ_TYPE_LEVEL_HIGH>,
                   <GIC_SPI 46 IRQ_TYPE_LEVEL_HIGH>,
                   <GIC_SPI 47 IRQ_TYPE_LEVEL_HIGH>,
                   <GIC_SPI 48 IRQ_TYPE_LEVEL_HIGH>;
      clocks = <&rcc CK_BUS_HPDMA1>;
      #dma-cells = <3>;
    };
...
```

## Documentation/devicetree/bindings/dma/sun4i-dma.txt
```
Allwinner A10 DMA Controller

This driver follows the generic DMA bindings defined in dma.txt.

Required properties:

- compatible:	Must be "allwinner,sun4i-a10-dma"
- reg:		Should contain the registers base address and length
- interrupts:	Should contain a reference to the interrupt used by this device
- clocks:	Should contain a reference to the parent AHB clock
- #dma-cells :	Should be 2, first cell denoting normal or dedicated dma,
		second cell holding the request line number.

Example:
	dma: dma-controller@01c02000 {
		compatible = "allwinner,sun4i-a10-dma";
		reg = <0x01c02000 0x1000>;
		interrupts = <27>;
		clocks = <&ahb_gates 6>;
		#dma-cells = <2>;
	};

Clients:

DMA clients connected to the Allwinner A10 DMA controller must use the
format described in the dma.txt file, using a three-cell specifier for
each channel: a phandle plus two integer cells.
The three cells in order are:

1. A phandle pointing to the DMA controller.
2. Whether it is using normal (0) or dedicated (1) channels
3. The port ID as specified in the datasheet

Example:
	spi2: spi@01c17000 {
		compatible = "allwinner,sun4i-a10-spi";
		reg = <0x01c17000 0x1000>;
		interrupts = <0 12 4>;
		clocks = <&ahb_gates 22>, <&spi2_clk>;
		clock-names = "ahb", "mod";
		dmas = <&dma 1 29>, <&dma 1 28>;
		dma-names = "rx", "tx";
		#address-cells = <1>;
		#size-cells = <0>;
	};
```

## Documentation/devicetree/bindings/dma/sun6i-dma.txt
```
Allwinner A31 DMA Controller

This driver follows the generic DMA bindings defined in dma.txt.

Required properties:

- compatible:	Must be one of
		  "allwinner,sun6i-a31-dma"
		  "allwinner,sun8i-a23-dma"
		  "allwinner,sun8i-h3-dma"
- reg:		Should contain the registers base address and length
- interrupts:	Should contain a reference to the interrupt used by this device
- clocks:	Should contain a reference to the parent AHB clock
- resets:	Should contain a reference to the reset controller asserting
		this device in reset
- #dma-cells :	Should be 1, a single cell holding a line request number

Example:
	dma: dma-controller@01c02000 {
		compatible = "allwinner,sun6i-a31-dma";
		reg = <0x01c02000 0x1000>;
		interrupts = <0 50 4>;
		clocks = <&ahb1_gates 6>;
		resets = <&ahb1_rst 6>;
		#dma-cells = <1>;
	};

Clients:

DMA clients connected to the A31 DMA controller must use the format
described in the dma.txt file, using a two-cell specifier for each
channel: a phandle plus one integer cells.
The two cells in order are:

1. A phandle pointing to the DMA controller.
2. The port ID as specified in the datasheet

Example:
spi2: spi@01c6a000 {
	compatible = "allwinner,sun6i-a31-spi";
	reg = <0x01c6a000 0x1000>;
	interrupts = <0 67 4>;
	clocks = <&ahb1_gates 22>, <&spi2_clk>;
	clock-names = "ahb", "mod";
	dmas = <&dma 25>, <&dma 25>;
	dma-names = "rx", "tx";
	resets = <&ahb1_rst 22>;
};
```

## Documentation/devicetree/bindings/dma/tegra20-apbdma.txt
```
* NVIDIA Tegra APB DMA controller

Required properties:
- compatible: Should be "nvidia,<chip>-apbdma"
- reg: Should contain DMA registers location and length. This shuld include
  all of the per-channel registers.
- interrupts: Should contain all of the per-channel DMA interrupts.

Examples:

apbdma: dma@6000a000 {
	compatible = "nvidia,tegra20-apbdma";
	reg = <0x6000a000 0x1200>;
	interrupts = < 0 136 0x04
		       0 137 0x04
		       0 138 0x04
		       0 139 0x04
		       0 140 0x04
		       0 141 0x04
		       0 142 0x04
		       0 143 0x04
		       0 144 0x04
		       0 145 0x04
		       0 146 0x04
		       0 147 0x04
		       0 148 0x04
		       0 149 0x04
		       0 150 0x04
		       0 151 0x04 >;
};
```

## Documentation/devicetree/bindings/dma/ti-dma-crossbar.txt
```
Texas Instruments DMA Crossbar (DMA request router)

Required properties:
- compatible:	"ti,dra7-dma-crossbar" for DRA7xx DMA crossbar
		"ti,am335x-edma-crossbar" for AM335x and AM437x
- reg:		Memory map for accessing module
- #dma-cells:	Should be set to to match with the DMA controller's dma-cells
		for ti,dra7-dma-crossbar and <3> for ti,am335x-edma-crossbar.
- dma-requests:	Number of DMA requests the crossbar can receive
- dma-masters:	phandle pointing to the DMA controller

The DMA controller node need to have the following poroperties:
- dma-requests:	Number of DMA requests the controller can handle

Optional properties:
- ti,dma-safe-map: Safe routing value for unused request lines

Notes:
When requesting channel via ti,dra7-dma-crossbar, the DMA clinet must request
the DMA event number as crossbar ID (input to the DMA crossbar).

For ti,am335x-edma-crossbar: the meaning of parameters of dmas for clients:
dmas = <&edma_xbar 12 0 1>; where <12> is the DMA request number, <0> is the TC
the event should be assigned and <1> is the mux selection for in the crossbar.
When mux 0 is used the DMA channel can be requested directly from edma node.

Example:

/* DMA controller */
sdma: dma-controller@4a056000 {
	compatible = "ti,omap4430-sdma";
	reg = <0x4a056000 0x1000>;
	interrupts =	<GIC_SPI 7 IRQ_TYPE_LEVEL_HIGH>,
			<GIC_SPI 8 IRQ_TYPE_LEVEL_HIGH>,
			<GIC_SPI 9 IRQ_TYPE_LEVEL_HIGH>,
			<GIC_SPI 10 IRQ_TYPE_LEVEL_HIGH>;
	#dma-cells = <1>;
	dma-channels = <32>;
	dma-requests = <127>;
};

/* DMA crossbar */
sdma_xbar: dma-router@4a002b78 {
	compatible = "ti,dra7-dma-crossbar";
	reg = <0x4a002b78 0xfc>;
	#dma-cells = <1>;
	dma-requests = <205>;
	ti,dma-safe-map = <0>;
	dma-masters = <&sdma>;
};

/* DMA client */
uart1: serial@4806a000 {
	compatible = "ti,omap4-uart";
	reg = <0x4806a000 0x100>;
	interrupts-extended = <&gic GIC_SPI 67 IRQ_TYPE_LEVEL_HIGH>;
	ti,hwmods = "uart1";
	clock-frequency = <48000000>;
	status = "disabled";
	/* Requesting crossbar input 49 and 50 */
	dmas = <&sdma_xbar 49>, <&sdma_xbar 50>;
	dma-names = "tx", "rx";
};
```
