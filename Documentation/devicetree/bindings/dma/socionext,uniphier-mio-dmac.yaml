## Documentation/devicetree/bindings/dma/socionext,uniphier-mio-dmac.yaml
```yaml
# SPDX-License-Identifier: GPL-2.0-only OR BSD-2-Clause
%YAML 1.2
---
$id: http://devicetree.org/schemas/dma/socionext,uniphier-mio-dmac.yaml#
$schema: http://devicetree.org/meta-schemas/core.yaml#

title: UniPhier Media IO DMA controller

description: |
  This works as an external DMA engine for SD/eMMC controllers etc.
  found in UniPhier LD4, Pro4, sLD8 SoCs.

maintainers:
  - Masahiro Yamada <yamada.masahiro@socionext.com>

allOf:
  - $ref: "dma-controller.yaml#"

properties:
  compatible:
    const: socionext,uniphier-mio-dmac

  reg:
    maxItems: 1

  interrupts:
    description: |
      A list of interrupt specifiers associated with the DMA channels.
      The number of interrupt lines is SoC-dependent.

  clocks:
    maxItems: 1

  resets:
    maxItems: 1

  '#dma-cells':
    description: The single cell represents the channel index.
    const: 1

required:
  - compatible
  - reg
  - interrupts
  - clocks
  - '#dma-cells'

additionalProperties: false

examples:
  - |
    // In the example below, "interrupts = <0 68 4>, <0 68 4>, ..." is not a
    // typo. The first two channels share a single interrupt line.

    dmac: dma-controller@5a000000 {
        compatible = "socionext,uniphier-mio-dmac";
        reg = <0x5a000000 0x1000>;
        interrupts = <0 68 4>, <0 68 4>, <0 69 4>, <0 70 4>,
                     <0 71 4>, <0 72 4>, <0 73 4>, <0 74 4>;
        clocks = <&mio_clk 7>;
        resets = <&mio_rst 7>;
        #dma-cells = <1>;
    };
```

## Documentation/devicetree/bindings/dma/socionext,uniphier-xdmac.yaml
```yaml
# SPDX-License-Identifier: (GPL-2.0-only OR BSD-2-Clause)
%YAML 1.2
---
$id: http://devicetree.org/schemas/dma/socionext,uniphier-xdmac.yaml#
$schema: http://devicetree.org/meta-schemas/core.yaml#

title: Socionext UniPhier external DMA controller

description: |
  This describes the devicetree bindings for an external DMA engine to perform
  memory-to-memory or peripheral-to-memory data transfer capable of supporting
  16 channels, implemented in Socionext UniPhier SoCs.

maintainers:
  - Kunihiko Hayashi <hayashi.kunihiko@socionext.com>

allOf:
  - $ref: "dma-controller.yaml#"

properties:
  compatible:
    const: socionext,uniphier-xdmac

  reg:
    items:
      - description: XDMAC base register region (offset and length)
      - description: XDMAC extension register region (offset and length)

  interrupts:
    maxItems: 1

  "#dma-cells":
    const: 2
    description: |
      DMA request from clients consists of 2 cells:
        1. Channel index
        2. Transfer request factor number, If no transfer factor, use 0.
           The number is SoC-specific, and this should be specified with
           relation to the device to use the DMA controller.

  dma-channels:
    minimum: 1
    maximum: 16

additionalProperties: false

required:
  - compatible
  - reg
  - interrupts
  - "#dma-cells"

examples:
  - |
    xdmac: dma-controller@5fc10000 {
        compatible = "socionext,uniphier-xdmac";
        reg = <0x5fc10000 0x1000>, <0x5fc20000 0x800>;
        interrupts = <0 188 4>;
        #dma-cells = <2>;
        dma-channels = <16>;
    };

...
```

## Documentation/devicetree/bindings/dma/sophgo,cv1800b-dmamux.yaml
```yaml
# SPDX-License-Identifier: (GPL-2.0-only OR BSD-2-Clause)
%YAML 1.2
---
$id: http://devicetree.org/schemas/dma/sophgo,cv1800b-dmamux.yaml#
$schema: http://devicetree.org/meta-schemas/core.yaml#

title: Sophgo CV1800/SG200 Series DMA multiplexer

maintainers:
  - Inochi Amaoto <inochiama@gmail.com>

description:
  The DMA multiplexer of CV1800 is a subdevice of the system
  controller. It support mapping 8 channels, but each channel
  can be mapped only once.

allOf:
  - $ref: dma-router.yaml#

properties:
  compatible:
    const: sophgo,cv1800b-dmamux

  reg:
    items:
      - description: DMA channal remapping register
      - description: DMA channel interrupt mapping register

  '#dma-cells':
    const: 2
    description:
      The first cells is device id. The second one is the cpu id.

  dma-masters:
    maxItems: 1

required:
  - reg
  - '#dma-cells'
  - dma-masters

additionalProperties: false

examples:
  - |
    dma-router@154 {
      compatible = "sophgo,cv1800b-dmamux";
      reg = <0x154 0x8>, <0x298 0x4>;
      #dma-cells = <2>;
      dma-masters = <&dmac>;
    };
```

## Documentation/devicetree/bindings/dma/spacemit,k1-pdma.yaml
```yaml
# SPDX-License-Identifier: (GPL-2.0-only OR BSD-2-Clause)
%YAML 1.2
---
$id: http://devicetree.org/schemas/dma/spacemit,k1-pdma.yaml#
$schema: http://devicetree.org/meta-schemas/core.yaml#

title: SpacemiT K1 PDMA Controller

maintainers:
  - Guodong Xu <guodong@riscstar.com>

allOf:
  - $ref: dma-controller.yaml#

properties:
  compatible:
    const: spacemit,k1-pdma

  reg:
    maxItems: 1

  interrupts:
    description: Shared interrupt for all DMA channels
    maxItems: 1

  clocks:
    maxItems: 1

  resets:
    maxItems: 1

  dma-channels:
    maximum: 16

  '#dma-cells':
    const: 1
    description:
      The DMA request number for the peripheral device.

required:
  - compatible
  - reg
  - interrupts
  - clocks
  - resets
  - dma-channels
  - '#dma-cells'

unevaluatedProperties: false

examples:
  - |
    #include <dt-bindings/clock/spacemit,k1-syscon.h>

    soc {
        #address-cells = <2>;
        #size-cells = <2>;

        dma-controller@d4000000 {
            compatible = "spacemit,k1-pdma";
            reg = <0x0 0xd4000000 0x0 0x4000>;
            interrupts = <72>;
            clocks = <&syscon_apmu CLK_DMA>;
            resets = <&syscon_apmu RESET_DMA>;
            dma-channels = <16>;
            #dma-cells = <1>;
        };
    };
```

## Documentation/devicetree/bindings/dma/sprd,sc9860-dma.yaml
```yaml
# SPDX-License-Identifier: GPL-2.0-only OR BSD-2-Clause
%YAML 1.2
---
$id: http://devicetree.org/schemas/dma/sprd,sc9860-dma.yaml#
$schema: http://devicetree.org/meta-schemas/core.yaml#

title: Spreadtrum SC9860 DMA controller

description: |
  There are three DMA controllers: AP DMA, AON DMA and AGCP DMA. For AGCP
  DMA controller, it can or do not request the IRQ, which will save
  system power without resuming system by DMA interrupts if AGCP DMA
  does not request the IRQ.

maintainers:
  - Orson Zhai <orsonzhai@gmail.com>
  - Baolin Wang <baolin.wang7@gmail.com>
  - Chunyan Zhang <zhang.lyra@gmail.com>

properties:
  compatible:
    const: sprd,sc9860-dma

  reg:
    maxItems: 1

  interrupts:
    maxItems: 1

  clocks:
    minItems: 1
    items:
      - description: DMA enable clock
      - description: optional ashb_eb clock, only for the AGCP DMA controller

  clock-names:
    minItems: 1
    items:
      - const: enable
      - const: ashb_eb

  '#dma-cells':
    const: 1

  dma-channels:
    const: 32

  '#dma-channels':
    const: 32
    deprecated: true

required:
  - compatible
  - reg
  - clocks
  - clock-names
  - '#dma-cells'
  - dma-channels

allOf:
  - $ref: dma-controller.yaml#

unevaluatedProperties: false

examples:
  - |
    #include <dt-bindings/clock/sprd,sc9860-clk.h>
    #include <dt-bindings/interrupt-controller/arm-gic.h>
    #include <dt-bindings/interrupt-controller/irq.h>

    /* AP DMA controller */
    dma-controller@20100000 {
      compatible = "sprd,sc9860-dma";
      reg = <0x20100000 0x4000>;
      interrupts = <GIC_SPI 42 IRQ_TYPE_LEVEL_HIGH>;
      clocks = <&apahb_gate CLK_DMA_EB>;
      clock-names = "enable";
      #dma-cells = <1>;
      dma-channels = <32>;
    };

    /* AGCP DMA controller */
    dma-controller@41580000 {
      compatible = "sprd,sc9860-dma";
      reg = <0x41580000 0x4000>;
      clocks = <&agcp_gate CLK_AGCP_DMAAP_EB>,
               <&agcp_gate CLK_AGCP_AP_ASHB_EB>;
      clock-names = "enable", "ashb_eb";
      #dma-cells = <1>;
      dma-channels = <32>;
    };
...
```

## Documentation/devicetree/bindings/dma/sprd-dma.txt
```
* Spreadtrum DMA controller

This binding follows the generic DMA bindings defined in dma.txt.

Required properties:
- compatible: Should be "sprd,sc9860-dma".
- reg: Should contain DMA registers location and length.
- interrupts: Should contain one interrupt shared by all channel.
- #dma-cells: must be <1>. Used to represent the number of integer
	cells in the dmas property of client device.
- #dma-channels : Number of DMA channels supported. Should be 32.
- clock-names: Should contain the clock of the DMA controller.
- clocks: Should contain a clock specifier for each entry in clock-names.

Example:

Controller:
apdma: dma-controller@20100000 {
	compatible = "sprd,sc9860-dma";
	reg = <0x20100000 0x4000>;
	interrupts = <GIC_SPI 50 IRQ_TYPE_LEVEL_HIGH>;
	#dma-cells = <1>;
	#dma-channels = <32>;
	clock-names = "enable";
	clocks = <&clk_ap_ahb_gates 5>;
};


Client:
DMA clients connected to the Spreadtrum DMA controller must use the format
described in the dma.txt file, using a two-cell specifier for each channel.
The two cells in order are:
1. A phandle pointing to the DMA controller.
2. The channel id.

spi0: spi@70a00000{
	...
	dma-names = "rx_chn", "tx_chn";
	dmas = <&apdma 11>, <&apdma 12>;
	...
};
```

## Documentation/devicetree/bindings/dma/st,stm32-dma.yaml
```yaml
# SPDX-License-Identifier: (GPL-2.0-only OR BSD-2-Clause)
%YAML 1.2
---
$id: http://devicetree.org/schemas/dma/st,stm32-dma.yaml#
$schema: http://devicetree.org/meta-schemas/core.yaml#

title: STMicroelectronics STM32 DMA Controller bindings

description: |
  The STM32 DMA is a general-purpose direct memory access controller capable of
  supporting 8 independent DMA channels. Each channel can have up to 8 requests.
  DMA clients connected to the STM32 DMA controller must use the format
  described in the dma.txt file, using a four-cell specifier for each
  channel: a phandle to the DMA controller plus the following four integer cells:
    1. The channel id
    2. The request line number
    3. A 32bit mask specifying the DMA channel configuration which are device
      dependent:
        -bit 9: Peripheral Increment Address
          0x0: no address increment between transfers
          0x1: increment address between transfers
        -bit 10: Memory Increment Address
          0x0: no address increment between transfers
          0x1: increment address between transfers
        -bit 15: Peripheral Increment Offset Size
          0x0: offset size is linked to the peripheral bus width
          0x1: offset size is fixed to 4 (32-bit alignment)
        -bit 16-17: Priority level
          0x0: low
          0x1: medium
          0x2: high
          0x3: very high
    4. A 32bit bitfield value specifying DMA features which are device dependent:
       -bit 0-1: DMA FIFO threshold selection
         0x0: 1/4 full FIFO
         0x1: 1/2 full FIFO
         0x2: 3/4 full FIFO
         0x3: full FIFO
       -bit 2: DMA direct mode
         0x0: FIFO mode with threshold selectable with bit 0-1
         0x1: Direct mode: each DMA request immediately initiates a transfer
              from/to the memory, FIFO is bypassed.
       -bit 4: alternative DMA request/acknowledge protocol
         0x0: Use standard DMA ACK management, where ACK signal is maintained
              up to the removal of request and transfer completion
         0x1: Use alternative DMA ACK management, where ACK de-assertion does
              not wait for the de-assertion of the REQuest, ACK is only managed
              by transfer completion. This must only be used on channels
              managing transfers for STM32 USART/UART.


maintainers:
  - Amelie Delaunay <amelie.delaunay@st.com>

allOf:
  - $ref: "dma-controller.yaml#"

properties:
  "#dma-cells":
    const: 4

  compatible:
    const: st,stm32-dma

  reg:
    maxItems: 1

  clocks:
    maxItems: 1

  interrupts:
    maxItems: 8
    description: Should contain all of the per-channel DMA
      interrupts in ascending order with respect to the
      DMA channel index.

  resets:
    maxItems: 1

  st,mem2mem:
    $ref: /schemas/types.yaml#/definitions/flag
    description: if defined, it indicates that the controller
      supports memory-to-memory transfer

required:
  - compatible
  - reg
  - clocks
  - interrupts

unevaluatedProperties: false

examples:
  - |
    #include <dt-bindings/interrupt-controller/arm-gic.h>
    #include <dt-bindings/clock/stm32mp1-clks.h>
    #include <dt-bindings/reset/stm32mp1-resets.h>
    dma-controller@40026400 {
      compatible = "st,stm32-dma";
      reg = <0x40026400 0x400>;
      interrupts = <56>,
                   <57>,
                   <58>,
                   <59>,
                   <60>,
                   <68>,
                   <69>,
                   <70>;
      clocks = <&clk_hclk>;
      #dma-cells = <4>;
      st,mem2mem;
      resets = <&rcc 150>;
      dma-requests = <8>;
    };

...
```

## Documentation/devicetree/bindings/dma/st,stm32-dmamux.yaml
```yaml
# SPDX-License-Identifier: (GPL-2.0-only OR BSD-2-Clause)
%YAML 1.2
---
$id: http://devicetree.org/schemas/dma/st,stm32-dmamux.yaml#
$schema: http://devicetree.org/meta-schemas/core.yaml#

title: STMicroelectronics STM32 DMA MUX (DMA request router)

maintainers:
  - Amelie Delaunay <amelie.delaunay@foss.st.com>

allOf:
  - $ref: dma-router.yaml#

properties:
  "#dma-cells":
    const: 3

  compatible:
    const: st,stm32h7-dmamux

  reg:
    maxItems: 1

  clocks:
    maxItems: 1

  resets:
    maxItems: 1

  access-controllers:
    minItems: 1
    maxItems: 2

required:
  - compatible
  - reg
  - dma-masters

unevaluatedProperties: false

examples:
  - |
    #include <dt-bindings/interrupt-controller/arm-gic.h>
    #include <dt-bindings/clock/stm32mp1-clks.h>
    #include <dt-bindings/reset/stm32mp1-resets.h>
    dma-router@40020800 {
      compatible = "st,stm32h7-dmamux";
      reg = <0x40020800 0x3c>;
      #dma-cells = <3>;
      dma-requests = <128>;
      dma-channels = <16>;
      dma-masters = <&dma1>, <&dma2>;
      clocks = <&timer_clk>;
    };

...
```
