## Documentation/devicetree/bindings/dma/st,stm32-mdma.yaml
```yaml
# SPDX-License-Identifier: (GPL-2.0-only OR BSD-2-Clause)
%YAML 1.2
---
$id: http://devicetree.org/schemas/dma/st,stm32-mdma.yaml#
$schema: http://devicetree.org/meta-schemas/core.yaml#

title: STMicroelectronics STM32 MDMA Controller bindings

description: |
  The STM32 MDMA is a general-purpose direct memory access controller capable of
  supporting 64 independent DMA channels with 256 HW requests.
  DMA clients connected to the STM32 MDMA controller must use the format
  described in the dma.txt file, using a five-cell specifier for each channel:
  a phandle to the MDMA controller plus the following five integer cells:
    1. The request line number
    2. The priority level
      0x0: Low
      0x1: Medium
      0x2: High
      0x3: Very high
    3. A 32bit mask specifying the DMA channel configuration
      -bit 0-1: Source increment mode
        0x0: Source address pointer is fixed
        0x2: Source address pointer is incremented after each data transfer
        0x3: Source address pointer is decremented after each data transfer
      -bit 2-3: Destination increment mode
        0x0: Destination address pointer is fixed
        0x2: Destination address pointer is incremented after each data transfer
        0x3: Destination address pointer is decremented after each data transfer
      -bit 8-9: Source increment offset size
        0x0: byte (8bit)
        0x1: half-word (16bit)
        0x2: word (32bit)
        0x3: double-word (64bit)
      -bit 10-11: Destination increment offset size
        0x0: byte (8bit)
        0x1: half-word (16bit)
        0x2: word (32bit)
        0x3: double-word (64bit)
      -bit 25-18: The number of bytes to be transferred in a single transfer
                  (min = 1 byte, max = 128 bytes)
      -bit 29:28: Trigger Mode
        0x00: Each MDMA request triggers a buffer transfer (max 128 bytes)
        0x1: Each MDMA request triggers a block transfer (max 64K bytes)
        0x2: Each MDMA request triggers a repeated block transfer
        0x3: Each MDMA request triggers a linked list transfer
    4. A 32bit value specifying the register to be used to acknowledge the request
       if no HW ack signal is used by the MDMA client
    5. A 32bit mask specifying the value to be written to acknowledge the request
       if no HW ack signal is used by the MDMA client

maintainers:
  - Amelie Delaunay <amelie.delaunay@st.com>

allOf:
  - $ref: "dma-controller.yaml#"

properties:
  "#dma-cells":
    const: 5

  compatible:
    const: st,stm32h7-mdma

  reg:
    maxItems: 1

  clocks:
    maxItems: 1

  interrupts:
    maxItems: 1

  resets:
    maxItems: 1

  st,ahb-addr-masks:
    $ref: /schemas/types.yaml#/definitions/uint32-array
    description: Array of u32 mask to list memory devices addressed via AHB bus.

required:
  - compatible
  - reg
  - clocks
  - interrupts

unevaluatedProperties: false

examples:
  - |
    #include <dt-bindings/interrupt-controller/arm-gic.h>
    #include <dt-bindings/clock/stm32mp1-clks.h>
    #include <dt-bindings/reset/stm32mp1-resets.h>
    dma-controller@52000000 {
      compatible = "st,stm32h7-mdma";
      reg = <0x52000000 0x1000>;
      interrupts = <122>;
      clocks = <&timer_clk>;
      resets = <&rcc 992>;
      #dma-cells = <5>;
      dma-channels = <16>;
      dma-requests = <32>;
      st,ahb-addr-masks = <0x20000000>, <0x00000000>;
    };

...
```

## Documentation/devicetree/bindings/dma/st_fdma.txt
```
* STMicroelectronics Flexible Direct Memory Access Device Tree bindings

The FDMA is a general-purpose direct memory access controller capable of
supporting 16 independent DMA channels. It accepts up to 32 DMA requests.
The FDMA is based on a Slim processor which requires a firmware.

* FDMA Controller

Required properties:
- compatible	: Should be one of
		 - st,stih407-fdma-mpe31-11, "st,slim-rproc";
		 - st,stih407-fdma-mpe31-12, "st,slim-rproc";
		 - st,stih407-fdma-mpe31-13, "st,slim-rproc";
- reg		: Should contain an entry for each name in reg-names
- reg-names	: Must contain "slimcore", "dmem", "peripherals", "imem" entries
- interrupts	: Should contain one interrupt shared by all channels
- dma-channels	: Number of channels supported by the controller
- #dma-cells	: Must be <3>. See DMA client section below
- clocks	: Must contain an entry for each clock
See: Documentation/devicetree/bindings/clock/clock-bindings.txt


Example:

	fdma0: dma-controller@8e20000 {
		compatible = "st,stih407-fdma-mpe31-11", "st,slim-rproc";
		reg = <0x8e20000 0x8000>,
		      <0x8e30000 0x3000>,
		      <0x8e37000 0x1000>,
		      <0x8e38000 0x8000>;
		reg-names = "slimcore", "dmem", "peripherals", "imem";
		clocks = <&clk_s_c0_flexgen CLK_FDMA>,
			 <&clk_s_c0_flexgen CLK_EXT2F_A9>,
			 <&clk_s_c0_flexgen CLK_EXT2F_A9>,
			 <&clk_s_c0_flexgen CLK_EXT2F_A9>;
		interrupts = <GIC_SPI 5 IRQ_TYPE_NONE>;
		dma-channels = <16>;
		#dma-cells = <3>;
	};

* DMA client

Required properties:
- dmas: Comma separated list of dma channel requests
- dma-names: Names of the aforementioned requested channels

Each dmas request consists of 4 cells:
1. A phandle pointing to the FDMA controller
2. The request line number
3. A 32bit mask specifying (see include/linux/platform_data/dma-st-fdma.h)
 -bit 2-0: Holdoff value, dreq will be masked for
	0x0: 0-0.5us
	0x1: 0.5-1us
	0x2: 1-1.5us
 -bit 17: data swap
	0x0: disabled
	0x1: enabled
 -bit 21: Increment Address
	0x0: no address increment between transfers
	0x1: increment address between transfers
 -bit 22: 2 STBus Initiator Coprocessor interface
	0x0: high priority port
	0x1: low priority port
4. transfers type
 0 free running
 1 paced

Example:

	sti_uni_player2: sti-uni-player@2 {
		compatible = "st,sti-uni-player";
		#sound-dai-cells = <0>;
		st,syscfg = <&syscfg_core>;
		clocks = <&clk_s_d0_flexgen CLK_PCM_2>;
		assigned-clocks = <&clk_s_d0_flexgen CLK_PCM_2>;
		assigned-clock-parents = <&clk_s_d0_quadfs 2>;
		assigned-clock-rates = <50000000>;
		reg = <0x8D82000 0x158>;
		interrupts = <GIC_SPI 86 IRQ_TYPE_NONE>;
		dmas = <&fdma0 4 0 1>;
		dai-name = "Uni Player #1 (DAC)";
		dma-names = "tx";
		st,uniperiph-id = <2>;
		st,version = <5>;
		st,mode = "PCM";
	};
```

## Documentation/devicetree/bindings/dma/starfive-pl080.yaml
```yaml
# SPDX-License-Identifier: (GPL-2.0-only OR BSD-2-Clause)
%YAML 1.2
---
$id: http://devicetree.org/schemas/crypto/starfive-sec.yaml#
$schema: http://devicetree.org/meta-schemas/core.yaml#

title: Starfive SEC controller Device Tree Bindings

properties:
    compatible:
        const: starfive,jh7110-pl080

    reg:
        minItem: 1

    reg-names:
        maxItem: 1
        const: sec_dma

    interrupts:
        minItem: 1

    clocks:
        minItem: 1
        items:
            -description:sec_hclk clock
            -description:sec_ahb clock

    clock-names:
        minItem: 1
        items:
            -const:sec_hclk
            -const:sec_ahb

    resets:
        minItem: 1
        items:
            -description:sec_hre reset

    reset-names:
        minItem: 1
        items:
            -const:sec_hre

required:
    - compatible
    - reg
    - reg-names
    - interrupts
    - clocks
    - clock-names
    - resets
    - reset-names

additionalProperties:false

examples:
    - |
        sec_dma: sec_dma@16008000 {
			compatible = "starfive,pl080", "arm,pl080";
			reg = <0x0 0x16008000 0x0 0x4000>;
			reg-names = "sec_dma";
			interrupts = <29>;
			clocks = <&clkgen JH7110_SEC_HCLK>,
				 <&clkgen JH7110_SEC_MISCAHB_CLK>;
			clock-names = "sec_hclk","sec_ahb";
			resets = <&rstgen RSTN_U0_SEC_TOP_HRESETN>;
			reset-names = "sec_hre";
			lli-bus-interface-ahb1;
			mem-bus-interface-ahb1;
			memcpy-burst-size = <256>;
			memcpy-bus-width = <32>;
			#dma-cells = <2>;
			status = "disabled";
		};
```

## Documentation/devicetree/bindings/dma/ste-coh901318.txt
```
ST-Ericsson COH 901 318 DMA Controller

This is a DMA controller which has begun as a fork of the
ARM PL08x PrimeCell VHDL code.

Required properties:
- compatible: should be "stericsson,coh901318"
- reg: register locations and length
- interrupts: the single DMA IRQ
- #dma-cells: must be set to <1>, as the channels on the
  COH 901 318 are simple and identified by a single number
- dma-channels: the number of DMA channels handled

Example:

dmac: dma-controller@c00020000 {
	compatible = "stericsson,coh901318";
	reg = <0xc0020000 0x1000>;
	interrupt-parent = <&vica>;
	interrupts = <2>;
	#dma-cells = <1>;
	dma-channels = <40>;
};

Consumers example:

uart0: serial@c0013000 {
	compatible = "...";
	(...)
	dmas = <&dmac 17 &dmac 18>;
	dma-names = "tx", "rx";
};
```

## Documentation/devicetree/bindings/dma/ste-dma40.txt
```
* DMA40 DMA Controller

Required properties:
- compatible: "stericsson,dma40"
- reg: Address range of the DMAC registers
- reg-names: Names of the above areas to use during resource look-up
- interrupt: Should contain the DMAC interrupt number
- #dma-cells: must be <3>
- memcpy-channels: Channels to be used for memcpy

Optional properties:
- dma-channels: Number of channels supported by hardware - if not present
		the driver will attempt to obtain the information from H/W
- disabled-channels: Channels which can not be used

Example:

	dma: dma-controller@801C0000 {
		compatible = "stericsson,db8500-dma40", "stericsson,dma40";
		reg = <0x801C0000 0x1000  0x40010000 0x800>;
		reg-names = "base", "lcpa";
		interrupt-parent = <&intc>;
		interrupts = <0 25 0x4>;

		#dma-cells = <2>;
		memcpy-channels  = <56 57 58 59 60>;
		disabled-channels  = <12>;
		dma-channels = <8>;
	};

Clients
Required properties:
- dmas: Comma separated list of dma channel requests
- dma-names: Names of the aforementioned requested channels

Each dmas request consists of 4 cells:
  1. A phandle pointing to the DMA controller
  2. Device signal number, the signal line for single and burst requests
     connected from the device to the DMA40 engine
  3. The DMA request line number (only when 'use fixed channel' is set)
  4. A 32bit mask specifying; mode, direction and endianness
     [NB: This list will grow]
        0x00000001: Mode:
                Logical channel when unset
                Physical channel when set
        0x00000002: Direction:
                Memory to Device when unset
                Device to Memory when set
        0x00000004: Endianness:
                Little endian when unset
                Big endian when set
        0x00000008: Use fixed channel:
                Use automatic channel selection when unset
                Use DMA request line number when set
        0x00000010: Set channel as high priority:
                Normal priority when unset
                High priority when set

Existing signal numbers for the DB8500 ASIC. Unless specified, the signals are
bidirectional, i.e. the same for RX and TX operations:

0:  SPI controller 0
1:  SD/MMC controller 0 (unused)
2:  SD/MMC controller 1 (unused)
3:  SD/MMC controller 2 (unused)
4:  I2C port 1
5:  I2C port 3
6:  I2C port 2
7:  I2C port 4
8:  Synchronous Serial Port SSP0
9:  Synchronous Serial Port SSP1
10: Multi-Channel Display Engine MCDE RX
11: UART port 2
12: UART port 1
13: UART port 0
14: Multirate Serial Port MSP2
15: I2C port 0
16: USB OTG in/out endpoints 7 & 15
17: USB OTG in/out endpoints 6 & 14
18: USB OTG in/out endpoints 5 & 13
19: USB OTG in/out endpoints 4 & 12
20: SLIMbus or HSI channel 0
21: SLIMbus or HSI channel 1
22: SLIMbus or HSI channel 2
23: SLIMbus or HSI channel 3
24: Multimedia DSP SXA0
25: Multimedia DSP SXA1
26: Multimedia DSP SXA2
27: Multimedia DSP SXA3
28: SD/MM controller 2
29: SD/MM controller 0
30: MSP port 1 on DB8500 v1, MSP port 3 on DB8500 v2
31: MSP port 0 or SLIMbus channel 0
32: SD/MM controller 1
33: SPI controller 2
34: i2c3 RX2 TX2
35: SPI controller 1
36: USB OTG in/out endpoints 3 & 11
37: USB OTG in/out endpoints 2 & 10
38: USB OTG in/out endpoints 1 & 9
39: USB OTG in/out endpoints 8
40: SPI controller 3
41: SD/MM controller 3
42: SD/MM controller 4
43: SD/MM controller 5
44: Multimedia DSP SXA4
45: Multimedia DSP SXA5
46: SLIMbus channel 8 or Multimedia DSP SXA6
47: SLIMbus channel 9 or Multimedia DSP SXA7
48: Crypto Accelerator 1
49: Crypto Accelerator 1 TX or Hash Accelerator 1 TX
50: Hash Accelerator 1 TX
51: memcpy TX (to be used by the DMA driver for memcpy operations)
52: SLIMbus or HSI channel 4
53: SLIMbus or HSI channel 5
54: SLIMbus or HSI channel 6
55: SLIMbus or HSI channel 7
56: memcpy (to be used by the DMA driver for memcpy operations)
57: memcpy (to be used by the DMA driver for memcpy operations)
58: memcpy (to be used by the DMA driver for memcpy operations)
59: memcpy (to be used by the DMA driver for memcpy operations)
60: memcpy (to be used by the DMA driver for memcpy operations)
61: Crypto Accelerator 0
62: Crypto Accelerator 0 TX or Hash Accelerator 0 TX
63: Hash Accelerator 0 TX

Example:

	uart@80120000 {
		compatible = "arm,pl011", "arm,primecell";
		reg = <0x80120000 0x1000>;
		interrupts = <0 11 0x4>;

		dmas = <&dma 13 0 0x2>, /* Logical - DevToMem */
		       <&dma 13 0 0x0>; /* Logical - MemToDev */
		dma-names = "rx", "rx";

		status = "disabled";
	};
```
