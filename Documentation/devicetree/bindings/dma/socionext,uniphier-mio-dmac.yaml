## Documentation/devicetree/bindings/dma/stericsson,dma40.yaml
```yaml
# SPDX-License-Identifier: (GPL-2.0 OR BSD-2-Clause)
%YAML 1.2
---
$id: http://devicetree.org/schemas/dma/stericsson,dma40.yaml#
$schema: http://devicetree.org/meta-schemas/core.yaml#

title: ST-Ericsson DMA40 DMA Engine

maintainers:
  - Linus Walleij <linus.walleij@linaro.org>

allOf:
  - $ref: dma-controller.yaml#

properties:
  "#dma-cells":
    const: 3
    description: |
      The first cell is the unique device channel number as indicated by this
      table for DB8500 which is the only ASIC known to use DMA40:

      0:  SPI controller 0
      1:  SD/MMC controller 0 (unused)
      2:  SD/MMC controller 1 (unused)
      3:  SD/MMC controller 2 (unused)
      4:  I2C port 1
      5:  I2C port 3
      6:  I2C port 2
      7:  I2C port 4
      8:  Synchronous Serial Port SSP0
      9:  Synchronous Serial Port SSP1
      10: Multi-Channel Display Engine MCDE RX
      11: UART port 2
      12: UART port 1
      13: UART port 0
      14: Multirate Serial Port MSP2
      15: I2C port 0
      16: USB OTG in/out endpoints 7 & 15
      17: USB OTG in/out endpoints 6 & 14
      18: USB OTG in/out endpoints 5 & 13
      19: USB OTG in/out endpoints 4 & 12
      20: SLIMbus or HSI channel 0
      21: SLIMbus or HSI channel 1
      22: SLIMbus or HSI channel 2
      23: SLIMbus or HSI channel 3
      24: Multimedia DSP SXA0
      25: Multimedia DSP SXA1
      26: Multimedia DSP SXA2
      27: Multimedia DSP SXA3
      28: SD/MMC controller 2
      29: SD/MMC controller 0
      30: MSP port 1 on DB8500 v1, MSP port 3 on DB8500 v2
      31: MSP port 0 or SLIMbus channel 0
      32: SD/MMC controller 1
      33: SPI controller 2
      34: i2c3 RX2 TX2
      35: SPI controller 1
      36: USB OTG in/out endpoints 3 & 11
      37: USB OTG in/out endpoints 2 & 10
      38: USB OTG in/out endpoints 1 & 9
      39: USB OTG in/out endpoints 8
      40: SPI controller 3
      41: SD/MMC controller 3
      42: SD/MMC controller 4
      43: SD/MMC controller 5
      44: Multimedia DSP SXA4
      45: Multimedia DSP SXA5
      46: SLIMbus channel 8 or Multimedia DSP SXA6
      47: SLIMbus channel 9 or Multimedia DSP SXA7
      48: Crypto Accelerator 1
      49: Crypto Accelerator 1 TX or Hash Accelerator 1 TX
      50: Hash Accelerator 1 TX
      51: memcpy TX (to be used by the DMA driver for memcpy operations)
      52: SLIMbus or HSI channel 4
      53: SLIMbus or HSI channel 5
      54: SLIMbus or HSI channel 6
      55: SLIMbus or HSI channel 7
      56: memcpy (to be used by the DMA driver for memcpy operations)
      57: memcpy (to be used by the DMA driver for memcpy operations)
      58: memcpy (to be used by the DMA driver for memcpy operations)
      59: memcpy (to be used by the DMA driver for memcpy operations)
      60: memcpy (to be used by the DMA driver for memcpy operations)
      61: Crypto Accelerator 0
      62: Crypto Accelerator 0 TX or Hash Accelerator 0 TX
      63: Hash Accelerator 0 TX

      The second cell is the DMA request line number. This is only used when
      a fixed channel is allocated, and indicated by setting bit 3 in the
      flags field (see below).

      The third cell is a 32bit flags bitfield with the following possible
      bits set:
      0x00000001 (bit 0) - mode:
        Logical channel when unset
        Physical channel when set
      0x00000002 (bit 1) - direction:
        Memory to Device when unset
        Device to Memory when set
      0x00000004 (bit 2) - endianness:
        Little endian when unset
        Big endian when set
      0x00000008 (bit 3) - use fixed channel:
        Use automatic channel selection when unset
        Use DMA request line number when set
      0x00000010 (bit 4) - set channel as high priority:
        Normal priority when unset
        High priority when set

  compatible:
    items:
      - const: stericsson,db8500-dma40
      - const: stericsson,dma40

  reg:
    oneOf:
      - items:
          - description: DMA40 memory base
      - items:
          - description: DMA40 memory base
          - description: LCPA memory base, deprecated, use eSRAM pool instead
        deprecated: true


  reg-names:
    oneOf:
      - items:
          - const: base
      - items:
          - const: base
          - const: lcpa
        deprecated: true

  interrupts:
    maxItems: 1

  clocks:
    maxItems: 1

  sram:
    $ref: /schemas/types.yaml#/definitions/phandle-array
    description: A phandle array with inner size 1 (no arg cells).
      First phandle is the LCPA (Logical Channel Parameter Address) memory.
      Second phandle is the  LCLA (Logical Channel Link base Address) memory.
    maxItems: 2
    items:
      maxItems: 1

  memcpy-channels:
    $ref: /schemas/types.yaml#/definitions/uint32-array
    description: Array of u32 elements indicating which channels on the DMA
      engine are eligible for memcpy transfers

required:
  - "#dma-cells"
  - compatible
  - reg
  - interrupts
  - clocks
  - sram
  - memcpy-channels

additionalProperties: false

examples:
  - |
    #include <dt-bindings/interrupt-controller/irq.h>
    #include <dt-bindings/interrupt-controller/arm-gic.h>
    #include <dt-bindings/mfd/dbx500-prcmu.h>
    dma-controller@801c0000 {
        compatible = "stericsson,db8500-dma40", "stericsson,dma40";
        reg = <0x801c0000 0x1000>;
        reg-names = "base";
        sram = <&lcpa>, <&lcla>;
        interrupts = <GIC_SPI 25 IRQ_TYPE_LEVEL_HIGH>;
        #dma-cells = <3>;
        memcpy-channels = <56 57 58 59 60>;
        clocks = <&prcmu_clk PRCMU_DMACLK>;
    };
...
```

## Documentation/devicetree/bindings/dma/stm32-dma.txt
```
* STMicroelectronics STM32 DMA controller

The STM32 DMA is a general-purpose direct memory access controller capable of
supporting 8 independent DMA channels. Each channel can have up to 8 requests.

Required properties:
- compatible: Should be "st,stm32-dma"
- reg: Should contain DMA registers location and length. This should include
  all of the per-channel registers.
- interrupts: Should contain all of the per-channel DMA interrupts in
  ascending order with respect to the DMA channel index.
- clocks: Should contain the input clock of the DMA instance.
- #dma-cells : Must be <4>. See DMA client paragraph for more details.

Optional properties:
- resets: Reference to a reset controller asserting the DMA controller
- st,mem2mem: boolean; if defined, it indicates that the controller supports
  memory-to-memory transfer

Example:

	dma2: dma-controller@40026400 {
		compatible = "st,stm32-dma";
		reg = <0x40026400 0x400>;
		interrupts = <56>,
			     <57>,
			     <58>,
			     <59>,
			     <60>,
			     <68>,
			     <69>,
			     <70>;
		clocks = <&clk_hclk>;
		#dma-cells = <4>;
		st,mem2mem;
		resets = <&rcc 150>;
	};

* DMA client

DMA clients connected to the STM32 DMA controller must use the format
described in the dma.txt file, using a five-cell specifier for each
channel: a phandle plus four integer cells.
The four cells in order are:

1. The channel id
2. The request line number
3. A 32bit mask specifying the DMA channel configuration which are device
   dependent:
  -bit 9: Peripheral Increment Address
	0x0: no address increment between transfers
	0x1: increment address between transfers
 -bit 10: Memory Increment Address
	0x0: no address increment between transfers
	0x1: increment address between transfers
 -bit 15: Peripheral Increment Offset Size
	0x0: offset size is linked to the peripheral bus width
	0x1: offset size is fixed to 4 (32-bit alignment)
 -bit 16-17: Priority level
	0x0: low
	0x1: medium
	0x2: high
	0x3: very high
5. A 32bit mask specifying the DMA FIFO threshold configuration which are device
   dependent:
 -bit 0-1: Fifo threshold
	0x0: 1/4 full FIFO
	0x1: 1/2 full FIFO
	0x2: 3/4 full FIFO
	0x3: full FIFO

Example:

	usart1: serial@40011000 {
		compatible = "st,stm32-usart", "st,stm32-uart";
		reg = <0x40011000 0x400>;
		interrupts = <37>;
		clocks = <&clk_pclk2>;
		dmas = <&dma2 2 4 0x10400 0x3>,
		       <&dma2 7 5 0x10200 0x3>;
		dma-names = "rx", "tx";
	};
```

## Documentation/devicetree/bindings/dma/stm32-dmamux.txt
```
STM32 DMA MUX (DMA request router)

Required properties:
- compatible:	"st,stm32h7-dmamux"
- reg:		Memory map for accessing module
- #dma-cells:	Should be set to <3>.
		First parameter is request line number.
		Second is DMA channel configuration
		Third is Fifo threshold
		For more details about the three cells, please see
		stm32-dma.txt documentation binding file
- dma-masters:	Phandle pointing to the DMA controllers.
		Several controllers are allowed. Only "st,stm32-dma" DMA
		compatible are supported.

Optional properties:
- dma-channels : Number of DMA requests supported.
- dma-requests : Number of DMAMUX requests supported.
- resets: Reference to a reset controller asserting the DMA controller
- clocks: Input clock of the DMAMUX instance.

Example:

/* DMA controller 1 */
dma1: dma-controller@40020000 {
	compatible = "st,stm32-dma";
	reg = <0x40020000 0x400>;
	interrupts = <11>,
		     <12>,
		     <13>,
		     <14>,
		     <15>,
		     <16>,
		     <17>,
		     <47>;
	clocks = <&timer_clk>;
	#dma-cells = <4>;
	st,mem2mem;
	resets = <&rcc 150>;
	dma-channels = <8>;
	dma-requests = <8>;
};

/* DMA controller 1 */
dma2: dma@40020400 {
	compatible = "st,stm32-dma";
	reg = <0x40020400 0x400>;
	interrupts = <56>,
		     <57>,
		     <58>,
		     <59>,
		     <60>,
		     <68>,
		     <69>,
		     <70>;
	clocks = <&timer_clk>;
	#dma-cells = <4>;
	st,mem2mem;
	resets = <&rcc 150>;
	dma-channels = <8>;
	dma-requests = <8>;
};

/* DMA mux */
dmamux1: dma-router@40020800 {
	compatible = "st,stm32h7-dmamux";
	reg = <0x40020800 0x3c>;
	#dma-cells = <3>;
	dma-requests = <128>;
	dma-channels = <16>;
	dma-masters = <&dma1 &dma2>;
	clocks = <&timer_clk>;
};

/* DMA client */
usart1: serial@40011000 {
	compatible = "st,stm32-usart", "st,stm32-uart";
	reg = <0x40011000 0x400>;
	interrupts = <37>;
	clocks = <&timer_clk>;
	dmas = <&dmamux1 41 0x414 0>,
	       <&dmamux1 42 0x414 0>;
	dma-names = "rx", "tx";
};
```

## Documentation/devicetree/bindings/dma/stm32-mdma.txt
```
* STMicroelectronics STM32 MDMA controller

The STM32 MDMA is a general-purpose direct memory access controller capable of
supporting 64 independent DMA channels with 256 HW requests.

Required properties:
- compatible: Should be "st,stm32h7-mdma"
- reg: Should contain MDMA registers location and length. This should include
  all of the per-channel registers.
- interrupts: Should contain the MDMA interrupt.
- clocks: Should contain the input clock of the DMA instance.
- resets: Reference to a reset controller asserting the DMA controller.
- #dma-cells : Must be <5>. See DMA client paragraph for more details.

Optional properties:
- dma-channels: Number of DMA channels supported by the controller.
- dma-requests: Number of DMA request signals supported by the controller.
- st,ahb-addr-masks: Array of u32 mask to list memory devices addressed via
  AHB bus.

Example:

	mdma1: dma@52000000 {
		compatible = "st,stm32h7-mdma";
		reg = <0x52000000 0x1000>;
		interrupts = <122>;
		clocks = <&timer_clk>;
		resets = <&rcc 992>;
		#dma-cells = <5>;
		dma-channels = <16>;
		dma-requests = <32>;
		st,ahb-addr-masks = <0x20000000>, <0x00000000>;
	};

* DMA client

DMA clients connected to the STM32 MDMA controller must use the format
described in the dma.txt file, using a five-cell specifier for each channel:
a phandle to the MDMA controller plus the following five integer cells:

1. The request line number
2. The priority level
	0x00: Low
	0x01: Medium
	0x10: High
	0x11: Very high
3. A 32bit mask specifying the DMA channel configuration
 -bit 0-1: Source increment mode
	0x00: Source address pointer is fixed
	0x10: Source address pointer is incremented after each data transfer
	0x11: Source address pointer is decremented after each data transfer
 -bit 2-3: Destination increment mode
	0x00: Destination address pointer is fixed
	0x10: Destination address pointer is incremented after each data
	transfer
	0x11: Destination address pointer is decremented after each data
	transfer
 -bit 8-9: Source increment offset size
	0x00: byte (8bit)
	0x01: half-word (16bit)
	0x10: word (32bit)
	0x11: double-word (64bit)
 -bit 10-11: Destination increment offset size
	0x00: byte (8bit)
	0x01: half-word (16bit)
	0x10: word (32bit)
	0x11: double-word (64bit)
-bit 25-18: The number of bytes to be transferred in a single transfer
	(min = 1 byte, max = 128 bytes)
-bit 29:28: Trigger Mode
	0x00: Each MDMA request triggers a buffer transfer (max 128 bytes)
	0x01: Each MDMA request triggers a block transfer (max 64K bytes)
	0x10: Each MDMA request triggers a repeated block transfer
	0x11: Each MDMA request triggers a linked list transfer
4. A 32bit value specifying the register to be used to acknowledge the request
   if no HW ack signal is used by the MDMA client
5. A 32bit mask specifying the value to be written to acknowledge the request
   if no HW ack signal is used by the MDMA client

Example:

	i2c4: i2c@5c002000 {
		compatible = "st,stm32f7-i2c";
		reg = <0x5c002000 0x400>;
		interrupts = <95>,
			     <96>;
		clocks = <&timer_clk>;
		#address-cells = <1>;
		#size-cells = <0>;
		dmas = <&mdma1 36 0x0 0x40008 0x0 0x0>,
		       <&mdma1 37 0x0 0x40002 0x0 0x0>;
		dma-names = "rx", "tx";
		status = "disabled";
	};
```
