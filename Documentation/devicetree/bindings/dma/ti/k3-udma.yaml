## Documentation/devicetree/bindings/drm/exynos/mixer.txt
```
Device-Tree bindings for mixer driver

Required properties:
- compatible: value should be "samsung,exynos5-mixer".
- reg: physical base address of the mixer and length of memory mapped
	region.
- interrupts: interrupt number to the cpu.

Example:

	mixer {
		compatible = "samsung,exynos5-mixer";
		reg = <0x14450000 0x10000>;
		interrupts = <0 94 0>;
	};
```

## Documentation/devicetree/bindings/drm/i2c/tda998x.txt
```
Device-Tree bindings for the NXP TDA998x HDMI transmitter

Required properties;
  - compatible: must be "nxp,tda998x"

  - reg: I2C address

Optional properties:
  - interrupts: interrupt number and trigger type
	default: polling

  - pinctrl-0: pin control group to be used for
	screen plug/unplug interrupt.

  - pinctrl-names: must contain a "default" entry.

  - video-ports: 24 bits value which defines how the video controller
	output is wired to the TDA998x input - default: <0x230145>

Example:

	tda998x: hdmi-encoder {
		compatible = "nxp,tda998x";
		reg = <0x70>;
		interrupt-parent = <&gpio0>;
		interrupts = <27 2>;		/* falling edge */
		pinctrl-0 = <&pmx_camera>;
		pinctrl-names = "default";
	};
```

## Documentation/devicetree/bindings/drm/imx/hdmi.txt
```
Device-Tree bindings for HDMI Transmitter

HDMI Transmitter
================

The HDMI Transmitter is a Synopsys DesignWare HDMI 1.4 TX controller IP
with accompanying PHY IP.

Required properties:
 - #address-cells : should be <1>
 - #size-cells : should be <0>
 - compatible : should be "fsl,imx6q-hdmi" or "fsl,imx6dl-hdmi".
 - gpr : should be <&gpr>.
   The phandle points to the iomuxc-gpr region containing the HDMI
   multiplexer control register.
 - clocks, clock-names : phandles to the HDMI iahb and isrf clocks, as described
   in Documentation/devicetree/bindings/clock/clock-bindings.txt and
   Documentation/devicetree/bindings/clock/imx6q-clock.txt.
 - port@[0-4]: Up to four port nodes with endpoint definitions as defined in
   Documentation/devicetree/bindings/media/video-interfaces.txt,
   corresponding to the four inputs to the HDMI multiplexer.

Optional properties:
 - ddc-i2c-bus: phandle of an I2C controller used for DDC EDID probing

example:

	gpr: iomuxc-gpr@020e0000 {
		/* ... */
	};

        hdmi: hdmi@0120000 {
                #address-cells = <1>;
                #size-cells = <0>;
                compatible = "fsl,imx6q-hdmi";
                reg = <0x00120000 0x9000>;
                interrupts = <0 115 0x04>;
                gpr = <&gpr>;
                clocks = <&clks 123>, <&clks 124>;
                clock-names = "iahb", "isfr";
                ddc-i2c-bus = <&i2c2>;

                port@0 {
                        reg = <0>;

                        hdmi_mux_0: endpoint {
                                remote-endpoint = <&ipu1_di0_hdmi>;
                        };
                };

                port@1 {
                        reg = <1>;

                        hdmi_mux_1: endpoint {
                                remote-endpoint = <&ipu1_di1_hdmi>;
                        };
                };
        };
```

## Documentation/devicetree/bindings/drm/msm/dsi.txt
```
Qualcomm Technologies Inc. adreno/snapdragon DSI output

Required properties:
- compatible:
  * "qcom,mdss-dsi-ctrl"
- reg: Physical base address and length of the registers of controller, PLL,
  PHY and PHY regulator
- reg-names: The names of register regions. The following regions are required:
  * "dsi_ctrl"
  * "dsi_pll"
  * "dsi_phy"
  * "dsi_phy_regulator"
- qcom,dsi-host-index: The ID of DSI controller hardware instance. This should
  be 0 or 1, since we have 2 DSI controllers at most for now.
- interrupts: The interrupt signal from the DSI block.
- power-domains: Should be <&mmcc MDSS_GDSC>.
- clocks: device clocks
  See Documentation/devicetree/bindings/clocks/clock-bindings.txt for details.
- clock-names: the following clocks are required:
  * "bus_clk"
  * "byte_clk"
  * "core_clk"
  * "core_mmss_clk"
  * "iface_clk"
  * "mdp_core_clk"
  * "pixel_clk"
- #clock-cells: The value should be 1.
- vdd-supply: phandle to vdd regulator device node
- vddio-supply: phandle to vdd-io regulator device node
- vdda-supply: phandle to vdda regulator device node

Optional properties:
- panel@0: Node of panel connected to this DSI controller.
  See files in Documentation/devicetree/bindings/panel/ for each supported
  panel.
- qcom,dual-panel-mode: Boolean value indicating if the DSI controller is
  driving a panel which needs 2 DSI links.
- qcom,master-panel: Boolean value indicating if the DSI controller is driving
  the master link of the 2-DSI panel.
- qcom,sync-dual-panel: Boolean value indicating if the DSI controller is
  driving a 2-DSI panel whose 2 links need receive command simultaneously.
- interrupt-parent: phandle to the MDP block if the interrupt signal is routed
  through MDP block

Example:
	mdss_dsi0: qcom,mdss_dsi@fd922800 {
		compatible = "qcom,mdss-dsi-ctrl";
		qcom,dsi-host-index = <0>;
		interrupt-parent = <&mdss_mdp>;
		interrupts = <4 0>;
		reg-names =
			"dsi_ctrl",
			"dsi_pll",
			"dsi_phy",
			"dsi_phy_regulator",
		reg =	<0xfd922800 0x200>,
			<0xfd922a00 0xd4>,
			<0xfd922b00 0x2b0>,
			<0xfd922d80 0x7b>,
			<0xfd828000 0x108>;
		power-domains = <&mmcc MDSS_GDSC>;
		clock-names =
			"bus_clk",
			"byte_clk",
			"core_clk",
			"core_mmss_clk",
			"iface_clk",
			"mdp_core_clk",
			"pixel_clk";
		clocks =
			<&mmcc MDSS_AXI_CLK>,
			<&mmcc MDSS_BYTE0_CLK>,
			<&mmcc MDSS_ESC0_CLK>,
			<&mmcc MMSS_MISC_AHB_CLK>,
			<&mmcc MDSS_AHB_CLK>,
			<&mmcc MDSS_MDP_CLK>,
			<&mmcc MDSS_PCLK0_CLK>;
		#clock-cells = <1>;
		vdda-supply = <&pma8084_l2>;
		vdd-supply = <&pma8084_l22>;
		vddio-supply = <&pma8084_l12>;

		qcom,dual-panel-mode;
		qcom,master-panel;
		qcom,sync-dual-panel;

		panel: panel@0 {
			compatible = "sharp,lq101r1sx01";
			reg = <0>;
			link2 = <&secondary>;

			power-supply = <...>;
			backlight = <...>;
		};
	};
```

## Documentation/devicetree/bindings/drm/msm/hdmi.txt
```
Qualcomm adreno/snapdragon hdmi output

Required properties:
- compatible: one of the following
   * "qcom,hdmi-tx-8084"
   * "qcom,hdmi-tx-8074"
   * "qcom,hdmi-tx-8660"
   * "qcom,hdmi-tx-8960"
- reg: Physical base address and length of the controller's registers
- reg-names: "core_physical"
- interrupts: The interrupt signal from the hdmi block.
- clocks: device clocks
  See ../clocks/clock-bindings.txt for details.
- qcom,hdmi-tx-ddc-clk-gpio: ddc clk pin
- qcom,hdmi-tx-ddc-data-gpio: ddc data pin
- qcom,hdmi-tx-hpd-gpio: hpd pin
- core-vdda-supply: phandle to supply regulator
- hdmi-mux-supply: phandle to mux regulator

Optional properties:
- qcom,hdmi-tx-mux-en-gpio: hdmi mux enable pin
- qcom,hdmi-tx-mux-sel-gpio: hdmi mux select pin

Example:

/ {
	...

	hdmi: qcom,hdmi-tx-8960@4a00000 {
		compatible = "qcom,hdmi-tx-8960";
		reg-names = "core_physical";
		reg = <0x04a00000 0x1000>;
		interrupts = <GIC_SPI 79 0>;
		clock-names =
		    "core_clk",
		    "master_iface_clk",
		    "slave_iface_clk";
		clocks =
		    <&mmcc HDMI_APP_CLK>,
		    <&mmcc HDMI_M_AHB_CLK>,
		    <&mmcc HDMI_S_AHB_CLK>;
		qcom,hdmi-tx-ddc-clk = <&msmgpio 70 GPIO_ACTIVE_HIGH>;
		qcom,hdmi-tx-ddc-data = <&msmgpio 71 GPIO_ACTIVE_HIGH>;
		qcom,hdmi-tx-hpd = <&msmgpio 72 GPIO_ACTIVE_HIGH>;
		core-vdda-supply = <&pm8921_hdmi_mvs>;
		hdmi-mux-supply = <&ext_3p3v>;
	};
};
```

## Documentation/devicetree/bindings/drm/msm/mdp.txt
```
Qualcomm adreno/snapdragon display controller

Required properties:
- compatible:
  * "qcom,mdp" - mdp4
- reg: Physical base address and length of the controller's registers.
- interrupts: The interrupt signal from the display controller.
- connectors: array of phandles for output device(s)
- clocks: device clocks
  See ../clocks/clock-bindings.txt for details.
- clock-names: the following clocks are required:
  * "core_clk"
  * "iface_clk"
  * "lut_clk"
  * "src_clk"
  * "hdmi_clk"
  * "mpd_clk"

Optional properties:
- gpus: phandle for gpu device

Example:

/ {
	...

	mdp: qcom,mdp@5100000 {
		compatible = "qcom,mdp";
		reg = <0x05100000 0xf0000>;
		interrupts = <GIC_SPI 75 0>;
		connectors = <&hdmi>;
		gpus = <&gpu>;
		clock-names =
		    "core_clk",
		    "iface_clk",
		    "lut_clk",
		    "src_clk",
		    "hdmi_clk",
		    "mdp_clk";
		clocks =
		    <&mmcc MDP_SRC>,
		    <&mmcc MDP_AHB_CLK>,
		    <&mmcc MDP_LUT_CLK>,
		    <&mmcc TV_SRC>,
		    <&mmcc HDMI_TV_CLK>,
		    <&mmcc MDP_TV_CLK>;
	};
};
```

## Documentation/devicetree/bindings/drm/tilcdc/slave.txt
```
Device-Tree bindings for tilcdc DRM encoder slave output driver

Required properties:
 - compatible: value should be "ti,tilcdc,slave".
 - i2c: the phandle for the i2c device the encoder slave is connected to

Recommended properties:
 - pinctrl-names, pinctrl-0: the pincontrol settings to configure
   muxing properly for pins that connect to TFP410 device

Example:

	hdmi {
		compatible = "ti,tilcdc,slave";
		i2c = <&i2c0>;
		pinctrl-names = "default";
		pinctrl-0 = <&nxp_hdmi_bonelt_pins>;
	};
```
