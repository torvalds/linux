## Documentation/devicetree/bindings/dma/xilinx/xlnx,axi-dma.yaml
```yaml
# SPDX-License-Identifier: (GPL-2.0-only OR BSD-2-Clause)
%YAML 1.2
---
$id: http://devicetree.org/schemas/dma/xilinx/xlnx,axi-dma.yaml#
$schema: http://devicetree.org/meta-schemas/core.yaml#

title: Xilinx AXI VDMA, DMA, CDMA and MCDMA IP

maintainers:
  - Radhey Shyam Pandey <radhey.shyam.pandey@amd.com>
  - Abin Joseph <abin.joseph@amd.com>

description: >
  Xilinx AXI VDMA engine, it does transfers between memory and video devices.
  It can be configured to have one channel or two channels. If configured
  as two channels, one is to transmit to the video device and another is
  to receive from the video device.

  Xilinx AXI DMA engine, it does transfers between memory and AXI4 stream
  target devices. It can be configured to have one channel or two channels.
  If configured as two channels, one is to transmit to the device and another
  is to receive from the device.

  Xilinx AXI CDMA engine, it does transfers between memory-mapped source
  address and a memory-mapped destination address.

  Xilinx AXI MCDMA engine, it does transfer between memory and AXI4 stream
  target devices. It can be configured to have up to 16 independent transmit
  and receive channels.

properties:
  compatible:
    enum:
      - xlnx,axi-cdma-1.00.a
      - xlnx,axi-dma-1.00.a
      - xlnx,axi-mcdma-1.00.a
      - xlnx,axi-vdma-1.00.a

  reg:
    maxItems: 1

  "#dma-cells":
    const: 1

  "#address-cells":
    const: 1

  "#size-cells":
    const: 1

  interrupts:
    items:
      - description: Interrupt for single channel (MM2S or S2MM)
      - description: Interrupt for dual channel configuration
    minItems: 1
    description:
      Interrupt lines for the DMA controller. Only used when
      xlnx,axistream-connected is present (DMA connected to AXI Stream
      IP). When child dma-channel nodes are present, interrupts are
      specified in the child nodes instead.

  clocks:
    minItems: 1
    maxItems: 5

  clock-names:
    minItems: 1
    maxItems: 5

  dma-ranges: true

  xlnx,addrwidth:
    $ref: /schemas/types.yaml#/definitions/uint32
    enum: [32, 64]
    description: The DMA addressing size in bits.

  xlnx,num-fstores:
    $ref: /schemas/types.yaml#/definitions/uint32
    minimum: 1
    maximum: 32
    description: Should be the number of framebuffers as configured in h/w.

  xlnx,flush-fsync:
    type: boolean
    description: Tells which channel to Flush on Frame sync.

  xlnx,sg-length-width:
    $ref: /schemas/types.yaml#/definitions/uint32
    minimum: 8
    maximum: 26
    default: 23
    description:
      Width in bits of the length register as configured in hardware.

  xlnx,irq-delay:
    $ref: /schemas/types.yaml#/definitions/uint32
    minimum: 0
    maximum: 255
    description:
      Tells the interrupt delay timeout value. Valid range is from 0-255.
      Setting this value to zero disables the delay timer interrupt.
      1 timeout interval = 125 * clock period of SG clock.

  xlnx,axistream-connected:
    type: boolean
    description: Tells whether DMA is connected to AXI stream IP.

patternProperties:
  "^dma-channel(-mm2s|-s2mm)?$":
    type: object
    description:
      Should have at least one channel and can have up to two channels per
      device. This node specifies the properties of each DMA channel.

    properties:
      compatible:
        enum:
          - xlnx,axi-vdma-mm2s-channel
          - xlnx,axi-vdma-s2mm-channel
          - xlnx,axi-cdma-channel
          - xlnx,axi-dma-mm2s-channel
          - xlnx,axi-dma-s2mm-channel

      interrupts:
        maxItems: 1

      xlnx,datawidth:
        $ref: /schemas/types.yaml#/definitions/uint32
        enum: [32, 64, 128, 256, 512, 1024]
        description: Should contain the stream data width, take values {32,64...1024}.

      xlnx,include-dre:
        type: boolean
        description: Tells hardware is configured for Data Realignment Engine.

      xlnx,genlock-mode:
        type: boolean
        description: Tells Genlock synchronization is enabled/disabled in hardware.

      xlnx,enable-vert-flip:
        type: boolean
        description:
          Tells vertical flip is enabled/disabled in hardware(S2MM path).

      dma-channels:
        $ref: /schemas/types.yaml#/definitions/uint32
        description: Number of dma channels in child node.

    required:
      - compatible
      - interrupts
      - xlnx,datawidth

    additionalProperties: false

allOf:
  - $ref: ../dma-controller.yaml#

  - if:
      properties:
        compatible:
          contains:
            const: xlnx,axi-vdma-1.00.a
    then:
      properties:
        clock-names:
          items:
            - const: s_axi_lite_aclk
            - const: m_axi_mm2s_aclk
            - const: m_axi_s2mm_aclk
            - const: m_axis_mm2s_aclk
            - const: s_axis_s2mm_aclk
          minItems: 1
        interrupts: false
      patternProperties:
        "^dma-channel(-mm2s|-s2mm)?$":
          properties:
            compatible:
              enum:
                - xlnx,axi-vdma-mm2s-channel
                - xlnx,axi-vdma-s2mm-channel
      required:
        - xlnx,num-fstores

  - if:
      properties:
        compatible:
          contains:
            const: xlnx,axi-cdma-1.00.a
    then:
      properties:
        clock-names:
          items:
            - const: s_axi_lite_aclk
            - const: m_axi_aclk
        interrupts: false
      patternProperties:
        "^dma-channel(-mm2s|-s2mm)?$":
          properties:
            compatible:
              enum:
                - xlnx,axi-cdma-channel

  - if:
      properties:
        compatible:
          contains:
            enum:
              - xlnx,axi-dma-1.00.a
              - xlnx,axi-mcdma-1.00.a
    then:
      properties:
        clock-names:
          items:
            - const: s_axi_lite_aclk
            - const: m_axi_mm2s_aclk
            - const: m_axi_s2mm_aclk
            - const: m_axi_sg_aclk
          minItems: 1
      patternProperties:
        "^dma-channel(-mm2s|-s2mm)?(@[0-9a-f]+)?$":
          properties:
            compatible:
              enum:
                - xlnx,axi-dma-mm2s-channel
                - xlnx,axi-dma-s2mm-channel

required:
  - "#dma-cells"
  - reg
  - xlnx,addrwidth
  - dma-ranges
  - clocks
  - clock-names

unevaluatedProperties: false

examples:
  - |
    #include <dt-bindings/interrupt-controller/arm-gic.h>

    dma-controller@40030000 {
        compatible = "xlnx,axi-vdma-1.00.a";
        reg = <0x40030000 0x10000>;
        #dma-cells = <1>;
        #address-cells = <1>;
        #size-cells = <1>;
        dma-ranges = <0x0 0x0 0x40000000>;
        clocks = <&clk 0>, <&clk 1>, <&clk 2>, <&clk 3>, <&clk 4>;
        clock-names = "s_axi_lite_aclk", "m_axi_mm2s_aclk",
                      "m_axi_s2mm_aclk", "m_axis_mm2s_aclk",
                      "s_axis_s2mm_aclk";
        xlnx,num-fstores = <8>;
        xlnx,flush-fsync;
        xlnx,addrwidth = <32>;

        dma-channel-mm2s {
            compatible = "xlnx,axi-vdma-mm2s-channel";
            interrupts = <GIC_SPI 54 IRQ_TYPE_LEVEL_HIGH>;
            xlnx,datawidth = <64>;
        };

        dma-channel-s2mm {
            compatible = "xlnx,axi-vdma-s2mm-channel";
            interrupts = <GIC_SPI 53 IRQ_TYPE_LEVEL_HIGH>;
            xlnx,datawidth = <64>;
        };
    };

  - |
    #include <dt-bindings/interrupt-controller/arm-gic.h>

    dma-controller@a4030000 {
        compatible = "xlnx,axi-dma-1.00.a";
        reg = <0xa4030000 0x10000>;
        #dma-cells = <1>;
        #address-cells = <1>;
        #size-cells = <1>;
        dma-ranges = <0x0 0x0 0x40000000>;
        clocks = <&clk 0>, <&clk 1>, <&clk 2>, <&clk 3>;
        clock-names = "s_axi_lite_aclk", "m_axi_mm2s_aclk",
                      "m_axi_s2mm_aclk", "m_axi_sg_aclk";
        xlnx,addrwidth = <32>;
        xlnx,sg-length-width = <14>;

        dma-channel-mm2s {
            compatible = "xlnx,axi-dma-mm2s-channel";
            interrupts = <GIC_SPI 86 IRQ_TYPE_LEVEL_HIGH>;
            xlnx,datawidth = <64>;
            xlnx,include-dre;
        };

        dma-channel-s2mm {
            compatible = "xlnx,axi-dma-s2mm-channel";
            interrupts = <GIC_SPI 87 IRQ_TYPE_LEVEL_HIGH>;
            xlnx,datawidth = <64>;
            xlnx,include-dre;
        };
    };
```

## Documentation/devicetree/bindings/dma/xilinx/xlnx,zynqmp-dma-1.0.yaml
```yaml
# SPDX-License-Identifier: (GPL-2.0-only OR BSD-2-Clause)
%YAML 1.2
---
$id: http://devicetree.org/schemas/dma/xilinx/xlnx,zynqmp-dma-1.0.yaml#
$schema: http://devicetree.org/meta-schemas/core.yaml#

title: Xilinx ZynqMP DMA Engine

description: |
  The Xilinx ZynqMP DMA engine supports memory to memory transfers,
  memory to device and device to memory transfers. It also has flow
  control and rate control support for slave/peripheral dma access.

maintainers:
  - Michael Tretter <m.tretter@pengutronix.de>
  - Harini Katakam <harini.katakam@amd.com>
  - Radhey Shyam Pandey <radhey.shyam.pandey@amd.com>

allOf:
  - $ref: ../dma-controller.yaml#

properties:
  "#dma-cells":
    const: 1

  compatible:
    enum:
      - amd,versal2-dma-1.0
      - xlnx,zynqmp-dma-1.0

  reg:
    description: memory map for gdma/adma module access
    maxItems: 1

  interrupts:
    description: DMA channel interrupt
    maxItems: 1

  clocks:
    description: input clocks
    minItems: 2
    maxItems: 2

  clock-names:
    items:
      - const: clk_main
      - const: clk_apb

  xlnx,bus-width:
    $ref: /schemas/types.yaml#/definitions/uint32
    enum:
      - 64
      - 128
    description: AXI bus width in bits

  iommus:
    maxItems: 1

  power-domains:
    maxItems: 1

  dma-coherent:
    description: present if dma operations are coherent

required:
  - "#dma-cells"
  - compatible
  - reg
  - interrupts
  - clocks
  - clock-names
  - xlnx,bus-width

additionalProperties: false

examples:
  - |

    fpd_dma_chan1: dma-controller@fd500000 {
      compatible = "xlnx,zynqmp-dma-1.0";
      reg = <0xfd500000 0x1000>;
      interrupt-parent = <&gic>;
      interrupts = <0 117 0x4>;
      #dma-cells = <1>;
      clock-names = "clk_main", "clk_apb";
      clocks = <&zynqmp_clk 19>, <&zynqmp_clk 31>;
      xlnx,bus-width = <128>;
      dma-coherent;
    };
```

## Documentation/devicetree/bindings/dma/xilinx/xlnx,zynqmp-dpdma.yaml
```yaml
# SPDX-License-Identifier: (GPL-2.0-only OR BSD-2-Clause)
%YAML 1.2
---
$id: http://devicetree.org/schemas/dma/xilinx/xlnx,zynqmp-dpdma.yaml#
$schema: http://devicetree.org/meta-schemas/core.yaml#

title: Xilinx ZynqMP DisplayPort DMA Controller

description: |
  These bindings describe the DMA engine included in the Xilinx ZynqMP
  DisplayPort Subsystem. The DMA engine supports up to 6 DMA channels (3
  channels for a video stream, 1 channel for a graphics stream, and 2 channels
  for an audio stream).

maintainers:
  - Laurent Pinchart <laurent.pinchart@ideasonboard.com>

allOf:
  - $ref: ../dma-controller.yaml#

properties:
  "#dma-cells":
    const: 1
    description: |
      The cell is the DMA channel ID (see dt-bindings/dma/xlnx-zynqmp-dpdma.h
      for a list of channel IDs).

  compatible:
    const: xlnx,zynqmp-dpdma

  reg:
    maxItems: 1

  interrupts:
    maxItems: 1

  clocks:
    description: The AXI clock
    maxItems: 1

  clock-names:
    const: axi_clk

required:
  - "#dma-cells"
  - compatible
  - reg
  - interrupts
  - clocks
  - clock-names

additionalProperties: false

examples:
  - |
    #include <dt-bindings/interrupt-controller/arm-gic.h>

    dma: dma-controller@fd4c0000 {
      compatible = "xlnx,zynqmp-dpdma";
      reg = <0xfd4c0000 0x1000>;
      interrupts = <GIC_SPI 122 IRQ_TYPE_LEVEL_HIGH>;
      interrupt-parent = <&gic>;
      clocks = <&dpdma_clk>;
      clock-names = "axi_clk";
      #dma-cells = <1>;
    };

...
```

## Documentation/devicetree/bindings/dma/xilinx/zynqmp_dma.txt
```
Xilinx ZynqMP DMA engine, it does support memory to memory transfers,
memory to device and device to memory transfers. It also has flow
control and rate control support for slave/peripheral dma access.

Required properties:
- compatible		: Should be "xlnx,zynqmp-dma-1.0"
- reg			: Memory map for gdma/adma module access.
- interrupt-parent	: Interrupt controller the interrupt is routed through
- interrupts		: Should contain DMA channel interrupt.
- xlnx,bus-width	: Axi buswidth in bits. Should contain 128 or 64
- clock-names		: List of input clocks "clk_main", "clk_apb"
			  (see clock bindings for details)

Optional properties:
- dma-coherent		: Present if dma operations are coherent.

Example:
++++++++
fpd_dma_chan1: dma@fd500000 {
	compatible = "xlnx,zynqmp-dma-1.0";
	reg = <0x0 0xFD500000 0x1000>;
	interrupt-parent = <&gic>;
	interrupts = <0 117 4>;
	clock-names = "clk_main", "clk_apb";
	xlnx,bus-width = <128>;
	dma-coherent;
};
```

## Documentation/devicetree/bindings/dma/zxdma.txt
```
* ZTE ZX296702 DMA controller

Required properties:
- compatible: Should be "zte,zx296702-dma"
- reg: Should contain DMA registers location and length.
- interrupts: Should contain one interrupt shared by all channel
- #dma-cells: see dma.txt, should be 1, para number
- dma-channels: physical channels supported
- dma-requests: virtual channels supported, each virtual channel
		have specific request line
- clocks: clock required

Example:

Controller:
	dma: dma-controller@09c00000{
		compatible = "zte,zx296702-dma";
		reg = <0x09c00000 0x1000>;
		clocks = <&topclk ZX296702_DMA_ACLK>;
		interrupts = <GIC_SPI 66 IRQ_TYPE_LEVEL_HIGH>;
		#dma-cells = <1>;
		dma-channels = <24>;
		dma-requests = <24>;
	};

Client:
Use specific request line passing from dmax
For example, spdif0 tx channel request line is 4
	spdif0: spdif0@b004000 {
		#sound-dai-cells = <0>;
		compatible = "zte,zx296702-spdif";
		reg = <0x0b004000 0x1000>;
		clocks = <&lsp0clk ZX296702_SPDIF0_DIV>;
		clock-names = "tx";
		interrupts = <GIC_SPI 21 IRQ_TYPE_LEVEL_HIGH>;
		dmas = <&dma 4>;
		dma-names = "tx";
	}
```

## Documentation/devicetree/bindings/dpll/dpll-device.yaml
```yaml
# SPDX-License-Identifier: (GPL-2.0 OR BSD-2-Clause)
%YAML 1.2
---
$id: http://devicetree.org/schemas/dpll/dpll-device.yaml#
$schema: http://devicetree.org/meta-schemas/core.yaml#

title: Digital Phase-Locked Loop (DPLL) Device

maintainers:
  - Ivan Vecera <ivecera@redhat.com>

description:
  Digital Phase-Locked Loop (DPLL) device is used for precise clock
  synchronization in networking and telecom hardware. The device can
  have one or more channels (DPLLs) and one or more physical input and
  output pins. Each DPLL channel can either produce pulse-per-clock signal
  or drive ethernet equipment clock. The type of each channel can be
  indicated by dpll-types property.

properties:
  $nodename:
    pattern: "^dpll(@.*)?$"

  "#address-cells":
    const: 0

  "#size-cells":
    const: 0

  dpll-types:
    description: List of DPLL channel types, one per DPLL instance.
    $ref: /schemas/types.yaml#/definitions/non-unique-string-array
    items:
      enum: [pps, eec]

  input-pins:
    type: object
    description: DPLL input pins
    unevaluatedProperties: false

    properties:
      "#address-cells":
        const: 1
      "#size-cells":
        const: 0

    patternProperties:
      "^pin@[0-9a-f]+$":
        $ref: /schemas/dpll/dpll-pin.yaml
        unevaluatedProperties: false

    required:
      - "#address-cells"
      - "#size-cells"

  output-pins:
    type: object
    description: DPLL output pins
    unevaluatedProperties: false

    properties:
      "#address-cells":
        const: 1
      "#size-cells":
        const: 0

    patternProperties:
      "^pin@[0-9]+$":
        $ref: /schemas/dpll/dpll-pin.yaml
        unevaluatedProperties: false

    required:
      - "#address-cells"
      - "#size-cells"

additionalProperties: true
```
