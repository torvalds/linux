## Documentation/devicetree/bindings/dpll/dpll-pin.yaml
```yaml
# SPDX-License-Identifier: (GPL-2.0 OR BSD-2-Clause)
%YAML 1.2
---
$id: http://devicetree.org/schemas/dpll/dpll-pin.yaml#
$schema: http://devicetree.org/meta-schemas/core.yaml#

title: DPLL Pin

maintainers:
  - Ivan Vecera <ivecera@redhat.com>

description: |
  The DPLL pin is either a physical input or output pin that is provided
  by a DPLL( Digital Phase-Locked Loop) device. The pin is identified by
  its physical order number that is stored in reg property and can have
  an additional set of properties like supported (allowed) frequencies,
  label, type and may support embedded sync.

  Note that the pin in this context has nothing to do with pinctrl.

properties:
  reg:
    description: Hardware index of the DPLL pin.
    maxItems: 1

  connection-type:
    description: Connection type of the pin
    $ref: /schemas/types.yaml#/definitions/string
    enum: [ext, gnss, int, mux, synce]

  esync-control:
    description: Indicates whether the pin supports embedded sync functionality.
    type: boolean

  label:
    description: String exposed as the pin board label
    $ref: /schemas/types.yaml#/definitions/string

  supported-frequencies-hz:
    description: List of supported frequencies for this pin, expressed in Hz.

required:
  - reg

additionalProperties: false
```

## Documentation/devicetree/bindings/dpll/microchip,zl30731.yaml
```yaml
# SPDX-License-Identifier: (GPL-2.0 OR BSD-2-Clause)
%YAML 1.2
---
$id: http://devicetree.org/schemas/dpll/microchip,zl30731.yaml#
$schema: http://devicetree.org/meta-schemas/core.yaml#

title: Microchip Azurite DPLL device

maintainers:
  - Ivan Vecera <ivecera@redhat.com>

description:
  Microchip Azurite DPLL (ZL3073x) is a family of DPLL devices that
  provides up to 5 independent DPLL channels, up to 10 differential or
  single-ended inputs and 10 differential or 20 single-ended outputs.
  These devices support both I2C and SPI interfaces.

properties:
  compatible:
    enum:
      - microchip,zl30731
      - microchip,zl30732
      - microchip,zl30733
      - microchip,zl30734
      - microchip,zl30735

  reg:
    maxItems: 1

required:
  - compatible
  - reg

allOf:
  - $ref: /schemas/dpll/dpll-device.yaml#
  - $ref: /schemas/spi/spi-peripheral-props.yaml#

unevaluatedProperties: false

examples:
  - |
    i2c {
      #address-cells = <1>;
      #size-cells = <0>;

      dpll@70 {
        compatible = "microchip,zl30732";
        reg = <0x70>;
        dpll-types = "pps", "eec";

        input-pins {
          #address-cells = <1>;
          #size-cells = <0>;

          sync0: pin@0 { /* REF0P - 1 PPS sync source */
            reg = <0>;
            connection-type = "ext";
            label = "SMA1";
            supported-frequencies-hz = /bits/ 64 <1>;
          };

          pin@1 { /* REF0N - clock source, can pair with sync0 */
            reg = <1>;
            connection-type = "ext";
            label = "SMA2";
            supported-frequencies-hz = /bits/ 64 <10000 10000000>;
            ref-sync-sources = <&sync0>;
          };
        };

        output-pins {
          #address-cells = <1>;
          #size-cells = <0>;

          pin@3 { /* OUT1N */
            reg = <3>;
            connection-type = "gnss";
            esync-control;
            label = "Output 1";
            supported-frequencies-hz = /bits/ 64 <1 10000>;
          };
        };
      };
    };
  - |
    spi {
      #address-cells = <1>;
      #size-cells = <0>;

      dpll@70 {
        compatible = "microchip,zl30731";
        reg = <0x70>;
        spi-max-frequency = <12500000>;

        dpll-types = "pps";

        input-pins {
          #address-cells = <1>;
          #size-cells = <0>;

          sync1: pin@0 { /* REF0P - 1 PPS sync source */
            reg = <0>;
            connection-type = "gnss";
            label = "GNSS_1PPS_IN";
            supported-frequencies-hz = /bits/ 64 <1>;
          };

          pin@1 { /* REF0N - clock source */
            reg = <1>;
            connection-type = "gnss";
            label = "GNSS_10M_IN";
            supported-frequencies-hz = /bits/ 64 <10000000>;
            ref-sync-sources = <&sync1>;
          };
        };

        output-pins {
          #address-cells = <1>;
          #size-cells = <0>;

          pin@3 { /* OUT1N */
            reg = <3>;
            connection-type = "gnss";
            esync-control;
            label = "Output 1";
            supported-frequencies-hz = /bits/ 64 <1 10000>;
          };
        };
      };
    };
...
```

## Documentation/devicetree/bindings/dram/rk3368_dram_timing.txt
```
* rk3368 dram default timing is at arch/arm64/boot/dts/rk3368_dram_default_timing.dtsi

Required properties:
- compatible : Should be "rockchip,ddr-timing"
- dram_spd_bin : value is defined at include/dt-bindings/clock/ddr.h
  it select ddr3 cl-trp-trcd type, default value "DDR3_DEFAULT".it must selected
  according to "Speed Bin" in ddr3 datasheet, DO NOT use smaller "Speed Bin" than
  ddr3 exactly is.

- sr_idle : configure the SR_IDLE value, defined the selfrefresh idle period,
  memories are places into self-refresh mode if bus is idle for SR_IDLE*32 DFI
  clocks (DFI clocks freq is half of dram's clocks), defaule value is "1"

- pd_idle : config the PD_IDLE value, defined the power-down idle period, memories
  are places into power-down mode if bus is idle for PD_IDLE DFI clocks.

- dram_dll_disb_freq : it's defined the DDR3 dll bypass frequency in MHz (Mega Hz),
  when ddr freq less than DRAM_DLL_DISB_FREQ, ddr3 dll will bypssed
  note: if dll was bypassed, the odt also stop working.

- phy_dll_disb_freq : defined the PHY dll bypass frequency in MHz (Mega Hz),
  when ddr freq less than DRAM_DLL_DISB_FREQ, phy dll will bypssed
  note: phy dll and phy odt are independent

- dram_odt_disb_freq : defined the DDR3 and LPDDR3 odt disable frequency in
  MHz (Mega Hz), when ddr frequency less then DRAM_ODT_DISB_FREQ, the DDR3
  and LPDDR3 ODT are disabled.

- phy_odt_disb_freq : defined the PHY odt disable frequency in MHz (Mega Hz),
  when ddr frequency less then PHY_ODT_DISB_FREQ, the PHY ODT are disabled.

- ddr3_drv : define the DDR3 driver stength in ohm, default value is DDR3_DS_40

- ddr3_odt : define the DDR3 ODT in ohm, default value is DDR3_ODT_120

- lpddr3_drv : define the lPDDR3 driver stength in ohm, default value is LP3_DS_34

- lpddr3_odt : define the LPDDR3 ODT in ohm, default value is LP3_ODT_240

- lpddr2_drv : define the LPDDR2 driver stength in ohm, default value is LP2_DS_34

- phy_clk_drv : define the phy clocks driver strength in ohm, default value is
  PHY_RON_45ohm

- phy_cmd_drv : define the phy commands driver strength in ohm, default value is
  PHY_RON_34ohm

- phy_dqs_drv : define the phy dqs and dq driver strength in ohm, default value is
  PHY_RON_34ohm

- phy_odt : define the phy odt in ohm, default value isPHY_RTT_279ohm

the driver strength and odt value are defined at include/dt-bindings/dram/rockchip,rk3368.h

Example:

/ {
        ddr_timing: ddr_timing {
                compatible = "rockchip,ddr-timing";
                dram_spd_bin = <DDR3_DEFAULT>;
                sr_idle = <1>;
                pd_idle = <0x20>;
                dram_dll_disb_freq = <300>;
                phy_dll_disb_freq = <400>;
                dram_odt_disb_freq = <333>;
                phy_odt_disb_freq = <333>;
                ddr3_drv = <DDR3_DS_40ohm>;
                ddr3_odt = <DDR3_ODT_120ohm>;
                lpddr3_drv = <LP3_DS_34ohm>;
                lpddr3_odt = <LP3_ODT_240ohm>;
                lpddr2_drv = <LP2_DS_34ohm>;/*lpddr2 not supported odt*/
                phy_clk_drv = <PHY_RON_45ohm>;
                phy_cmd_drv = <PHY_RON_34ohm>;
                phy_dqs_drv = <PHY_RON_34ohm>;
                phy_odt = <PHY_RTT_279ohm>;
        };
};
```

## Documentation/devicetree/bindings/dram/rk3399_dram_timing.txt
```
* rk3399 dram default timing is at arch/arm64/boot/dts/rk3399_dram_default_timing.dtsi

Required properties:
- compatible : Should be "rockchip,ddr-timing"

- ddr3_speed_bin : Value is defined at include/dt-bindings/clock/ddr.h.
  It select DDR3 cl-trp-trcd type, default value "DDR3_DEFAULT".it must selected
  according to "Speed Bin" in DDR3 datasheet, DO NOT use smaller "Speed Bin" than
  DDR3 exactly is.

- pd_idle : Defines the power-down mode auto entry controller clocks.
  This parameter defines the number of idle controller clocks that can elapse
  before the controller will automatically issue an entry into the appropriate
  power-down low power state.

- sr_idle : Defines the Self-Refresh or Self-Refresh with Memory Clock Gating
  auto entry periodic cycles.
  This parameter defines the number of long count sequences that can elapse
  before the controller will automatically issue an entry into the Self-Refresh
  or Self-Refresh with Memory Clock Gating low power state.

- sr_mc_gate_idle : Defined the Self-Refresh with Memory and Controller Clock Gating
  auto entry periodic cycles.
  This parameter defines the number of long count sequences that can elapse before
  the controller will automatically issue an entry into the Self-Refresh with
  Memory and Controller Clock Gating low power state.

- srpd_lite_idle : Define the Lite Self-Refresh Power-Down auto entry periodic
  cycles.
  This parameter defines the number of long count sequences that can elapse
  before the controller will automatically issue an entry into the
  Lite Self-Refresh Power-Down low power state.

- standby_idle : Define the standby mode auto entry periodic cycles.

- auto_lp_dis_freq : It's defined the auto low down mode frequency in MHz (Mega Hz),
  when ddr freq greater than or equal this setting value, auto power-down will disable.

- ddr3_dll_dis_freq : It's defined the DDR3 dll bypass frequency in MHz (Mega Hz),
  when ddr freq less than or equal this setting value, DDR3 dll will bypssed.
  note: if dll was bypassed, the odt also stop working.

- phy_dll_dis_freq : Defined the PHY dll bypass frequency in MHz (Mega Hz),
  when ddr freq less than or equal this setting value, phy dll will bypssed.
  note: phy dll and phy odt are independent.

- ddr3_odt_dis_freq : Defined the DDR3 odt disable frequency in
  MHz (Mega Hz), when ddr frequency less then or equal ethis setting value, the DDR3
  ODT are disabled.

- ddr3_drv : Define the driver strength in ohm when connect DDR3.

- ddr3_odt : Define the ODT in ohm when connect DDR3.

- phy_ddr3_ca_drv : Define the PHY CA driver strength in ohm when connect DDR3.

- phy_ddr3_dq_drv : Define the PHY DQ driver strength in ohm when connect DDR3.

- phy_ddr3_odt : Define the phy odt in ohm when connect DDR3.

- lpddr3_odt_dis_freq : Defined the LPDDR3 odt disable frequency in
  MHz (Mega Hz), when ddr frequency less or equal then this setting value, the LPDDR3
  ODT are disabled.

- lpddr3_drv : Define the driver strength in ohm when connect LPDDR3.

- lpddr3_odt : Define the ODT in ohm when connect LPDDR3.

- phy_lpddr3_ca_drv : Define the PHY CA driver strength in ohm when connect LPDDR3.

- phy_lpddr3_dq_drv : Define the PHY DQ driver strength in ohm when connect LPDDR3.

- phy_lpddr3_odt : Define the phy odt in ohm when connect LPDDR3.

- lpddr4_odt_dis_freq : Defined the LPDDR4 odt disable frequency in
  MHz (Mega Hz), when ddr frequency less or equal then this setting value, the LPDDR4
  ODT are disabled.

- lpddr4_drv : Define the driver strength in ohm when connect LPDDR4.

- lpddr4_dq_odt : Define the DQ ODT in ohm when connect LPDDR4.

- lpddr4_ca_odt : Define the CA ODT in ohm when connect LPDDR4.

- phy_lpddr4_ca_drv : Define the PHY CA driver strength in ohm when connect LPDDR4.

- phy_lpddr4_ck_cs_drv : Define the PHY CLK and CS driver strength in ohm when connect LPDDR4.

- phy_lpddr4_dq_drv : Define the PHY DQ driver strength in ohm when connect LPDDR4.

- phy_lpddr4_odt : Define the phy odt in ohm when connect LPDDR4.

Example:
/ {
	ddr_timing: ddr_timing {
		compatible = "rockchip,ddr-timing";
		ddr3_speed_bin = <21>;
		pd_idle = <0>;
		sr_idle = <0>;
		sr_mc_gate_idle = <0>;
		srpd_lite_idle  = <0>;
		standby_idle = <0>;
		auto_lp_dis_freq = <666>;
		ddr3_dll_dis_freq = <300>;
		phy_dll_dis_freq = <260>;

		ddr3_odt_dis_freq = <666>;
		ddr3_drv = <DDR3_DS_40ohm>;
		ddr3_odt = <DDR3_ODT_120ohm>;
		phy_ddr3_ca_drv = <PHY_DRV_ODT_40>;
		phy_ddr3_dq_drv = <PHY_DRV_ODT_40>;
		phy_ddr3_odt = <PHY_DRV_ODT_240>;

		lpddr3_odt_dis_freq = <666>;
		lpddr3_drv = <LP3_DS_34ohm>;
		lpddr3_odt = <LP3_ODT_240ohm>;
		phy_lpddr3_ca_drv = <PHY_DRV_ODT_34_3>;
		phy_lpddr3_dq_drv = <PHY_DRV_ODT_34_3>;
		phy_lpddr3_odt = <PHY_DRV_ODT_240>;

		lpddr4_odt_dis_freq = <933>;
		lpddr4_drv = <LP4_PDDS_60ohm>;
		lpddr4_dq_odt = <LP4_DQ_ODT_40ohm>;
		lpddr4_ca_odt = <LP4_CA_ODT_40ohm>;
		phy_lpddr4_ca_drv = <PHY_DRV_ODT_40>;
		phy_lpddr4_ck_cs_drv = <PHY_DRV_ODT_80>;
		phy_lpddr4_dq_drv = <PHY_DRV_ODT_80>;
		phy_lpddr4_odt = <PHY_DRV_ODT_60>;
	};
};
```

## Documentation/devicetree/bindings/drm/armada/marvell,dove-lcd.txt
```
Device Tree bindings for Armada DRM CRTC driver

Required properties:
 - compatible: value should be "marvell,dove-lcd".
 - reg: base address and size of the LCD controller
 - interrupts: single interrupt number for the LCD controller
 - port: video output port with endpoints, as described by graph.txt

Optional properties:

 - clocks: as described by clock-bindings.txt
 - clock-names: as described by clock-bindings.txt
	"axiclk" - axi bus clock for pixel clock
	"plldivider" - pll divider clock for pixel clock
	"ext_ref_clk0" - external clock 0 for pixel clock
	"ext_ref_clk1" - external clock 1 for pixel clock

Note: all clocks are optional but at least one must be specified.
Further clocks may be added in the future according to requirements of
different SoCs.

Example:

	lcd0: lcd-controller@820000 {
		compatible = "marvell,dove-lcd";
		reg = <0x820000 0x1000>;
		interrupts = <47>;
		clocks = <&si5351 0>;
		clock-names = "ext_ref_clk_1";
	};
```

## Documentation/devicetree/bindings/drm/bridge/ptn3460.txt
```
ptn3460 bridge bindings

Required properties:
	- compatible: "nxp,ptn3460"
	- reg: i2c address of the bridge
	- powerdown-gpio: OF device-tree gpio specification
	- reset-gpio: OF device-tree gpio specification
	- edid-emulation: The EDID emulation entry to use
		+-------+------------+------------------+
		| Value | Resolution | Description      |
		|   0   |  1024x768  | NXP Generic      |
		|   1   |  1920x1080 | NXP Generic      |
		|   2   |  1920x1080 | NXP Generic      |
		|   3   |  1600x900  | Samsung LTM200KT |
		|   4   |  1920x1080 | Samsung LTM230HT |
		|   5   |  1366x768  | NXP Generic      |
		|   6   |  1600x900  | ChiMei M215HGE   |
		+-------+------------+------------------+

Example:
	lvds-bridge@20 {
		compatible = "nxp,ptn3460";
		reg = <0x20>;
		powerdown-gpio = <&gpy2 5 1 0 0>;
		reset-gpio = <&gpx1 5 1 0 0>;
		edid-emulation = <5>;
	};
```

## Documentation/devicetree/bindings/drm/exynos/g2d.txt
```
Samsung 2D Graphic Accelerator using DRM frame work

Samsung FIMG2D is a graphics 2D accelerator which supports Bit Block Transfer.
We set the drawing-context registers for configuring rendering parameters and
then start rendering.
This driver is for SOCs which contain G2D IPs with version 4.1.

Required properties:
	-compatible:
		should be "samsung,exynos-g2d-41".
	-reg:
		physical base address of the controller and length
		of memory mapped region.
	-interrupts:
		interrupt combiner values.

Example:
	g2d {
		compatible = "samsung,exynos-g2d-41";
		reg = <0x10850000 0x1000>;
		interrupts = <0 91 0>;
	};
```

## Documentation/devicetree/bindings/drm/exynos/hdmiddc.txt
```
Device-Tree bindings for hdmiddc driver

Required properties:
- compatible: value should be "samsung,exynos5-hdmiddc".
- reg: I2C address of the hdmiddc device.

Example:

	hdmiddc {
		compatible = "samsung,exynos5-hdmiddc";
		reg = <0x50>;
	};
```
