## Documentation/devicetree/bindings/dma/renesas,usb-dmac.txt
```
* Renesas USB DMA Controller Device Tree bindings

Required Properties:
-compatible: "renesas,<soctype>-usb-dmac", "renesas,usb-dmac" as fallback.
	Examples with soctypes are:
	  - "renesas,r8a7743-usb-dmac" (RZ/G1M)
	  - "renesas,r8a7744-usb-dmac" (RZ/G1N)
	  - "renesas,r8a7745-usb-dmac" (RZ/G1E)
	  - "renesas,r8a77470-usb-dmac" (RZ/G1C)
	  - "renesas,r8a774a1-usb-dmac" (RZ/G2M)
	  - "renesas,r8a774b1-usb-dmac" (RZ/G2N)
	  - "renesas,r8a774c0-usb-dmac" (RZ/G2E)
	  - "renesas,r8a7790-usb-dmac" (R-Car H2)
	  - "renesas,r8a7791-usb-dmac" (R-Car M2-W)
	  - "renesas,r8a7793-usb-dmac" (R-Car M2-N)
	  - "renesas,r8a7794-usb-dmac" (R-Car E2)
	  - "renesas,r8a7795-usb-dmac" (R-Car H3)
	  - "renesas,r8a7796-usb-dmac" (R-Car M3-W)
	  - "renesas,r8a77961-usb-dmac" (R-Car M3-W+)
	  - "renesas,r8a77965-usb-dmac" (R-Car M3-N)
	  - "renesas,r8a77990-usb-dmac" (R-Car E3)
	  - "renesas,r8a77995-usb-dmac" (R-Car D3)
- reg: base address and length of the registers block for the DMAC
- interrupts: interrupt specifiers for the DMAC, one for each entry in
  interrupt-names.
- interrupt-names: one entry per channel, named "ch%u", where %u is the
  channel number ranging from zero to the number of channels minus one.
- clocks: a list of phandle + clock-specifier pairs.
- #dma-cells: must be <1>, the cell specifies the channel number of the DMAC
  port connected to the DMA client.
- dma-channels: number of DMA channels

Example: R8A7790 (R-Car H2) USB-DMACs

	usb_dmac0: dma-controller@e65a0000 {
		compatible = "renesas,r8a7790-usb-dmac", "renesas,usb-dmac";
		reg = <0 0xe65a0000 0 0x100>;
		interrupts = <0 109 IRQ_TYPE_LEVEL_HIGH
			      0 109 IRQ_TYPE_LEVEL_HIGH>;
		interrupt-names = "ch0", "ch1";
		clocks = <&mstp3_clks R8A7790_CLK_USBDMAC0>;
		#dma-cells = <1>;
		dma-channels = <2>;
	};

	usb_dmac1: dma-controller@e65b0000 {
		compatible = "renesas,usb-dmac";
		reg = <0 0xe65b0000 0 0x100>;
		interrupts = <0 110 IRQ_TYPE_LEVEL_HIGH
			      0 110 IRQ_TYPE_LEVEL_HIGH>;
		interrupt-names = "ch0", "ch1";
		clocks = <&mstp3_clks R8A7790_CLK_USBDMAC1>;
		#dma-cells = <1>;
		dma-channels = <2>;
	};
```

## Documentation/devicetree/bindings/dma/renesas,usb-dmac.yaml
```yaml
# SPDX-License-Identifier: (GPL-2.0-only OR BSD-2-Clause)
%YAML 1.2
---
$id: http://devicetree.org/schemas/dma/renesas,usb-dmac.yaml#
$schema: http://devicetree.org/meta-schemas/core.yaml#

title: Renesas USB DMA Controller

maintainers:
  - Yoshihiro Shimoda <yoshihiro.shimoda.uh@renesas.com>

allOf:
  - $ref: "dma-controller.yaml#"

properties:
  compatible:
    items:
      - enum:
          - renesas,r8a7742-usb-dmac  # RZ/G1H
          - renesas,r8a7743-usb-dmac  # RZ/G1M
          - renesas,r8a7744-usb-dmac  # RZ/G1N
          - renesas,r8a7745-usb-dmac  # RZ/G1E
          - renesas,r8a77470-usb-dmac # RZ/G1C
          - renesas,r8a774a1-usb-dmac # RZ/G2M
          - renesas,r8a774b1-usb-dmac # RZ/G2N
          - renesas,r8a774c0-usb-dmac # RZ/G2E
          - renesas,r8a774e1-usb-dmac # RZ/G2H
          - renesas,r8a7790-usb-dmac  # R-Car H2
          - renesas,r8a7791-usb-dmac  # R-Car M2-W
          - renesas,r8a7793-usb-dmac  # R-Car M2-N
          - renesas,r8a7794-usb-dmac  # R-Car E2
          - renesas,r8a7795-usb-dmac  # R-Car H3
          - renesas,r8a7796-usb-dmac  # R-Car M3-W
          - renesas,r8a77961-usb-dmac # R-Car M3-W+
          - renesas,r8a77965-usb-dmac # R-Car M3-N
          - renesas,r8a77990-usb-dmac # R-Car E3
          - renesas,r8a77995-usb-dmac # R-Car D3
      - const: renesas,usb-dmac

  reg:
    maxItems: 1

  interrupts:
    minItems: 2
    maxItems: 2

  interrupt-names:
    items:
      - pattern: ch0
      - pattern: ch1

  clocks:
    maxItems: 1

  '#dma-cells':
    const: 1
    description:
      The cell specifies the channel number of the DMAC port connected to
      the DMA client.

  dma-channels:
    const: 2

  iommus:
    minItems: 2
    maxItems: 2

  power-domains:
    maxItems: 1

  resets:
    maxItems: 1

required:
  - compatible
  - reg
  - interrupts
  - interrupt-names
  - clocks
  - '#dma-cells'
  - dma-channels
  - power-domains
  - resets

additionalProperties: false

examples:
  - |
    #include <dt-bindings/clock/r8a7790-cpg-mssr.h>
    #include <dt-bindings/interrupt-controller/arm-gic.h>
    #include <dt-bindings/power/r8a7790-sysc.h>

    usb_dmac0: dma-controller@e65a0000 {
        compatible = "renesas,r8a7790-usb-dmac", "renesas,usb-dmac";
        reg = <0xe65a0000 0x100>;
        interrupts = <GIC_SPI 109 IRQ_TYPE_LEVEL_HIGH>,
                     <GIC_SPI 109 IRQ_TYPE_LEVEL_HIGH>;
        interrupt-names = "ch0", "ch1";
        clocks = <&cpg CPG_MOD 330>;
        power-domains = <&sysc R8A7790_PD_ALWAYS_ON>;
        resets = <&cpg 330>;
        #dma-cells = <1>;
        dma-channels = <2>;
    };
```

## Documentation/devicetree/bindings/dma/shdma.txt
```
* SHDMA Device Tree bindings

Sh-/r-mobile and R-Car systems often have multiple identical DMA controller
instances, capable of serving any of a common set of DMA slave devices, using
the same configuration. To describe this topology we require all compatible
SHDMA DT nodes to be placed under a DMA multiplexer node. All such compatible
DMAC instances have the same number of channels and use the same DMA
descriptors. Therefore respective DMA DT bindings can also all be placed in the
multiplexer node. Even if there is only one such DMAC instance on a system, it
still has to be placed under such a multiplexer node.

* DMA multiplexer

Required properties:
- compatible:	should be "renesas,shdma-mux"
- #dma-cells:	should be <1>, see "dmas" property below

Optional properties (currently unused):
- dma-channels:	number of DMA channels
- dma-requests:	number of DMA request signals

* DMA controller

Required properties:
- compatible:	should be of the form "renesas,shdma-<soc>", where <soc> should
		be replaced with the desired SoC model, e.g.
		"renesas,shdma-r8a73a4" for the system DMAC on r8a73a4 SoC

Example:
	dmac: dma-multiplexer@0 {
		compatible = "renesas,shdma-mux";
		#dma-cells = <1>;
		dma-channels = <20>;
		dma-requests = <256>;
		#address-cells = <2>;
		#size-cells = <2>;
		ranges;

		dma0: dma-controller@e6700020 {
			compatible = "renesas,shdma-r8a73a4";
			reg = <0 0xe6700020 0 0x89e0>;
			interrupt-parent = <&gic>;
			interrupts = <0 220 4
					0 200 4
					0 201 4
					0 202 4
					0 203 4
					0 204 4
					0 205 4
					0 206 4
					0 207 4
					0 208 4
					0 209 4
					0 210 4
					0 211 4
					0 212 4
					0 213 4
					0 214 4
					0 215 4
					0 216 4
					0 217 4
					0 218 4
					0 219 4>;
			interrupt-names = "error",
					"ch0", "ch1", "ch2", "ch3",
					"ch4", "ch5", "ch6", "ch7",
					"ch8", "ch9", "ch10", "ch11",
					"ch12", "ch13", "ch14", "ch15",
					"ch16", "ch17", "ch18", "ch19";
		};
	};

* DMA client

Required properties:
- dmas:		a list of <[DMA multiplexer phandle] [MID/RID value]> pairs,
		where MID/RID values are fixed handles, specified in the SoC
		manual
- dma-names:	a list of DMA channel names, one per "dmas" entry

Example:
	dmas = <&dmac 0xd1
		&dmac 0xd2>;
	dma-names = "tx", "rx";
```

## Documentation/devicetree/bindings/dma/sifive,fu540-c000-pdma.yaml
```yaml
# SPDX-License-Identifier: GPL-2.0
%YAML 1.2
---
$id: http://devicetree.org/schemas/dma/sifive,fu540-c000-pdma.yaml#
$schema: http://devicetree.org/meta-schemas/core.yaml#

title: SiFive Unleashed Rev C000 Platform DMA

maintainers:
  - Green Wan <green.wan@sifive.com>
  - Palmer Debbelt <palmer@sifive.com>
  - Paul Walmsley <paul.walmsley@sifive.com>

description: |
  Platform DMA is a DMA engine of SiFive Unleashed. It supports 4
  channels. Each channel has 2 interrupts. One is for DMA done and
  the other is for DME error.

  In different SoC, DMA could be attached to different IRQ line.
  DT file need to be changed to meet the difference. For technical
  doc,

  https://static.dev.sifive.com/FU540-C000-v1.0.pdf

allOf:
  - $ref: dma-controller.yaml#

properties:
  compatible:
    items:
      - enum:
          - sifive,fu540-c000-pdma
      - const: sifive,pdma0
    description:
      Should be "sifive,<chip>-pdma" and "sifive,pdma<version>".
      Supported compatible strings are -
      "sifive,fu540-c000-pdma" for the SiFive PDMA v0 as integrated onto the
      SiFive FU540 chip resp and "sifive,pdma0" for the SiFive PDMA v0 IP block
      with no chip integration tweaks.

  reg:
    maxItems: 1

  interrupts:
    minItems: 1
    maxItems: 8

  dma-channels:
    description: For backwards-compatibility, the default value is 4
    minimum: 1
    maximum: 4
    default: 4

  '#dma-cells':
    const: 1

required:
  - compatible
  - reg
  - interrupts

unevaluatedProperties: false

examples:
  - |
    dma-controller@3000000 {
      compatible = "sifive,fu540-c000-pdma", "sifive,pdma0";
      reg = <0x3000000 0x8000>;
      dma-channels = <4>;
      interrupts = <23>, <24>, <25>, <26>, <27>, <28>, <29>, <30>;
      #dma-cells = <1>;
    };

...
```

## Documentation/devicetree/bindings/dma/sirfsoc-dma.txt
```
* CSR SiRFSoC DMA controller

See dma.txt first

Required properties:
- compatible: Should be "sirf,prima2-dmac" or "sirf,marco-dmac"
- reg: Should contain DMA registers location and length.
- interrupts: Should contain one interrupt shared by all channel
- #dma-cells: must be <1>. used to represent the number of integer
    cells in the dmas property of client device.
- clocks: clock required

Example:

Controller:
dmac0: dma-controller@b00b0000 {
	compatible = "sirf,prima2-dmac";
	reg = <0xb00b0000 0x10000>;
	interrupts = <12>;
	clocks = <&clks 24>;
	#dma-cells = <1>;
};


Client:
Fill the specific dma request line in dmas. In the below example, spi0 read
channel request line is 9 of the 2nd dma controller, while write channel uses
4 of the 2nd dma controller; spi1 read channel request line is 12 of the 1st
dma controller, while write channel uses 13 of the 1st dma controller:

spi0: spi@b00d0000 {
	compatible = "sirf,prima2-spi";
	dmas = <&dmac1 9>,
		<&dmac1 4>;
	dma-names = "rx", "tx";
};

spi1: spi@b0170000 {
	compatible = "sirf,prima2-spi";
	dmas = <&dmac0 12>,
		<&dmac0 13>;
	dma-names = "rx", "tx";
};
```

## Documentation/devicetree/bindings/dma/snps,dma-spear1340.yaml
```yaml
# SPDX-License-Identifier: GPL-2.0-only
%YAML 1.2
---
$id: http://devicetree.org/schemas/dma/snps,dma-spear1340.yaml#
$schema: http://devicetree.org/meta-schemas/core.yaml#

title: Synopsys Designware DMA Controller

maintainers:
  - Viresh Kumar <vireshk@kernel.org>
  - Andy Shevchenko <andriy.shevchenko@linux.intel.com>

allOf:
  - $ref: "dma-controller.yaml#"

properties:
  compatible:
    const: snps,dma-spear1340

  "#dma-cells":
    minimum: 3
    maximum: 4
    description: |
      First cell is a phandle pointing to the DMA controller. Second one is
      the DMA request line number. Third cell is the memory master identifier
      for transfers on dynamically allocated channel. Fourth cell is the
      peripheral master identifier for transfers on an allocated channel. Fifth
      cell is an optional mask of the DMA channels permitted to be allocated
      for the corresponding client device.

  reg:
    maxItems: 1

  interrupts:
    maxItems: 1

  clocks:
    maxItems: 1

  clock-names:
    description: AHB interface reference clock.
    const: hclk

  dma-channels:
    description: |
      Number of DMA channels supported by the controller. In case if
      not specified the driver will try to auto-detect this and
      the rest of the optional parameters.
    minimum: 1
    maximum: 8

  dma-requests:
    minimum: 1
    maximum: 16

  dma-masters:
    $ref: /schemas/types.yaml#/definitions/uint32
    description: |
      Number of DMA masters supported by the controller. In case if
      not specified the driver will try to auto-detect this and
      the rest of the optional parameters.
    minimum: 1
    maximum: 4

  chan_allocation_order:
    $ref: /schemas/types.yaml#/definitions/uint32
    description: |
      DMA channels allocation order specifier. Zero means ascending order
      (first free allocated), while one - descending (last free allocated).
    default: 0
    enum: [0, 1]

  chan_priority:
    $ref: /schemas/types.yaml#/definitions/uint32
    description: |
      DMA channels priority order. Zero means ascending channels priority
      so the very first channel has the highest priority. While 1 means
      descending priority (the last channel has the highest priority).
    default: 0
    enum: [0, 1]

  block_size:
    $ref: /schemas/types.yaml#/definitions/uint32
    description: Maximum block size supported by the DMA controller.
    enum: [3, 7, 15, 31, 63, 127, 255, 511, 1023, 2047, 4095]

  data-width:
    $ref: /schemas/types.yaml#/definitions/uint32-array
    description: Data bus width per each DMA master in bytes.
    items:
      maxItems: 4
      items:
        enum: [4, 8, 16, 32]

  data_width:
    $ref: /schemas/types.yaml#/definitions/uint32-array
    deprecated: true
    description: |
      Data bus width per each DMA master in (2^n * 8) bits. This property is
      deprecated. It' usage is discouraged in favor of data-width one. Moreover
      the property incorrectly permits to define data-bus width of 8 and 16
      bits, which is impossible in accordance with DW DMAC IP-core data book.
    items:
      maxItems: 4
      items:
        enum:
          - 0 # 8 bits
          - 1 # 16 bits
          - 2 # 32 bits
          - 3 # 64 bits
          - 4 # 128 bits
          - 5 # 256 bits
        default: 0

  multi-block:
    $ref: /schemas/types.yaml#/definitions/uint32-array
    description: |
      LLP-based multi-block transfer supported by hardware per
      each DMA channel.
    items:
      maxItems: 8
      items:
        enum: [0, 1]
        default: 1

  snps,max-burst-len:
    $ref: /schemas/types.yaml#/definitions/uint32-array
    description: |
      Maximum length of the burst transactions supported by the controller.
      This property defines the upper limit of the run-time burst setting
      (CTLx.SRC_MSIZE/CTLx.DST_MSIZE fields) so the allowed burst length
      will be from 1 to max-burst-len words. It's an array property with one
      cell per channel in the units determined by the value set in the
      CTLx.SRC_TR_WIDTH/CTLx.DST_TR_WIDTH fields (data width).
    items:
      maxItems: 8
      items:
        enum: [4, 8, 16, 32, 64, 128, 256]
        default: 256

  snps,dma-protection-control:
    $ref: /schemas/types.yaml#/definitions/uint32
    description: |
      Bits one-to-one passed to the AHB HPROT[3:1] bus. Each bit setting
      indicates the following features: bit 0 - privileged mode,
      bit 1 - DMA is bufferable, bit 2 - DMA is cacheable.
    default: 0
    minimum: 0
    maximum: 7

unevaluatedProperties: false

required:
  - compatible
  - "#dma-cells"
  - reg
  - interrupts

examples:
  - |
    dma-controller@fc000000 {
      compatible = "snps,dma-spear1340";
      reg = <0xfc000000 0x1000>;
      interrupt-parent = <&vic1>;
      interrupts = <12>;

      dma-channels = <8>;
      dma-requests = <16>;
      dma-masters = <4>;
      #dma-cells = <3>;

      chan_allocation_order = <1>;
      chan_priority = <1>;
      block_size = <0xfff>;
      data-width = <8 8>;
      multi-block = <0 0 0 0 0 0 0 0>;
      snps,max-burst-len = <16 16 4 4 4 4 4 4>;
    };
...
```
