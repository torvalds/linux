## Documentation/devicetree/bindings/dma/nvidia,tegra210-adma.yaml
```yaml
# SPDX-License-Identifier: (GPL-2.0-only OR BSD-2-Clause)
%YAML 1.2
---
$id: http://devicetree.org/schemas/dma/nvidia,tegra210-adma.yaml#
$schema: http://devicetree.org/meta-schemas/core.yaml#

title: NVIDIA Tegra Audio DMA (ADMA) controller

description: |
  The Tegra Audio DMA controller is used for transferring data
  between system memory and the Audio Processing Engine (APE).

maintainers:
  - Jon Hunter <jonathanh@nvidia.com>

properties:
  compatible:
    oneOf:
      - enum:
          - nvidia,tegra210-adma
          - nvidia,tegra186-adma
          - nvidia,tegra264-adma
      - items:
          - enum:
              - nvidia,tegra234-adma
              - nvidia,tegra194-adma
          - const: nvidia,tegra186-adma

  reg:
    description:
      The 'page' region describes the address space of the page
      used for accessing the DMA channel registers. The 'global'
      region describes the address space of the global DMA registers.
      In the absence of the 'reg-names' property, there must be a
      single entry that covers the address space of the global DMA
      registers and the DMA channel registers.
    minItems: 1
    maxItems: 2

  reg-names:
    minItems: 1
    maxItems: 2

  interrupts:
    description: |
      Should contain all of the per-channel DMA interrupts in
      ascending order with respect to the DMA channel index.
    minItems: 1
    maxItems: 32

  clocks:
    description: Must contain one entry for the ADMA module clock
    maxItems: 1

  clock-names:
    const: d_audio

  "#dma-cells":
    description: |
      The first cell denotes the receive/transmit request number and
      should be between 1 and the maximum number of requests supported.
      This value corresponds to the RX/TX_REQUEST_SELECT fields in the
      ADMA_CHn_CTRL register.
    const: 1

  dma-channel-mask:
    maxItems: 1

required:
  - compatible
  - reg
  - interrupts
  - clocks
  - clock-names

allOf:
  - $ref: dma-controller.yaml#
  - if:
      properties:
        compatible:
          contains:
            enum:
              - nvidia,tegra210-adma
    then:
      properties:
        reg:
          items:
            - description: Full address space range of DMA registers.

  - if:
      properties:
        compatible:
          contains:
            enum:
              - nvidia,tegra186-adma
              - nvidia,tegra264-adma
    then:
      anyOf:
        - properties:
            reg:
              items:
                - description: Full address space range of DMA registers.
        - properties:
            reg:
              items:
                - description: Channel Page address space range of DMA registers.
            reg-names:
              items:
                - const: page
        - properties:
            reg:
              items:
                - description: Channel Page address space range of DMA registers.
                - description: Global Page address space range of DMA registers.
            reg-names:
              items:
                - const: page
                - const: global

additionalProperties: false

examples:
  - |
    #include <dt-bindings/interrupt-controller/arm-gic.h>
    #include<dt-bindings/clock/tegra210-car.h>

    dma-controller@702e2000 {
        compatible = "nvidia,tegra210-adma";
        reg = <0x702e2000 0x2000>;
        interrupt-parent = <&tegra_agic>;
        interrupts = <GIC_SPI 24 IRQ_TYPE_LEVEL_HIGH>,
                     <GIC_SPI 25 IRQ_TYPE_LEVEL_HIGH>,
                     <GIC_SPI 26 IRQ_TYPE_LEVEL_HIGH>,
                     <GIC_SPI 27 IRQ_TYPE_LEVEL_HIGH>,
                     <GIC_SPI 28 IRQ_TYPE_LEVEL_HIGH>,
                     <GIC_SPI 29 IRQ_TYPE_LEVEL_HIGH>,
                     <GIC_SPI 30 IRQ_TYPE_LEVEL_HIGH>,
                     <GIC_SPI 31 IRQ_TYPE_LEVEL_HIGH>,
                     <GIC_SPI 32 IRQ_TYPE_LEVEL_HIGH>,
                     <GIC_SPI 33 IRQ_TYPE_LEVEL_HIGH>,
                     <GIC_SPI 34 IRQ_TYPE_LEVEL_HIGH>,
                     <GIC_SPI 35 IRQ_TYPE_LEVEL_HIGH>,
                     <GIC_SPI 36 IRQ_TYPE_LEVEL_HIGH>,
                     <GIC_SPI 37 IRQ_TYPE_LEVEL_HIGH>,
                     <GIC_SPI 38 IRQ_TYPE_LEVEL_HIGH>,
                     <GIC_SPI 39 IRQ_TYPE_LEVEL_HIGH>,
                     <GIC_SPI 40 IRQ_TYPE_LEVEL_HIGH>,
                     <GIC_SPI 41 IRQ_TYPE_LEVEL_HIGH>,
                     <GIC_SPI 42 IRQ_TYPE_LEVEL_HIGH>,
                     <GIC_SPI 43 IRQ_TYPE_LEVEL_HIGH>,
                     <GIC_SPI 44 IRQ_TYPE_LEVEL_HIGH>,
                     <GIC_SPI 45 IRQ_TYPE_LEVEL_HIGH>;
        clocks = <&tegra_car TEGRA210_CLK_D_AUDIO>;
        clock-names = "d_audio";
        #dma-cells = <1>;
    };

...
```

## Documentation/devicetree/bindings/dma/nxp,lpc3220-dmamux.yaml
```yaml
# SPDX-License-Identifier: (GPL-2.0-only OR BSD-2-Clause)
%YAML 1.2
---
$id: http://devicetree.org/schemas/dma/nxp,lpc3220-dmamux.yaml#
$schema: http://devicetree.org/meta-schemas/core.yaml#

title: DMA multiplexer for LPC32XX SoC (DMA request router)

maintainers:
  - J.M.B. Downing <jonathan.downing@nautel.com>
  - Piotr Wojtaszczyk <piotr.wojtaszczyk@timesys.com>

allOf:
  - $ref: dma-router.yaml#

properties:
  compatible:
    const: nxp,lpc3220-dmamux

  reg:
    maxItems: 1

  dma-masters:
    description: phandle to a dma node compatible with arm,pl080
    maxItems: 1

  "#dma-cells":
    const: 3
    description: |
      First two cells same as for device pointed in dma-masters.
      Third cell represents mux value for the request.

required:
  - compatible
  - reg
  - dma-masters

additionalProperties: false

examples:
  - |
    dma-router@7c {
      compatible = "nxp,lpc3220-dmamux";
      reg = <0x7c 0x8>;
      dma-masters = <&dma>;
      #dma-cells = <3>;
    };

...
```

## Documentation/devicetree/bindings/dma/owl-dma.txt
```
* Actions Semi Owl SoCs DMA controller

This binding follows the generic DMA bindings defined in dma.txt.

Required properties:
- compatible: Should be "actions,s900-dma".
- reg: Should contain DMA registers location and length.
- interrupts: Should contain 4 interrupts shared by all channel.
- #dma-cells: Must be <1>. Used to represent the number of integer
              cells in the dmas property of client device.
- dma-channels: Physical channels supported.
- dma-requests: Number of DMA request signals supported by the controller.
                Refer to Documentation/devicetree/bindings/dma/dma.txt
- clocks: Phandle and Specifier of the clock feeding the DMA controller.

Example:

Controller:
                dma: dma-controller@e0260000 {
                        compatible = "actions,s900-dma";
                        reg = <0x0 0xe0260000 0x0 0x1000>;
                        interrupts = <GIC_SPI 57 IRQ_TYPE_LEVEL_HIGH>,
                                     <GIC_SPI 58 IRQ_TYPE_LEVEL_HIGH>,
                                     <GIC_SPI 59 IRQ_TYPE_LEVEL_HIGH>,
                                     <GIC_SPI 60 IRQ_TYPE_LEVEL_HIGH>;
                        #dma-cells = <1>;
                        dma-channels = <12>;
                        dma-requests = <46>;
                        clocks = <&clock CLK_DMAC>;
                };

Client:

DMA clients connected to the Actions Semi Owl SoCs DMA controller must
use the format described in the dma.txt file, using a two-cell specifier
for each channel.

The two cells in order are:
1. A phandle pointing to the DMA controller.
2. The channel id.

uart5: serial@e012a000 {
        ...
        dma-names = "tx", "rx";
        dmas = <&dma 26>, <&dma 27>;
        ...
};
```

## Documentation/devicetree/bindings/dma/owl-dma.yaml
```yaml
# SPDX-License-Identifier: GPL-2.0
%YAML 1.2
---
$id: http://devicetree.org/schemas/dma/owl-dma.yaml#
$schema: http://devicetree.org/meta-schemas/core.yaml#

title: Actions Semi Owl SoCs DMA controller

description: |
  The OWL DMA is a general-purpose direct memory access controller capable of
  supporting 10 independent DMA channels for the Actions Semi S700 SoC and 12
  independent DMA channels for the S500 and S900 SoC variants.

maintainers:
  - Manivannan Sadhasivam <manivannan.sadhasivam@linaro.org>

allOf:
  - $ref: "dma-controller.yaml#"

properties:
  compatible:
    enum:
      - actions,s500-dma
      - actions,s700-dma
      - actions,s900-dma

  reg:
    maxItems: 1

  interrupts:
    description:
      controller supports 4 interrupts, which are freely assignable to the
      DMA channels.
    maxItems: 4

  "#dma-cells":
    const: 1

  dma-channels:
    maximum: 12

  dma-requests:
    maximum: 46

  clocks:
    maxItems: 1
    description:
      Phandle and Specifier of the clock feeding the DMA controller.

  power-domains:
    maxItems: 1

required:
  - compatible
  - reg
  - interrupts
  - "#dma-cells"
  - dma-channels
  - dma-requests
  - clocks

unevaluatedProperties: false

examples:
  - |
    #include <dt-bindings/interrupt-controller/arm-gic.h>
    dma: dma-controller@e0260000 {
        compatible = "actions,s900-dma";
        reg = <0xe0260000 0x1000>;
        interrupts = <GIC_SPI 57 IRQ_TYPE_LEVEL_HIGH>,
                     <GIC_SPI 58 IRQ_TYPE_LEVEL_HIGH>,
                     <GIC_SPI 59 IRQ_TYPE_LEVEL_HIGH>,
                     <GIC_SPI 60 IRQ_TYPE_LEVEL_HIGH>;
        #dma-cells = <1>;
        dma-channels = <12>;
        dma-requests = <46>;
        clocks = <&clock 22>;
    };

...
```

## Documentation/devicetree/bindings/dma/qcom,adm.yaml
```yaml
# SPDX-License-Identifier: (GPL-2.0-only OR BSD-2-Clause)
%YAML 1.2
---
$id: http://devicetree.org/schemas/dma/qcom,adm.yaml#
$schema: http://devicetree.org/meta-schemas/core.yaml#

title: Qualcomm ADM DMA Controller

maintainers:
  - Christian Marangi <ansuelsmth@gmail.com>
  - Bjorn Andersson <bjorn.andersson@linaro.org>

description: |
  QCOM ADM DMA controller provides DMA capabilities for
  peripheral buses such as NAND and SPI.

properties:
  compatible:
    const: qcom,adm

  reg:
    maxItems: 1

  interrupts:
    maxItems: 1

  "#dma-cells":
    const: 1

  clocks:
    items:
      - description: phandle to the core clock
      - description: phandle to the iface clock

  clock-names:
    items:
      - const: core
      - const: iface

  resets:
    items:
      - description: phandle to the clk reset
      - description: phandle to the pbus reset
      - description: phandle to the c0 reset
      - description: phandle to the c1 reset
      - description: phandle to the c2 reset

  reset-names:
    items:
      - const: clk
      - const: pbus
      - const: c0
      - const: c1
      - const: c2

  qcom,ee:
    $ref: /schemas/types.yaml#/definitions/uint32
    description: indicates the security domain identifier used in the secure world.
    minimum: 0
    maximum: 255

required:
  - compatible
  - reg
  - interrupts
  - "#dma-cells"
  - clocks
  - clock-names
  - resets
  - reset-names
  - qcom,ee

additionalProperties: false

examples:
  - |
    #include <dt-bindings/clock/qcom,gcc-ipq806x.h>
    #include <dt-bindings/reset/qcom,gcc-ipq806x.h>

    adm_dma: dma-controller@18300000 {
        compatible = "qcom,adm";
        reg = <0x18300000 0x100000>;
        interrupts = <0 170 0>;
        #dma-cells = <1>;

        clocks = <&gcc ADM0_CLK>,
                  <&gcc ADM0_PBUS_CLK>;
        clock-names = "core", "iface";

        resets = <&gcc ADM0_RESET>,
                  <&gcc ADM0_PBUS_RESET>,
                  <&gcc ADM0_C0_RESET>,
                  <&gcc ADM0_C1_RESET>,
                  <&gcc ADM0_C2_RESET>;
        reset-names = "clk", "pbus", "c0", "c1", "c2";
        qcom,ee = <0>;
    };

...
```

## Documentation/devicetree/bindings/dma/qcom,bam-dma.yaml
```yaml
# SPDX-License-Identifier: (GPL-2.0-only OR BSD-2-Clause)
%YAML 1.2
---
$id: http://devicetree.org/schemas/dma/qcom,bam-dma.yaml#
$schema: http://devicetree.org/meta-schemas/core.yaml#

title: Qualcomm Technologies Inc BAM DMA controller

maintainers:
  - Andy Gross <agross@kernel.org>
  - Bjorn Andersson <andersson@kernel.org>

allOf:
  - $ref: dma-controller.yaml#

properties:
  compatible:
    oneOf:
      - enum:
          # APQ8064, IPQ8064 and MSM8960
          - qcom,bam-v1.3.0
          # MSM8974, APQ8074 and APQ8084
          - qcom,bam-v1.4.0
          # MSM8916, SDM630
          - qcom,bam-v1.7.0
      - items:
          - enum:
              # SDM845, SM6115, SM8150, SM8250 and QCM2290
              - qcom,bam-v1.7.4
          - const: qcom,bam-v1.7.0

  clocks:
    maxItems: 1

  clock-names:
    items:
      - const: bam_clk

  "#dma-cells":
    const: 1

  interrupts:
    maxItems: 1

  iommus:
    minItems: 1
    maxItems: 6

  num-channels:
    $ref: /schemas/types.yaml#/definitions/uint32
    description:
      Indicates supported number of DMA channels in a remotely controlled bam.

  qcom,controlled-remotely:
    type: boolean
    description:
      Indicates that the bam is controlled by remote proccessor i.e. execution
      environment.

  qcom,ee:
    $ref: /schemas/types.yaml#/definitions/uint32
    minimum: 0
    maximum: 7
    description:
      Indicates the active Execution Environment identifier (0-7) used in the
      secure world.

  qcom,num-ees:
    $ref: /schemas/types.yaml#/definitions/uint32
    description:
      Indicates supported number of Execution Environments in a remotely
      controlled bam.

  qcom,powered-remotely:
    type: boolean
    description:
      Indicates that the bam is powered up by a remote processor but must be
      initialized by the local processor.

  reg:
    maxItems: 1

required:
  - compatible
  - "#dma-cells"
  - interrupts
  - qcom,ee
  - reg

anyOf:
  - required:
      - qcom,powered-remotely
  - required:
      - qcom,controlled-remotely
  - required:
      - clocks
      - clock-names

additionalProperties: false

examples:
  - |
    #include <dt-bindings/interrupt-controller/arm-gic.h>
    #include <dt-bindings/clock/qcom,gcc-msm8974.h>

    dma-controller@f9944000 {
        compatible = "qcom,bam-v1.4.0";
        reg = <0xf9944000 0x19000>;
        interrupts = <GIC_SPI 239 IRQ_TYPE_LEVEL_HIGH>;
        clocks = <&gcc GCC_BLSP2_AHB_CLK>;
        clock-names = "bam_clk";
        #dma-cells = <1>;
        qcom,ee = <0>;
    };
...
```
