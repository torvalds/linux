## Documentation/devicetree/bindings/rng/ingenic,rng.yaml
```yaml
# SPDX-License-Identifier: (GPL-2.0-only OR BSD-2-Clause)
%YAML 1.2
---
$id: http://devicetree.org/schemas/rng/ingenic,rng.yaml#
$schema: http://devicetree.org/meta-schemas/core.yaml#

title: RNG in Ingenic SoCs

maintainers:
  - 周琰杰 (Zhou Yanjie) <zhouyanjie@wanyeetech.com>

description:
  The Random Number Generator in Ingenic SoCs.

properties:
  compatible:
    enum:
      - ingenic,jz4780-rng
      - ingenic,x1000-rng

  reg:
    maxItems: 1

required:
  - compatible
  - reg

additionalProperties: false

examples:
  - |
    rng: rng@d8 {
        compatible = "ingenic,jz4780-rng";
        reg = <0xd8 0x8>;
    };
...
```

## Documentation/devicetree/bindings/rng/ingenic,trng.yaml
```yaml
# SPDX-License-Identifier: (GPL-2.0-only OR BSD-2-Clause)
%YAML 1.2
---
$id: http://devicetree.org/schemas/rng/ingenic,trng.yaml#
$schema: http://devicetree.org/meta-schemas/core.yaml#

title: Bindings for DTRNG in Ingenic SoCs

maintainers:
  - 周琰杰 (Zhou Yanjie) <zhouyanjie@wanyeetech.com>

description:
  The True Random Number Generator in Ingenic SoCs.

properties:
  compatible:
    enum:
      - ingenic,x1830-dtrng

  reg:
    maxItems: 1

  clocks:
    maxItems: 1

required:
  - compatible
  - reg
  - clocks

additionalProperties: false

examples:
  - |
    #include <dt-bindings/clock/ingenic,x1830-cgu.h>

    dtrng: trng@10072000 {
        compatible = "ingenic,x1830-dtrng";
        reg = <0x10072000 0xc>;

        clocks = <&cgu X1830_CLK_DTRNG>;
    };
...
```

## Documentation/devicetree/bindings/rng/intel,ixp46x-rng.yaml
```yaml
# SPDX-License-Identifier: (GPL-2.0-only OR BSD-2-Clause)
%YAML 1.2
---
$id: http://devicetree.org/schemas/rng/intel,ixp46x-rng.yaml#
$schema: http://devicetree.org/meta-schemas/core.yaml#

title: Intel IXP46x RNG

description: |
  The Intel IXP46x has a random number generator at a fixed physical
  location in memory. Each read is guaranteed to provide a unique
  32 bit random number.

maintainers:
  - Linus Walleij <linus.walleij@linaro.org>

properties:
  compatible:
    const: intel,ixp46x-rng

  reg:
    maxItems: 1

required:
  - compatible
  - reg

additionalProperties: false

examples:
  - |
    rng@70002100 {
      compatible = "intel,ixp46x-rng";
      reg = <0x70002100 4>;
    };
```

## Documentation/devicetree/bindings/rng/ks-sa-rng.txt
```
Keystone SoC Hardware Random Number Generator(HWRNG) Module

On Keystone SoCs HWRNG module is a submodule of the Security Accelerator.

- compatible: should be "ti,keystone-rng"
- ti,syscon-sa-cfg: phandle to syscon node of the SA configuration registers.
		    This registers are shared between hwrng and crypto drivers.
- clocks: phandle to the reference clocks for the subsystem
- clock-names: functional clock name. Should be set to "fck"
- reg: HWRNG module register space

Example:
/* K2HK */

rng@24000 {
	compatible = "ti,keystone-rng";
	ti,syscon-sa-cfg = <&sa_config>;
	clocks = <&clksa>;
	clock-names = "fck";
	reg = <0x24000 0x1000>;
};
```

## Documentation/devicetree/bindings/rng/microchip,pic32-rng.txt
```
* Microchip PIC32 Random Number Generator

The PIC32 RNG provides a pseudo random number generator which can be seeded by
another true random number generator.

Required properties:
- compatible : should be "microchip,pic32mzda-rng"
- reg : Specifies base physical address and size of the registers.
- clocks: clock phandle.

Example:

	rng: rng@1f8e6000 {
		compatible = "microchip,pic32mzda-rng";
		reg = <0x1f8e6000 0x1000>;
		clocks = <&PBCLK5>;
	};
```
