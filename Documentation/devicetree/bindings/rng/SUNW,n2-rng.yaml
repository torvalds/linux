## Documentation/devicetree/bindings/rng/SUNW,n2-rng.yaml
```yaml
# SPDX-License-Identifier: (GPL-2.0-only OR BSD-2-Clause)
%YAML 1.2
---
$id: http://devicetree.org/schemas/rng/SUNW,n2-rng.yaml#
$schema: http://devicetree.org/meta-schemas/core.yaml#

title: SUN UltraSPARC HWRNG

maintainers:
  - David S. Miller <davem@davemloft.net>

properties:
  compatible:
    enum:
      - SUNW,n2-rng  # for Niagara 2 Platform (SUN UltraSPARC T2 CPU)
      - SUNW,vf-rng  # for Victoria Falls Platform (SUN UltraSPARC T2 Plus CPU)
      # for Rainbow/Yosemite Falls Platform (SUN SPARC T3/T4),
      #  (UltraSPARC KT/Niagara 3 - development names)
      #  more recent systems (after Oracle acquisition of SUN)
      - SUNW,kt-rng
      - ORCL,m4-rng  # for SPARC T5/M5
      - ORCL,m7-rng  # for SPARC T7/M7

  reg:
    maxItems: 1

  "rng-#units":
    description: Number of RNG units
    $ref: /schemas/types.yaml#/definitions/uint32
    minimum: 1

required:
  - compatible
  - reg

additionalProperties: false

# PS: see as well prtconfs.git by DaveM
examples:
  - |
    bus {
        #address-cells = <1>;
        #size-cells = <0>;

        rng@e {
            compatible = "ORCL,m4-rng";
            reg = <0xe>;
            rng-#units = <2>;
        };
    };
```

## Documentation/devicetree/bindings/rng/airoha,en7581-trng.yaml
```yaml
# SPDX-License-Identifier: (GPL-2.0-only OR BSD-2-Clause)
%YAML 1.2
---
$id: http://devicetree.org/schemas/rng/airoha,en7581-trng.yaml#
$schema: http://devicetree.org/meta-schemas/core.yaml#

title: Airoha EN7851 True Random Number Generator

maintainers:
  - Christian Marangi <ansuelsmth@gmail.com>

properties:
  compatible:
    const: airoha,en7581-trng

  reg:
    maxItems: 1

  interrupts:
    maxItems: 1

required:
  - compatible
  - reg
  - interrupts

additionalProperties: false

examples:
  - |
    #include <dt-bindings/interrupt-controller/irq.h>
    #include <dt-bindings/interrupt-controller/arm-gic.h>

    rng@1faa1000 {
        compatible = "airoha,en7581-trng";
        reg = <0x1faa1000 0x1000>;
        interrupts = <GIC_SPI 19 IRQ_TYPE_LEVEL_HIGH>;
    };
```

## Documentation/devicetree/bindings/rng/amlogic,meson-rng.txt
```
Amlogic Meson Random number generator
=====================================

Required properties:

- compatible : should be "amlogic,meson-rng"
- reg : Specifies base physical address and size of the registers.

Optional properties:

- clocks : phandle to the following named clocks
- clock-names: Name of core clock, must be "core"

Example:

rng {
	compatible = "amlogic,meson-rng";
	reg = <0x0 0xc8834000 0x0 0x4>;
	clocks = <&clkc CLKID_RNG0>;
	clock-names = "core";
};
```

## Documentation/devicetree/bindings/rng/amlogic,meson-rng.yaml
```yaml
# SPDX-License-Identifier: (GPL-2.0 OR BSD-2-Clause)
# Copyright 2019 BayLibre, SAS
%YAML 1.2
---
$id: "http://devicetree.org/schemas/rng/amlogic,meson-rng.yaml#"
$schema: "http://devicetree.org/meta-schemas/core.yaml#"

title: Amlogic Meson Random number generator

maintainers:
  - Neil Armstrong <neil.armstrong@linaro.org>

properties:
  compatible:
    enum:
      - amlogic,meson-rng

  reg:
    maxItems: 1

  clocks:
    maxItems: 1

  clock-names:
    items:
      - const: core

required:
  - compatible
  - reg

additionalProperties: false

examples:
  - |
    rng@c8834000 {
          compatible = "amlogic,meson-rng";
          reg = <0xc8834000 0x4>;
    };
```

## Documentation/devicetree/bindings/rng/apm,rng.txt
```
APM X-Gene SoC random number generator.

Required properties:

- compatible  : should be "apm,xgene-rng"
- reg         : specifies base physical address and size of the registers map
- clocks      : phandle to clock-controller plus clock-specifier pair
- interrupts  : specify the fault interrupt for the RNG device

Example:

	rng: rng@10520000 {
		compatible = "apm,xgene-rng";
		reg = <0x0 0x10520000 0x0 0x100>;
		interrupts =   <0x0 0x41 0x4>;
		clocks = <&rngpkaclk 0>;
	};
```

## Documentation/devicetree/bindings/rng/apm,x-gene-rng.yaml
```yaml
# SPDX-License-Identifier: GPL-2.0-only OR BSD-2-Clause
%YAML 1.2
---
$id: http://devicetree.org/schemas/rng/apm,x-gene-rng.yaml#
$schema: http://devicetree.org/meta-schemas/core.yaml#

title: APM X-Gene SoC Random Number Generator

maintainers:
  - Khuong Dinh <khuong@os.amperecomputing.com>

properties:
  compatible:
    const: apm,xgene-rng

  clocks:
    maxItems: 1

  interrupts:
    maxItems: 1

  reg:
    maxItems: 1

required:
  - compatible
  - clocks
  - interrupts
  - reg

additionalProperties: false

examples:
  - |
    #include <dt-bindings/interrupt-controller/arm-gic.h>

    soc {
        #address-cells = <2>;
        #size-cells = <2>;

        rng@10520000 {
            compatible = "apm,xgene-rng";
            reg = <0x0 0x10520000 0x0 0x100>;
            interrupts = <GIC_SPI 65 IRQ_TYPE_LEVEL_HIGH>;
            clocks = <&rngpkaclk 0>;
        };
    };
```

## Documentation/devicetree/bindings/rng/arm-cctrng.yaml
```yaml
# SPDX-License-Identifier: (GPL-2.0 OR BSD-2-Clause)
%YAML 1.2
---
$id: http://devicetree.org/schemas/rng/arm-cctrng.yaml#
$schema: http://devicetree.org/meta-schemas/core.yaml#

title: Arm TrustZone CryptoCell TRNG engine

maintainers:
  - Hadar Gat <hadar.gat@arm.com>

description: |+
  Arm TrustZone CryptoCell TRNG (True Random Number Generator) engine.

properties:
  compatible:
    enum:
      - arm,cryptocell-713-trng
      - arm,cryptocell-703-trng

  interrupts:
    maxItems: 1

  reg:
    maxItems: 1

  arm,rosc-ratio:
    description:
      Arm TrustZone CryptoCell TRNG engine has 4 ring oscillators.
      Sampling ratio values for these 4 ring oscillators. (from calibration)
    $ref: /schemas/types.yaml#/definitions/uint32-array
    maxItems: 4

  clocks:
    maxItems: 1

required:
  - compatible
  - interrupts
  - reg
  - arm,rosc-ratio

additionalProperties: false

examples:
  - |
    arm_cctrng: rng@60000000 {
        compatible = "arm,cryptocell-713-trng";
        interrupts = <0 29 4>;
        reg = <0x60000000 0x10000>;
        arm,rosc-ratio = <5000 1000 500 0>;
    };
```

## Documentation/devicetree/bindings/rng/atmel,at91-trng.yaml
```yaml
# SPDX-License-Identifier: GPL-2.0-only OR BSD-2-Clause
%YAML 1.2
---
$id: http://devicetree.org/schemas/rng/atmel,at91-trng.yaml#
$schema: http://devicetree.org/meta-schemas/core.yaml#

title: Atmel AT91 True Random Number Generator

maintainers:
  - Nicolas Ferre <nicolas.ferre@microchip.com>
  - Alexandre Belloni <alexandre.belloni@bootlin.com>
  - Ludovic Desroches <ludovic.desroches@microchip.com>

properties:
  compatible:
    oneOf:
      - enum:
          - atmel,at91sam9g45-trng
          - microchip,sam9x60-trng
      - items:
          - enum:
              - microchip,sama7g5-trng
          - const: atmel,at91sam9g45-trng

  clocks:
    maxItems: 1

  interrupts:
    maxItems: 1

  reg:
    maxItems: 1

required:
  - compatible
  - clocks
  - interrupts
  - reg

additionalProperties: false

examples:
  - |
    #include <dt-bindings/interrupt-controller/irq.h>

    rng@fffcc000 {
        compatible = "atmel,at91sam9g45-trng";
        reg = <0xfffcc000 0x4000>;
        interrupts = <6 IRQ_TYPE_LEVEL_HIGH 0>;
        clocks = <&trng_clk>;
    };
```

## Documentation/devicetree/bindings/rng/atmel-trng.txt
```
Atmel TRNG (True Random Number Generator) block

Required properties:
- compatible : Should be "atmel,at91sam9g45-trng" or "microchip,sam9x60-trng"
- reg : Offset and length of the register set of this block
- interrupts : the interrupt number for the TRNG block
- clocks: should contain the TRNG clk source

Example:

trng@fffcc000 {
	compatible = "atmel,at91sam9g45-trng";
	reg = <0xfffcc000 0x4000>;
	interrupts = <6 IRQ_TYPE_LEVEL_HIGH 0>;
	clocks = <&trng_clk>;
};
```

## Documentation/devicetree/bindings/rng/brcm,bcm2835.txt
```
BCM2835/6368 Random number generator

Required properties:

- compatible : should be one of
	"brcm,bcm2835-rng"
	"brcm,bcm-nsp-rng"
	"brcm,bcm5301x-rng" or
	"brcm,bcm6368-rng"
- reg : Specifies base physical address and size of the registers.

Optional properties:

- clocks : phandle to clock-controller plus clock-specifier pair
- clock-names : "ipsec" as a clock name

Optional properties:

- interrupts: specify the interrupt for the RNG block

Example:

rng {
	compatible = "brcm,bcm2835-rng";
	reg = <0x7e104000 0x10>;
	interrupts = <2 29>;
};

rng@18033000 {
	compatible = "brcm,bcm-nsp-rng";
	reg = <0x18033000 0x14>;
};

random: rng@10004180 {
	compatible = "brcm,bcm6368-rng";
	reg = <0x10004180 0x14>;

	clocks = <&periph_clk 18>;
	clock-names = "ipsec";
};
```

## Documentation/devicetree/bindings/rng/brcm,bcm2835.yaml
```yaml
# SPDX-License-Identifier: (GPL-2.0 OR BSD-2-Clause)
%YAML 1.2
---
$id: http://devicetree.org/schemas/rng/brcm,bcm2835.yaml#
$schema: http://devicetree.org/meta-schemas/core.yaml#

title: BCM2835/6368 Random number generator

maintainers:
  - Stefan Wahren <stefan.wahren@i2se.com>
  - Florian Fainelli <f.fainelli@gmail.com>
  - Herbert Xu <herbert@gondor.apana.org.au>

properties:
  compatible:
    enum:
      - brcm,bcm2835-rng
      - brcm,bcm-nsp-rng
      - brcm,bcm5301x-rng
      - brcm,bcm6368-rng

  reg:
    maxItems: 1

  clocks:
    maxItems: 1

  clock-names:
    const: ipsec

  interrupts:
    maxItems: 1

required:
  - compatible
  - reg

additionalProperties: false

examples:
  - |
    rng@7e104000 {
        compatible = "brcm,bcm2835-rng";
        reg = <0x7e104000 0x10>;
        interrupts = <2 29>;
    };

  - |
    rng@18033000 {
        compatible = "brcm,bcm-nsp-rng";
        reg = <0x18033000 0x14>;
    };

  - |
    rng@10004180 {
        compatible = "brcm,bcm6368-rng";
        reg = <0x10004180 0x14>;

        clocks = <&periph_clk 18>;
        clock-names = "ipsec";
    };
```

## Documentation/devicetree/bindings/rng/brcm,bcm6368.txt
```
BCM6368 Random number generator

Required properties:

- compatible : should be "brcm,bcm6368-rng"
- reg : Specifies base physical address and size of the registers
- clocks : phandle to clock-controller plus clock-specifier pair
- clock-names : "ipsec" as a clock name

Example:
	random: rng@10004180 {
		compatible = "brcm,bcm6368-rng";
		reg = <0x10004180 0x14>;

		clocks = <&periph_clk 18>;
		clock-names = "ipsec";
	};
```

## Documentation/devicetree/bindings/rng/brcm,bcm74110-rng.yaml
```yaml
# SPDX-License-Identifier: (GPL-2.0 OR BSD-2-Clause)
%YAML 1.2
---
$id: http://devicetree.org/schemas/rng/brcm,bcm74110-rng.yaml#
$schema: http://devicetree.org/meta-schemas/core.yaml#

title: BCM74110 Random number generator

description:
  Random number generator used on the BCM74110.

maintainers:
  - Markus Mayer <mmayer@broadcom.com>
  - Florian Fainelli <florian.fainelli@broadcom.com>

properties:
  compatible:
    enum:
      - brcm,bcm74110-rng

  reg:
    maxItems: 1

required:
  - compatible
  - reg

additionalProperties: false

examples:
  - |
    rng@83ba000 {
        compatible = "brcm,bcm74110-rng";
        reg = <0x83ba000 0x14>;
    };
```

## Documentation/devicetree/bindings/rng/brcm,iproc-rng200.txt
```
HWRNG support for the iproc-rng200 driver

Required properties:
- compatible : Must be one of:
	       "brcm,bcm2711-rng200"
	       "brcm,bcm7211-rng200"
	       "brcm,bcm7278-rng200"
	       "brcm,iproc-rng200"
- reg : base address and size of control register block

Example:

rng {
        compatible = "brcm,iproc-rng200";
        reg = <0x18032000 0x28>;
};
```

## Documentation/devicetree/bindings/rng/brcm,iproc-rng200.yaml
```yaml
# SPDX-License-Identifier: (GPL-2.0 OR BSD-2-Clause)
%YAML 1.2
---
$id: "http://devicetree.org/schemas/rng/brcm,iproc-rng200.yaml#"
$schema: "http://devicetree.org/meta-schemas/core.yaml#"

title: HWRNG support for the iproc-rng200 driver

maintainers:
  - Florian Fainelli <f.fainelli@gmail.com>

properties:
  compatible:
    enum:
      - brcm,bcm2711-rng200
      - brcm,bcm7211-rng200
      - brcm,bcm7278-rng200
      - brcm,iproc-rng200

  reg:
    maxItems: 1

additionalProperties: false

examples:
  - |
    rng@18032000 {
        compatible = "brcm,iproc-rng200";
        reg = <0x18032000 0x28>;
    };
```

## Documentation/devicetree/bindings/rng/hisi-rng.txt
```
Hisilicon Random Number Generator

Required properties:
- compatible : Should be "hisilicon,hip04-rng" or "hisilicon,hip05-rng"
- reg : Offset and length of the register set of this block

Example:

rng@d1010000 {
	compatible = "hisilicon,hip05-rng";
	reg = <0xd1010000 0x100>;
};
```

## Documentation/devicetree/bindings/rng/hisi-rng.yaml
```yaml
# SPDX-License-Identifier: (GPL-2.0-only OR BSD-2-Clause)
%YAML 1.2
---
$id: http://devicetree.org/schemas/rng/hisi-rng.yaml#
$schema: http://devicetree.org/meta-schemas/core.yaml#

title: Hisilicon Random Number Generator

maintainers:
  - Kefeng Wang <wangkefeng.wang@huawei>

properties:
  compatible:
    enum:
      - hisilicon,hip04-rng
      - hisilicon,hip05-rng

  reg:
    maxItems: 1

required:
  - compatible
  - reg

additionalProperties: false

examples:
  - |
    rng@d1010000 {
      compatible = "hisilicon,hip05-rng";
      reg = <0xd1010000 0x100>;
    };
```

## Documentation/devicetree/bindings/rng/imx-rng.txt
```
Freescale RNGA/RNGB/RNGC (Random Number Generator Versions A, B and C)

Required properties:
- compatible : should be one of
               "fsl,imx21-rnga"
               "fsl,imx31-rnga" (backward compatible with "fsl,imx21-rnga")
               "fsl,imx25-rngb"
               "fsl,imx6sl-rngb" (backward compatible with "fsl,imx25-rngb")
               "fsl,imx6sll-rngb" (backward compatible with "fsl,imx25-rngb")
               "fsl,imx6ull-rngb" (backward compatible with "fsl,imx25-rngb")
               "fsl,imx35-rngc"
- reg : offset and length of the register set of this block
- interrupts : the interrupt number for the RNG block
- clocks : the RNG clk source

Example:

rng@53fb0000 {
	compatible = "fsl,imx25-rngb";
	reg = <0x53fb0000 0x4000>;
	interrupts = <22>;
	clocks = <&trng_clk>;
};
```

## Documentation/devicetree/bindings/rng/imx-rng.yaml
```yaml
# SPDX-License-Identifier: (GPL-2.0-only OR BSD-2-Clause)
%YAML 1.2
---
$id: http://devicetree.org/schemas/rng/imx-rng.yaml#
$schema: http://devicetree.org/meta-schemas/core.yaml#

title: Freescale RNGA/RNGB/RNGC (Random Number Generator Versions A, B and C)

maintainers:
  - Vladimir Zapolskiy <vz@mleia.com>

properties:
  compatible:
    oneOf:
      - const: fsl,imx21-rnga
      - const: fsl,imx25-rngb
      - const: fsl,imx31-rnga
      - items:
          - const: fsl,imx21-rnga
      - items:
          - enum:
              - fsl,imx6sl-rngb
              - fsl,imx6sll-rngb
              - fsl,imx6ull-rngb
          - const: fsl,imx25-rngb
      - const: fsl,imx35-rngc

  reg:
    maxItems: 1

  interrupts:
    maxItems: 1

  clocks:
    maxItems: 1

required:
  - compatible
  - reg
  - interrupts
  - clocks

additionalProperties: false

examples:
  - |
    rngb@53fb0000 {
        compatible = "fsl,imx25-rngb";
        reg = <0x53fb0000 0x4000>;
        clocks = <&clks 109>;
        interrupts = <22>;
    };
```

## Documentation/devicetree/bindings/rng/imx-rngc.txt
```
Freescale RNGC (Random Number Generator Version C)

The driver also supports version B, which is mostly compatible
to version C.

Required properties:
- compatible : should be one of
               "fsl,imx25-rngb"
               "fsl,imx35-rngc"
- reg : offset and length of the register set of this block
- interrupts : the interrupt number for the RNGC block
- clocks : the RNGC clk source

Example:

rng@53fb0000 {
	compatible = "fsl,imx25-rngb";
	reg = <0x53fb0000 0x4000>;
	interrupts = <22>;
	clocks = <&trng_clk>;
};
```
