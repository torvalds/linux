## Documentation/devicetree/bindings/rng/timeriomem_rng.txt
```
HWRNG support for the timeriomem_rng driver

Required properties:
- compatible : "timeriomem_rng"
- reg : base address to sample from
- period : wait time in microseconds to use between samples

Optional properties:
- quality : estimated number of bits of true entropy per 1024 bits read from the
            rng.  Defaults to zero which causes the kernel's default quality to
            be used instead.  Note that the default quality is usually zero
            which disables using this rng to automatically fill the kernel's
            entropy pool.

N.B. currently 'reg' must be at least four bytes wide and 32-bit aligned

Example:

hwrng@44 {
	#address-cells = <1>;
	#size-cells = <1>;
	compatible = "timeriomem_rng";
	reg = <0x44 0x04>;
	period = <1000000>;
};
```

## Documentation/devicetree/bindings/rng/timeriomem_rng.yaml
```yaml
# SPDX-License-Identifier: GPL-2.0-only
%YAML 1.2
---
$id: http://devicetree.org/schemas/rng/timeriomem_rng.yaml#
$schema: http://devicetree.org/meta-schemas/core.yaml#

title: TimerIO Random Number Generator

maintainers:
  - Krzysztof Kozlowski <krzk@kernel.org>

properties:
  compatible:
    const: timeriomem_rng

  period:
    $ref: /schemas/types.yaml#/definitions/uint32
    description: wait time in microseconds to use between samples

  quality:
    $ref: /schemas/types.yaml#/definitions/uint32
    default: 0
    description:
      Estimated number of bits of true entropy per 1024 bits read from the rng.
      Defaults to zero which causes the kernel's default quality to be used
      instead.  Note that the default quality is usually zero which disables
      using this rng to automatically fill the kernel's entropy pool.

  reg:
    maxItems: 1
    description:
      Base address to sample from. Currently 'reg' must be at least four bytes
      wide and 32-bit aligned.

required:
  - compatible
  - period
  - reg

additionalProperties: false

examples:
  - |
    rng@44 {
        compatible = "timeriomem_rng";
        reg = <0x44 0x04>;
        period = <1000000>;
    };
```

## Documentation/devicetree/bindings/rng/xiphera,xip8001b-trng.yaml
```yaml
# SPDX-License-Identifier: (GPL-2.0-only OR BSD-2-Clause)
%YAML 1.2
---
$id: http://devicetree.org/schemas/rng/xiphera,xip8001b-trng.yaml#
$schema: http://devicetree.org/meta-schemas/core.yaml#

title: Xiphera XIP8001B-trng bindings

maintainers:
  - Atte Tommiska <atte.tommiska@xiphera.com>

description: |
  Xiphera FPGA-based true random number generator intellectual property core.

properties:
  compatible:
    const: xiphera,xip8001b-trng

  reg:
    maxItems: 1

required:
  - compatible
  - reg

additionalProperties: false

examples:
  - |
    rng@43c00000 {
        compatible = "xiphera,xip8001b-trng";
        reg = <0x43c00000 0x10000>;
    };
```

## Documentation/devicetree/bindings/rpmsg/rpmsg-rockchip.txt
```
* Rockchip RPMsg Platform Driver

The Rockchip RPMsg Platform Driver is used for Remote Processors Messaging.

Required Properties:

- compatible: should be one of the following.
    "rockchip,rk3568-rpmsg" for rk3568 SoCs.
- mbox-names: mailbox name for "rpmsg-rx" or "rpmsg-tx".
- mboxes: mailbox channel for rpmsg.
- rockchip,vdev-nums: number of rpmsg instance.
- rockchip,link-id: link_id of rpmsg instance. 4bit for master cpu_id and 4bit
    for remote cpu_id.

Optional Properties:

Example:

	rpmsg: rpmsg {
		compatible = "rockchip,rk3568-rpmsg";
		mbox-names = "rpmsg-rx", "rpmsg-tx";
		mboxes = <&mailbox 0 &mailbox 3>;
		rockchip,vdev-nums = <1>;
		rockchip,link-id = <0x03>;
		reg = <0x0 0x7c00000 0x0 0x20000>;
		memory-region = <&rpmsg_dma_reserved>;

		status = "okay";
	};

	reserved-memory {
		#address-cells = <2>;
		#size-cells = <2>;
		ranges;

		rpmsg_reserved: rpmsg@7c00000 {
			reg = <0x0 0x7c00000 0x0 0x400000>;
			no-map;
		};

		rpmsg_dma_reserved: rpmsg-dma@8000000 {
			compatible = "shared-dma-pool";
			reg = <0x0 0x8000000 0x0 0x100000>;
			no-map;
		};
	};
```

## Documentation/devicetree/bindings/rtc/abracon,abx80x.txt
```
Abracon ABX80X I2C ultra low power RTC/Alarm chip

The Abracon ABX80X family consist of the ab0801, ab0803, ab0804, ab0805, ab1801,
ab1803, ab1804 and ab1805. The ab0805 is the superset of ab080x and the ab1805
is the superset of ab180x.

Required properties:

 - "compatible": should one of:
        "abracon,abx80x"
        "abracon,ab0801"
        "abracon,ab0803"
        "abracon,ab0804"
        "abracon,ab0805"
        "abracon,ab1801"
        "abracon,ab1803"
        "abracon,ab1804"
        "abracon,ab1805"
	Using "abracon,abx80x" will enable chip autodetection.
 - "reg": I2C bus address of the device

Optional properties:

The abx804 and abx805 have a trickle charger that is able to charge the
connected battery or supercap. Both the following properties have to be defined
and valid to enable charging:

 - "abracon,tc-diode": should be "standard" (0.6V) or "schottky" (0.3V)
 - "abracon,tc-resistor": should be <0>, <3>, <6> or <11>. 0 disables the output
                          resistor, the other values are in ohm.
```

## Documentation/devicetree/bindings/rtc/abracon,abx80x.yaml
```yaml
# SPDX-License-Identifier: (GPL-2.0-only OR BSD-2-Clause)
%YAML 1.2
---
$id: http://devicetree.org/schemas/rtc/abracon,abx80x.yaml#
$schema: http://devicetree.org/meta-schemas/core.yaml#

title: Abracon ABX80X I2C ultra low power RTC/Alarm chip

maintainers:
  - linux-rtc@vger.kernel.org

properties:
  compatible:
    description:
      The wildcard 'abracon,abx80x' may be used to support a mix
      of different abracon rtc`s. In this case the driver
      must perform auto-detection from ID register.
    enum:
      - abracon,abx80x
      - abracon,ab0801
      - abracon,ab0803
      - abracon,ab0804
      - abracon,ab0805
      - abracon,ab1801
      - abracon,ab1803
      - abracon,ab1804
      - abracon,ab1805
      - microcrystal,rv1805

  reg:
    maxItems: 1

  interrupts:
    maxItems: 1

  abracon,tc-diode:
    description:
      Trickle-charge diode type.
      Required to enable charging backup battery.

      Supported are 'standard' diodes with a 0.6V drop
      and 'schottky' diodes with a 0.3V drop.
    $ref: /schemas/types.yaml#/definitions/string
    enum:
      - standard
      - schottky

  abracon,tc-resistor:
    description:
      Trickle-charge resistor value in kOhm.
      Required to enable charging backup battery.
    $ref: /schemas/types.yaml#/definitions/uint32
    enum: [0, 3, 6, 11]

dependentRequired:
  abracon,tc-diode: ["abracon,tc-resistor"]
  abracon,tc-resistor: ["abracon,tc-diode"]

required:
  - compatible
  - reg

allOf:
  - $ref: rtc.yaml#
  - if:
      properties:
        compatible:
          not:
            contains:
              enum:
                - abracon,abx80x
                - abracon,ab0804
                - abracon,ab1804
                - abracon,ab0805
                - abracon,ab1805
    then:
      properties:
        abracon,tc-diode: false
        abracon,tc-resistor: false

unevaluatedProperties: false

examples:
  - |
    #include <dt-bindings/interrupt-controller/irq.h>

    i2c {
        #address-cells = <1>;
        #size-cells = <0>;

        rtc@69 {
            compatible = "abracon,abx80x";
            reg = <0x69>;
            abracon,tc-diode = "schottky";
            abracon,tc-resistor = <3>;
            interrupts = <44 IRQ_TYPE_EDGE_FALLING>;
        };
    };
```

## Documentation/devicetree/bindings/rtc/adi,max31335.yaml
```yaml
# SPDX-License-Identifier: GPL-2.0-only OR BSD-2-Clause
%YAML 1.2
---
$id: http://devicetree.org/schemas/rtc/adi,max31335.yaml#
$schema: http://devicetree.org/meta-schemas/core.yaml#

title: Analog Devices MAX31335 RTC

maintainers:
  - Antoniu Miclaus <antoniu.miclaus@analog.com>

description:
  Analog Devices MAX31335 I2C RTC ±2ppm Automotive Real-Time Clock with
  Integrated MEMS Resonator.

allOf:
  - $ref: rtc.yaml#

properties:
  compatible:
    enum:
      - adi,max31331
      - adi,max31335

  reg:
    maxItems: 1

  interrupts:
    maxItems: 1

  "#clock-cells":
    description:
      RTC can be used as a clock source through its clock output pin.
    const: 0

  adi,tc-diode:
    description:
      Select the diode configuration for the trickle charger.
      schottky - Schottky diode in series.
      standard+schottky - standard diode + Schottky diode in series.
    enum: [schottky, standard+schottky]

  trickle-resistor-ohms:
    description:
      Selected resistor for trickle charger. Should be specified if trickle
      charger should be enabled.
    enum: [3000, 6000, 11000]

required:
  - compatible
  - reg

unevaluatedProperties: false

examples:
  - |
    #include <dt-bindings/interrupt-controller/irq.h>
    i2c {
        #address-cells = <1>;
        #size-cells = <0>;

        rtc@68 {
            compatible = "adi,max31335";
            reg = <0x68>;
            pinctrl-0 = <&rtc_nint_pins>;
            interrupts-extended = <&gpio1 16 IRQ_TYPE_LEVEL_HIGH>;
            aux-voltage-chargeable = <1>;
            trickle-resistor-ohms = <6000>;
            adi,tc-diode = "schottky";
        };
    };
...
```

## Documentation/devicetree/bindings/rtc/allwinner,sun4i-a10-rtc.yaml
```yaml
# SPDX-License-Identifier: GPL-2.0
%YAML 1.2
---
$id: http://devicetree.org/schemas/rtc/allwinner,sun4i-a10-rtc.yaml#
$schema: http://devicetree.org/meta-schemas/core.yaml#

title: Allwinner A10 RTC

allOf:
  - $ref: rtc.yaml#

maintainers:
  - Chen-Yu Tsai <wens@csie.org>
  - Maxime Ripard <mripard@kernel.org>

properties:
  compatible:
    enum:
      - allwinner,sun4i-a10-rtc
      - allwinner,sun7i-a20-rtc

  reg:
    maxItems: 1

  interrupts:
    maxItems: 1

required:
  - compatible
  - reg
  - interrupts

additionalProperties: false

examples:
  - |
    rtc: rtc@1c20d00 {
        compatible = "allwinner,sun4i-a10-rtc";
        reg = <0x01c20d00 0x20>;
        interrupts = <24>;
    };

...
```

## Documentation/devicetree/bindings/rtc/allwinner,sun6i-a31-rtc.yaml
```yaml
# SPDX-License-Identifier: GPL-2.0
%YAML 1.2
---
$id: http://devicetree.org/schemas/rtc/allwinner,sun6i-a31-rtc.yaml#
$schema: http://devicetree.org/meta-schemas/core.yaml#

title: Allwinner A31 RTC

maintainers:
  - Chen-Yu Tsai <wens@csie.org>
  - Maxime Ripard <mripard@kernel.org>

properties:
  "#clock-cells":
    const: 1

  compatible:
    oneOf:
      - enum:
          - allwinner,sun6i-a31-rtc
          - allwinner,sun8i-a23-rtc
          - allwinner,sun8i-h3-rtc
          - allwinner,sun8i-r40-rtc
          - allwinner,sun8i-v3-rtc
          - allwinner,sun50i-h5-rtc
          - allwinner,sun50i-h6-rtc
          - allwinner,sun50i-h616-rtc
          - allwinner,sun50i-r329-rtc
      - items:
          - const: allwinner,sun50i-a64-rtc
          - const: allwinner,sun8i-h3-rtc
      - items:
          - const: allwinner,sun20i-d1-rtc
          - const: allwinner,sun50i-r329-rtc

  reg:
    maxItems: 1

  interrupts:
    minItems: 1
    items:
      - description: RTC Alarm 0
      - description: RTC Alarm 1

  clocks:
    minItems: 1
    maxItems: 4

  clock-names:
    minItems: 1
    maxItems: 4

  clock-output-names:
    minItems: 1
    maxItems: 3
    description:
      The RTC provides up to three clocks
        - the Low Frequency Oscillator or LOSC, at index 0,
        - the Low Frequency Oscillator External output (X32KFOUT in
          the datasheet), at index 1,
        - the Internal Oscillator, at index 2.

allOf:
  - $ref: "rtc.yaml#"
  - if:
      properties:
        compatible:
          contains:
            const: allwinner,sun6i-a31-rtc

    then:
      properties:
        clock-output-names:
          maxItems: 1

  - if:
      properties:
        compatible:
          contains:
            enum:
              - allwinner,sun8i-a23-rtc
              - allwinner,sun8i-r40-rtc
              - allwinner,sun8i-v3-rtc

    then:
      properties:
        clock-output-names:
          minItems: 2
          maxItems: 2

  - if:
      properties:
        compatible:
          contains:
            enum:
              - allwinner,sun8i-h3-rtc
              - allwinner,sun50i-h5-rtc
              - allwinner,sun50i-h6-rtc

    then:
      properties:
        clock-output-names:
          minItems: 3

  - if:
      properties:
        compatible:
          contains:
            const: allwinner,sun50i-h616-rtc

    then:
      properties:
        clocks:
          items:
            - description: Bus clock for register access
            - description: 24 MHz oscillator
            - description: 32 kHz clock from the CCU

        clock-names:
          items:
            - const: bus
            - const: hosc
            - const: pll-32k

      required:
        - clocks
        - clock-names

  - if:
      properties:
        compatible:
          contains:
            const: allwinner,sun50i-r329-rtc

    then:
      properties:
        clocks:
          minItems: 3
          items:
            - description: Bus clock for register access
            - description: 24 MHz oscillator
            - description: AHB parent for internal SPI clock
            - description: External 32768 Hz oscillator

        clock-names:
          minItems: 3
          items:
            - const: bus
            - const: hosc
            - const: ahb
            - const: ext-osc32k

      required:
        - clocks
        - clock-names

  - if:
      properties:
        compatible:
          contains:
            enum:
              - allwinner,sun8i-r40-rtc
              - allwinner,sun50i-h616-rtc
              - allwinner,sun50i-r329-rtc

    then:
      properties:
        interrupts:
          maxItems: 1

    else:
      properties:
        interrupts:
          minItems: 2

required:
  - "#clock-cells"
  - compatible
  - reg
  - interrupts

additionalProperties: false

examples:
  - |
    rtc: rtc@1f00000 {
        compatible = "allwinner,sun6i-a31-rtc";
        reg = <0x01f00000 0x400>;
        interrupts = <0 40 4>, <0 41 4>;
        clock-output-names = "osc32k";
        clocks = <&ext_osc32k>;
        #clock-cells = <1>;
    };

...
```

## Documentation/devicetree/bindings/rtc/alphascale,asm9260-rtc.txt
```
* Alphascale asm9260 SoC Real Time Clock

Required properties:
- compatible: Should be "alphascale,asm9260-rtc"
- reg: Physical base address of the controller and length
       of memory mapped region.
- interrupts: IRQ line for the RTC.
- clocks: Reference to the clock entry.
- clock-names: should contain:
  * "ahb" for the SoC RTC clock

Example:
rtc0: rtc@800a0000 {
	compatible = "alphascale,asm9260-rtc";
	reg = <0x800a0000 0x100>;
	clocks = <&acc CLKID_AHB_RTC>;
	clock-names = "ahb";
	interrupts = <2>;
};
```

## Documentation/devicetree/bindings/rtc/alphascale,asm9260-rtc.yaml
```yaml
# SPDX-License-Identifier: (GPL-2.0 OR BSD-2-Clause)
%YAML 1.2
---
$id: http://devicetree.org/schemas/rtc/alphascale,asm9260-rtc.yaml#
$schema: http://devicetree.org/meta-schemas/core.yaml#

title: Alphascale asm9260 SoC Real Time Clock

maintainers:
  - Javier Carrasco <javier.carrasco.cruz@gmail.com>

allOf:
  - $ref: rtc.yaml#

properties:
  compatible:
    const: alphascale,asm9260-rtc

  reg:
    maxItems: 1

  clocks:
    maxItems: 1

  clock-names:
    const: ahb

  interrupts:
    maxItems: 1

required:
  - compatible
  - reg
  - clocks
  - clock-names
  - interrupts

unevaluatedProperties: false

examples:
  - |
    #include <dt-bindings/clock/alphascale,asm9260.h>

    rtc@800a0000 {
        compatible = "alphascale,asm9260-rtc";
        reg = <0x800a0000 0x100>;
        clocks = <&acc CLKID_AHB_RTC>;
        clock-names = "ahb";
        interrupts = <2>;
    };
```
