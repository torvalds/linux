## Documentation/devicetree/bindings/rtc/amlogic,a4-rtc.yaml
```yaml
# SPDX-License-Identifier: (GPL-2.0-only OR BSD-2-Clause)
# Copyright (C) 2024 Amlogic, Inc. All rights reserved
%YAML 1.2
---
$id: http://devicetree.org/schemas/rtc/amlogic,a4-rtc.yaml#
$schema: http://devicetree.org/meta-schemas/core.yaml#

title: Amlogic A4 and A5 RTC

maintainers:
  - Yiting Deng <yiting.deng@amlogic.com>
  - Xianwei Zhao <xianwei.zhao@amlogic.com>

allOf:
  - $ref: rtc.yaml#

properties:
  compatible:
    enum:
      - amlogic,a4-rtc
      - amlogic,a5-rtc

  reg:
    maxItems: 1

  clocks:
    items:
      - description: RTC clock source, available 24M or 32K crystal
          oscillator source. when using 24M, need to divide 24M into 32K.
      - description: RTC module accesses the clock of the apb bus.

  clock-names:
    items:
      - const: osc
      - const: sys

  interrupts:
    maxItems: 1

required:
  - compatible
  - reg
  - clocks
  - clock-names
  - interrupts

additionalProperties: false

examples:
  - |
    #include <dt-bindings/interrupt-controller/arm-gic.h>
    apb {
        #address-cells = <2>;
        #size-cells = <2>;

        rtc@8e600 {
            compatible = "amlogic,a4-rtc";
            reg = <0x0 0x8e600 0x0 0x38>;
            clocks = <&xtal_32k>, <&clkc_periphs 1>;
            clock-names = "osc", "sys";
            interrupts = <GIC_SPI 131 IRQ_TYPE_EDGE_RISING>;
        };
    };
```

## Documentation/devicetree/bindings/rtc/amlogic,meson-vrtc.yaml
```yaml
# SPDX-License-Identifier: (GPL-2.0-only OR BSD-2-Clause)
%YAML 1.2
---
$id: http://devicetree.org/schemas/rtc/amlogic,meson-vrtc.yaml#
$schema: http://devicetree.org/meta-schemas/core.yaml#

title: Amlogic Virtual RTC (VRTC)

maintainers:
  - Neil Armstrong <neil.armstrong@linaro.org>

description: |
  This is a Linux interface to an RTC managed by firmware, hence it's
  virtual from a Linux perspective.  The interface is 1 register where
  an alarm time (in seconds) is to be written.
  The alarm register is a simple scratch register shared between the
  application processors (AP) and the secure co-processor (SCP.)  When
  the AP suspends, the SCP will use the value of this register to
  program an always-on timer before going sleep. When the timer expires,
  the SCP will wake up and will then wake the AP.

allOf:
  - $ref: rtc.yaml#

properties:
  compatible:
    enum:
      - amlogic,meson-vrtc

  reg:
    maxItems: 1

required:
  - compatible
  - reg

additionalProperties: false

examples:
  - |
    rtc@a8 {
      compatible = "amlogic,meson-vrtc";
      reg = <0x000a8 0x4>;
    };
```

## Documentation/devicetree/bindings/rtc/amlogic,meson6-rtc.yaml
```yaml
# SPDX-License-Identifier: (GPL-2.0-only OR BSD-2-Clause)
%YAML 1.2
---
$id: http://devicetree.org/schemas/rtc/amlogic,meson6-rtc.yaml#
$schema: http://devicetree.org/meta-schemas/core.yaml#

title: Amlogic Meson6, Meson8, Meson8b and Meson8m2 RTC

maintainers:
  - Neil Armstrong <neil.armstrong@linaro.org>
  - Martin Blumenstingl <martin.blumenstingl@googlemail.com>

allOf:
  - $ref: rtc.yaml#
  - $ref: /schemas/nvmem/nvmem.yaml#

properties:
  compatible:
    enum:
      - amlogic,meson6-rtc
      - amlogic,meson8-rtc
      - amlogic,meson8b-rtc
      - amlogic,meson8m2-rtc

  reg:
    maxItems: 1

  clocks:
    maxItems: 1

  interrupts:
    maxItems: 1

  resets:
    maxItems: 1

  vdd-supply: true

required:
  - compatible
  - reg

unevaluatedProperties: false

examples:
  - |
    #include <dt-bindings/interrupt-controller/irq.h>
    #include <dt-bindings/interrupt-controller/arm-gic.h>
    rtc: rtc@740 {
        compatible = "amlogic,meson6-rtc";
        reg = <0x740 0x14>;
        interrupts = <GIC_SPI 72 IRQ_TYPE_EDGE_RISING>;
        clocks = <&rtc32k_xtal>;
        vdd-supply = <&rtc_vdd>;
        resets = <&reset_rtc>;
        #address-cells = <1>;
        #size-cells = <1>;

        mac@0 {
            reg = <0 6>;
        };
    };
```

## Documentation/devicetree/bindings/rtc/andestech,atcrtc100.yaml
```yaml
# SPDX-License-Identifier: (GPL-2.0-only OR BSD-2-Clause)
%YAML 1.2
---
$id: http://devicetree.org/schemas/rtc/andestech,atcrtc100.yaml#
$schema: http://devicetree.org/meta-schemas/core.yaml#

title: Andes ATCRTC100 Real-Time Clock

maintainers:
  - CL Wang <cl634@andestech.com>

allOf:
  - $ref: rtc.yaml#

properties:
  compatible:
    enum:
      - andestech,atcrtc100

  reg:
    maxItems: 1

  interrupts:
    items:
      - description: Periodic timekeeping interrupt
      - description: RTC alarm interrupt

required:
  - compatible
  - reg
  - interrupts

unevaluatedProperties: false

examples:
  - |
    #include <dt-bindings/interrupt-controller/irq.h>

    rtc@f0300000 {
        compatible = "andestech,atcrtc100";
        reg = <0xf0300000 0x100>;
        interrupts = <1 IRQ_TYPE_LEVEL_HIGH>, <2 IRQ_TYPE_LEVEL_HIGH>;
    };
```

## Documentation/devicetree/bindings/rtc/apm,xgene-rtc.yaml
```yaml
# SPDX-License-Identifier: (GPL-2.0-only OR BSD-2-Clause)
%YAML 1.2
---
$id: http://devicetree.org/schemas/rtc/apm,xgene-rtc.yaml#
$schema: http://devicetree.org/meta-schemas/core.yaml#

title: APM X-Gene Real Time Clock

maintainers:
  - Khuong Dinh <khuong@os.amperecomputing.com>

properties:
  compatible:
    const: apm,xgene-rtc

  reg:
    maxItems: 1

  interrupts:
    maxItems: 1

  '#clock-cells':
    const: 1

  clocks:
    maxItems: 1

required:
  - compatible
  - reg
  - interrupts
  - '#clock-cells'
  - clocks

additionalProperties: false

examples:
  - |
    rtc@10510000 {
        compatible = "apm,xgene-rtc";
        reg = <0x10510000 0x400>;
        interrupts = <0x0 0x46 0x4>;
        #clock-cells = <1>;
        clocks = <&rtcclk 0>;
    };
```

## Documentation/devicetree/bindings/rtc/apple,smc-rtc.yaml
```yaml
# SPDX-License-Identifier: (GPL-2.0-only OR BSD-2-Clause)
%YAML 1.2
---
$id: http://devicetree.org/schemas/rtc/apple,smc-rtc.yaml#
$schema: http://devicetree.org/meta-schemas/core.yaml#

title: Apple SMC RTC

description:
  Apple Silicon Macs (M1, etc.) have an RTC that is part of the PMU IC,
  but most of the PMU functionality is abstracted out by the SMC.
  An additional RTC offset stored inside NVMEM is required to compute
  the current date/time.

maintainers:
  - Sven Peter <sven@kernel.org>

properties:
  compatible:
    const: apple,smc-rtc

  nvmem-cells:
    items:
      - description: 48bit RTC offset, specified in 32768 (2^15) Hz clock ticks

  nvmem-cell-names:
    items:
      - const: rtc_offset

required:
  - compatible
  - nvmem-cells
  - nvmem-cell-names

additionalProperties: false
```

## Documentation/devicetree/bindings/rtc/arm,pl031.yaml
```yaml
# SPDX-License-Identifier: (GPL-2.0-only OR BSD-2-Clause)
%YAML 1.2
---
$id: http://devicetree.org/schemas/rtc/arm,pl031.yaml#
$schema: http://devicetree.org/meta-schemas/core.yaml#

title: Arm Primecell PL031 Real Time Clock

select:
  properties:
    compatible:
      contains:
        const: arm,pl031
  required:
    - compatible

allOf:
  - $ref: rtc.yaml#

maintainers:
  - Rob Herring <robh@kernel.org>

properties:
  compatible:
    items:
      - const: arm,pl031
      - const: arm,primecell

  reg:
    maxItems: 1

  interrupts:
    maxItems: 1

  clocks:
    maxItems: 1

  clock-names:
    maxItems: 1

  start-year: true

required:
  - compatible
  - reg
  - clocks
  - clock-names

additionalProperties: false

examples:
  - |
    rtc@10017000 {
        compatible = "arm,pl031", "arm,primecell";
        reg = <0x10017000 0x1000>;
        clocks = <&pclk>;
        clock-names = "apb_pclk";
    };
```

## Documentation/devicetree/bindings/rtc/armada-380-rtc.txt
```
* Real Time Clock of the Armada 38x/7K/8K SoCs

RTC controller for the Armada 38x, 7K and 8K SoCs

Required properties:
- compatible : Should be one of the following:
	"marvell,armada-380-rtc" for Armada 38x SoC
	"marvell,armada-8k-rtc" for Aramda 7K/8K SoCs
- reg: a list of base address and size pairs, one for each entry in
  reg-names
- reg names: should contain:
  * "rtc" for the RTC registers
  * "rtc-soc" for the SoC related registers and among them the one
    related to the interrupt.
- interrupts: IRQ line for the RTC.

Example:

rtc@a3800 {
	compatible = "marvell,armada-380-rtc";
	reg = <0xa3800 0x20>, <0x184a0 0x0c>;
	reg-names = "rtc", "rtc-soc";
	interrupts = <GIC_SPI 21 IRQ_TYPE_LEVEL_HIGH>;
};
```

## Documentation/devicetree/bindings/rtc/atmel,at91rm9200-rtc.txt
```
Atmel AT91RM9200 Real Time Clock

Required properties:
- compatible: should be: "atmel,at91rm9200-rtc" or "atmel,at91sam9x5-rtc"
- reg: physical base address of the controller and length of memory mapped
  region.
- interrupts: rtc alarm/event interrupt
- clocks: phandle to input clock.

Example:

rtc@fffffe00 {
	compatible = "atmel,at91rm9200-rtc";
	reg = <0xfffffe00 0x100>;
	interrupts = <1 4 7>;
	clocks = <&clk32k>;
};
```

## Documentation/devicetree/bindings/rtc/atmel,at91rm9200-rtc.yaml
```yaml
# SPDX-License-Identifier: GPL-2.0
%YAML 1.2
---
$id: http://devicetree.org/schemas/rtc/atmel,at91rm9200-rtc.yaml#
$schema: http://devicetree.org/meta-schemas/core.yaml#

title: Atmel AT91 RTC

allOf:
  - $ref: rtc.yaml#

maintainers:
  - Alexandre Belloni <alexandre.belloni@bootlin.com>

properties:
  compatible:
    oneOf:
      - enum:
          - atmel,at91rm9200-rtc
          - atmel,at91sam9x5-rtc
          - atmel,sama5d4-rtc
          - atmel,sama5d2-rtc
          - microchip,sam9x60-rtc
          - microchip,sama7g5-rtc
      - items:
          - enum:
              - microchip,sam9x7-rtc
              - microchip,sama7d65-rtc
          - const: microchip,sam9x60-rtc

  reg:
    maxItems: 1

  interrupts:
    maxItems: 1

  clocks:
    maxItems: 1

required:
  - compatible
  - reg
  - interrupts
  - clocks

additionalProperties: false

examples:
  - |
    rtc@fffffe00 {
        compatible = "atmel,at91rm9200-rtc";
        reg = <0xfffffe00 0x100>;
        interrupts = <1 4 7>;
        clocks = <&clk32k>;
    };
...
```

## Documentation/devicetree/bindings/rtc/atmel,at91sam9-rtc.txt
```
Atmel AT91SAM9260 Real Time Timer

Required properties:
- compatible: should be: "atmel,at91sam9260-rtt"
- reg: should encode the memory region of the RTT controller
- interrupts: rtt alarm/event interrupt
- clocks: should contain the 32 KHz slow clk that will drive the RTT block.
- atmel,rtt-rtc-time-reg: should encode the GPBR register used to store
	the time base when the RTT is used as an RTC.
	The first cell should point to the GPBR node and the second one
	encode the offset within the GPBR block (or in other words, the
	GPBR register used to store the time base).


Example:

rtt@fffffd20 {
	compatible = "atmel,at91sam9260-rtt";
	reg = <0xfffffd20 0x10>;
	interrupts = <1 4 7>;
	clocks = <&clk32k>;
	atmel,rtt-rtc-time-reg = <&gpbr 0x0>;
};
```

## Documentation/devicetree/bindings/rtc/atmel,at91sam9260-rtt.yaml
```yaml
# SPDX-License-Identifier: (GPL-2.0-only OR BSD-2-Clause)
# Copyright (C) 2022 Microchip Technology, Inc. and its subsidiaries
%YAML 1.2
---
$id: http://devicetree.org/schemas/rtc/atmel,at91sam9260-rtt.yaml#
$schema: http://devicetree.org/meta-schemas/core.yaml#

title: Atmel AT91 RTT

allOf:
  - $ref: "rtc.yaml#"

maintainers:
  - Alexandre Belloni <alexandre.belloni@bootlin.com>

properties:
  compatible:
    oneOf:
      - items:
          - const: atmel,at91sam9260-rtt
      - items:
          - const: microchip,sam9x60-rtt
          - const: atmel,at91sam9260-rtt
      - items:
          - const: microchip,sama7g5-rtt
          - const: microchip,sam9x60-rtt
          - const: atmel,at91sam9260-rtt

  reg:
    maxItems: 1

  interrupts:
    maxItems: 1

  clocks:
    maxItems: 1

  atmel,rtt-rtc-time-reg:
    $ref: /schemas/types.yaml#/definitions/phandle-array
    items:
      - items:
          - description: Phandle to the GPBR node.
          - description: Offset within the GPBR block.
    description:
      Should encode the GPBR register used to store the time base when the
      RTT is used as an RTC. The first cell should point to the GPBR node
      and the second one encodes the offset within the GPBR block (or in
      other words, the GPBR register used to store the time base).

required:
  - compatible
  - reg
  - interrupts
  - clocks
  - atmel,rtt-rtc-time-reg

unevaluatedProperties: false

examples:
  - |
    #include <dt-bindings/interrupt-controller/irq.h>

    rtc@fffffd20 {
        compatible = "atmel,at91sam9260-rtt";
        reg = <0xfffffd20 0x10>;
        interrupts = <1 IRQ_TYPE_LEVEL_HIGH 7>;
        clocks = <&clk32k>;
        atmel,rtt-rtc-time-reg = <&gpbr 0x0>;
    };
```

## Documentation/devicetree/bindings/rtc/brcm,brcmstb-waketimer.txt
```
Broadcom STB wake-up Timer

The Broadcom STB wake-up timer provides a 27Mhz resolution timer, with the
ability to wake up the system from low-power suspend/standby modes.

Required properties:
- compatible     : should contain "brcm,brcmstb-waketimer"
- reg            : the register start and length for the WKTMR block
- interrupts     : The TIMER interrupt
- clocks	 : The phandle to the UPG fixed clock (27Mhz domain)

Example:

waketimer@f0411580 {
	compatible = "brcm,brcmstb-waketimer";
	reg = <0xf0411580 0x14>;
	interrupts = <0x3>;
	interrupt-parent = <&aon_pm_l2_intc>;
	clocks = <&upg_fixed>;
};
```

## Documentation/devicetree/bindings/rtc/brcm,brcmstb-waketimer.yaml
```yaml
# SPDX-License-Identifier: (GPL-2.0-only OR BSD-2-Clause)
%YAML 1.2
---
$id: http://devicetree.org/schemas/rtc/brcm,brcmstb-waketimer.yaml#
$schema: http://devicetree.org/meta-schemas/core.yaml#

title: Broadcom STB wake-up Timer

maintainers:
  - Florian Fainelli <f.fainelli@gmail.com>

description:
  The Broadcom STB wake-up timer provides a 27Mhz resolution timer, with the
  ability to wake up the system from low-power suspend/standby modes and
  optionally generate RTC alarm interrupts.

allOf:
  - $ref: "rtc.yaml#"

properties:
  compatible:
    const: brcm,brcmstb-waketimer

  reg:
    maxItems: 1

  interrupts:
    minItems: 1
    items:
      - description: the TIMER interrupt
      - description: the ALARM interrupt
    description:
      The TIMER interrupt wakes the system from low-power suspend/standby modes.
      An ALARM interrupt may be specified to interrupt the CPU when an RTC alarm
      is enabled.

  clocks:
    description: clock reference in the 27MHz domain
    maxItems: 1

additionalProperties: false

examples:
  - |
    rtc@f041a080 {
        compatible = "brcm,brcmstb-waketimer";
        reg = <0xf041a080 0x14>;
        interrupts-extended = <&aon_pm_l2_intc 0x04>,
                              <&upg_aux_aon_intr2_intc 0x08>;
        clocks = <&upg_fixed>;
    };
```
