## Documentation/devicetree/bindings/rng/samsung,exynos5250-trng.txt
```
Exynos True Random Number Generator

Required properties:

- compatible  : Should be "samsung,exynos5250-trng".
- reg         : Specifies base physical address and size of the registers map.
- clocks      : Phandle to clock-controller plus clock-specifier pair.
- clock-names : "secss" as a clock name.

Example:

	rng@10830600 {
		compatible = "samsung,exynos5250-trng";
		reg = <0x10830600 0x100>;
		clocks = <&clock CLK_SSS>;
		clock-names = "secss";
	};
```

## Documentation/devicetree/bindings/rng/samsung,exynos5250-trng.yaml
```yaml
# SPDX-License-Identifier: (GPL-2.0 OR BSD-2-Clause)
%YAML 1.2
---
$id: http://devicetree.org/schemas/rng/samsung,exynos5250-trng.yaml#
$schema: http://devicetree.org/meta-schemas/core.yaml#

title: Samsung Exynos SoC True Random Number Generator

maintainers:
  - Krzysztof Kozlowski <krzk@kernel.org>
  - Łukasz Stelmach <l.stelmach@samsung.com>

properties:
  compatible:
    enum:
      - samsung,exynos5250-trng
      - samsung,exynos850-trng

  clocks:
    minItems: 1
    maxItems: 2

  clock-names:
    minItems: 1
    maxItems: 2

  reg:
    maxItems: 1

required:
  - compatible
  - clocks
  - clock-names
  - reg

allOf:
  - if:
      properties:
        compatible:
          contains:
            const: samsung,exynos850-trng

    then:
      properties:
        clocks:
          items:
            - description: SSS (Security Sub System) operating clock
            - description: SSS (Security Sub System) bus clock

        clock-names:
          items:
            - const: secss
            - const: pclk

    else:
      properties:
        clocks:
          items:
            - description: SSS (Security Sub System) operating clock

        clock-names:
          items:
            - const: secss

additionalProperties: false

examples:
  - |
    #include <dt-bindings/clock/exynos5250.h>

    rng@10830600 {
        compatible = "samsung,exynos5250-trng";
        reg = <0x10830600 0x100>;
        clocks = <&clock CLK_SSS>;
        clock-names = "secss";
    };
```

## Documentation/devicetree/bindings/rng/silex-insight,ba431-rng.yaml
```yaml
# SPDX-License-Identifier: (GPL-2.0-only OR BSD-2-Clause)
%YAML 1.2
---
$id: http://devicetree.org/schemas/rng/silex-insight,ba431-rng.yaml#
$schema: http://devicetree.org/meta-schemas/core.yaml#

title: Silex Insight BA431 RNG bindings

description: |
  The BA431 hardware random number generator is an IP that is FIPS-140-2/3
  certified.

maintainers:
  - Olivier Sobrie <olivier.sobrie@silexinsight.com>

properties:
  compatible:
    const: silex-insight,ba431-rng

  reg:
    maxItems: 1

required:
  - compatible
  - reg

additionalProperties: false

examples:
  - |
    rng@42800000 {
      compatible = "silex-insight,ba431-rng";
      reg = <0x42800000 0x1000>;
    };

...
```

## Documentation/devicetree/bindings/rng/st,rng.txt
```
STMicroelectronics HW Random Number Generator
----------------------------------------------

Required parameters:
compatible	: Should be "st,rng"
reg		: Base address and size of IP's register map.
clocks		: Phandle to device's clock (See: ../clocks/clock-bindings.txt)

Example:

rng@fee80000 {
	compatible      = "st,rng";
	reg		= <0xfee80000 0x1000>;
	clocks          = <&clk_sysin>;
}
```

## Documentation/devicetree/bindings/rng/st,rng.yaml
```yaml
# SPDX-License-Identifier: GPL-2.0-only OR BSD-2-Clause
%YAML 1.2
---
$id: http://devicetree.org/schemas/rng/st,rng.yaml#
$schema: http://devicetree.org/meta-schemas/core.yaml#

title: STMicroelectronics Hardware Random Number Generator

maintainers:
  - Patrice Chotard <patrice.chotard@foss.st.com>

properties:
  compatible:
    const: st,rng

  clocks:
    maxItems: 1

  reg:
    maxItems: 1

required:
  - compatible
  - clocks
  - reg

additionalProperties: false

examples:
  - |
    rng@fee80000 {
        compatible = "st,rng";
        reg = <0xfee80000 0x1000>;
        clocks = <&clk_sysin>;
    };
```

## Documentation/devicetree/bindings/rng/st,stm32-rng.txt
```
STMicroelectronics STM32 HW RNG
===============================

The STM32 hardware random number generator is a simple fixed purpose IP and
is fully separated from other crypto functions.

Required properties:

- compatible : Should be "st,stm32-rng"
- reg : Should be register base and length as documented in the datasheet
- interrupts : The designated IRQ line for the RNG
- clocks : The clock needed to enable the RNG

Example:

	rng: rng@50060800 {
		compatible = "st,stm32-rng";
		reg = <0x50060800 0x400>;
		interrupts = <80>;
		clocks = <&rcc 0 38>;
	};
```

## Documentation/devicetree/bindings/rng/st,stm32-rng.yaml
```yaml
# SPDX-License-Identifier: (GPL-2.0-only OR BSD-2-Clause)
%YAML 1.2
---
$id: http://devicetree.org/schemas/rng/st,stm32-rng.yaml#
$schema: http://devicetree.org/meta-schemas/core.yaml#

title: STMicroelectronics STM32 RNG bindings

description: |
  The STM32 hardware random number generator is a simple fixed purpose
  IP and is fully separated from other crypto functions.

maintainers:
  - Lionel Debieve <lionel.debieve@foss.st.com>

properties:
  compatible:
    const: st,stm32-rng

  reg:
    maxItems: 1

  clocks:
    maxItems: 1

  resets:
    maxItems: 1

  clock-error-detect:
    type: boolean
    description: If set enable the clock detection management

required:
  - compatible
  - reg
  - clocks

additionalProperties: false

examples:
  - |
    #include <dt-bindings/clock/stm32mp1-clks.h>
    rng@54003000 {
      compatible = "st,stm32-rng";
      reg = <0x54003000 0x400>;
      clocks = <&rcc RNG1_K>;
    };

...
```

## Documentation/devicetree/bindings/rng/starfive,jh7110-trng.yaml
```yaml
# SPDX-License-Identifier: (GPL-2.0-only OR BSD-2-Clause)
%YAML 1.2
---
$id: http://devicetree.org/schemas/rng/starfive,jh7110-trng.yaml#
$schema: http://devicetree.org/meta-schemas/core.yaml#

title: StarFive SoC TRNG Module

maintainers:
  - Jia Jie Ho <jiajie.ho@starfivetech.com>

properties:
  compatible:
    const: starfive,jh7110-trng

  reg:
    maxItems: 1

  clocks:
    items:
      - description: Hardware reference clock
      - description: AHB reference clock

  clock-names:
    items:
      - const: hclk
      - const: ahb

  resets:
    maxItems: 1

  interrupts:
    maxItems: 1

required:
  - compatible
  - reg
  - clocks
  - clock-names
  - resets
  - interrupts

additionalProperties: false

examples:
  - |
    rng: rng@1600C000 {
        compatible = "starfive,jh7110-trng";
        reg = <0x1600C000 0x4000>;
        clocks = <&clk 15>, <&clk 16>;
        clock-names = "hclk", "ahb";
        resets = <&reset 3>;
        interrupts = <30>;
    };
...
```

## Documentation/devicetree/bindings/rng/ti,keystone-rng.yaml
```yaml
# SPDX-License-Identifier: GPL-2.0-only OR BSD-2-Clause
%YAML 1.2
---
$id: http://devicetree.org/schemas/rng/ti,keystone-rng.yaml#
$schema: http://devicetree.org/meta-schemas/core.yaml#

title: Keystone SoC Hardware Random Number Generator

maintainers:
  - Nishanth Menon <nm@ti.com>
  - Santosh Shilimkar <ssantosh@kernel.org>

properties:
  compatible:
    const: ti,keystone-rng

  clocks:
    maxItems: 1

  clock-names:
    items:
      - const: fck

  reg:
    maxItems: 1

  ti,syscon-sa-cfg:
    $ref: /schemas/types.yaml#/definitions/phandle
    description: |
      Phandle to syscon node of the SA configuration registers.  These
      registers are shared between HWRNG and crypto drivers.

required:
  - compatible
  - clocks
  - clock-names
  - reg
  - ti,syscon-sa-cfg

additionalProperties: false

examples:
  - |
    rng@24000 {
        compatible = "ti,keystone-rng";
        ti,syscon-sa-cfg = <&sa_config>;
        clocks = <&clksa>;
        clock-names = "fck";
        reg = <0x24000 0x1000>;
    };
```

## Documentation/devicetree/bindings/rng/ti,omap-rom-rng.yaml
```yaml
# SPDX-License-Identifier: GPL-2.0-only OR BSD-2-Clause
%YAML 1.2
---
$id: http://devicetree.org/schemas/rng/ti,omap-rom-rng.yaml#
$schema: http://devicetree.org/meta-schemas/core.yaml#

title: OMAP ROM Random Number Generator

maintainers:
  - Pali Rohár <pali@kernel.org>
  - Tony Lindgren <tony@atomide.com>

description:
  Secure SoCs may provide RNG via secure ROM calls like Nokia N900 does.
  The implementation can depend on the SoC secure ROM used.

properties:
  compatible:
    const: nokia,n900-rom-rng

  clocks:
    maxItems: 1

  clock-names:
    items:
      - const: ick

required:
  - compatible
  - clocks
  - clock-names

additionalProperties: false

examples:
  - |
    rng {
        compatible = "nokia,n900-rom-rng";
        clocks = <&rng_ick>;
        clock-names = "ick";
    };
```
