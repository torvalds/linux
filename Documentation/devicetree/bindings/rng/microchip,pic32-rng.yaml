## Documentation/devicetree/bindings/rng/microchip,pic32-rng.yaml
```yaml
# SPDX-License-Identifier: (GPL-2.0-only OR BSD-2-Clause)
%YAML 1.2
---
$id: http://devicetree.org/schemas/rng/microchip,pic32-rng.yaml#
$schema: http://devicetree.org/meta-schemas/core.yaml#

title: Microchip PIC32 Random Number Generator

description: |
  The PIC32 RNG provides a pseudo random number generator which can be seeded
  by another true random number generator.

maintainers:
  - Joshua Henderson <joshua.henderson@microchip.com>

properties:
  compatible:
    enum:
      - microchip,pic32mzda-rng

  reg:
    maxItems: 1

  clocks:
    maxItems: 1

required:
  - compatible
  - reg
  - clocks

additionalProperties: false

examples:
  - |
    rng: rng@1f8e6000 {
      compatible = "microchip,pic32mzda-rng";
      reg = <0x1f8e6000 0x1000>;
      clocks = <&PBCLK5>;
    };
```

## Documentation/devicetree/bindings/rng/microsoft,vmgenid.yaml
```yaml
# SPDX-License-Identifier: (GPL-2.0-only OR BSD-2-Clause)
%YAML 1.2
---
$id: http://devicetree.org/schemas/rng/microsoft,vmgenid.yaml#
$schema: http://devicetree.org/meta-schemas/core.yaml#

title: Virtual Machine Generation ID

maintainers:
  - Jason A. Donenfeld <Jason@zx2c4.com>

description:
  Firmwares or hypervisors can use this devicetree to describe an
  interrupt and a shared resource to inject a Virtual Machine Generation ID.
  Virtual Machine Generation ID is a globally unique identifier (GUID) and
  the devicetree binding follows VMGenID specification defined in
  http://go.microsoft.com/fwlink/?LinkId=260709.

properties:
  compatible:
    const: microsoft,vmgenid

  reg:
    description:
      Specifies a 16-byte VMGenID in endianness-agnostic hexadecimal format.
    maxItems: 1

  interrupts:
    description:
      Interrupt used to notify that a new VMGenID is available.
    maxItems: 1

required:
  - compatible
  - reg
  - interrupts

additionalProperties: false

examples:
  - |
    #include <dt-bindings/interrupt-controller/arm-gic.h>
    rng@80000000 {
      compatible = "microsoft,vmgenid";
      reg = <0x80000000 0x1000>;
      interrupts = <GIC_SPI 35 IRQ_TYPE_EDGE_RISING>;
    };

...
```

## Documentation/devicetree/bindings/rng/mtk-rng.txt
```
Device-Tree bindings for Mediatek random number generator
found in MediaTek SoC family

Required properties:
- compatible	    : Should be
			"mediatek,mt7622-rng", 	"mediatek,mt7623-rng" : for MT7622
			"mediatek,mt7629-rng",  "mediatek,mt7623-rng" : for MT7629
			"mediatek,mt7623-rng" : for MT7623
			"mediatek,mt8516-rng", "mediatek,mt7623-rng" : for MT8516
- clocks	    : list of clock specifiers, corresponding to
		      entries in clock-names property;
- clock-names	    : Should contain "rng" entries;
- reg 		    : Specifies base physical address and size of the registers

Example:

rng: rng@1020f000 {
	compatible = "mediatek,mt7623-rng";
	reg = <0 0x1020f000 0 0x1000>;
	clocks = <&infracfg CLK_INFRA_TRNG>;
	clock-names = "rng";
};
```

## Documentation/devicetree/bindings/rng/mtk-rng.yaml
```yaml
# SPDX-License-Identifier: (GPL-2.0 OR BSD-2-Clause)
%YAML 1.2
---
$id: http://devicetree.org/schemas/rng/mtk-rng.yaml#
$schema: http://devicetree.org/meta-schemas/core.yaml#

title: MediaTek Random number generator

maintainers:
  - Sean Wang <sean.wang@mediatek.com>

properties:
  $nodename:
    pattern: "^rng(@[0-9a-f]+)?$"

  compatible:
    oneOf:
      - enum:
          - mediatek,mt7623-rng
          - mediatek,mt7981-rng
      - items:
          - enum:
              - mediatek,mt7622-rng
              - mediatek,mt7629-rng
              - mediatek,mt7986-rng
              - mediatek,mt8365-rng
              - mediatek,mt8516-rng
          - const: mediatek,mt7623-rng
      - items:
          - enum:
              - mediatek,mt7987-rng
              - mediatek,mt7988-rng
          - const: mediatek,mt7981-rng

  reg:
    maxItems: 1

  clocks:
    maxItems: 1

  clock-names:
    items:
      - const: rng

required:
  - compatible

allOf:
  - if:
      properties:
        compatible:
          contains:
            const: mediatek,mt7981-rng
    then:
      properties:
        reg: false
        clocks: false
        clock-names: false
    else:
      required:
        - reg
        - clocks
        - clock-names

additionalProperties: false

examples:
  - |
    #include <dt-bindings/clock/mt2701-clk.h>

    rng@1020f000 {
        compatible = "mediatek,mt7623-rng";
        reg = <0x1020f000 0x1000>;
        clocks = <&infracfg CLK_INFRA_TRNG>;
        clock-names = "rng";
    };
  - |
    rng {
        compatible = "mediatek,mt7981-rng";
    };
```

## Documentation/devicetree/bindings/rng/nuvoton,npcm-rng.txt
```
NPCM SoC Random Number Generator

Required properties:
- compatible  : "nuvoton,npcm750-rng" for the NPCM7XX BMC.
- reg         : Specifies physical base address and size of the registers.

Example:

rng: rng@f000b000 {
	compatible = "nuvoton,npcm750-rng";
	reg = <0xf000b000 0x8>;
};
```

## Documentation/devicetree/bindings/rng/nuvoton,npcm-rng.yaml
```yaml
# SPDX-License-Identifier: GPL-2.0-only OR BSD-2-Clause
%YAML 1.2
---
$id: http://devicetree.org/schemas/rng/nuvoton,npcm-rng.yaml#
$schema: http://devicetree.org/meta-schemas/core.yaml#

title: Nuvoton NPCM SoC Random Number Generator

maintainers:
  - Avi Fishman <avifishman70@gmail.com>
  - Tomer Maimon <tmaimon77@gmail.com>
  - Tali Perry <tali.perry1@gmail.com>
  - Patrick Venture <venture@google.com>
  - Nancy Yuen <yuenn@google.com>
  - Benjamin Fair <benjaminfair@google.com>

properties:
  compatible:
    const: nuvoton,npcm750-rng

  reg:
    maxItems: 1

required:
  - compatible
  - reg

additionalProperties: false

examples:
  - |
    rng@f000b000 {
        compatible = "nuvoton,npcm750-rng";
        reg = <0xf000b000 0x8>;
    };
```

## Documentation/devicetree/bindings/rng/omap3_rom_rng.txt
```
OMAP ROM RNG driver binding

Secure SoCs may provide RNG via secure ROM calls like Nokia N900 does. The
implementation can depend on the SoC secure ROM used.

- compatible:
	Usage: required
	Value type: <string>
	Definition: must be "nokia,n900-rom-rng"

- clocks:
	Usage: required
	Value type: <prop-encoded-array>
	Definition: reference to the the RNG interface clock

- clock-names:
	Usage: required
	Value type: <stringlist>
	Definition: must be "ick"

Example:

	rom_rng: rng {
		compatible = "nokia,n900-rom-rng";
		clocks = <&rng_ick>;
		clock-names = "ick";
	};
```

## Documentation/devicetree/bindings/rng/omap_rng.txt
```
OMAP SoC and Inside-Secure HWRNG Module

Required properties:

- compatible : Should contain entries for this and backward compatible
  RNG versions:
  - "ti,omap2-rng" for OMAP2.
  - "ti,omap4-rng" for OMAP4, OMAP5 and AM33XX.
  - "inside-secure,safexcel-eip76" for SoCs with EIP76 IP block
  Note that these two versions are incompatible.
- ti,hwmods: Name of the hwmod associated with the RNG module
- reg : Offset and length of the register set for the module
- interrupts : the interrupt number for the RNG module.
		Used for "ti,omap4-rng" and "inside-secure,safexcel-eip76"
- clocks: the trng clock source. Only mandatory for the
  "inside-secure,safexcel-eip76" compatible, the second clock is
  needed for the Armada 7K/8K SoCs
- clock-names: mandatory if there is a second clock, in this case the
  name must be "core" for the first clock and "reg" for the second
  one


Example:
/* AM335x */
rng: rng@48310000 {
	compatible = "ti,omap4-rng";
	ti,hwmods = "rng";
	reg = <0x48310000 0x2000>;
	interrupts = <111>;
};

/* SafeXcel IP-76 */
trng: rng@f2760000 {
	compatible = "inside-secure,safexcel-eip76";
	reg = <0xf2760000 0x7d>;
	interrupts = <GIC_SPI 59 IRQ_TYPE_LEVEL_HIGH>;
	clocks = <&cpm_syscon0 1 25>;
};
```

## Documentation/devicetree/bindings/rng/omap_rng.yaml
```yaml
# SPDX-License-Identifier: (GPL-2.0-only OR BSD-2-Clause)
%YAML 1.2
---
$id: http://devicetree.org/schemas/rng/omap_rng.yaml#
$schema: http://devicetree.org/meta-schemas/core.yaml#

title: OMAP SoC and Inside-Secure HWRNG Module

maintainers:
  - Jayesh Choudhary <j-choudhary@ti.com>

properties:
  compatible:
    enum:
      - ti,omap2-rng
      - ti,omap4-rng
      - inside-secure,safexcel-eip76

  ti,hwmods:
    const: rng
    deprecated: true
    description: Name of the hwmod associated with the RNG module

  reg:
    maxItems: 1

  interrupts:
    maxItems: 1

  clocks:
    minItems: 1
    items:
      - description: EIP150 gatable clock
      - description: Main gatable clock

  clock-names:
    minItems: 1
    items:
      - const: core
      - const: reg


allOf:
  - if:
      properties:
        compatible:
          contains:
            enum:
              - ti,omap4-rng
              - inside-secure,safexcel-eip76

    then:
      required:
        - interrupts


required:
  - compatible
  - reg

additionalProperties: false

examples:
  - |
    /* AM335x */
    rng: rng@48310000 {
            compatible = "ti,omap4-rng";
            ti,hwmods = "rng";
            reg = <0x48310000 0x2000>;
            interrupts = <111>;
    };
  - |
    /* SafeXcel IP-76 */
    trng: rng@f2760000 {
            compatible = "inside-secure,safexcel-eip76";
            reg = <0xf2760000 0x7d>;
            interrupts = <0 59 4>;
            clocks = <&cpm_syscon0 1 25>;
    };

...
```

## Documentation/devicetree/bindings/rng/qcom,prng.txt
```
Qualcomm MSM pseudo random number generator.

Required properties:

- compatible  : should be "qcom,prng"
- reg         : specifies base physical address and size of the registers map
- clocks      : phandle to clock-controller plus clock-specifier pair
- clock-names : "core" clocks all registers, FIFO and circuits in PRNG IP block

Example:

	rng@f9bff000 {
		compatible = "qcom,prng";
		reg = <0xf9bff000 0x200>;
		clocks = <&clock GCC_PRNG_AHB_CLK>;
		clock-names = "core";
	};
```

## Documentation/devicetree/bindings/rng/rockchip,rk3568-rng.yaml
```yaml
# SPDX-License-Identifier: (GPL-2.0-only OR BSD-2-Clause)
%YAML 1.2
---
$id: http://devicetree.org/schemas/rng/rockchip,rk3568-rng.yaml#
$schema: http://devicetree.org/meta-schemas/core.yaml#

title: Rockchip RK3568 TRNG

description: True Random Number Generator on Rockchip RK3568 SoC

maintainers:
  - Aurelien Jarno <aurelien@aurel32.net>
  - Daniel Golle <daniel@makrotopia.org>

properties:
  compatible:
    enum:
      - rockchip,rk3568-rng

  reg:
    maxItems: 1

  clocks:
    items:
      - description: TRNG clock
      - description: TRNG AHB clock

  clock-names:
    items:
      - const: core
      - const: ahb

  resets:
    maxItems: 1

required:
  - compatible
  - reg
  - clocks
  - clock-names
  - resets

additionalProperties: false

examples:
  - |
    #include <dt-bindings/clock/rk3568-cru.h>
    bus {
      #address-cells = <2>;
      #size-cells = <2>;

      rng@fe388000 {
        compatible = "rockchip,rk3568-rng";
        reg = <0x0 0xfe388000 0x0 0x4000>;
        clocks = <&cru CLK_TRNG_NS>, <&cru HCLK_TRNG_NS>;
        clock-names = "core", "ahb";
        resets = <&cru SRST_TRNG_NS>;
      };
    };

...
```

## Documentation/devicetree/bindings/rng/rockchip,rk3588-rng.yaml
```yaml
# SPDX-License-Identifier: (GPL-2.0-only OR BSD-2-Clause)
%YAML 1.2
---
$id: http://devicetree.org/schemas/rng/rockchip,rk3588-rng.yaml#
$schema: http://devicetree.org/meta-schemas/core.yaml#

title: Rockchip RK3588 TRNG

description: True Random Number Generator on Rockchip RK3588 SoC

maintainers:
  - Nicolas Frattaroli <nicolas.frattaroli@collabora.com>

properties:
  compatible:
    enum:
      - rockchip,rk3588-rng

  reg:
    maxItems: 1

  clocks:
    items:
      - description: TRNG AHB clock

  interrupts:
    maxItems: 1

  resets:
    maxItems: 1

required:
  - compatible
  - reg
  - clocks
  - interrupts

additionalProperties: false

examples:
  - |
    #include <dt-bindings/clock/rockchip,rk3588-cru.h>
    #include <dt-bindings/interrupt-controller/arm-gic.h>
    #include <dt-bindings/interrupt-controller/irq.h>
    #include <dt-bindings/reset/rockchip,rk3588-cru.h>
    bus {
      #address-cells = <2>;
      #size-cells = <2>;

      rng@fe378000 {
        compatible = "rockchip,rk3588-rng";
        reg = <0x0 0xfe378000 0x0 0x200>;
        interrupts = <GIC_SPI 400 IRQ_TYPE_LEVEL_HIGH 0>;
        clocks = <&scmi_clk SCMI_HCLK_SECURE_NS>;
        resets = <&scmi_reset SCMI_SRST_H_TRNG_NS>;
      };
    };

...
```

## Documentation/devicetree/bindings/rng/rockchip,rng.txt
```
Rockchip Hardware Random Number Generator

Required properties:

- compatible  : should be one of the following.
		"rockchip,cryptov1-rng" for crypto v1
		"rockchip,cryptov2-rng" for crypto v2
- reg         : Specifies base physical address and size of the registers map.
- clocks      : Phandle to clock-controller plus clock-specifier pair.
- clock-names : "clk_crypto", "clk_crypto_apk", "aclk_crypto", "hclk_crypto" as a clock name.
- assigned-clocks: Main clock, should be <&cru SCLK_CRYPTO>, <&cru SCLK_CRYPTO_APK>,
		<&cru ACLK_CRYPTO>, <&cru HCLK_CRYPTO>
- assigned-clock-rates : The rng core clk frequency, shall be: <150000000>, <150000000>,
		<200000000>, <100000000>
- resets      : Used for module reset
- reset-names : Reset names, should be "reset"
Example:

	rng: rng@100fc000 {
		compatible = "rockchip,cryptov1-rng";
		reg = <0x100fc000 0x4000>;
		clocks = <&cru SCLK_CRYPTO>, <&cru HCLK_CRYPTO>;
		clock-names = "clk_crypto", "hclk_crypto";
		assigned-clocks = <&cru SCLK_CRYPTO>, <&cru HCLK_CRYPTO>;
		assigned-clock-rates = <150000000>, <100000000>;
		resets = <&cru SRST_CRYPTO>;
		reset-names = "reset";
		status = "disabled";
	};

	rng: rng@ff2f0000 {
		compatible = "rockchip,cryptov2-rng";
		reg = <0x0 0xff2f0000 0x0 0x4000>;
		clocks = <&cru SCLK_CRYPTO>, <&cru SCLK_CRYPTO_APK>,
			<&cru ACLK_CRYPTO>, <&cru HCLK_CRYPTO>;
		clock-names = "clk_crypto", "clk_crypto_apk",
			"aclk_crypto", "hclk_crypto";
		assigned-clocks = <&cru SCLK_CRYPTO>, <&cru SCLK_CRYPTO_APK>,
				<&cru ACLK_CRYPTO>, <&cru HCLK_CRYPTO>;
		assigned-clock-rates = <150000000>, <150000000>,
					<200000000>, <100000000>;
		resets = <&cru SRST_CRYPTO>;
		reset-names = "reset";
	};
```

## Documentation/devicetree/bindings/rng/samsung,exynos4-rng.txt
```
Exynos Pseudo Random Number Generator

Required properties:

- compatible  : One of:
                - "samsung,exynos4-rng" for Exynos4210 and Exynos4412
                - "samsung,exynos5250-prng" for Exynos5250+
- reg         : Specifies base physical address and size of the registers map.
- clocks      : Phandle to clock-controller plus clock-specifier pair.
- clock-names : "secss" as a clock name.

Example:

	rng@10830400 {
		compatible = "samsung,exynos4-rng";
		reg = <0x10830400 0x200>;
		clocks = <&clock CLK_SSS>;
		clock-names = "secss";
	};
```

## Documentation/devicetree/bindings/rng/samsung,exynos4-rng.yaml
```yaml
# SPDX-License-Identifier: GPL-2.0
%YAML 1.2
---
$id: http://devicetree.org/schemas/rng/samsung,exyyess4-rng.yaml#
$schema: http://devicetree.org/meta-schemas/core.yaml#

title: Samsung Exyyess SoC Pseudo Random Number Generator

maintainers:
  - Krzysztof Kozlowski <krzk@kernel.org>

properties:
  compatible:
    enum:
      - samsung,exyyess4-rng                   # for Exyyess4210 and Exyyess4412
      - samsung,exyyess5250-prng               # for Exyyess5250+

  reg:
    maxItems: 1

  clocks:
    maxItems: 1

  clock-names:
    items:
      - const: secss

required:
  - compatible
  - reg
  - clock-names
  - clocks

additionalProperties: false

examples:
  - |
    #include <dt-bindings/clock/exyyess4.h>

    rng@10830400 {
        compatible = "samsung,exyyess4-rng";
        reg = <0x10830400 0x200>;
        clocks = <&clock CLK_SSS>;
        clock-names = "secss";
    };
```
