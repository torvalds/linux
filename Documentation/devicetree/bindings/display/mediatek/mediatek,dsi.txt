## Documentation/devicetree/bindings/display/mediatek/mediatek,mt8195-hdmi.yaml
```yaml
# SPDX-License-Identifier: (GPL-2.0-only OR BSD-2-Clause)
%YAML 1.2
---
$id: http://devicetree.org/schemas/display/mediatek/mediatek,mt8195-hdmi.yaml#
$schema: http://devicetree.org/meta-schemas/core.yaml#

title: MediaTek MT8195 series HDMI-TX Encoder

maintainers:
  - AngeloGioacchino Del Regno <angelogioacchino.delregno@collabora.com>
  - CK Hu <ck.hu@mediatek.com>

description:
  The MediaTek HDMI-TX v2 encoder can generate HDMI format data based on
  the HDMI Specification 2.0b.

properties:
  compatible:
    enum:
      - mediatek,mt8188-hdmi-tx
      - mediatek,mt8195-hdmi-tx

  reg:
    maxItems: 1

  interrupts:
    maxItems: 1

  clocks:
    items:
      - description: HDMI Peripheral Bus (APB) clock
      - description: HDCP and HDMI_TOP clock
      - description: HDCP, HDMI_TOP and HDMI Audio reference clock
      - description: VPP HDMI Split clock

  clock-names:
    items:
      - const: bus
      - const: hdcp
      - const: hdcp24m
      - const: hdmi-split

  i2c:
    type: object
    $ref: /schemas/display/mediatek/mediatek,mt8195-hdmi-ddc.yaml
    unevaluatedProperties: false
    description: HDMI DDC I2C controller

  phys:
    maxItems: 1
    description: PHY providing clocking TMDS and pixel to controller

  phy-names:
    items:
      - const: hdmi

  power-domains:
    maxItems: 1

  '#sound-dai-cells':
    const: 1

  ports:
    $ref: /schemas/graph.yaml#/properties/ports

    properties:
      port@0:
        $ref: /schemas/graph.yaml#/properties/port
        description:
          Input port, usually connected to the output port of a DPI

      port@1:
        $ref: /schemas/graph.yaml#/properties/port
        description:
          Output port that must be connected either to the input port of
          a HDMI connector node containing a ddc-i2c-bus, or to the input
          port of an attached bridge chip, such as a SlimPort transmitter.

    required:
      - port@0
      - port@1

required:
  - compatible
  - reg
  - interrupts
  - clocks
  - clock-names
  - power-domains
  - phys
  - phy-names
  - ports

allOf:
  - $ref: /schemas/sound/dai-common.yaml#

additionalProperties: false

examples:
  - |
    #include <dt-bindings/clock/mt8195-clk.h>
    #include <dt-bindings/interrupt-controller/arm-gic.h>
    #include <dt-bindings/power/mt8195-power.h>

    soc {
        #address-cells = <2>;
        #size-cells = <2>;

        hdmi@1c300000 {
            compatible = "mediatek,mt8195-hdmi-tx";
            reg = <0 0x1c300000 0 0x1000>;
            clocks = <&topckgen CLK_TOP_HDMI_APB>,
                     <&topckgen CLK_TOP_HDCP>,
                     <&topckgen CLK_TOP_HDCP_24M>,
                     <&vppsys1 CLK_VPP1_VPP_SPLIT_HDMI>;
            clock-names = "bus", "hdcp", "hdcp24m", "hdmi-split";
            interrupts = <GIC_SPI 677 IRQ_TYPE_LEVEL_HIGH 0>;
            phys = <&hdmi_phy>;
            phy-names = "hdmi";
            power-domains = <&spm MT8195_POWER_DOMAIN_HDMI_TX>;
            pinctrl-names = "default";
            pinctrl-0 = <&hdmi_pins>;
            #sound-dai-cells = <1>;

            hdmitx_ddc: i2c {
                compatible = "mediatek,mt8195-hdmi-ddc";
                clocks = <&clk26m>;
            };

            ports {
                #address-cells = <1>;
                #size-cells = <0>;

                port@0 {
                    reg = <0>;

                    hdmi_in: endpoint {
                        remote-endpoint = <&dpi1_out>;
                    };
                };

                port@1 {
                    reg = <1>;

                    hdmi_out: endpoint {
                        remote-endpoint = <&hdmi_connector_in>;
                    };
                };
            };
        };
    };
```

## Documentation/devicetree/bindings/display/mediatek/mediatek,mutex.yaml
```yaml
# SPDX-License-Identifier: (GPL-2.0-only OR BSD-2-Clause)
%YAML 1.2
---
$id: http://devicetree.org/schemas/display/mediatek/mediatek,mutex.yaml#
$schema: http://devicetree.org/meta-schemas/core.yaml#

title: Mediatek mutex

maintainers:
  - Chun-Kuang Hu <chunkuang.hu@kernel.org>
  - Philipp Zabel <p.zabel@pengutronix.de>

description: |
  Mediatek mutex, namely MUTEX, is used to send the triggers signals called
  Start Of Frame (SOF) / End Of Frame (EOF) to each sub-modules on the display
  data path or MDP data path.
  In some SoC, such as mt2701, MUTEX could be a hardware mutex which protects
  the shadow register.
  MUTEX device node must be siblings to the central MMSYS_CONFIG node.
  For a description of the MMSYS_CONFIG binding, see
  Documentation/devicetree/bindings/arm/mediatek/mediatek,mmsys.yaml
  for details.

properties:
  compatible:
    enum:
      - mediatek,mt2701-disp-mutex
      - mediatek,mt2712-disp-mutex
      - mediatek,mt8167-disp-mutex
      - mediatek,mt8173-disp-mutex
      - mediatek,mt8183-disp-mutex
      - mediatek,mt8186-disp-mutex
      - mediatek,mt8192-disp-mutex
      - mediatek,mt8195-disp-mutex

  reg:
    maxItems: 1

  interrupts:
    maxItems: 1

  power-domains:
    description: A phandle and PM domain specifier as defined by bindings of
      the power controller specified by phandle. See
      Documentation/devicetree/bindings/power/power-domain.yaml for details.

  clocks:
    items:
      - description: MUTEX Clock

  mediatek,gce-events:
    description:
      The event id which is mapping to the specific hardware event signal
      to gce. The event id is defined in the gce header
      include/dt-bindings/gce/<chip>-gce.h of each chips.
    $ref: /schemas/types.yaml#/definitions/uint32-array

required:
  - compatible
  - reg
  - interrupts
  - power-domains
  - clocks

additionalProperties: false

examples:
  - |
    #include <dt-bindings/interrupt-controller/arm-gic.h>
    #include <dt-bindings/clock/mt8173-clk.h>
    #include <dt-bindings/power/mt8173-power.h>
    #include <dt-bindings/gce/mt8173-gce.h>

    soc {
        #address-cells = <2>;
        #size-cells = <2>;

        mutex: mutex@14020000 {
            compatible = "mediatek,mt8173-disp-mutex";
            reg = <0 0x14020000 0 0x1000>;
            interrupts = <GIC_SPI 169 IRQ_TYPE_LEVEL_LOW>;
            power-domains = <&spm MT8173_POWER_DOMAIN_MM>;
            clocks = <&mmsys CLK_MM_MUTEX_32K>;
            mediatek,gce-events = <CMDQ_EVENT_MUTEX0_STREAM_EOF>,
                                  <CMDQ_EVENT_MUTEX1_STREAM_EOF>;
        };
    };
```

## Documentation/devicetree/bindings/display/mediatek/mediatek,od.yaml
```yaml
# SPDX-License-Identifier: (GPL-2.0-only OR BSD-2-Clause)
%YAML 1.2
---
$id: http://devicetree.org/schemas/display/mediatek/mediatek,od.yaml#
$schema: http://devicetree.org/meta-schemas/core.yaml#

title: Mediatek display overdirve

maintainers:
  - Chun-Kuang Hu <chunkuang.hu@kernel.org>
  - Philipp Zabel <p.zabel@pengutronix.de>

description: |
  Mediatek display overdrive, namely OD, increases the transition values
  of pixels between consecutive frames to make LCD rotate faster.
  OD device node must be siblings to the central MMSYS_CONFIG node.
  For a description of the MMSYS_CONFIG binding, see
  Documentation/devicetree/bindings/arm/mediatek/mediatek,mmsys.yaml
  for details.

properties:
  compatible:
    oneOf:
      - enum:
          - mediatek,mt2712-disp-od
          - mediatek,mt8173-disp-od
      - items:
          - const: mediatek,mt6795-disp-od
          - const: mediatek,mt8173-disp-od

  reg:
    maxItems: 1

  interrupts:
    maxItems: 1

  clocks:
    items:
      - description: OD Clock

  ports:
    $ref: /schemas/graph.yaml#/properties/ports
    description:
      Input and output ports can have multiple endpoints, each of those
      connects to either the primary, secondary, etc, display pipeline.

    properties:
      port@0:
        $ref: /schemas/graph.yaml#/properties/port
        description: OD input port, usually from an AAL block

      port@1:
        $ref: /schemas/graph.yaml#/properties/port
        description:
          OD output to the input of the next desired component in the
          display pipeline, for example one of the available RDMA or
          other blocks.

    required:
      - port@0
      - port@1

required:
  - compatible
  - reg
  - clocks

additionalProperties: false

examples:
  - |
    #include <dt-bindings/clock/mt8173-clk.h>

    soc {
        #address-cells = <2>;
        #size-cells = <2>;

        od@14023000 {
            compatible = "mediatek,mt8173-disp-od";
            reg = <0 0x14023000 0 0x1000>;
            clocks = <&mmsys CLK_MM_DISP_OD>;
        };
    };
```

## Documentation/devicetree/bindings/display/mediatek/mediatek,ovl-2l.yaml
```yaml
# SPDX-License-Identifier: (GPL-2.0-only OR BSD-2-Clause)
%YAML 1.2
---
$id: http://devicetree.org/schemas/display/mediatek/mediatek,ovl-2l.yaml#
$schema: http://devicetree.org/meta-schemas/core.yaml#

title: Mediatek display overlay 2 layer

maintainers:
  - Chun-Kuang Hu <chunkuang.hu@kernel.org>
  - Philipp Zabel <p.zabel@pengutronix.de>

description: |
  Mediatek display overlay 2 layer, namely OVL-2L, provides 2 more layer
  for OVL.
  OVL-2L device node must be siblings to the central MMSYS_CONFIG node.
  For a description of the MMSYS_CONFIG binding, see
  Documentation/devicetree/bindings/arm/mediatek/mediatek,mmsys.yaml
  for details.

properties:
  compatible:
    oneOf:
      - items:
          - const: mediatek,mt8183-disp-ovl-2l
      - items:
          - const: mediatek,mt8192-disp-ovl-2l

  reg:
    maxItems: 1

  interrupts:
    maxItems: 1

  power-domains:
    description: A phandle and PM domain specifier as defined by bindings of
      the power controller specified by phandle. See
      Documentation/devicetree/bindings/power/power-domain.yaml for details.

  clocks:
    items:
      - description: OVL-2L Clock

  iommus:
    description:
      This property should point to the respective IOMMU block with master port as argument,
      see Documentation/devicetree/bindings/iommu/mediatek,iommu.yaml for details.

  mediatek,gce-client-reg:
    description: The register of client driver can be configured by gce with
      4 arguments defined in this property, such as phandle of gce, subsys id,
      register offset and size. Each GCE subsys id is mapping to a client
      defined in the header include/dt-bindings/gce/<chip>-gce.h.
    $ref: /schemas/types.yaml#/definitions/phandle-array
    maxItems: 1

required:
  - compatible
  - reg
  - interrupts
  - power-domains
  - clocks
  - iommus

additionalProperties: false

examples:
  - |

    ovl_2l0: ovl@14009000 {
        compatible = "mediatek,mt8183-disp-ovl-2l";
        reg = <0 0x14009000 0 0x1000>;
        interrupts = <GIC_SPI 226 IRQ_TYPE_LEVEL_LOW>;
        power-domains = <&spm MT8183_POWER_DOMAIN_DISP>;
        clocks = <&mmsys CLK_MM_DISP_OVL0_2L>;
        iommus = <&iommu M4U_PORT_DISP_2L_OVL0_LARB0>;
        mediatek,gce-client-reg = <&gce SUBSYS_1400XXXX 0x9000 0x1000>;
    };
```

## Documentation/devicetree/bindings/display/mediatek/mediatek,ovl.yaml
```yaml
# SPDX-License-Identifier: (GPL-2.0-only OR BSD-2-Clause)
%YAML 1.2
---
$id: http://devicetree.org/schemas/display/mediatek/mediatek,ovl.yaml#
$schema: http://devicetree.org/meta-schemas/core.yaml#

title: Mediatek display overlay

maintainers:
  - Chun-Kuang Hu <chunkuang.hu@kernel.org>
  - Philipp Zabel <p.zabel@pengutronix.de>

description: |
  Mediatek display overlay, namely OVL, can do alpha blending from
  the memory.
  OVL device node must be siblings to the central MMSYS_CONFIG node.
  For a description of the MMSYS_CONFIG binding, see
  Documentation/devicetree/bindings/arm/mediatek/mediatek,mmsys.yaml
  for details.

properties:
  compatible:
    oneOf:
      - items:
          - const: mediatek,mt2701-disp-ovl
      - items:
          - const: mediatek,mt8173-disp-ovl
      - items:
          - const: mediatek,mt8183-disp-ovl
      - items:
          - const: mediatek,mt8192-disp-ovl
      - items:
          - enum:
              - mediatek,mt7623-disp-ovl
              - mediatek,mt2712-disp-ovl
          - enum:
              - mediatek,mt2701-disp-ovl
      - items:
          - enum:
              - mediatek,mt8195-disp-ovl
          - enum:
              - mediatek,mt8183-disp-ovl

  reg:
    maxItems: 1

  interrupts:
    maxItems: 1

  power-domains:
    description: A phandle and PM domain specifier as defined by bindings of
      the power controller specified by phandle. See
      Documentation/devicetree/bindings/power/power-domain.yaml for details.

  clocks:
    items:
      - description: OVL Clock

  iommus:
    description:
      This property should point to the respective IOMMU block with master port as argument,
      see Documentation/devicetree/bindings/iommu/mediatek,iommu.yaml for details.

  mediatek,larb:
    description:
      This property should contain a phandle pointing to the local arbiter devices defined in
      Documentation/devicetree/bindings/memory-controllers/mediatek,smi-larb.yaml.
      It must sort according to the local arbiter index, like larb0, larb1, larb2...
    $ref: /schemas/types.yaml#/definitions/phandle-array
    minItems: 1
    maxItems: 32

  mediatek,gce-client-reg:
    description: The register of client driver can be configured by gce with
      4 arguments defined in this property, such as phandle of gce, subsys id,
      register offset and size. Each GCE subsys id is mapping to a client
      defined in the header include/dt-bindings/gce/<chip>-gce.h.
    $ref: /schemas/types.yaml#/definitions/phandle-array
    maxItems: 1

required:
  - compatible
  - reg
  - interrupts
  - power-domains
  - clocks
  - iommu

additionalProperties: false

examples:
  - |

    ovl0: ovl@1400c000 {
        compatible = "mediatek,mt8173-disp-ovl";
        reg = <0 0x1400c000 0 0x1000>;
        interrupts = <GIC_SPI 180 IRQ_TYPE_LEVEL_LOW>;
        power-domains = <&scpsys MT8173_POWER_DOMAIN_MM>;
        clocks = <&mmsys CLK_MM_DISP_OVL0>;
        iommus = <&iommu M4U_PORT_DISP_OVL0>;
        mediatek,larb = <&larb0>;
        mediatek,gce-client-reg = <&gce SUBSYS_1400XXXX 0xc000 0x1000>;
    };
```
