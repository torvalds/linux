## Documentation/devicetree/bindings/display/mediatek/mediatek,padding.yaml
```yaml
# SPDX-License-Identifier: (GPL-2.0-only OR BSD-2-Clause)
%YAML 1.2
---
$id: http://devicetree.org/schemas/display/mediatek/mediatek,padding.yaml#
$schema: http://devicetree.org/meta-schemas/core.yaml#

title: MediaTek Display Padding

maintainers:
  - Chun-Kuang Hu <chunkuang.hu@kernel.org>
  - Philipp Zabel <p.zabel@pengutronix.de>

description:
  Padding provides ability to add pixels to width and height of a layer with
  specified colors. Due to hardware design, Mixer in VDOSYS1 requires
  width of a layer to be 2-pixel-align, or 4-pixel-align when ETHDR is enabled,
  we need Padding to deal with odd width.
  Please notice that even if the Padding is in bypass mode, settings in
  register must be cleared to 0, or undefined behaviors could happen.

properties:
  compatible:
    enum:
      - mediatek,mt8188-disp-padding
      - mediatek,mt8195-mdp3-padding

  reg:
    maxItems: 1

  power-domains:
    maxItems: 1

  clocks:
    items:
      - description: Padding's clocks

  mediatek,gce-client-reg:
    description:
      GCE (Global Command Engine) is a multi-core micro processor that helps
      its clients to execute commands without interrupting CPU. This property
      describes GCE client's information that is composed by 4 fields.
      1. Phandle of the GCE (there may be several GCE processors)
      2. Sub-system ID defined in the dt-binding like a user ID
         (Please refer to include/dt-bindings/gce/<chip>-gce.h)
      3. Offset from base address of the subsys you are at
      4. Size of the register the client needs
    $ref: /schemas/types.yaml#/definitions/phandle-array
    items:
      items:
        - description: Phandle of the GCE
        - description: Subsys ID defined in the dt-binding
        - description: Offset from base address of the subsys
        - description: Size of register
    maxItems: 1

required:
  - compatible
  - reg
  - power-domains
  - clocks
  - mediatek,gce-client-reg

additionalProperties: false

examples:
  - |
    #include <dt-bindings/interrupt-controller/arm-gic.h>
    #include <dt-bindings/clock/mediatek,mt8188-clk.h>
    #include <dt-bindings/power/mediatek,mt8188-power.h>
    #include <dt-bindings/gce/mt8195-gce.h>

    soc {
        #address-cells = <2>;
        #size-cells = <2>;

        padding0: padding@1c11d000 {
            compatible = "mediatek,mt8188-disp-padding";
            reg = <0 0x1c11d000 0 0x1000>;
            clocks = <&vdosys1 CLK_VDO1_PADDING0>;
            power-domains = <&spm MT8188_POWER_DOMAIN_VDOSYS1>;
            mediatek,gce-client-reg = <&gce0 SUBSYS_1c11XXXX 0xd000 0x1000>;
        };
    };
```

## Documentation/devicetree/bindings/display/mediatek/mediatek,postmask.yaml
```yaml
# SPDX-License-Identifier: (GPL-2.0-only OR BSD-2-Clause)
%YAML 1.2
---
$id: http://devicetree.org/schemas/display/mediatek/mediatek,postmask.yaml#
$schema: http://devicetree.org/meta-schemas/core.yaml#

title: Mediatek display postmask

maintainers:
  - Chun-Kuang Hu <chunkuang.hu@kernel.org>
  - Philipp Zabel <p.zabel@pengutronix.de>

description: |
  Mediatek display postmask, namely POSTMASK, provides round corner pattern
  generation.
  POSTMASK device node must be siblings to the central MMSYS_CONFIG node.
  For a description of the MMSYS_CONFIG binding, see
  Documentation/devicetree/bindings/arm/mediatek/mediatek,mmsys.yaml
  for details.

properties:
  compatible:
    oneOf:
      - enum:
          - mediatek,mt8192-disp-postmask
      - items:
          - enum:
              - mediatek,mt8186-disp-postmask
              - mediatek,mt8188-disp-postmask
          - const: mediatek,mt8192-disp-postmask

  reg:
    maxItems: 1

  interrupts:
    maxItems: 1

  power-domains:
    description: A phandle and PM domain specifier as defined by bindings of
      the power controller specified by phandle. See
      Documentation/devicetree/bindings/power/power-domain.yaml for details.

  clocks:
    items:
      - description: POSTMASK Clock

  mediatek,gce-client-reg:
    description: The register of client driver can be configured by gce with
      4 arguments defined in this property, such as phandle of gce, subsys id,
      register offset and size. Each GCE subsys id is mapping to a client
      defined in the header include/dt-bindings/gce/<chip>-gce.h.
    $ref: /schemas/types.yaml#/definitions/phandle-array
    maxItems: 1

  ports:
    $ref: /schemas/graph.yaml#/properties/ports
    description:
      Input and output ports can have multiple endpoints, each of those
      connects to either the primary, secondary, etc, display pipeline.

    properties:
      port@0:
        $ref: /schemas/graph.yaml#/properties/port
        description: POSTMASK input port, usually from GAMMA

      port@1:
        $ref: /schemas/graph.yaml#/properties/port
        description:
          POSTMASK output to the input of the next desired component in the
          display pipeline, for example one of the available DITHER blocks.

    required:
      - port@0
      - port@1

required:
  - compatible
  - reg
  - interrupts
  - power-domains
  - clocks

additionalProperties: false

examples:
  - |
    #include <dt-bindings/interrupt-controller/arm-gic.h>
    #include <dt-bindings/clock/mt8192-clk.h>
    #include <dt-bindings/power/mt8192-power.h>
    #include <dt-bindings/gce/mt8192-gce.h>

    soc {
        #address-cells = <2>;
        #size-cells = <2>;

        postmask0: postmask@1400d000 {
            compatible = "mediatek,mt8192-disp-postmask";
            reg = <0 0x1400d000 0 0x1000>;
            interrupts = <GIC_SPI 262 IRQ_TYPE_LEVEL_HIGH 0>;
            power-domains = <&scpsys MT8192_POWER_DOMAIN_DISP>;
            clocks = <&mmsys CLK_MM_DISP_POSTMASK0>;
            mediatek,gce-client-reg = <&gce SUBSYS_1400XXXX 0xd000 0x1000>;
        };
    };
```

## Documentation/devicetree/bindings/display/mediatek/mediatek,rdma.yaml
```yaml
# SPDX-License-Identifier: (GPL-2.0-only OR BSD-2-Clause)
%YAML 1.2
---
$id: http://devicetree.org/schemas/display/mediatek/mediatek,rdma.yaml#
$schema: http://devicetree.org/meta-schemas/core.yaml#

title: Mediatek Read Direct Memory Access

maintainers:
  - Chun-Kuang Hu <chunkuang.hu@kernel.org>
  - Philipp Zabel <p.zabel@pengutronix.de>

description: |
  Mediatek Read Direct Memory Access(RDMA) component used to read the
  data into DMA. It provides real time data to the back-end panel
  driver, such as DSI, DPI and DP_INTF.
  It contains one line buffer to store the sufficient pixel data.
  RDMA device node must be siblings to the central MMSYS_CONFIG node.
  For a description of the MMSYS_CONFIG binding, see
  Documentation/devicetree/bindings/arm/mediatek/mediatek,mmsys.yaml
  for details.

properties:
  compatible:
    oneOf:
      - items:
          - const: mediatek,mt2701-disp-rdma
      - items:
          - const: mediatek,mt8173-disp-rdma
      - items:
          - const: mediatek,mt8183-disp-rdma
      - items:
          - enum:
              - mediatek,mt7623-disp-rdma
              - mediatek,mt2712-disp-rdma
          - enum:
              - mediatek,mt2701-disp-rdma
      - items:
          - enum:
              - mediatek,mt8192-disp-rdma
          - enum:
              - mediatek,mt8183-disp-rdma

  reg:
    maxItems: 1

  interrupts:
    maxItems: 1

  power-domains:
    description: A phandle and PM domain specifier as defined by bindings of
      the power controller specified by phandle. See
      Documentation/devicetree/bindings/power/power-domain.yaml for details.

  clocks:
    items:
      - description: RDMA Clock

  iommus:
    description:
      This property should point to the respective IOMMU block with master port as argument,
      see Documentation/devicetree/bindings/iommu/mediatek,iommu.yaml for details.

  mediatek,larb:
    description:
      This property should contain a phandle pointing to the local arbiter devices defined in
      Documentation/devicetree/bindings/memory-controllers/mediatek,smi-larb.yaml.
      It must sort according to the local arbiter index, like larb0, larb1, larb2...
    $ref: /schemas/types.yaml#/definitions/phandle-array
    minItems: 1
    maxItems: 32

  mediatek,rdma-fifo-size:
    description:
      rdma fifo size may be different even in same SOC, add this property to the
      corresponding rdma.
      The value below is the Max value which defined in hardware data sheet
      mediatek,rdma-fifo-size of mt8173-rdma0 is 8K
      mediatek,rdma-fifo-size of mt8183-rdma0 is 5K
      mediatek,rdma-fifo-size of mt8183-rdma1 is 2K
    $ref: /schemas/types.yaml#/definitions/uint32
    enum: [8192, 5120, 2048]

  mediatek,gce-client-reg:
    description: The register of client driver can be configured by gce with
      4 arguments defined in this property, such as phandle of gce, subsys id,
      register offset and size. Each GCE subsys id is mapping to a client
      defined in the header include/dt-bindings/gce/<chip>-gce.h.
    $ref: /schemas/types.yaml#/definitions/phandle-array
    maxItems: 1

required:
  - compatible
  - reg
  - interrupts
  - power-domains
  - clocks
  - iommus

additionalProperties: false

examples:
  - |

    rdma0: rdma@1400e000 {
        compatible = "mediatek,mt8173-disp-rdma";
        reg = <0 0x1400e000 0 0x1000>;
        interrupts = <GIC_SPI 182 IRQ_TYPE_LEVEL_LOW>;
        power-domains = <&scpsys MT8173_POWER_DOMAIN_MM>;
        clocks = <&mmsys CLK_MM_DISP_RDMA0>;
        iommus = <&iommu M4U_PORT_DISP_RDMA0>;
        mediatek,larb = <&larb0>;
        mediatek,rdma-fifosize = <8192>;
        mediatek,gce-client-reg = <&gce SUBSYS_1400XXXX 0xe000 0x1000>;
    };
```

## Documentation/devicetree/bindings/display/mediatek/mediatek,split.yaml
```yaml
# SPDX-License-Identifier: (GPL-2.0-only OR BSD-2-Clause)
%YAML 1.2
---
$id: http://devicetree.org/schemas/display/mediatek/mediatek,split.yaml#
$schema: http://devicetree.org/meta-schemas/core.yaml#

title: Mediatek display split

maintainers:
  - Chun-Kuang Hu <chunkuang.hu@kernel.org>
  - Philipp Zabel <p.zabel@pengutronix.de>

description: |
  Mediatek display split, namely SPLIT, is used to split stream to two
  encoders.
  SPLIT device node must be siblings to the central MMSYS_CONFIG node.
  For a description of the MMSYS_CONFIG binding, see
  Documentation/devicetree/bindings/arm/mediatek/mediatek,mmsys.yaml
  for details.

properties:
  compatible:
    oneOf:
      - enum:
          - mediatek,mt8173-disp-split
          - mediatek,mt8195-mdp3-split
      - items:
          - const: mediatek,mt6795-disp-split
          - const: mediatek,mt8173-disp-split

  reg:
    maxItems: 1

  interrupts:
    maxItems: 1

  power-domains:
    description: A phandle and PM domain specifier as defined by bindings of
      the power controller specified by phandle. See
      Documentation/devicetree/bindings/power/power-domain.yaml for details.

  mediatek,gce-client-reg:
    description:
      The register of display function block to be set by gce. There are 4 arguments,
      such as gce node, subsys id, offset and register size. The subsys id that is
      mapping to the register of display function blocks is defined in the gce header
      include/dt-bindings/gce/<chip>-gce.h of each chips.
    $ref: /schemas/types.yaml#/definitions/phandle-array
    items:
      items:
        - description: phandle of GCE
        - description: GCE subsys id
        - description: register offset
        - description: register size
    maxItems: 1

  clocks:
    items:
      - description: SPLIT Clock

required:
  - compatible
  - reg
  - power-domains
  - clocks

allOf:
  - if:
      properties:
        compatible:
          contains:
            const: mediatek,mt8195-mdp3-split

    then:
      required:
        - mediatek,gce-client-reg

additionalProperties: false

examples:
  - |
    #include <dt-bindings/clock/mt8173-clk.h>
    #include <dt-bindings/power/mt8173-power.h>

    soc {
        #address-cells = <2>;
        #size-cells = <2>;

        split0: split@14018000 {
            compatible = "mediatek,mt8173-disp-split";
            reg = <0 0x14018000 0 0x1000>;
            power-domains = <&spm MT8173_POWER_DOMAIN_MM>;
            clocks = <&mmsys CLK_MM_DISP_SPLIT0>;
        };
    };
```

## Documentation/devicetree/bindings/display/mediatek/mediatek,ufoe.yaml
```yaml
# SPDX-License-Identifier: (GPL-2.0-only OR BSD-2-Clause)
%YAML 1.2
---
$id: http://devicetree.org/schemas/display/mediatek/mediatek,ufoe.yaml#
$schema: http://devicetree.org/meta-schemas/core.yaml#

title: Mediatek display UFOe

maintainers:
  - Chun-Kuang Hu <chunkuang.hu@kernel.org>
  - Philipp Zabel <p.zabel@pengutronix.de>

description: |
  Mediatek display UFOe stands for Unified Frame Optimization engine.
  UFOe can cut the data rate for DSI port which may lead to reduce power
  consumption.
  UFOe device node must be siblings to the central MMSYS_CONFIG node.
  For a description of the MMSYS_CONFIG binding, see
  Documentation/devicetree/bindings/arm/mediatek/mediatek,mmsys.yaml
  for details.

properties:
  compatible:
    oneOf:
      - enum:
          - mediatek,mt8173-disp-ufoe
      - items:
          - const: mediatek,mt6795-disp-ufoe
          - const: mediatek,mt8173-disp-ufoe

  reg:
    maxItems: 1

  interrupts:
    maxItems: 1

  power-domains:
    description: A phandle and PM domain specifier as defined by bindings of
      the power controller specified by phandle. See
      Documentation/devicetree/bindings/power/power-domain.yaml for details.

  clocks:
    items:
      - description: UFOe Clock

  ports:
    $ref: /schemas/graph.yaml#/properties/ports
    description:
      Input and output ports can have multiple endpoints, each of those
      connects to either the primary, secondary, etc, display pipeline.

    properties:
      port@0:
        $ref: /schemas/graph.yaml#/properties/port
        description: UFOE input, usually from one of the RDMA blocks.

      port@1:
        $ref: /schemas/graph.yaml#/properties/port
        description:
          UFOE output to the input of the next desired component in the
          display pipeline, usually one of the available DSI blocks.

    required:
      - port@0
      - port@1

  mediatek,gce-client-reg:
    $ref: /schemas/types.yaml#/definitions/phandle-array
    description: describes how to locate the GCE client register
    items:
      - items:
          - description: Phandle reference to a Mediatek GCE Mailbox
          - description:
              GCE subsys id mapping to a client defined in header
              include/dt-bindings/gce/<chip>-gce.h.
          - description: offset for the GCE register offset
          - description: size of the GCE register offset

required:
  - compatible
  - reg
  - interrupts
  - power-domains
  - clocks

additionalProperties: false

examples:
  - |
    #include <dt-bindings/interrupt-controller/arm-gic.h>
    #include <dt-bindings/clock/mt8173-clk.h>
    #include <dt-bindings/gce/mt8173-gce.h>
    #include <dt-bindings/power/mt8173-power.h>

    soc {
        #address-cells = <2>;
        #size-cells = <2>;

        ufoe@1401a000 {
            compatible = "mediatek,mt8173-disp-ufoe";
            reg = <0 0x1401a000 0 0x1000>;
            interrupts = <GIC_SPI 191 IRQ_TYPE_LEVEL_LOW>;
            power-domains = <&scpsys MT8173_POWER_DOMAIN_MM>;
            clocks = <&mmsys CLK_MM_DISP_UFOE>;
            mediatek,gce-client-reg = <&gce SUBSYS_1401XXXX 0xa000 0x1000>;
        };
    };
```
