## Documentation/devicetree/bindings/display/mediatek/mediatek,dsi.txt
```
Mediatek DSI Device
===================

The Mediatek DSI function block is a sink of the display subsystem and can
drive up to 4-lane MIPI DSI output. Two DSIs can be synchronized for dual-
channel output.

Required properties:
- compatible: "mediatek,<chip>-dsi"
- the supported chips are mt2701, mt7623, mt8173 and mt8183.
- reg: Physical base address and length of the controller's registers
- interrupts: The interrupt signal from the function block.
- clocks: device clocks
  See Documentation/devicetree/bindings/clock/clock-bindings.txt for details.
- clock-names: must contain "engine", "digital", and "hs"
- phys: phandle link to the MIPI D-PHY controller.
- phy-names: must contain "dphy"
- port: Output port node with endpoint definitions as described in
  Documentation/devicetree/bindings/graph.txt. This port should be connected
  to the input port of an attached DSI panel or DSI-to-eDP encoder chip.

MIPI TX Configuration Module
============================

The MIPI TX configuration module controls the MIPI D-PHY.

Required properties:
- compatible: "mediatek,<chip>-mipi-tx"
- the supported chips are mt2701, 7623, mt8173 and mt8183.
- reg: Physical base address and length of the controller's registers
- clocks: PLL reference clock
- clock-output-names: name of the output clock line to the DSI encoder
- #clock-cells: must be <0>;
- #phy-cells: must be <0>.

Optional properties:
- drive-strength-microamp: adjust driving current, should be 3000 ~ 6000. And
						   the step is 200.
- nvmem-cells: A phandle to the calibration data provided by a nvmem device. If
               unspecified default values shall be used.
- nvmem-cell-names: Should be "calibration-data"

Example:

mipi_tx0: mipi-dphy@10215000 {
	compatible = "mediatek,mt8173-mipi-tx";
	reg = <0 0x10215000 0 0x1000>;
	clocks = <&clk26m>;
	clock-output-names = "mipi_tx0_pll";
	#clock-cells = <0>;
	#phy-cells = <0>;
	drive-strength-microamp = <4600>;
	nvmem-cells= <&mipi_tx_calibration>;
	nvmem-cell-names = "calibration-data";
};

dsi0: dsi@1401b000 {
	compatible = "mediatek,mt8173-dsi";
	reg = <0 0x1401b000 0 0x1000>;
	interrupts = <GIC_SPI 192 IRQ_TYPE_LEVEL_LOW>;
	clocks = <&mmsys MM_DSI0_ENGINE>, <&mmsys MM_DSI0_DIGITAL>,
		 <&mipi_tx0>;
	clock-names = "engine", "digital", "hs";
	phys = <&mipi_tx0>;
	phy-names = "dphy";

	port {
		dsi0_out: endpoint {
			remote-endpoint = <&panel_in>;
		};
	};
};
```

## Documentation/devicetree/bindings/display/mediatek/mediatek,dsi.yaml
```yaml
# SPDX-License-Identifier: (GPL-2.0-only OR BSD-2-Clause)
%YAML 1.2
---
$id: http://devicetree.org/schemas/display/mediatek/mediatek,dsi.yaml#
$schema: http://devicetree.org/meta-schemas/core.yaml#

title: MediaTek DSI Controller

maintainers:
  - Chun-Kuang Hu <chunkuang.hu@kernel.org>
  - Philipp Zabel <p.zabel@pengutronix.de>
  - Jitao Shi <jitao.shi@mediatek.com>

description: |
  The MediaTek DSI function block is a sink of the display subsystem and can
  drive up to 4-lane MIPI DSI output. Two DSIs can be synchronized for dual-
  channel output.

allOf:
  - $ref: /schemas/display/dsi-controller.yaml#

properties:
  compatible:
    oneOf:
      - enum:
          - mediatek,mt2701-dsi
          - mediatek,mt7623-dsi
          - mediatek,mt8167-dsi
          - mediatek,mt8173-dsi
          - mediatek,mt8183-dsi
          - mediatek,mt8186-dsi
          - mediatek,mt8188-dsi
      - items:
          - enum:
              - mediatek,mt6795-dsi
          - const: mediatek,mt8173-dsi
      - items:
          - enum:
              - mediatek,mt8195-dsi
              - mediatek,mt8365-dsi
          - const: mediatek,mt8183-dsi

  reg:
    maxItems: 1

  interrupts:
    maxItems: 1

  power-domains:
    maxItems: 1

  clocks:
    items:
      - description: Engine Clock
      - description: Digital Clock
      - description: HS Clock

  clock-names:
    items:
      - const: engine
      - const: digital
      - const: hs

  resets:
    maxItems: 1

  phys:
    maxItems: 1

  phy-names:
    items:
      - const: dphy

  port:
    $ref: /schemas/graph.yaml#/properties/port
    description:
      Output port node. This port should be connected to the input
      port of an attached DSI panel or DSI-to-eDP encoder chip.

  ports:
    $ref: /schemas/graph.yaml#/properties/ports
    description:
      Input ports can have multiple endpoints, each of those connects
      to either the primary, secondary, etc, display pipeline.

    properties:
      port@0:
        $ref: /schemas/graph.yaml#/properties/port
        description: DSI input port, usually from DITHER, DSC or MERGE

      port@1:
        $ref: /schemas/graph.yaml#/properties/port
        description:
          DSI output to an attached DSI panel, or a DSI-to-X encoder chip

    required:
      - port@0
      - port@1

required:
  - compatible
  - reg
  - interrupts
  - power-domains
  - clocks
  - clock-names
  - phys
  - phy-names

oneOf:
  - required:
      - port
  - required:
      - ports

unevaluatedProperties: false

examples:
  - |
    #include <dt-bindings/clock/mt8183-clk.h>
    #include <dt-bindings/interrupt-controller/arm-gic.h>
    #include <dt-bindings/interrupt-controller/irq.h>
    #include <dt-bindings/power/mt8183-power.h>
    #include <dt-bindings/phy/phy.h>
    #include <dt-bindings/reset/mt8183-resets.h>

    soc {
        #address-cells = <2>;
        #size-cells = <2>;

        dsi0: dsi@14014000 {
            compatible = "mediatek,mt8183-dsi";
            reg = <0 0x14014000 0 0x1000>;
            interrupts = <GIC_SPI 236 IRQ_TYPE_LEVEL_LOW>;
            power-domains = <&spm MT8183_POWER_DOMAIN_DISP>;
            clocks = <&mmsys CLK_MM_DSI0_MM>,
                <&mmsys CLK_MM_DSI0_IF>,
                <&mipi_tx0>;
            clock-names = "engine", "digital", "hs";
            resets = <&mmsys MT8183_MMSYS_SW0_RST_B_DISP_DSI0>;
            phys = <&mipi_tx0>;
            phy-names = "dphy";
            port {
                dsi0_out: endpoint {
                    remote-endpoint = <&panel_in>;
                };
            };
        };
    };

...
```

## Documentation/devicetree/bindings/display/mediatek/mediatek,ethdr.yaml
```yaml
# SPDX-License-Identifier: (GPL-2.0-only OR BSD-2-Clause)
%YAML 1.2
---
$id: http://devicetree.org/schemas/display/mediatek/mediatek,ethdr.yaml#
$schema: http://devicetree.org/meta-schemas/core.yaml#

title: MediaTek Ethdr Device

maintainers:
  - Chun-Kuang Hu <chunkuang.hu@kernel.org>
  - Philipp Zabel <p.zabel@pengutronix.de>

description:
  ETHDR (ET High Dynamic Range) is a MediaTek internal HDR engine and is
  designed for HDR video and graphics conversion in the external display path.
  It handles multiple HDR input types and performs tone mapping, color
  space/color format conversion, and then combine different layers,
  output the required HDR or SDR signal to the subsequent display path.
  This engine is composed of two video frontends, two graphic frontends,
  one video backend and a mixer. ETHDR has two DMA function blocks, DS and ADL.
  These two function blocks read the pre-programmed registers from DRAM and
  set them to HW in the v-blanking period.

properties:
  compatible:
    oneOf:
      - const: mediatek,mt8195-disp-ethdr
      - items:
          - const: mediatek,mt8188-disp-ethdr
          - const: mediatek,mt8195-disp-ethdr

  reg:
    maxItems: 7

  reg-names:
    items:
      - const: mixer
      - const: vdo_fe0
      - const: vdo_fe1
      - const: gfx_fe0
      - const: gfx_fe1
      - const: vdo_be
      - const: adl_ds

  interrupts:
    maxItems: 1

  iommus:
    minItems: 1
    maxItems: 2

  clocks:
    items:
      - description: mixer clock
      - description: video frontend 0 clock
      - description: video frontend 1 clock
      - description: graphic frontend 0 clock
      - description: graphic frontend 1 clock
      - description: video backend clock
      - description: autodownload and menuload clock
      - description: video frontend 0 async clock
      - description: video frontend 1 async clock
      - description: graphic frontend 0 async clock
      - description: graphic frontend 1 async clock
      - description: video backend async clock
      - description: ethdr top clock

  clock-names:
    items:
      - const: mixer
      - const: vdo_fe0
      - const: vdo_fe1
      - const: gfx_fe0
      - const: gfx_fe1
      - const: vdo_be
      - const: adl_ds
      - const: vdo_fe0_async
      - const: vdo_fe1_async
      - const: gfx_fe0_async
      - const: gfx_fe1_async
      - const: vdo_be_async
      - const: ethdr_top

  power-domains:
    maxItems: 1

  resets:
    items:
      - description: video frontend 0 async reset
      - description: video frontend 1 async reset
      - description: graphic frontend 0 async reset
      - description: graphic frontend 1 async reset
      - description: video backend async reset

  reset-names:
    items:
      - const: vdo_fe0_async
      - const: vdo_fe1_async
      - const: gfx_fe0_async
      - const: gfx_fe1_async
      - const: vdo_be_async

  mediatek,gce-client-reg:
    $ref: /schemas/types.yaml#/definitions/phandle-array
    minItems: 1
    maxItems: 7
    description: The register of display function block to be set by gce.
      There are 4 arguments in this property, gce node, subsys id, offset and
      register size. The subsys id is defined in the gce header of each chips
      include/dt-bindings/gce/<chip>-gce.h, mapping to the register of display
      function block.

required:
  - compatible
  - reg
  - clocks
  - clock-names
  - interrupts
  - power-domains
  - resets
  - mediatek,gce-client-reg

additionalProperties: false

examples:
  - |
    #include <dt-bindings/interrupt-controller/arm-gic.h>
    #include <dt-bindings/clock/mt8195-clk.h>
    #include <dt-bindings/gce/mt8195-gce.h>
    #include <dt-bindings/memory/mt8195-memory-port.h>
    #include <dt-bindings/power/mt8195-power.h>
    #include <dt-bindings/reset/mt8195-resets.h>

    soc {
        #address-cells = <2>;
        #size-cells = <2>;

        hdr-engine@1c114000 {
                compatible = "mediatek,mt8195-disp-ethdr";
                reg = <0 0x1c114000 0 0x1000>,
                      <0 0x1c115000 0 0x1000>,
                      <0 0x1c117000 0 0x1000>,
                      <0 0x1c119000 0 0x1000>,
                      <0 0x1c11a000 0 0x1000>,
                      <0 0x1c11b000 0 0x1000>,
                      <0 0x1c11c000 0 0x1000>;
                reg-names = "mixer", "vdo_fe0", "vdo_fe1", "gfx_fe0", "gfx_fe1",
                            "vdo_be", "adl_ds";
                mediatek,gce-client-reg = <&gce0 SUBSYS_1c11XXXX 0x4000 0x1000>,
                                          <&gce0 SUBSYS_1c11XXXX 0x5000 0x1000>,
                                          <&gce0 SUBSYS_1c11XXXX 0x7000 0x1000>,
                                          <&gce0 SUBSYS_1c11XXXX 0x9000 0x1000>,
                                          <&gce0 SUBSYS_1c11XXXX 0xa000 0x1000>,
                                          <&gce0 SUBSYS_1c11XXXX 0xb000 0x1000>,
                                          <&gce0 SUBSYS_1c11XXXX 0xc000 0x1000>;
                clocks = <&vdosys1 CLK_VDO1_DISP_MIXER>,
                         <&vdosys1 CLK_VDO1_HDR_VDO_FE0>,
                         <&vdosys1 CLK_VDO1_HDR_VDO_FE1>,
                         <&vdosys1 CLK_VDO1_HDR_GFX_FE0>,
                         <&vdosys1 CLK_VDO1_HDR_GFX_FE1>,
                         <&vdosys1 CLK_VDO1_HDR_VDO_BE>,
                         <&vdosys1 CLK_VDO1_26M_SLOW>,
                         <&vdosys1 CLK_VDO1_HDR_VDO_FE0_DL_ASYNC>,
                         <&vdosys1 CLK_VDO1_HDR_VDO_FE1_DL_ASYNC>,
                         <&vdosys1 CLK_VDO1_HDR_GFX_FE0_DL_ASYNC>,
                         <&vdosys1 CLK_VDO1_HDR_GFX_FE1_DL_ASYNC>,
                         <&vdosys1 CLK_VDO1_HDR_VDO_BE_DL_ASYNC>,
                         <&topckgen CLK_TOP_ETHDR>;
                clock-names = "mixer", "vdo_fe0", "vdo_fe1", "gfx_fe0", "gfx_fe1",
                              "vdo_be", "adl_ds", "vdo_fe0_async", "vdo_fe1_async",
                              "gfx_fe0_async", "gfx_fe1_async","vdo_be_async",
                              "ethdr_top";
                power-domains = <&spm MT8195_POWER_DOMAIN_VDOSYS1>;
                iommus = <&iommu_vpp M4U_PORT_L3_HDR_DS>,
                         <&iommu_vpp M4U_PORT_L3_HDR_ADL>;
                interrupts = <GIC_SPI 517 IRQ_TYPE_LEVEL_HIGH 0>; /* disp mixer */
                resets = <&vdosys1 MT8195_VDOSYS1_SW1_RST_B_HDR_VDO_FE0_DL_ASYNC>,
                         <&vdosys1 MT8195_VDOSYS1_SW1_RST_B_HDR_VDO_FE1_DL_ASYNC>,
                         <&vdosys1 MT8195_VDOSYS1_SW1_RST_B_HDR_GFX_FE0_DL_ASYNC>,
                         <&vdosys1 MT8195_VDOSYS1_SW1_RST_B_HDR_GFX_FE1_DL_ASYNC>,
                         <&vdosys1 MT8195_VDOSYS1_SW1_RST_B_HDR_VDO_BE_DL_ASYNC>;
                reset-names = "vdo_fe0_async", "vdo_fe1_async", "gfx_fe0_async",
                              "gfx_fe1_async", "vdo_be_async";
        };
    };
...
```

## Documentation/devicetree/bindings/display/mediatek/mediatek,gamma.yaml
```yaml
# SPDX-License-Identifier: (GPL-2.0-only OR BSD-2-Clause)
%YAML 1.2
---
$id: http://devicetree.org/schemas/display/mediatek/mediatek,gamma.yaml#
$schema: http://devicetree.org/meta-schemas/core.yaml#

title: Mediatek display gamma correction

maintainers:
  - Chun-Kuang Hu <chunkuang.hu@kernel.org>
  - Philipp Zabel <p.zabel@pengutronix.de>

description: |
  Mediatek display gamma correction, namely GAMMA, provides a nonlinear
  operation used to adjust luminance in display system.
  GAMMA device node must be siblings to the central MMSYS_CONFIG node.
  For a description of the MMSYS_CONFIG binding, see
  Documentation/devicetree/bindings/arm/mediatek/mediatek,mmsys.yaml
  for details.

properties:
  compatible:
    oneOf:
      - items:
          - const: mediatek,mt8173-disp-gamma
      - items:
          - const: mediatek,mt8183-disp-gamma
      - items:
          - enum:
              - mediatek,mt8186-disp-gamma
              - mediatek,mt8192-disp-gamma
              - mediatek,mt8195-disp-gamma
          - const: mediatek,mt8183-disp-gamma

  reg:
    maxItems: 1

  interrupts:
    maxItems: 1

  power-domains:
    description: A phandle and PM domain specifier as defined by bindings of
      the power controller specified by phandle. See
      Documentation/devicetree/bindings/power/power-domain.yaml for details.

  clocks:
    items:
      - description: GAMMA Clock

  mediatek,gce-client-reg:
    description: The register of client driver can be configured by gce with
      4 arguments defined in this property, such as phandle of gce, subsys id,
      register offset and size. Each GCE subsys id is mapping to a client
      defined in the header include/dt-bindings/gce/<chip>-gce.h.
    $ref: /schemas/types.yaml#/definitions/phandle-array
    maxItems: 1

required:
  - compatible
  - reg
  - interrupts
  - power-domains
  - clocks

additionalProperties: false

examples:
  - |
    #include <dt-bindings/interrupt-controller/arm-gic.h>
    #include <dt-bindings/clock/mt8173-clk.h>
    #include <dt-bindings/power/mt8173-power.h>
    #include <dt-bindings/gce/mt8173-gce.h>

    soc {
        #address-cells = <2>;
        #size-cells = <2>;

        gamma@14016000 {
            compatible = "mediatek,mt8173-disp-gamma";
            reg = <0 0x14016000 0 0x1000>;
            interrupts = <GIC_SPI 190 IRQ_TYPE_LEVEL_LOW>;
            power-domains = <&scpsys MT8173_POWER_DOMAIN_MM>;
            clocks = <&mmsys CLK_MM_DISP_GAMMA>;
            mediatek,gce-client-reg = <&gce SUBSYS_1401XXXX 0x6000 0x1000>;
        };
    };
```
