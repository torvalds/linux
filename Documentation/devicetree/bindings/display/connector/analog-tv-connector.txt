## Documentation/devicetree/bindings/display/connector/analog-tv-connector.txt
```
Analog TV Connector
===================

Required properties:
- compatible: "composite-video-connector" or "svideo-connector"

Optional properties:
- label: a symbolic name for the connector
- sdtv-standards: limit the supported TV standards on a connector to the given
                  ones. If not specified all TV standards are allowed.
                  Possible TV standards are defined in
                  include/dt-bindings/display/sdtv-standards.h.

Required nodes:
- Video port for TV input

Example
-------
#include <dt-bindings/display/sdtv-standards.h>

tv: connector {
	compatible = "composite-video-connector";
	label = "tv";
	sdtv-standards = <(SDTV_STD_PAL | SDTV_STD_NTSC)>;

	port {
		tv_connector_in: endpoint {
			remote-endpoint = <&venc_out>;
		};
	};
};
```

## Documentation/devicetree/bindings/display/connector/analog-tv-connector.yaml
```yaml
# SPDX-License-Identifier: GPL-2.0-only
%YAML 1.2
---
$id: http://devicetree.org/schemas/display/connector/analog-tv-connector.yaml#
$schema: http://devicetree.org/meta-schemas/core.yaml#

title: Analog TV Connector

maintainers:
  - Laurent Pinchart <Laurent.pinchart@ideasonboard.com>

properties:
  compatible:
    enum:
      - composite-video-connector
      - svideo-connector

  label: true

  sdtv-standards:
    description:
      Limit the supported TV standards on a connector to the given ones. If
      not specified all TV standards are allowed. Possible TV standards are
      defined in include/dt-bindings/display/sdtv-standards.h.
    $ref: /schemas/types.yaml#/definitions/uint32

  port:
    description: Connection to controller providing analog TV signals

required:
  - compatible
  - port

additionalProperties: false

examples:
  - |
    #include <dt-bindings/display/sdtv-standards.h>

    connector {
        compatible = "composite-video-connector";
        label = "tv";
        sdtv-standards = <(SDTV_STD_PAL | SDTV_STD_NTSC)>;

        port {
            tv_connector_in: endpoint {
                remote-endpoint = <&venc_out>;
            };
        };
    };

...
```

## Documentation/devicetree/bindings/display/connector/dp-connector.yaml
```yaml
# SPDX-License-Identifier: (GPL-2.0-only OR BSD-2-Clause)
%YAML 1.2
---
$id: http://devicetree.org/schemas/display/connector/dp-connector.yaml#
$schema: http://devicetree.org/meta-schemas/core.yaml#

title: DisplayPort Connector

maintainers:
  - Tomi Valkeinen <tomi.valkeinen@ti.com>

properties:
  compatible:
    const: dp-connector

  label: true

  type:
    enum:
      - full-size
      - mini

  hpd-gpios:
    description: A GPIO line connected to HPD
    maxItems: 1

  dp-pwr-supply:
    description: Power supply for the DP_PWR pin

  port:
    $ref: /schemas/graph.yaml#/properties/port
    description: Connection to controller providing DP signals

  ports:
    $ref: /schemas/graph.yaml#/properties/ports
    description: OF graph representation of signales routed to DP connector

    properties:
      port@0:
        $ref: /schemas/graph.yaml#/properties/port
        description: Connection to controller providing DP signals

      port@1:
        $ref: /schemas/graph.yaml#/properties/port
        description: Connection to controller providing AUX signals

    required:
      - port@0
      - port@1

required:
  - compatible
  - type

oneOf:
  - required:
      - port
  - required:
      - ports

additionalProperties: false

examples:
  - |
    connector {
        compatible = "dp-connector";
        label = "dp0";
        type = "full-size";

        port {
            dp_connector_in: endpoint {
                remote-endpoint = <&dp_out>;
            };
        };
    };

  - |
    /* DP connecttor being driven by the USB+DP combo PHY */
    connector {
        compatible = "dp-connector";
        label = "dp0";
        type = "full-size";

        ports {
            #address-cells = <1>;
            #size-cells = <0>;

            port@0 {
                reg = <0>;

                endpoint {
                    remote-endpoint = <&phy_ss_out>;
                };
            };

            port@1 {
                reg = <1>;

                endpoint {
                    remote-endpoint = <&phy_sbu_out>;
                };
            };
        };
    };
...
```

## Documentation/devicetree/bindings/display/connector/dvi-connector.txt
```
DVI Connector
==============

Required properties:
- compatible: "dvi-connector"

Optional properties:
- label: a symbolic name for the connector
- ddc-i2c-bus: phandle to the i2c bus that is connected to DVI DDC
- analog: the connector has DVI analog pins
- digital: the connector has DVI digital pins
- dual-link: the connector has pins for DVI dual-link
- hpd-gpios: HPD GPIO number

Required nodes:
- Video port for DVI input

Note: One (or both) of 'analog' or 'digital' must be set.

Example
-------

dvi0: connector@0 {
	compatible = "dvi-connector";
	label = "dvi";

	digital;

	ddc-i2c-bus = <&i2c3>;

	port {
		dvi_connector_in: endpoint {
			remote-endpoint = <&tfp410_out>;
		};
	};
};
```

## Documentation/devicetree/bindings/display/connector/dvi-connector.yaml
```yaml
# SPDX-License-Identifier: GPL-2.0-only
%YAML 1.2
---
$id: http://devicetree.org/schemas/display/connector/dvi-connector.yaml#
$schema: http://devicetree.org/meta-schemas/core.yaml#

title: DVI Connector

maintainers:
  - Laurent Pinchart <Laurent.pinchart@ideasonboard.com>

properties:
  compatible:
    const: dvi-connector

  label: true

  hpd-gpios:
    description: A GPIO line connected to HPD
    maxItems: 1

  ddc-i2c-bus:
    description: phandle link to the I2C controller used for DDC EDID probing
    $ref: /schemas/types.yaml#/definitions/phandle

  analog:
    type: boolean
    description: the connector has DVI analog pins

  digital:
    type: boolean
    description: the connector has DVI digital pins

  dual-link:
    type: boolean
    description: the connector has pins for DVI dual-link

  port:
    $ref: /schemas/graph.yaml#/properties/port
    description: Connection to controller providing DVI signals

required:
  - compatible
  - port

anyOf:
  - required:
      - analog
  - required:
      - digital

additionalProperties: false

examples:
  - |
    connector {
        compatible = "dvi-connector";
        label = "dvi";

        digital;

        ddc-i2c-bus = <&i2c3>;

        port {
            dvi_connector_in: endpoint {
                remote-endpoint = <&tfp410_out>;
            };
        };
    };

...
```

## Documentation/devicetree/bindings/display/connector/hdmi-connector.txt
```
HDMI Connector
==============

Required properties:
- compatible: "hdmi-connector"
- type: the HDMI connector type: "a", "b", "c", "d" or "e"

Optional properties:
- label: a symbolic name for the connector
- hpd-gpios: HPD GPIO number
- ddc-i2c-bus: phandle link to the I2C controller used for DDC EDID probing

Required nodes:
- Video port for HDMI input

Example
-------

hdmi0: connector@1 {
	compatible = "hdmi-connector";
	label = "hdmi";

	type = "a";

	port {
		hdmi_connector_in: endpoint {
			remote-endpoint = <&tpd12s015_out>;
		};
	};
};
```

## Documentation/devicetree/bindings/display/connector/hdmi-connector.yaml
```yaml
# SPDX-License-Identifier: GPL-2.0-only
%YAML 1.2
---
$id: http://devicetree.org/schemas/display/connector/hdmi-connector.yaml#
$schema: http://devicetree.org/meta-schemas/core.yaml#

title: HDMI Connector

maintainers:
  - Laurent Pinchart <Laurent.pinchart@ideasonboard.com>

properties:
  compatible:
    const: hdmi-connector

  type:
    description: The HDMI connector type
    enum:
      - a   # Standard full size
      - b   # Never deployed?
      - c   # Mini
      - d   # Micro
      - e   # automotive

  label: true

  hpd-gpios:
    description: A GPIO line connected to HPD
    maxItems: 1

  ddc-i2c-bus:
    description: phandle link to the I2C controller used for DDC EDID probing
    $ref: /schemas/types.yaml#/definitions/phandle

  ddc-en-gpios:
    description: GPIO signal to enable DDC bus
    maxItems: 1

  hdmi-pwr-supply:
    description: Power supply for the HDMI +5V Power pin

  port:
    $ref: /schemas/graph.yaml#/properties/port
    description: Connection to controller providing HDMI signals

required:
  - compatible
  - port
  - type

additionalProperties: false

examples:
  - |
    connector {
        compatible = "hdmi-connector";
        label = "hdmi";

        type = "a";

        port {
            hdmi_connector_in: endpoint {
                remote-endpoint = <&tpd12s015_out>;
            };
        };
    };

...
```

## Documentation/devicetree/bindings/display/connector/vga-connector.txt
```
VGA Connector
=============

Required properties:

- compatible: "vga-connector"

Optional properties:

- label: a symbolic name for the connector corresponding to a hardware label
- ddc-i2c-bus: phandle to the I2C bus that is connected to VGA DDC

Required nodes:

The VGA connector internal connections are modeled using the OF graph bindings
specified in Documentation/devicetree/bindings/graph.txt.

The VGA connector has a single port that must be connected to a video source
port.


Example
-------

vga0: connector@0 {
	compatible = "vga-connector";
	label = "vga";

	ddc-i2c-bus = <&i2c3>;

	port {
		vga_connector_in: endpoint {
			remote-endpoint = <&adv7123_out>;
		};
	};
};
```

## Documentation/devicetree/bindings/display/connector/vga-connector.yaml
```yaml
# SPDX-License-Identifier: GPL-2.0-only
%YAML 1.2
---
$id: http://devicetree.org/schemas/display/connector/vga-connector.yaml#
$schema: http://devicetree.org/meta-schemas/core.yaml#

title: VGA Connector

maintainers:
  - Laurent Pinchart <Laurent.pinchart@ideasonboard.com>

properties:
  compatible:
    const: vga-connector

  label: true

  ddc-i2c-bus:
    description: phandle link to the I2C controller used for DDC EDID probing
    $ref: /schemas/types.yaml#/definitions/phandle

  port:
    $ref: /schemas/graph.yaml#/properties/port
    description: Connection to controller providing VGA signals

required:
  - compatible
  - port

additionalProperties: false

examples:
  - |
    connector {
        compatible = "vga-connector";
        label = "vga";

        ddc-i2c-bus = <&i2c3>;

        port {
            vga_connector_in: endpoint {
                remote-endpoint = <&adv7123_out>;
            };
        };
    };

...
```

## Documentation/devicetree/bindings/display/dp-aux-bus.yaml
```yaml
# SPDX-License-Identifier: (GPL-2.0-only OR BSD-2-Clause)
%YAML 1.2
---
$id: http://devicetree.org/schemas/display/dp-aux-bus.yaml#
$schema: http://devicetree.org/meta-schemas/core.yaml#

title: DisplayPort AUX bus

maintainers:
  - Douglas Anderson <dianders@chromium.org>

description:
  DisplayPort controllers provide a control channel to the sinks that
  are hooked up to them. This is the DP AUX bus. Over the DP AUX bus
  we can query properties about a sink and also configure it. In
  particular, DP sinks support DDC over DP AUX which allows tunneling
  a standard I2C DDC connection over the AUX channel.

  To model this relationship, DP sinks should be placed as children
  of the DP controller under the "aux-bus" node.

  At the moment, this binding only handles the eDP case. It is
  possible it will be extended in the future to handle the DP case.
  For DP, presumably a connector would be listed under the DP AUX
  bus instead of a panel.

properties:
  $nodename:
    const: aux-bus

  panel:
    $ref: panel/panel-common.yaml#

additionalProperties: false

required:
  - panel
```

## Documentation/devicetree/bindings/display/dsi-controller.yaml
```yaml
# SPDX-License-Identifier: (GPL-2.0-only OR BSD-2-Clause)
%YAML 1.2
---
$id: http://devicetree.org/schemas/display/dsi-controller.yaml#
$schema: http://devicetree.org/meta-schemas/core.yaml#

title: Common Properties for DSI Display Panels

maintainers:
  - Linus Walleij <linus.walleij@linaro.org>

description: |
  This document defines device tree properties common to DSI, Display
  Serial Interface controllers and attached panels. It doesn't constitute
  a device tree binding specification by itself but is meant to be referenced
  by device tree bindings.

  When referenced from panel device tree bindings the properties defined in
  this document are defined as follows. The panel device tree bindings are
  responsible for defining whether each property is required or optional.

  Notice: this binding concerns DSI panels connected directly to a master
  without any intermediate port graph to the panel. Each DSI master
  can control one to four virtual channels to one panel. Each virtual
  channel should have a node "panel" for their virtual channel with their
  reg-property set to the virtual channel number, usually there is just
  one virtual channel, number 0.

properties:
  $nodename:
    pattern: "^dsi(@.*)?$"

  "#address-cells":
    const: 1

  "#size-cells":
    const: 0

patternProperties:
  "^panel@[0-3]$":
    description: Panels connected to the DSI link
    type: object

    properties:
      reg:
        minimum: 0
        maximum: 3
        description:
          The virtual channel number of a DSI peripheral. Must be in the range
          from 0 to 3, as DSI uses a 2-bit addressing scheme. Some DSI
          peripherals respond to more than a single virtual channel. In that
          case the reg property can take multiple entries, one for each virtual
          channel that the peripheral responds to.

      clock-master:
        type: boolean
        description:
          Should be enabled if the host is being used in conjunction with
          another DSI host to drive the same peripheral. Hardware supporting
          such a configuration generally requires the data on both the busses
          to be driven by the same clock. Only the DSI host instance
          controlling this clock should contain this property.

      enforce-video-mode:
        type: boolean
        description:
          The best option is usually to run a panel in command mode, as this
          gives better control over the panel hardware. However for different
          reasons like broken hardware, missing features or testing, it may be
          useful to be able to force a command mode-capable panel into video
          mode.

    required:
      - reg

examples:
  - |
    #include <dt-bindings/gpio/gpio.h>
    dsi@a0351000 {
        reg = <0xa0351000 0x1000>;
        #address-cells = <1>;
        #size-cells = <0>;
        panel@0 {
            compatible = "sony,acx424akp";
            reg = <0>;
            vddi-supply = <&ab8500_ldo_aux1_reg>;
            reset-gpios = <&gpio2 1 GPIO_ACTIVE_LOW>;
        };
    };

...
```

## Documentation/devicetree/bindings/display/elgin,jg10309-01.yaml
```yaml
# SPDX-License-Identifier: (GPL-2.0-only OR BSD-2-Clause)
%YAML 1.2
---
$id: http://devicetree.org/schemas/display/elgin,jg10309-01.yaml#
$schema: http://devicetree.org/meta-schemas/core.yaml#

title: Elgin JG10309-01 SPI-controlled display

maintainers:
  - Fabio Estevam <festevam@gmail.com>

description: |
  The Elgin JG10309-01 SPI-controlled display is used on the RV1108-Elgin-r1
  board and is a custom display.

allOf:
  - $ref: /schemas/spi/spi-peripheral-props.yaml#

properties:
  compatible:
    const: elgin,jg10309-01

  reg:
    maxItems: 1

  spi-max-frequency:
    maximum: 24000000

  spi-cpha: true

  spi-cpol: true

required:
  - compatible
  - reg
  - spi-cpha
  - spi-cpol

additionalProperties: false

examples:
  - |
    spi {
        #address-cells = <1>;
        #size-cells = <0>;

        display@0 {
            compatible = "elgin,jg10309-01";
            reg = <0>;
            spi-max-frequency = <24000000>;
            spi-cpha;
            spi-cpol;
        };
    };
```
