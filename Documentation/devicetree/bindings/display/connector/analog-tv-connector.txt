## Documentation/devicetree/bindings/display/exynos/exynos_hdmi.txt
```
Device-Tree bindings for drm hdmi driver

Required properties:
- compatible: value should be one among the following:
	1) "samsung,exyyess4210-hdmi"
	2) "samsung,exyyess4212-hdmi"
	3) "samsung,exyyess5420-hdmi"
	4) "samsung,exyyess5433-hdmi"
- reg: physical base address of the hdmi and length of memory mapped
	region.
- interrupts: interrupt number to the cpu.
- hpd-gpios: following information about the hotplug gpio pin.
	a) phandle of the gpio controller yesde.
	b) pin number within the gpio controller.
	c) optional flags and pull up/down.
- ddc: phandle to the hdmi ddc yesde
- phy: phandle to the hdmi phy yesde
- samsung,syscon-phandle: phandle for system controller yesde for PMU.
- #sound-dai-cells: should be 0.

Required properties for Exyyess 4210, 4212, 5420 and 5433:
- clocks: list of clock IDs from SoC clock driver.
	a) hdmi: Gate of HDMI IP bus clock.
	b) sclk_hdmi: Gate of HDMI special clock.
	c) sclk_pixel: Pixel special clock, one of the two possible inputs of
		HDMI clock mux.
	d) sclk_hdmiphy: HDMI PHY clock output, one of two possible inputs of
		HDMI clock mux.
	e) mout_hdmi: It is required by the driver to switch between the 2
		parents i.e. sclk_pixel and sclk_hdmiphy. If hdmiphy is stable
		after configuration, parent is set to sclk_hdmiphy else
		sclk_pixel.
- clock-names: aliases as per driver requirements for above clock IDs:
	"hdmi", "sclk_hdmi", "sclk_pixel", "sclk_hdmiphy" and "mout_hdmi".

Required properties for Exyyess 5433:
- clocks: list of clock specifiers according to common clock bindings.
	a) hdmi_pclk: Gate of HDMI IP APB bus.
	b) hdmi_i_pclk: Gate of HDMI-PHY IP APB bus.
	d) i_tmds_clk: Gate of HDMI TMDS clock.
	e) i_pixel_clk: Gate of HDMI pixel clock.
	f) i_spdif_clk: Gate of HDMI SPDIF clock.
	g) oscclk: Oscillator clock, used as parent of following *_user clocks
		in case HDMI-PHY is yest operational.
	h) tmds_clko: TMDS clock generated by HDMI-PHY.
	i) tmds_clko_user: MUX used to switch between oscclk and tmds_clko,
		respectively if HDMI-PHY is off and operational.
	j) pixel_clko: Pixel clock generated by HDMI-PHY.
	k) pixel_clko_user: MUX used to switch between oscclk and pixel_clko,
		respectively if HDMI-PHY is off and operational.
- clock-names: aliases for above clock specfiers.
- samsung,sysreg: handle to syscon used to control the system registers.

Example:

	hdmi {
		compatible = "samsung,exyyess4212-hdmi";
		reg = <0x14530000 0x100000>;
		interrupts = <0 95 0>;
		hpd-gpios = <&gpx3 7 1>;
		ddc = <&hdmi_ddc_yesde>;
		phy = <&hdmi_phy_yesde>;
		samsung,syscon-phandle = <&pmu_system_controller>;
	};
```

## Documentation/devicetree/bindings/display/exynos/exynos_hdmiddc.txt
```
Device-Tree bindings for hdmiddc driver

Required properties:
- compatible: value should be one of the following
	1) "samsung,exyyess5-hdmiddc" <DEPRECATED>
	2) "samsung,exyyess4210-hdmiddc"

- reg: I2C address of the hdmiddc device.

Example:

	hdmiddc {
		compatible = "samsung,exyyess4210-hdmiddc";
		reg = <0x50>;
	};
```

## Documentation/devicetree/bindings/display/exynos/exynos_hdmiphy.txt
```
Device-Tree bindings for hdmiphy driver

Required properties:
- compatible: value should be one of the following:
	1) "samsung,exyyess5-hdmiphy" <DEPRECATED>
	2) "samsung,exyyess4210-hdmiphy".
	3) "samsung,exyyess4212-hdmiphy".
- reg: I2C address of the hdmiphy device.

Example:

	hdmiphy {
		compatible = "samsung,exyyess4210-hdmiphy";
		reg = <0x38>;
	};
```

## Documentation/devicetree/bindings/display/exynos/exynos_mixer.txt
```
Device-Tree bindings for mixer driver

Required properties:
- compatible: value should be one of the following:
	1) "samsung,exyyess5-mixer" <DEPRECATED>
	2) "samsung,exyyess4210-mixer"
	3) "samsung,exyyess4212-mixer"
	4) "samsung,exyyess5250-mixer"
	5) "samsung,exyyess5420-mixer"

- reg: physical base address of the mixer and length of memory mapped
	region.
- interrupts: interrupt number to the cpu.
- clocks: list of clock IDs from SoC clock driver.
	a) mixer: Gate of Mixer IP bus clock.
	b) sclk_hdmi: HDMI Special clock, one of the two possible inputs of
               mixer mux.
	c) hdmi: Gate of HDMI IP bus clock, needed together with sclk_hdmi.

Example:

	mixer {
		compatible = "samsung,exyyess5250-mixer";
		reg = <0x14450000 0x10000>;
		interrupts = <0 94 0>;
	};
```

## Documentation/devicetree/bindings/display/exynos/samsung-fimd.txt
```
Device-Tree bindings for Samsung SoC display controller (FIMD)

FIMD (Fully Interactive Mobile Display) is the Display Controller for the
Samsung series of SoCs which transfers the image data from a video memory
buffer to an external LCD interface.

Required properties:
- compatible: value should be one of the following
		"samsung,s3c2443-fimd"; /* for S3C24XX SoCs */
		"samsung,s3c6400-fimd"; /* for S3C64XX SoCs */
		"samsung,s5pv210-fimd"; /* for S5PV210 SoC */
		"samsung,exynos3250-fimd"; /* for Exynos3250/3472 SoCs */
		"samsung,exynos4210-fimd"; /* for Exynos4 SoCs */
		"samsung,exynos4415-fimd"; /* for Exynos4415 SoC */
		"samsung,exynos5250-fimd"; /* for Exynos5250 SoCs */
		"samsung,exynos5420-fimd"; /* for Exynos5420/5422/5800 SoCs */

- reg: physical base address and length of the FIMD registers set.

- interrupt-parent: should be the phandle of the fimd controller's
		parent interrupt controller.

- interrupts: should contain a list of all FIMD IP block interrupts in the
		 order: FIFO Level, VSYNC, LCD_SYSTEM. The interrupt specifier
		 format depends on the interrupt controller used.

- interrupt-names: should contain the interrupt names: "fifo", "vsync",
	"lcd_sys", in the same order as they were listed in the interrupts
        property.

- pinctrl-0: pin control group to be used for this controller.

- pinctrl-names: must contain a "default" entry.

- clocks: must include clock specifiers corresponding to entries in the
         clock-names property.

- clock-names: list of clock names sorted in the same order as the clocks
               property. Must contain "sclk_fimd" and "fimd".

Optional Properties:
- power-domains: a phandle to FIMD power domain node.
- samsung,invert-vden: video enable signal is inverted
- samsung,invert-vclk: video clock signal is inverted
- display-timings: timing settings for FIMD, as described in document [1].
		Can be used in case timings cannot be provided otherwise
		or to override timings provided by the panel.
- samsung,sysreg: handle to syscon used to control the system registers
- i80-if-timings: timing configuration for lcd i80 interface support.
  - cs-setup: clock cycles for the active period of address signal is enabled
              until chip select is enabled.
              If not specified, the default value(0) will be used.
  - wr-setup: clock cycles for the active period of CS signal is enabled until
              write signal is enabled.
              If not specified, the default value(0) will be used.
  - wr-active: clock cycles for the active period of CS is enabled.
               If not specified, the default value(1) will be used.
  - wr-hold: clock cycles for the active period of CS is disabled until write
             signal is disabled.
             If not specified, the default value(0) will be used.

  The parameters are defined as:

    VCLK(internal)  __|??????|_____|??????|_____|??????|_____|??????|_____|??
                      :            :            :            :            :
    Address Output  --:<XXXXXXXXXXX:XXXXXXXXXXXX:XXXXXXXXXXXX:XXXXXXXXXXXX:XX
                      | cs-setup+1 |            :            :            :
                      |<---------->|            :            :            :
    Chip Select     ???????????????|____________:____________:____________|??
                                   | wr-setup+1 |            | wr-hold+1  |
                                   |<---------->|            |<---------->|
    Write Enable    ????????????????????????????|____________|???????????????
                                                | wr-active+1|
                                                |<---------->|
    Video Data      ----------------------------<XXXXXXXXXXXXXXXXXXXXXXXXX>--

The device node can contain 'port' child nodes according to the bindings defined
in [2]. The following are properties specific to those nodes:
- reg: (required) port index, can be:
		0 - for CAMIF0 input,
		1 - for CAMIF1 input,
		2 - for CAMIF2 input,
		3 - for parallel output,
		4 - for write-back interface

[1]: Documentation/devicetree/bindings/display/display-timing.txt
[2]: Documentation/devicetree/bindings/media/video-interfaces.txt

Example:

SoC specific DT entry:

	fimd@11c00000 {
		compatible = "samsung,exynos4210-fimd";
		interrupt-parent = <&combiner>;
		reg = <0x11c00000 0x20000>;
		interrupt-names = "fifo", "vsync", "lcd_sys";
		interrupts = <11 0>, <11 1>, <11 2>;
		clocks = <&clock 140>, <&clock 283>;
		clock-names = "sclk_fimd", "fimd";
		power-domains = <&pd_lcd0>;
		status = "disabled";
	};

Board specific DT entry:

	fimd@11c00000 {
		pinctrl-0 = <&lcd_clk &lcd_data24 &pwm1_out>;
		pinctrl-names = "default";
		status = "okay";
	};
```

## Documentation/devicetree/bindings/display/faraday,tve200.txt
```
* Faraday TV Encoder TVE200

Required properties:

- compatible: must be one of:
	"faraday,tve200"
	"cortina,gemini-tvc", "faraday,tve200"

- reg: base address and size of the control registers block

- interrupts: contains an interrupt specifier for the interrupt
	line from the TVE200

- clock-names: should contain "PCLK" for the clock line clocking the
	silicon and "TVE" for the 27MHz clock to the video driver

- clocks: contains phandle and clock specifier pairs for the entries
	in the clock-names property. See
	Documentation/devicetree/bindings/clock/clock-bindings.txt

Optional properties:

- resets: contains the reset line phandle for the block

Required sub-nodes:

- port: describes LCD panel signals, following the common binding
	for video transmitter interfaces; see
	Documentation/devicetree/bindings/media/video-interfaces.txt
	This port should have the properties:
	reg = <0>;
	It should have one endpoint connected to a remote endpoint where
	the display is connected.

Example:

display-controller@6a000000 {
	#address-cells = <1>;
	#size-cells = <0>;
	compatible = "faraday,tve200";
	reg = <0x6a000000 0x1000>;
	interrupts = <13 IRQ_TYPE_EDGE_RISING>;
	resets = <&syscon GEMINI_RESET_TVC>;
	clocks = <&syscon GEMINI_CLK_GATE_TVC>,
		 <&syscon GEMINI_CLK_TVC>;
	clock-names = "PCLK", "TVE";

	port@0 {
		reg = <0>;
		display_out: endpoint {
			remote-endpoint = <&panel_in>;
		};
	};
};
```

## Documentation/devicetree/bindings/display/faraday,tve200.yaml
```yaml
# SPDX-License-Identifier: (GPL-2.0-only OR BSD-2-Clause)
%YAML 1.2
---
$id: http://devicetree.org/schemas/display/faraday,tve200.yaml#
$schema: http://devicetree.org/meta-schemas/core.yaml#

title: Faraday TV Encoder TVE200

maintainers:
  - Linus Walleij <linus.walleij@linaro.org>

properties:
  compatible:
    oneOf:
      - const: faraday,tve200
      - items:
          - const: cortina,gemini-tvc
          - const: faraday,tve200

  reg:
    maxItems: 1

  interrupts:
    minItems: 1

  clock-names:
    items:
      - const: PCLK
      - const: TVE

  clocks:
    minItems: 2

  resets:
    minItems: 1

  port:
    $ref: /schemas/graph.yaml#/properties/port

required:
  - compatible
  - reg
  - interrupts
  - clock-names
  - clocks

additionalProperties: false

examples:
  - |
    #include <dt-bindings/clock/cortina,gemini-clock.h>
    #include <dt-bindings/interrupt-controller/irq.h>
    #include <dt-bindings/reset/cortina,gemini-reset.h>
    display-controller@6a000000 {
      compatible = "faraday,tve200";
      reg = <0x6a000000 0x1000>;
      interrupts = <13 IRQ_TYPE_EDGE_RISING>;
      resets = <&syscon GEMINI_RESET_TVC>;
      clocks = <&syscon GEMINI_CLK_GATE_TVC>,
               <&syscon GEMINI_CLK_TVC>;
      clock-names = "PCLK", "TVE";

      port {
        display_out: endpoint {
          remote-endpoint = <&panel_in>;
        };
      };
    };
```
