## Documentation/devicetree/bindings/display/imx/ldb.txt
```
Device-Tree bindings for LVDS Display Bridge (ldb)

LVDS Display Bridge
===================

The LVDS Display Bridge device tree node contains up to two lvds-channel
nodes describing each of the two LVDS encoder channels of the bridge.

Required properties:
 - #address-cells : should be <1>
 - #size-cells : should be <0>
 - compatible : should be "fsl,imx53-ldb" or "fsl,imx6q-ldb".
                Both LDB versions are similar, but i.MX6 has an additional
                multiplexer in the front to select any of the four IPU display
                interfaces as input for each LVDS channel.
 - gpr : should be <&gpr> on i.MX53 and i.MX6q.
         The phandle points to the iomuxc-gpr region containing the LVDS
         control register.
- clocks, clock-names : phandles to the LDB divider and selector clocks and to
                        the display interface selector clocks, as described in
                        Documentation/devicetree/bindings/clock/clock-bindings.txt
        The following clocks are expected on i.MX53:
                "di0_pll" - LDB LVDS channel 0 mux
                "di1_pll" - LDB LVDS channel 1 mux
                "di0" - LDB LVDS channel 0 gate
                "di1" - LDB LVDS channel 1 gate
                "di0_sel" - IPU1 DI0 mux
                "di1_sel" - IPU1 DI1 mux
        On i.MX6q the following additional clocks are needed:
                "di2_sel" - IPU2 DI0 mux
                "di3_sel" - IPU2 DI1 mux
        The needed clock numbers for each are documented in
        Documentation/devicetree/bindings/clock/imx5-clock.txt, and in
        Documentation/devicetree/bindings/clock/imx6q-clock.txt.

Optional properties:
 - pinctrl-names : should be "default" on i.MX53, not used on i.MX6q
 - pinctrl-0 : a phandle pointing to LVDS pin settings on i.MX53,
               not used on i.MX6q
 - fsl,dual-channel : boolean. if it exists, only LVDS channel 0 should
   be configured - one input will be distributed on both outputs in dual
   channel mode

LVDS Channel
============

Each LVDS Channel has to contain either an of graph link to a panel device node
or a display-timings node that describes the video timings for the connected
LVDS display as well as the fsl,data-mapping and fsl,data-width properties.

Required properties:
 - reg : should be <0> or <1>
 - port: Input and output port nodes with endpoint definitions as defined in
   Documentation/devicetree/bindings/graph.txt.
   On i.MX5, the internal two-input-multiplexer is used. Due to hardware
   limitations, only one input port (port@[0,1]) can be used for each channel
   (lvds-channel@[0,1], respectively).
   On i.MX6, there should be four input ports (port@[0-3]) that correspond
   to the four LVDS multiplexer inputs.
   A single output port (port@2 on i.MX5, port@4 on i.MX6) must be connected
   to a panel input port. Optionally, the output port can be left out if
   display-timings are used instead.

Optional properties (required if display-timings are used):
 - display-timings : A node that describes the display timings as defined in
   Documentation/devicetree/bindings/display/display-timing.txt.
 - fsl,data-mapping : should be "spwg" or "jeida"
                      This describes how the color bits are laid out in the
                      serialized LVDS signal.
 - fsl,data-width : should be <18> or <24>

example:

gpr: iomuxc-gpr@53fa8000 {
	/* ... */
};

ldb: ldb@53fa8008 {
	#address-cells = <1>;
	#size-cells = <0>;
	compatible = "fsl,imx53-ldb";
	gpr = <&gpr>;
	clocks = <&clks IMX5_CLK_LDB_DI0_SEL>,
		 <&clks IMX5_CLK_LDB_DI1_SEL>,
		 <&clks IMX5_CLK_IPU_DI0_SEL>,
		 <&clks IMX5_CLK_IPU_DI1_SEL>,
		 <&clks IMX5_CLK_LDB_DI0_GATE>,
		 <&clks IMX5_CLK_LDB_DI1_GATE>;
	clock-names = "di0_pll", "di1_pll",
		      "di0_sel", "di1_sel",
		      "di0", "di1";

	/* Using an of-graph endpoint link to connect the panel */
	lvds-channel@0 {
		#address-cells = <1>;
		#size-cells = <0>;
		reg = <0>;

		port@0 {
			reg = <0>;

			lvds0_in: endpoint {
				remote-endpoint = <&ipu_di0_lvds0>;
			};
		};

		port@2 {
			reg = <2>;

			lvds0_out: endpoint {
				remote-endpoint = <&panel_in>;
			};
		};
	};

	/* Using display-timings and fsl,data-mapping/width instead */
	lvds-channel@1 {
		#address-cells = <1>;
		#size-cells = <0>;
		reg = <1>;
		fsl,data-mapping = "spwg";
		fsl,data-width = <24>;

		display-timings {
			/* ... */
		};

		port@1 {
			reg = <1>;

			lvds1_in: endpoint {
				remote-endpoint = <&ipu_di1_lvds1>;
			};
		};
	};
};

panel: lvds-panel {
	/* ... */

	port {
		panel_in: endpoint {
			remote-endpoint = <&lvds0_out>;
		};
	};
};
```

## Documentation/devicetree/bindings/display/imx/nxp,imx8mq-dcss.yaml
```yaml
# SPDX-License-Identifier: (GPL-2.0 OR BSD-2-Clause)
# Copyright 2019 NXP
%YAML 1.2
---
$id: "http://devicetree.org/schemas/display/imx/nxp,imx8mq-dcss.yaml#"
$schema: "http://devicetree.org/meta-schemas/core.yaml#"

title: iMX8MQ Display Controller Subsystem (DCSS)

maintainers:
  - Laurentiu Palcu <laurentiu.palcu@nxp.com>

description:

  The DCSS (display controller sub system) is used to source up to three
  display buffers, compose them, and drive a display using HDMI 2.0a(with HDCP
  2.2) or MIPI-DSI. The DCSS is intended to support up to 4kp60 displays. HDR10
  image processing capabilities are included to provide a solution capable of
  driving next generation high dynamic range displays.

properties:
  compatible:
    const: nxp,imx8mq-dcss

  reg:
    items:
      - description: DCSS base address and size, up to IRQ steer start
      - description: DCSS BLKCTL base address and size

  interrupts:
    items:
      - description: Context loader completion and error interrupt
      - description: DTG interrupt used to signal context loader trigger time
      - description: DTG interrupt for Vblank

  interrupt-names:
    items:
      - const: ctxld
      - const: ctxld_kick
      - const: vblank

  clocks:
    items:
      - description: Display APB clock for all peripheral PIO access interfaces
      - description: Display AXI clock needed by DPR, Scaler, RTRAM_CTRL
      - description: RTRAM clock
      - description: Pixel clock, can be driven either by HDMI phy clock or MIPI
      - description: DTRC clock, needed by video decompressor

  clock-names:
    items:
      - const: apb
      - const: axi
      - const: rtrm
      - const: pix
      - const: dtrc

  assigned-clocks:
    items:
      - description: Phandle and clock specifier of IMX8MQ_CLK_DISP_AXI_ROOT
      - description: Phandle and clock specifier of IMX8MQ_CLK_DISP_RTRM
      - description: Phandle and clock specifier of either IMX8MQ_VIDEO2_PLL1_REF_SEL or
                     IMX8MQ_VIDEO_PLL1_REF_SEL

  assigned-clock-parents:
    items:
      - description: Phandle and clock specifier of IMX8MQ_SYS1_PLL_800M
      - description: Phandle and clock specifier of IMX8MQ_SYS1_PLL_800M
      - description: Phandle and clock specifier of IMX8MQ_CLK_27M

  assigned-clock-rates:
    items:
      - description: Must be 800 MHz
      - description: Must be 400 MHz

  port:
    $ref: /schemas/graph.yaml#/properties/port
    description:
      A port node pointing to the input port of a HDMI/DP or MIPI display bridge.

additionalProperties: false

examples:
  - |
    #include <dt-bindings/clock/imx8mq-clock.h>
    dcss: display-controller@32e00000 {
        compatible = "nxp,imx8mq-dcss";
        reg = <0x32e00000 0x2d000>, <0x32e2f000 0x1000>;
        interrupts = <6>, <8>, <9>;
        interrupt-names = "ctxld", "ctxld_kick", "vblank";
        interrupt-parent = <&irqsteer>;
        clocks = <&clk IMX8MQ_CLK_DISP_APB_ROOT>, <&clk IMX8MQ_CLK_DISP_AXI_ROOT>,
                 <&clk IMX8MQ_CLK_DISP_RTRM_ROOT>, <&clk IMX8MQ_VIDEO2_PLL_OUT>,
                 <&clk IMX8MQ_CLK_DISP_DTRC>;
        clock-names = "apb", "axi", "rtrm", "pix", "dtrc";
        assigned-clocks = <&clk IMX8MQ_CLK_DISP_AXI>, <&clk IMX8MQ_CLK_DISP_RTRM>,
                          <&clk IMX8MQ_VIDEO2_PLL1_REF_SEL>;
        assigned-clock-parents = <&clk IMX8MQ_SYS1_PLL_800M>, <&clk IMX8MQ_SYS1_PLL_800M>,
                                 <&clk IMX8MQ_CLK_27M>;
        assigned-clock-rates = <800000000>,
                               <400000000>;
        port {
            dcss_out: endpoint {
                remote-endpoint = <&hdmi_in>;
            };
        };
    };
```

## Documentation/devicetree/bindings/display/ingenic,ipu.yaml
```yaml
# SPDX-License-Identifier: (GPL-2.0 OR BSD-2-Clause)
%YAML 1.2
---
$id: http://devicetree.org/schemas/display/ingenic,ipu.yaml#
$schema: http://devicetree.org/meta-schemas/core.yaml#

title: Ingenic SoCs Image Processing Unit (IPU) devicetree bindings

maintainers:
  - Paul Cercueil <paul@crapouillou.net>

properties:
  compatible:
    oneOf:
      - enum:
          - ingenic,jz4725b-ipu
          - ingenic,jz4760-ipu
      - items:
          - const: ingenic,jz4770-ipu
          - const: ingenic,jz4760-ipu

  reg:
    maxItems: 1

  interrupts:
    maxItems: 1

  clocks:
    maxItems: 1

  clock-names:
    const: ipu

  port:
    $ref: /schemas/graph.yaml#/properties/port

required:
  - compatible
  - reg
  - interrupts
  - clocks
  - clock-names

additionalProperties: false

examples:
  - |
    #include <dt-bindings/clock/jz4770-cgu.h>
    ipu@13080000 {
      compatible = "ingenic,jz4770-ipu", "ingenic,jz4760-ipu";
      reg = <0x13080000 0x800>;

      interrupt-parent = <&intc>;
      interrupts = <29>;

      clocks = <&cgu JZ4770_CLK_IPU>;
      clock-names = "ipu";

      port {
        ipu_ep: endpoint {
          remote-endpoint = <&lcdc_ep>;
        };
      };
    };
```

## Documentation/devicetree/bindings/display/ingenic,lcd.txt
```
Ingenic JZ47xx LCD driver

Required properties:
- compatible: one of:
  * ingenic,jz4740-lcd
  * ingenic,jz4725b-lcd
  * ingenic,jz4770-lcd
- reg: LCD registers location and length
- clocks: LCD pixclock and device clock specifiers.
	   The device clock is only required on the JZ4740.
- clock-names: "lcd_pclk" and "lcd"
- interrupts: Specifies the interrupt line the LCD controller is connected to.

Example:

panel {
	compatible = "sharp,ls020b1dd01d";

	backlight = <&backlight>;
	power-supply = <&vcc>;

	port {
		panel_input: endpoint {
			remote-endpoint = <&panel_output>;
		};
	};
};


lcd: lcd-controller@13050000 {
	compatible = "ingenic,jz4725b-lcd";
	reg = <0x13050000 0x1000>;

	interrupt-parent = <&intc>;
	interrupts = <31>;

	clocks = <&cgu JZ4725B_CLK_LCD>;
	clock-names = "lcd";

	port {
		panel_output: endpoint {
			remote-endpoint = <&panel_input>;
		};
	};
};
```

## Documentation/devicetree/bindings/display/ingenic,lcd.yaml
```yaml
# SPDX-License-Identifier: (GPL-2.0 OR BSD-2-Clause)
%YAML 1.2
---
$id: http://devicetree.org/schemas/display/ingenic,lcd.yaml#
$schema: http://devicetree.org/meta-schemas/core.yaml#

title: Ingenic SoCs LCD controller devicetree bindings

maintainers:
  - Paul Cercueil <paul@crapouillou.net>

properties:
  $nodename:
    pattern: "^lcd-controller@[0-9a-f]+$"

  compatible:
    enum:
      - ingenic,jz4740-lcd
      - ingenic,jz4725b-lcd
      - ingenic,jz4770-lcd
      - ingenic,jz4780-lcd

  reg:
    maxItems: 1

  interrupts:
    maxItems: 1

  clocks:
    items:
      - description: Pixel clock
      - description: Module clock
    minItems: 1

  clock-names:
    items:
      - const: lcd_pclk
      - const: lcd
    minItems: 1

  port:
    $ref: /schemas/graph.yaml#/properties/port

  ports:
    $ref: /schemas/graph.yaml#/properties/ports

    properties:
      port@0:
        $ref: /schemas/graph.yaml#/properties/port
        description: DPI output, to interface with TFT panels.

      port@8:
        $ref: /schemas/graph.yaml#/properties/port
        description: Link to the Image Processing Unit (IPU).
          (See ingenic,ipu.yaml).

    required:
      - port@0

required:
  - compatible
  - reg
  - interrupts
  - clocks
  - clock-names

if:
  properties:
    compatible:
      contains:
        enum:
          - ingenic,jz4740-lcd
          - ingenic,jz4780-lcd
then:
  properties:
    clocks:
      minItems: 2
    clock-names:
      minItems: 2
else:
  properties:
    clocks:
      maxItems: 1
    clock-names:
      maxItems: 1

additionalProperties: false

examples:
  - |
    #include <dt-bindings/clock/ingenic,jz4740-cgu.h>
    lcd-controller@13050000 {
      compatible = "ingenic,jz4740-lcd";
      reg = <0x13050000 0x1000>;

      interrupt-parent = <&intc>;
      interrupts = <30>;

      clocks = <&cgu JZ4740_CLK_LCD_PCLK>, <&cgu JZ4740_CLK_LCD>;
      clock-names = "lcd_pclk", "lcd";

      port {
        endpoint {
          remote-endpoint = <&panel_input>;
        };
      };
    };

  - |
    #include <dt-bindings/clock/ingenic,jz4725b-cgu.h>
    lcd-controller@13050000 {
      compatible = "ingenic,jz4725b-lcd";
      reg = <0x13050000 0x1000>;

      interrupt-parent = <&intc>;
      interrupts = <31>;

      clocks = <&cgu JZ4725B_CLK_LCD>;
      clock-names = "lcd_pclk";

      port {
        endpoint {
          remote-endpoint = <&panel_input>;
        };
      };
    };
```

## Documentation/devicetree/bindings/display/intel,keembay-display.yaml
```yaml
# SPDX-License-Identifier: (GPL-2.0-only OR BSD-2-Clause)
%YAML 1.2
---
$id: http://devicetree.org/schemas/display/intel,keembay-display.yaml#
$schema: http://devicetree.org/meta-schemas/core.yaml#

title: Devicetree bindings for Intel Keem Bay display controller

maintainers:
  - Anitha Chrisanthus <anitha.chrisanthus@intel.com>
  - Edmond J Dea <edmund.j.dea@intel.com>

properties:
  compatible:
    const: intel,keembay-display

  reg:
    items:
      - description: LCD registers range

  reg-names:
    items:
      - const: lcd

  clocks:
    items:
      - description: LCD controller clock
      - description: pll0 clock

  clock-names:
    items:
      - const: clk_lcd
      - const: clk_pll0

  interrupts:
    maxItems: 1

  port:
    type: object
    description: Display output node to DSI.

required:
  - compatible
  - reg
  - reg-names
  - clocks
  - clock-names
  - interrupts
  - port

additionalProperties: false

examples:
  - |
    #include <dt-bindings/interrupt-controller/irq.h>
    #include <dt-bindings/interrupt-controller/arm-gic.h>

    display@20930000 {
        compatible = "intel,keembay-display";
        reg = <0x20930000 0x3000>;
        reg-names = "lcd";
        interrupts = <GIC_SPI 33 IRQ_TYPE_LEVEL_HIGH>;
        clocks = <&scmi_clk 0x83>,
                 <&scmi_clk 0x0>;
        clock-names = "clk_lcd", "clk_pll0";

        port {
            disp_out: endpoint {
                remote-endpoint = <&dsi_in>;
            };
        };
    };
```

## Documentation/devicetree/bindings/display/intel,keembay-msscam.yaml
```yaml
# SPDX-License-Identifier: (GPL-2.0-only OR BSD-2-Clause)
%YAML 1.2
---
$id: http://devicetree.org/schemas/display/intel,keembay-msscam.yaml#
$schema: http://devicetree.org/meta-schemas/core.yaml#

title: Devicetree bindings for Intel Keem Bay MSSCAM

maintainers:
  - Anitha Chrisanthus <anitha.chrisanthus@intel.com>
  - Edmond J Dea <edmund.j.dea@intel.com>

description: |
   MSSCAM controls local clocks in the display subsystem namely LCD clocks and
   MIPI DSI clocks. It also configures the interconnect between LCD and
   MIPI DSI.

properties:
  compatible:
    items:
     - const: intel,keembay-msscam
     - const: syscon

  reg:
    maxItems: 1

  reg-io-width:
    const: 4

required:
  - compatible
  - reg
  - reg-io-width

additionalProperties: false

examples:
  - |
    msscam:msscam@20910000 {
        compatible = "intel,keembay-msscam", "syscon";
        reg = <0x20910000 0x30>;
        reg-io-width = <4>;
    };
```
