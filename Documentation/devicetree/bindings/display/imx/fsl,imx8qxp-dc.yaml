## Documentation/devicetree/bindings/display/imx/fsl,imx8qxp-dc.yaml
```yaml
# SPDX-License-Identifier: (GPL-2.0-only OR BSD-2-Clause)
%YAML 1.2
---
$id: http://devicetree.org/schemas/display/imx/fsl,imx8qxp-dc.yaml#
$schema: http://devicetree.org/meta-schemas/core.yaml#

title: Freescale i.MX8qxp Display Controller

description: |
  The Freescale i.MX8qxp Display Controller(DC) is comprised of three main
  components that include a blit engine for 2D graphics accelerations, display
  controller for display output processing, as well as a command sequencer.

                                  Display buffers              Source buffers
                                 (AXI read master)            (AXI read master)
                                  | .......... |                  | | |
      +---------------------------+------------+------------------+-+-+------+
      | Display Controller (DC)   | .......... |                  | | |      |
      |                           |            |                  | | |      |
      |   @@@@@@@@@@@  +----------+------------+------------+     | | |      |
  A   |  | Command   | |          V            V            |     | | |      |
  X <-+->| Sequencer | |    @@@@@@@@@@@@@@@@@@@@@@@@@@@@    |     V V V      |
  I   |  | (AXI CLK) | |   |                            |   |   @@@@@@@@@@   |
      |   @@@@@@@@@@@  |   |       Pixel Engine         |   |  |          |  |
      |       |        |   |         (AXI CLK)          |   |  |          |  |
      |       V        |    @@@@@@@@@@@@@@@@@@@@@@@@@@@@    |  |          |  |
  A   |   ***********  |       |   |            |   |       |  |   Blit   |  |
  H <-+->| Configure | |       V   V            V   V       |  |  Engine  |  |
  B   |  | (CFG CLK) | |    00000000000      11111111111    |  | (AXI CLK)|  |
      |   ***********  |   |  Display  |    |  Display  |   |  |          |  |
      |                |   |  Engine   |    |  Engine   |   |  |          |  |
      |                |   | (Disp CLK)|    | (Disp CLK)|   |  |          |  |
      |   @@@@@@@@@@@  |    00000000000      11111111111    |   @@@@@@@@@@   |
  I   |  |  Common   | |         |                |         |       |        |
  R <-+--|  Control  | |         |    Display     |         |       |        |
  Q   |  | (AXI CLK) | |         |   Controller   |         |       |        |
      |   @@@@@@@@@@@  +------------------------------------+       |        |
      |                          |                |       ^         |        |
      +--------------------------+----------------+-------+---------+--------+
              ^                  |                |       |         |
              |                  V                V       |         V
       Clocks & Resets        Display          Display  Panic   Destination
                              Output0          Output1 Control    buffer
                                                              (AXI write master)

maintainers:
  - Liu Ying <victor.liu@nxp.com>

properties:
  compatible:
    const: fsl,imx8qxp-dc

  reg:
    maxItems: 1

  clocks:
    maxItems: 1

  resets:
    maxItems: 2

  reset-names:
    items:
      - const: axi
      - const: cfg

  power-domains:
    maxItems: 1

  "#address-cells":
    const: 1

  "#size-cells":
    const: 1

  ranges: true

patternProperties:
  "^command-sequencer@[0-9a-f]+$":
    type: object
    additionalProperties: true

    properties:
      compatible:
        const: fsl,imx8qxp-dc-command-sequencer

  "^display-engine@[0-9a-f]+$":
    type: object
    additionalProperties: true

    properties:
      compatible:
        const: fsl,imx8qxp-dc-display-engine

  "^interrupt-controller@[0-9a-f]+$":
    type: object
    additionalProperties: true

    properties:
      compatible:
        const: fsl,imx8qxp-dc-intc

  "^pixel-engine@[0-9a-f]+$":
    type: object
    additionalProperties: true

    properties:
      compatible:
        const: fsl,imx8qxp-dc-pixel-engine

  "^pmu@[0-9a-f]+$":
    type: object
    additionalProperties: true

    properties:
      compatible:
        const: fsl,imx8qxp-dc-axi-performance-counter

required:
  - compatible
  - reg
  - clocks
  - power-domains
  - "#address-cells"
  - "#size-cells"
  - ranges

additionalProperties: false

examples:
  - |
    #include <dt-bindings/clock/imx8-lpcg.h>
    #include <dt-bindings/firmware/imx/rsrc.h>

    display-controller@56180000 {
        compatible = "fsl,imx8qxp-dc";
        reg = <0x56180000 0x40000>;
        clocks = <&dc0_lpcg IMX_LPCG_CLK_4>;
        power-domains = <&pd IMX_SC_R_DC_0>;
        #address-cells = <1>;
        #size-cells = <1>;
        ranges;

        interrupt-controller@56180040 {
            compatible = "fsl,imx8qxp-dc-intc";
            reg = <0x56180040 0x60>;
            clocks = <&dc0_lpcg IMX_LPCG_CLK_5>;
            interrupt-controller;
            interrupt-parent = <&dc0_irqsteer>;
            #interrupt-cells = <1>;
            interrupts = <448>, <449>, <450>,  <64>,
                          <65>,  <66>,  <67>,  <68>,
                          <69>,  <70>, <193>, <194>,
                         <195>, <196>, <197>,  <72>,
                          <73>,  <74>,  <75>,  <76>,
                          <77>,  <78>,  <79>,  <80>,
                          <81>, <199>, <200>, <201>,
                         <202>, <203>, <204>, <205>,
                         <206>, <207>, <208>,   <5>,
                           <0>,   <1>,   <2>,   <3>,
                           <4>,  <82>,  <83>,  <84>,
                          <85>, <209>, <210>, <211>,
                         <212>;
            interrupt-names = "store9_shdload",
                              "store9_framecomplete",
                              "store9_seqcomplete",
                              "extdst0_shdload",
                              "extdst0_framecomplete",
                              "extdst0_seqcomplete",
                              "extdst4_shdload",
                              "extdst4_framecomplete",
                              "extdst4_seqcomplete",
                              "extdst1_shdload",
                              "extdst1_framecomplete",
                              "extdst1_seqcomplete",
                              "extdst5_shdload",
                              "extdst5_framecomplete",
                              "extdst5_seqcomplete",
                              "disengcfg_shdload0",
                              "disengcfg_framecomplete0",
                              "disengcfg_seqcomplete0",
                              "framegen0_int0",
                              "framegen0_int1",
                              "framegen0_int2",
                              "framegen0_int3",
                              "sig0_shdload",
                              "sig0_valid",
                              "sig0_error",
                              "disengcfg_shdload1",
                              "disengcfg_framecomplete1",
                              "disengcfg_seqcomplete1",
                              "framegen1_int0",
                              "framegen1_int1",
                              "framegen1_int2",
                              "framegen1_int3",
                              "sig1_shdload",
                              "sig1_valid",
                              "sig1_error",
                              "reserved",
                              "cmdseq_error",
                              "comctrl_sw0",
                              "comctrl_sw1",
                              "comctrl_sw2",
                              "comctrl_sw3",
                              "framegen0_primsync_on",
                              "framegen0_primsync_off",
                              "framegen0_secsync_on",
                              "framegen0_secsync_off",
                              "framegen1_primsync_on",
                              "framegen1_primsync_off",
                              "framegen1_secsync_on",
                              "framegen1_secsync_off";
        };

        pixel-engine@56180800 {
            compatible = "fsl,imx8qxp-dc-pixel-engine";
            reg = <0x56180800 0xac00>;
            clocks = <&dc0_lpcg IMX_LPCG_CLK_5>;
            #address-cells = <1>;
            #size-cells = <1>;
            ranges;
        };

        display-engine@5618b400 {
            compatible = "fsl,imx8qxp-dc-display-engine";
            reg = <0x5618b400 0x14>, <0x5618b800 0x1c00>;
            reg-names = "top", "cfg";
            interrupt-parent = <&dc0_intc>;
            interrupts = <15>, <16>, <17>;
            interrupt-names = "shdload", "framecomplete", "seqcomplete";
            power-domains = <&pd IMX_SC_R_DC_0_PLL_0>;
            #address-cells = <1>;
            #size-cells = <1>;
            ranges;
        };
    };
```

## Documentation/devicetree/bindings/display/imx/fsl-imx-drm.txt
```
Freescale i.MX DRM master device
================================

The freescale i.MX DRM master device is a virtual device needed to list all
IPU or other display interface nodes that comprise the graphics subsystem.

Required properties:
- compatible: Should be "fsl,imx-display-subsystem"
- ports: Should contain a list of phandles pointing to display interface ports
  of IPU devices

example:

display-subsystem {
	compatible = "fsl,display-subsystem";
	ports = <&ipu_di0>;
};


Freescale i.MX IPUv3
====================

Required properties:
- compatible: Should be "fsl,<chip>-ipu" where <chip> is one of
  - imx51
  - imx53
  - imx6q
  - imx6qp
- reg: should be register base and length as documented in the
  datasheet
- interrupts: Should contain sync interrupt and error interrupt,
  in this order.
- resets: phandle pointing to the system reset controller and
          reset line index, see reset/fsl,imx-src.txt for details
Additional required properties for fsl,imx6qp-ipu:
- fsl,prg: phandle to prg node associated with this IPU instance
Optional properties:
- port@[0-3]: Port nodes with endpoint definitions as defined in
  Documentation/devicetree/bindings/media/video-interfaces.txt.
  Ports 0 and 1 should correspond to CSI0 and CSI1,
  ports 2 and 3 should correspond to DI0 and DI1, respectively.

example:

ipu: ipu@18000000 {
	#address-cells = <1>;
	#size-cells = <0>;
	compatible = "fsl,imx53-ipu";
	reg = <0x18000000 0x080000000>;
	interrupts = <11 10>;
	resets = <&src 2>;

	ipu_di0: port@2 {
		reg = <2>;

		ipu_di0_disp0: endpoint {
			remote-endpoint = <&display_in>;
		};
	};
};

Freescale i.MX PRE (Prefetch Resolve Engine)
============================================

Required properties:
- compatible: should be "fsl,imx6qp-pre"
- reg: should be register base and length as documented in the
  datasheet
- clocks : phandle to the PRE axi clock input, as described
  in Documentation/devicetree/bindings/clock/clock-bindings.txt and
  Documentation/devicetree/bindings/clock/imx6q-clock.txt.
- clock-names: should be "axi"
- interrupts: should contain the PRE interrupt
- fsl,iram: phandle pointing to the mmio-sram device node, that should be
  used for the PRE SRAM double buffer.

example:

pre@21c8000 {
	compatible = "fsl,imx6qp-pre";
	reg = <0x021c8000 0x1000>;
	interrupts = <GIC_SPI 90 IRQ_TYPE_EDGE_RISING>;
	clocks = <&clks IMX6QDL_CLK_PRE0>;
	clock-names = "axi";
	fsl,iram = <&ocram2>;
};

Freescale i.MX PRG (Prefetch Resolve Gasket)
============================================

Required properties:
- compatible: should be "fsl,imx6qp-prg"
- reg: should be register base and length as documented in the
  datasheet
- clocks : phandles to the PRG ipg and axi clock inputs, as described
  in Documentation/devicetree/bindings/clock/clock-bindings.txt and
  Documentation/devicetree/bindings/clock/imx6q-clock.txt.
- clock-names: should be "ipg" and "axi"
- fsl,pres: phandles to the PRE units attached to this PRG, with the fixed
  PRE as the first entry and the muxable PREs following.

example:

prg@21cc000 {
	compatible = "fsl,imx6qp-prg";
	reg = <0x021cc000 0x1000>;
	clocks = <&clks IMX6QDL_CLK_PRG0_APB>,
		 <&clks IMX6QDL_CLK_PRG0_AXI>;
	clock-names = "ipg", "axi";
	fsl,pres = <&pre1>, <&pre2>, <&pre3>;
};

Parallel display support
========================

Required properties:
- compatible: Should be "fsl,imx-parallel-display"
Optional properties:
- interface-pix-fmt: How this display is connected to the
  display interface. Currently supported types: "rgb24", "rgb565", "bgr666"
  and "lvds666".
- edid: verbatim EDID data block describing attached display.
- ddc: phandle describing the i2c bus handling the display data
  channel
- port@[0-1]: Port nodes with endpoint definitions as defined in
  Documentation/devicetree/bindings/media/video-interfaces.txt.
  Port 0 is the input port connected to the IPU display interface,
  port 1 is the output port connected to a panel.

example:

disp0 {
	compatible = "fsl,imx-parallel-display";
	edid = [edid-data];
	interface-pix-fmt = "rgb24";

	port@0 {
		reg = <0>;

		display_in: endpoint {
			remote-endpoint = <&ipu_di0_disp0>;
		};
	};

	port@1 {
		reg = <1>;

		display_out: endpoint {
			remote-endpoint = <&panel_in>;
		};
	};
};

panel {
	...

	port {
		panel_in: endpoint {
			remote-endpoint = <&display_out>;
		};
	};
};
```

## Documentation/devicetree/bindings/display/imx/hdmi.txt
```
Freescale i.MX6 DWC HDMI TX Encoder
===================================

The HDMI transmitter is a Synopsys DesignWare HDMI 1.4 TX controller IP
with a companion PHY IP.

These DT bindings follow the Synopsys DWC HDMI TX bindings defined in
Documentation/devicetree/bindings/display/bridge/dw_hdmi.txt with the
following device-specific properties.


Required properties:

- compatible : Shall be one of "fsl,imx6q-hdmi" or "fsl,imx6dl-hdmi".
- reg: See dw_hdmi.txt.
- interrupts: HDMI interrupt number
- clocks: See dw_hdmi.txt.
- clock-names: Shall contain "iahb" and "isfr" as defined in dw_hdmi.txt.
- ports: See dw_hdmi.txt. The DWC HDMI shall have between one and four ports,
  numbered 0 to 3, corresponding to the four inputs of the HDMI multiplexer.
  Each port shall have a single endpoint.
- gpr : Shall contain a phandle to the iomuxc-gpr region containing the HDMI
  multiplexer control register.

Optional properties

- ddc-i2c-bus: The HDMI DDC bus can be connected to either a system I2C master
  or the functionally-reduced I2C master contained in the DWC HDMI. When
  connected to a system I2C master this property contains a phandle to that
  I2C master controller.


Example:

	gpr: iomuxc-gpr@020e0000 {
		/* ... */
	};

        hdmi: hdmi@0120000 {
                #address-cells = <1>;
                #size-cells = <0>;
                compatible = "fsl,imx6q-hdmi";
                reg = <0x00120000 0x9000>;
                interrupts = <0 115 0x04>;
                gpr = <&gpr>;
                clocks = <&clks 123>, <&clks 124>;
                clock-names = "iahb", "isfr";
                ddc-i2c-bus = <&i2c2>;

                port@0 {
                        reg = <0>;

                        hdmi_mux_0: endpoint {
                                remote-endpoint = <&ipu1_di0_hdmi>;
                        };
                };

                port@1 {
                        reg = <1>;

                        hdmi_mux_1: endpoint {
                                remote-endpoint = <&ipu1_di1_hdmi>;
                        };
                };
        };
```
