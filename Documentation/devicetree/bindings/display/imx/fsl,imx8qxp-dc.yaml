## Documentation/devicetree/bindings/display/lvds-dual-ports.yaml
```yaml
# SPDX-License-Identifier: (GPL-2.0-only OR BSD-2-Clause)
%YAML 1.2
---
$id: http://devicetree.org/schemas/display/lvds-dual-ports.yaml#
$schema: http://devicetree.org/meta-schemas/core.yaml#

title: Dual-link LVDS Display Common Properties

maintainers:
  - Liu Ying <victor.liu@nxp.com>

description: |
  Common properties for LVDS displays with dual LVDS links. Extend LVDS display
  common properties defined in lvds.yaml.

  Dual-link LVDS displays receive odd pixels and even pixels separately from
  the dual LVDS links. One link receives odd pixels and the other receives
  even pixels. Some of those displays may also use only one LVDS link to
  receive all pixels, being odd and even agnostic.

allOf:
  - $ref: lvds.yaml#

properties:
  ports:
    $ref: /schemas/graph.yaml#/properties/ports

    patternProperties:
      '^port@[01]$':
        $ref: /schemas/graph.yaml#/$defs/port-base
        unevaluatedProperties: false
        description: |
          port@0 represents the first LVDS input link.
          port@1 represents the second LVDS input link.

        properties:
          dual-lvds-odd-pixels:
            type: boolean
            description: LVDS input link for odd pixels

          dual-lvds-even-pixels:
            type: boolean
            description: LVDS input link for even pixels

        oneOf:
          - required: [dual-lvds-odd-pixels]
          - required: [dual-lvds-even-pixels]
          - properties:
              dual-lvds-odd-pixels: false
              dual-lvds-even-pixels: false

    anyOf:
      - required:
          - port@0
      - required:
          - port@1

required:
  - ports

additionalProperties: true

...
```

## Documentation/devicetree/bindings/display/lvds.yaml
```yaml
# SPDX-License-Identifier: GPL-2.0
%YAML 1.2
---
$id: http://devicetree.org/schemas/display/lvds.yaml#
$schema: http://devicetree.org/meta-schemas/core.yaml#

title: LVDS Display Common Properties

allOf:
  - $ref: lvds-data-mapping.yaml#

maintainers:
  - Laurent Pinchart <laurent.pinchart+renesas@ideasonboard.com>
  - Thierry Reding <thierry.reding@gmail.com>

description:
  This binding extends the data mapping defined in lvds-data-mapping.yaml.
  It supports reversing the bit order on the formats defined there in order
  to accommodate for even more specialized data formats, since a variety of
  data formats and layouts is used to drive LVDS displays.

properties:
  data-mirror:
    type: boolean
    description:
      If set, reverse the bit order described in the data mappings on all
      data lanes, transmitting bits for slots 6 to 0 instead of 0 to 6.

additionalProperties: true

...
```

## Documentation/devicetree/bindings/display/marvell,pxa2xx-lcdc.txt
```
PXA LCD Controller
------------------

Required properties:
 - compatible : one of these
	"marvell,pxa2xx-lcdc",
	"marvell,pxa270-lcdc",
	"marvell,pxa300-lcdc"
 - reg : should contain 1 register range (address and length).
 - interrupts : framebuffer controller interrupt.
 - clocks: phandle to input clocks

Optional properties:
 - lcd-supply: A phandle to a power regulator that controls the LCD voltage.

Required nodes:
 - port: connection to the LCD panel (see video-interfaces.txt)
	 This node must have its properties bus-width and remote-endpoint set.
	 If the panel is not a TFT color panel, then a "lcd-type" property in
	 the panel should specify the panel type.
	 This panel node should be in the board dts.

Example:
	lcd-controller@40500000 {
		compatible = "marvell,pxa2xx-lcdc";
		reg = <0x44000000 0x10000>;
		interrupts = <17>;
		clocks = <&clks CLK_LCD>;

		port {
			lcdc_out: endpoint {
				remote-endpoint = <&panel_in>;
				bus-width = <16>;
			};
		};
	};
```

## Documentation/devicetree/bindings/display/marvell,pxa300-gcu.txt
```
PXA3xx GCU Controller
---------------------

Required properties:
 - compatible : "marvell,pxa300-gcu"
 - reg : should contain the register range (address and length).
 - interrupts : Controller interrupt.
 - clocks: phandle to the PXA specific input clock.

Example for PXA300:

	display-controller@54000000 {
		compatible = "marvell,pxa300-gcu";
		reg = <0x54000000 0x1000>;
		interrupts = <39>;
		clocks = <&clks CLK_PXA300_GCU>;
	};
```

## Documentation/devicetree/bindings/display/mayqueen,pixpaper.yaml
```yaml
# SPDX-License-Identifier: (GPL-2.0 OR BSD-2-Clause)
%YAML 1.2
---
$id: http://devicetree.org/schemas/display/mayqueen,pixpaper.yaml#
$schema: http://devicetree.org/meta-schemas/core.yaml#

title: Mayqueen Pixpaper e-ink display panel

maintainers:
  - LiangCheng Wang <zaq14760@gmail.com>

description:
  The Pixpaper is an e-ink display panel controlled via an SPI interface.
  The panel has a resolution of 122x250 pixels and requires GPIO pins for
  reset, busy, and data/command control.

allOf:
  - $ref: /schemas/spi/spi-peripheral-props.yaml#

properties:
  compatible:
    const: mayqueen,pixpaper

  reg:
    maxItems: 1

  spi-max-frequency:
    maximum: 1000000
    default: 1000000

  reset-gpios:
    maxItems: 1

  busy-gpios:
    maxItems: 1

  dc-gpios:
    maxItems: 1

required:
  - compatible
  - reg
  - reset-gpios
  - busy-gpios
  - dc-gpios

unevaluatedProperties: false

examples:
  - |
    #include <dt-bindings/gpio/gpio.h>
    spi {
        #address-cells = <1>;
        #size-cells = <0>;
        display@0 {
            compatible = "mayqueen,pixpaper";
            reg = <0>;
            spi-max-frequency = <1000000>;
            reset-gpios = <&gpio1 17 GPIO_ACTIVE_HIGH>;
            busy-gpios = <&gpio1 18 GPIO_ACTIVE_HIGH>;
            dc-gpios = <&gpio1 19 GPIO_ACTIVE_HIGH>;
        };
    };
```

## Documentation/devicetree/bindings/display/mediatek/mediatek,aal.yaml
```yaml
# SPDX-License-Identifier: (GPL-2.0-only OR BSD-2-Clause)
%YAML 1.2
---
$id: http://devicetree.org/schemas/display/mediatek/mediatek,aal.yaml#
$schema: http://devicetree.org/meta-schemas/core.yaml#

title: Mediatek display adaptive ambient light processor

maintainers:
  - Chun-Kuang Hu <chunkuang.hu@kernel.org>
  - Philipp Zabel <p.zabel@pengutronix.de>

description: |
  Mediatek display adaptive ambient light processor, namely AAL,
  is responsible for backlight power saving and sunlight visibility improving.
  AAL device node must be siblings to the central MMSYS_CONFIG node.
  For a description of the MMSYS_CONFIG binding, see
  Documentation/devicetree/bindings/arm/mediatek/mediatek,mmsys.yaml
  for details.

properties:
  compatible:
    oneOf:
      - enum:
          - mediatek,mt8173-disp-aal
          - mediatek,mt8183-disp-aal
          - mediatek,mt8195-mdp3-aal
      - items:
          - enum:
              - mediatek,mt2712-disp-aal
              - mediatek,mt6795-disp-aal
          - const: mediatek,mt8173-disp-aal
      - items:
          - enum:
              - mediatek,mt8186-disp-aal
              - mediatek,mt8188-disp-aal
              - mediatek,mt8192-disp-aal
              - mediatek,mt8195-disp-aal
          - const: mediatek,mt8183-disp-aal

  reg:
    maxItems: 1

  interrupts:
    maxItems: 1

  power-domains:
    description: A phandle and PM domain specifier as defined by bindings of
      the power controller specified by phandle. See
      Documentation/devicetree/bindings/power/power-domain.yaml for details.

  clocks:
    items:
      - description: AAL Clock

  mediatek,gce-client-reg:
    description: The register of client driver can be configured by gce with
      4 arguments defined in this property, such as phandle of gce, subsys id,
      register offset and size. Each GCE subsys id is mapping to a client
      defined in the header include/dt-bindings/gce/<chip>-gce.h.
    $ref: /schemas/types.yaml#/definitions/phandle-array
    maxItems: 1

required:
  - compatible
  - reg
  - interrupts
  - power-domains
  - clocks

additionalProperties: false

examples:
  - |
    #include <dt-bindings/interrupt-controller/arm-gic.h>
    #include <dt-bindings/clock/mt8173-clk.h>
    #include <dt-bindings/power/mt8173-power.h>
    #include <dt-bindings/gce/mt8173-gce.h>

    soc {
        #address-cells = <2>;
        #size-cells = <2>;

        aal@14015000 {
           compatible = "mediatek,mt8173-disp-aal";
           reg = <0 0x14015000 0 0x1000>;
           interrupts = <GIC_SPI 189 IRQ_TYPE_LEVEL_LOW>;
           power-domains = <&scpsys MT8173_POWER_DOMAIN_MM>;
           clocks = <&mmsys CLK_MM_DISP_AAL>;
           mediatek,gce-client-reg = <&gce SUBSYS_1401XXXX 0x5000 0x1000>;
       };
    };
```

## Documentation/devicetree/bindings/display/mediatek/mediatek,ccorr.yaml
```yaml
# SPDX-License-Identifier: (GPL-2.0-only OR BSD-2-Clause)
%YAML 1.2
---
$id: http://devicetree.org/schemas/display/mediatek/mediatek,ccorr.yaml#
$schema: http://devicetree.org/meta-schemas/core.yaml#

title: Mediatek display color correction

maintainers:
  - Chun-Kuang Hu <chunkuang.hu@kernel.org>
  - Philipp Zabel <p.zabel@pengutronix.de>

description: |
  Mediatek display color correction, namely CCORR, reproduces correct color
  on panels with different color gamut.
  CCORR device node must be siblings to the central MMSYS_CONFIG node.
  For a description of the MMSYS_CONFIG binding, see
  Documentation/devicetree/bindings/arm/mediatek/mediatek,mmsys.yaml
  for details.

properties:
  compatible:
    oneOf:
      - enum:
          - mediatek,mt8183-disp-ccorr
          - mediatek,mt8192-disp-ccorr
      - items:
          - const: mediatek,mt8365-disp-ccorr
          - const: mediatek,mt8183-disp-ccorr
      - items:
          - enum:
              - mediatek,mt8186-disp-ccorr
              - mediatek,mt8188-disp-ccorr
              - mediatek,mt8195-disp-ccorr
          - const: mediatek,mt8192-disp-ccorr

  reg:
    maxItems: 1

  interrupts:
    maxItems: 1

  power-domains:
    description: A phandle and PM domain specifier as defined by bindings of
      the power controller specified by phandle. See
      Documentation/devicetree/bindings/power/power-domain.yaml for details.

  clocks:
    items:
      - description: CCORR Clock

  mediatek,gce-client-reg:
    description: The register of client driver can be configured by gce with
      4 arguments defined in this property, such as phandle of gce, subsys id,
      register offset and size. Each GCE subsys id is mapping to a client
      defined in the header include/dt-bindings/gce/<chip>-gce.h.
    $ref: /schemas/types.yaml#/definitions/phandle-array
    maxItems: 1

required:
  - compatible
  - reg
  - interrupts
  - power-domains
  - clocks

additionalProperties: false

examples:
  - |
    #include <dt-bindings/interrupt-controller/arm-gic.h>
    #include <dt-bindings/clock/mt8183-clk.h>
    #include <dt-bindings/power/mt8183-power.h>
    #include <dt-bindings/gce/mt8183-gce.h>

    soc {
        #address-cells = <2>;
        #size-cells = <2>;

        ccorr0: ccorr@1400f000 {
            compatible = "mediatek,mt8183-disp-ccorr";
            reg = <0 0x1400f000 0 0x1000>;
            interrupts = <GIC_SPI 232 IRQ_TYPE_LEVEL_LOW>;
            power-domains = <&spm MT8183_POWER_DOMAIN_DISP>;
            clocks = <&mmsys CLK_MM_DISP_CCORR0>;
            mediatek,gce-client-reg = <&gce SUBSYS_1400XXXX 0xf000 0x1000>;
        };
    };
```

## Documentation/devicetree/bindings/display/mediatek/mediatek,cec.yaml
```yaml
# SPDX-License-Identifier: (GPL-2.0-only OR BSD-2-Clause)
%YAML 1.2
---
$id: http://devicetree.org/schemas/display/mediatek/mediatek,cec.yaml#
$schema: http://devicetree.org/meta-schemas/core.yaml#

title: Mediatek HDMI CEC Controller

maintainers:
  - CK Hu <ck.hu@mediatek.com>
  - Jitao shi <jitao.shi@mediatek.com>

description: |
  The HDMI CEC controller handles hotplug detection and CEC communication.

properties:
  compatible:
    enum:
      - mediatek,mt7623-cec
      - mediatek,mt8167-cec
      - mediatek,mt8173-cec

  reg:
    maxItems: 1

  interrupts:
    maxItems: 1

  clocks:
    maxItems: 1

required:
  - compatible
  - reg
  - interrupts
  - clocks

additionalProperties: false

examples:
  - |
    #include <dt-bindings/clock/mt8173-clk.h>
    #include <dt-bindings/interrupt-controller/arm-gic.h>
    #include <dt-bindings/interrupt-controller/irq.h>
    cec: cec@10013000 {
        compatible = "mediatek,mt8173-cec";
        reg = <0x10013000 0xbc>;
        interrupts = <GIC_SPI 167 IRQ_TYPE_LEVEL_LOW>;
        clocks = <&infracfg CLK_INFRA_CEC>;
    };

...
```
