## Documentation/devicetree/bindings/display/imx/fsl,imx6qp-prg.yaml
```yaml
# SPDX-License-Identifier: (GPL-2.0-only OR BSD-2-Clause)
%YAML 1.2
---
$id: http://devicetree.org/schemas/display/imx/fsl,imx6qp-prg.yaml#
$schema: http://devicetree.org/meta-schemas/core.yaml#

title: Freescale i.MX PRG (Prefetch Resolve Gasket)

maintainers:
  - Frank Li <Frank.Li@nxp.com>

properties:
  compatible:
    const: fsl,imx6qp-prg

  reg:
    maxItems: 1

  clocks:
    maxItems: 2

  clock-names:
    items:
      - const: ipg
      - const: axi

  fsl,pres:
    $ref: /schemas/types.yaml#/definitions/phandle-array
    items:
      maxItems: 1
    description:
      phandles to the PRE units attached to this PRG, with the fixed
      PRE as the first entry and the muxable PREs following.

required:
  - compatible
  - reg
  - clocks
  - clock-names

additionalProperties: false

examples:
  - |
    #include <dt-bindings/clock/imx6qdl-clock.h>

    prg@21cc000 {
        compatible = "fsl,imx6qp-prg";
        reg = <0x021cc000 0x1000>;
        clocks = <&clks IMX6QDL_CLK_PRG0_APB>, <&clks IMX6QDL_CLK_PRG0_AXI>;
        clock-names = "ipg", "axi";
        fsl,pres = <&pre1>, <&pre2>, <&pre3>;
    };
```

## Documentation/devicetree/bindings/display/imx/fsl,imx8mp-hdmi-pai.yaml
```yaml
# SPDX-License-Identifier: (GPL-2.0-only OR BSD-2-Clause)
%YAML 1.2
---
$id: http://devicetree.org/schemas/display/imx/fsl,imx8mp-hdmi-pai.yaml#
$schema: http://devicetree.org/meta-schemas/core.yaml#

title: Freescale i.MX8MP HDMI Parallel Audio Interface

maintainers:
  - Shengjiu Wang <shengjiu.wang@nxp.com>

description:
  The HDMI TX Parallel Audio Interface (HTX_PAI) is a bridge between the
  Audio Subsystem to the HDMI TX Controller.

properties:
  compatible:
    const: fsl,imx8mp-hdmi-pai

  reg:
    maxItems: 1

  interrupts:
    maxItems: 1

  clocks:
    maxItems: 1

  clock-names:
    const: apb

  power-domains:
    maxItems: 1

  port:
    $ref: /schemas/graph.yaml#/properties/port
    description: Output to the HDMI TX controller.

required:
  - compatible
  - reg
  - interrupts
  - clocks
  - clock-names
  - power-domains
  - port

additionalProperties: false

examples:
  - |
    #include <dt-bindings/clock/imx8mp-clock.h>
    #include <dt-bindings/power/imx8mp-power.h>

    audio-bridge@32fc4800 {
        compatible = "fsl,imx8mp-hdmi-pai";
        reg = <0x32fc4800 0x800>;
        interrupt-parent = <&irqsteer_hdmi>;
        interrupts = <14>;
        clocks = <&clk IMX8MP_CLK_HDMI_APB>;
        clock-names = "apb";
        power-domains = <&hdmi_blk_ctrl IMX8MP_HDMIBLK_PD_PAI>;

        port {
            pai_to_hdmi_tx: endpoint {
                remote-endpoint = <&hdmi_tx_from_pai>;
            };
        };
    };
```

## Documentation/devicetree/bindings/display/imx/fsl,imx8mp-hdmi-pvi.yaml
```yaml
# SPDX-License-Identifier: (GPL-2.0-only OR BSD-2-Clause)
%YAML 1.2
---
$id: http://devicetree.org/schemas/display/imx/fsl,imx8mp-hdmi-pvi.yaml#
$schema: http://devicetree.org/meta-schemas/core.yaml#

title: Freescale i.MX8MP HDMI Parallel Video Interface

maintainers:
  - Lucas Stach <l.stach@pengutronix.de>

description:
  The HDMI parallel video interface is a timing and sync generator block in the
  i.MX8MP SoC, that sits between the video source and the HDMI TX controller.

properties:
  compatible:
    const: fsl,imx8mp-hdmi-pvi

  reg:
    maxItems: 1

  interrupts:
    maxItems: 1

  power-domains:
    maxItems: 1

  ports:
    $ref: /schemas/graph.yaml#/properties/ports

    properties:
      port@0:
        $ref: /schemas/graph.yaml#/properties/port
        description: Input from the LCDIF controller.

      port@1:
        $ref: /schemas/graph.yaml#/properties/port
        description: Output to the HDMI TX controller.

    required:
      - port@0
      - port@1

required:
  - compatible
  - reg
  - interrupts
  - power-domains
  - ports

additionalProperties: false

examples:
  - |
    #include <dt-bindings/interrupt-controller/irq.h>
    #include <dt-bindings/power/imx8mp-power.h>

    display-bridge@32fc4000 {
        compatible = "fsl,imx8mp-hdmi-pvi";
        reg = <0x32fc4000 0x44>;
        interrupt-parent = <&irqsteer_hdmi>;
        interrupts = <12 IRQ_TYPE_LEVEL_HIGH>;
        power-domains = <&hdmi_blk_ctrl IMX8MP_HDMIBLK_PD_PVI>;

        ports {
            #address-cells = <1>;
            #size-cells = <0>;

            port@0 {
                reg = <0>;
                pvi_from_lcdif3: endpoint {
                    remote-endpoint = <&lcdif3_to_pvi>;
                };
            };

            port@1 {
                reg = <1>;
                pvi_to_hdmi_tx: endpoint {
                    remote-endpoint = <&hdmi_tx_from_pvi>;
                };
            };
        };
    };
```

## Documentation/devicetree/bindings/display/imx/fsl,imx8qxp-dc-axi-performance-counter.yaml
```yaml
# SPDX-License-Identifier: (GPL-2.0-only OR BSD-2-Clause)
%YAML 1.2
---
$id: http://devicetree.org/schemas/display/imx/fsl,imx8qxp-dc-axi-performance-counter.yaml#
$schema: http://devicetree.org/meta-schemas/core.yaml#

title: Freescale i.MX8qxp Display Controller AXI Performance Counter

description: |
  Performance counters are provided to allow measurement of average bandwidth
  and latency during operation. The following features are supported:

  * Manual and timer controlled measurement mode.

  * Measurement counters:
    - GLOBAL_COUNTER for overall measurement time
    - BUSY_COUNTER for number of data bus busy cycles
    - DATA_COUNTER for number of data transfer cycles
    - TRANSFER_COUNTER for number of transfers
    - ADDRBUSY_COUNTER for number of address bus busy cycles
    - LATENCY_COUNTER for average latency

  * Counter overflow detection.

  * Outstanding Transfer Counters (OTC) which are used for latency measurement
    have to run immediately after reset, but can be disabled by software when
    there is no need for latency measurement.

maintainers:
  - Liu Ying <victor.liu@nxp.com>

properties:
  compatible:
    const: fsl,imx8qxp-dc-axi-performance-counter

  reg:
    maxItems: 1

  clocks:
    maxItems: 1

required:
  - compatible
  - reg
  - clocks

additionalProperties: false

examples:
  - |
    #include <dt-bindings/clock/imx8-lpcg.h>

    pmu@5618f000 {
        compatible = "fsl,imx8qxp-dc-axi-performance-counter";
        reg = <0x5618f000 0x90>;
        clocks = <&dc0_lpcg IMX_LPCG_CLK_5>;
    };
```

## Documentation/devicetree/bindings/display/imx/fsl,imx8qxp-dc-blit-engine.yaml
```yaml
# SPDX-License-Identifier: (GPL-2.0-only OR BSD-2-Clause)
%YAML 1.2
---
$id: http://devicetree.org/schemas/display/imx/fsl,imx8qxp-dc-blit-engine.yaml#
$schema: http://devicetree.org/meta-schemas/core.yaml#

title: Freescale i.MX8qxp Display Controller Blit Engine

description: |
  A blit operation (block based image transfer) reads up to 3 source images
  from memory and computes one destination image from it, which is written
  back to memory. The following basic operations are supported:

  * Buffer Fill
    Fills a buffer with constant color

  * Buffer Copy
    Copies one source to a destination buffer.

  * Image Blend
    Combines two source images by a blending equation and writes result to
    destination (which can be one of the sources).

  * Image Rop2/3
    Combines up to three source images by a logical equation (raster operation)
    and writes result to destination (which can be one of the sources).

  * Image Flip
    Mirrors the source image in horizontal and/or vertical direction.

  * Format Convert
    Convert between the supported color and buffer formats.

  * Color Transform
    Modify colors by linear or non-linear transformations.

  * Image Scale
    Changes size of the source image.

  * Image Rotate
    Rotates the source image by any angle.

  * Image Filter
    Performs an FIR filter operation on the source image.

  * Image Warp
    Performs a re-sampling of the source image with any pattern. The sample
    point positions are read from a compressed coordinate buffer.

  * Buffer Pack
    Writes an image with color components stored in up to three different
    buffers (planar formats) into a single buffer (packed format).

  * Chroma Resample
    Converts between different YUV formats that differ in chroma sampling rate
    (4:4:4, 4:2:2, 4:2:0).

maintainers:
  - Liu Ying <victor.liu@nxp.com>

properties:
  compatible:
    const: fsl,imx8qxp-dc-blit-engine

  reg:
    maxItems: 2

  reg-names:
    items:
      - const: pec
      - const: cfg

  "#address-cells":
    const: 1

  "#size-cells":
    const: 1

  ranges: true

patternProperties:
  "^blitblend@[0-9a-f]+$":
    type: object
    additionalProperties: true

    properties:
      compatible:
        const: fsl,imx8qxp-dc-blitblend

  "^clut@[0-9a-f]+$":
    type: object
    additionalProperties: true

    properties:
      compatible:
        const: fsl,imx8qxp-dc-clut

  "^fetchdecode@[0-9a-f]+$":
    type: object
    additionalProperties: true

    properties:
      compatible:
        const: fsl,imx8qxp-dc-fetchdecode

  "^fetcheco@[0-9a-f]+$":
    type: object
    additionalProperties: true

    properties:
      compatible:
        const: fsl,imx8qxp-dc-fetcheco

  "^fetchwarp@[0-9a-f]+$":
    type: object
    additionalProperties: true

    properties:
      compatible:
        const: fsl,imx8qxp-dc-fetchwarp

  "^filter@[0-9a-f]+$":
    type: object
    additionalProperties: true

    properties:
      compatible:
        const: fsl,imx8qxp-dc-filter

  "^hscaler@[0-9a-f]+$":
    type: object
    additionalProperties: true

    properties:
      compatible:
        const: fsl,imx8qxp-dc-hscaler

  "^matrix@[0-9a-f]+$":
    type: object
    additionalProperties: true

    properties:
      compatible:
        const: fsl,imx8qxp-dc-matrix

  "^rop@[0-9a-f]+$":
    type: object
    additionalProperties: true

    properties:
      compatible:
        const: fsl,imx8qxp-dc-rop

  "^store@[0-9a-f]+$":
    type: object
    additionalProperties: true

    properties:
      compatible:
        const: fsl,imx8qxp-dc-store

  "^vscaler@[0-9a-f]+$":
    type: object
    additionalProperties: true

    properties:
      compatible:
        const: fsl,imx8qxp-dc-vscaler

required:
  - compatible
  - reg
  - reg-names
  - "#address-cells"
  - "#size-cells"
  - ranges

additionalProperties: false

examples:
  - |
    blit-engine@56180820 {
        compatible = "fsl,imx8qxp-dc-blit-engine";
        reg = <0x56180820 0x13c>, <0x56181000 0x3400>;
        reg-names = "pec", "cfg";
        #address-cells = <1>;
        #size-cells = <1>;
        ranges;

        fetchdecode@56180820 {
            compatible = "fsl,imx8qxp-dc-fetchdecode";
            reg = <0x56180820 0x10>, <0x56181000 0x404>;
            reg-names = "pec", "cfg";
        };

        store@56180940 {
            compatible = "fsl,imx8qxp-dc-store";
            reg = <0x56180940 0x1c>, <0x56184000 0x5c>;
            reg-names = "pec", "cfg";
            interrupt-parent = <&dc0_intc>;
            interrupts = <0>, <1>, <2>;
            interrupt-names = "shdload", "framecomplete", "seqcomplete";
        };
    };
```

## Documentation/devicetree/bindings/display/imx/fsl,imx8qxp-dc-blitblend.yaml
```yaml
# SPDX-License-Identifier: (GPL-2.0-only OR BSD-2-Clause)
%YAML 1.2
---
$id: http://devicetree.org/schemas/display/imx/fsl,imx8qxp-dc-blitblend.yaml#
$schema: http://devicetree.org/meta-schemas/core.yaml#

title: Freescale i.MX8qxp Display Controller Blit Blend Unit

description:
  Combines two input frames to a single output frame, all frames having the
  same dimension.

maintainers:
  - Liu Ying <victor.liu@nxp.com>

properties:
  compatible:
    const: fsl,imx8qxp-dc-blitblend

  reg:
    maxItems: 2

  reg-names:
    items:
      - const: pec
      - const: cfg

required:
  - compatible
  - reg
  - reg-names

additionalProperties: false

examples:
  - |
    blitblend@56180920 {
        compatible = "fsl,imx8qxp-dc-blitblend";
        reg = <0x56180920 0x10>, <0x56183c00 0x3c>;
        reg-names = "pec", "cfg";
    };
```

## Documentation/devicetree/bindings/display/imx/fsl,imx8qxp-dc-clut.yaml
```yaml
# SPDX-License-Identifier: (GPL-2.0-only OR BSD-2-Clause)
%YAML 1.2
---
$id: http://devicetree.org/schemas/display/imx/fsl,imx8qxp-dc-clut.yaml#
$schema: http://devicetree.org/meta-schemas/core.yaml#

title: Freescale i.MX8qxp Display Controller Color Lookup Table

description: |
  The unit implements 3 look-up tables with 256 x 10 bit entries each. These
  can be used for different kinds of applications. From 10-bit input values
  only upper 8 bits are used.

  The unit supports color lookup, index lookup, dithering and alpha masking.

maintainers:
  - Liu Ying <victor.liu@nxp.com>

properties:
  compatible:
    const: fsl,imx8qxp-dc-clut

  reg:
    maxItems: 2

  reg-names:
    items:
      - const: pec
      - const: cfg

required:
  - compatible
  - reg
  - reg-names

additionalProperties: false

examples:
  - |
    clut@56180880 {
        compatible = "fsl,imx8qxp-dc-clut";
        reg = <0x56180880 0x10>, <0x56182400 0x404>;
        reg-names = "pec", "cfg";
    };
```

## Documentation/devicetree/bindings/display/imx/fsl,imx8qxp-dc-command-sequencer.yaml
```yaml
# SPDX-License-Identifier: (GPL-2.0-only OR BSD-2-Clause)
%YAML 1.2
---
$id: http://devicetree.org/schemas/display/imx/fsl,imx8qxp-dc-command-sequencer.yaml#
$schema: http://devicetree.org/meta-schemas/core.yaml#

title: Freescale i.MX8qxp Display Controller Command Sequencer

description: |
  The Command Sequencer is designed to autonomously process command lists.
  By that it can load setups into the DC configuration and synchronize to
  hardware events.  This releases a system's CPU from workload, because it
  does not need to wait for certain events.  Also it simplifies SW architecture,
  because no interrupt handlers are required.  Setups are read via AXI bus,
  while write access to configuration registers occurs directly via an internal
  bus.  This saves bandwidth for the AXI interconnect and improves the system
  architecture in terms of safety aspects.

maintainers:
  - Liu Ying <victor.liu@nxp.com>

properties:
  compatible:
    const: fsl,imx8qxp-dc-command-sequencer

  reg:
    maxItems: 1

  clocks:
    maxItems: 1

  interrupts:
    maxItems: 5

  interrupt-names:
    items:
      - const: error
      - const: sw0
      - const: sw1
      - const: sw2
      - const: sw3

  sram:
    $ref: /schemas/types.yaml#/definitions/phandle
    description: phandle pointing to the mmio-sram device node

required:
  - compatible
  - reg
  - clocks
  - interrupts
  - interrupt-names

additionalProperties: false

examples:
  - |
    #include <dt-bindings/clock/imx8-lpcg.h>

    command-sequencer@56180400 {
        compatible = "fsl,imx8qxp-dc-command-sequencer";
        reg = <0x56180400 0x1a4>;
        clocks = <&dc0_lpcg IMX_LPCG_CLK_5>;
        interrupt-parent = <&dc0_intc>;
        interrupts = <36>, <37>, <38>, <39>, <40>;
        interrupt-names = "error", "sw0", "sw1", "sw2", "sw3";
    };
```
