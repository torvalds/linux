## Documentation/devicetree/bindings/display/imx/fsl,imx8qxp-dc-signature.yaml
```yaml
# SPDX-License-Identifier: (GPL-2.0-only OR BSD-2-Clause)
%YAML 1.2
---
$id: http://devicetree.org/schemas/display/imx/fsl,imx8qxp-dc-signature.yaml#
$schema: http://devicetree.org/meta-schemas/core.yaml#

title: Freescale i.MX8qxp Display Controller Signature Unit

description: |
  In order to control the correctness of display output, signature values can
  be computed for each frame and compared against reference values. In case of
  a mismatch (signature violation) a HW event can be triggered, for example a
  SW interrupt.

  This unit supports signature computation, reference check, evaluation windows,
  alpha masking and panic modes.

maintainers:
  - Liu Ying <victor.liu@nxp.com>

properties:
  compatible:
    const: fsl,imx8qxp-dc-signature

  reg:
    maxItems: 1

  interrupts:
    maxItems: 3

  interrupt-names:
    items:
      - const: shdload
      - const: valid
      - const: error

required:
  - compatible
  - reg
  - interrupts
  - interrupt-names

additionalProperties: false

examples:
  - |
    signature@5618d000 {
        compatible = "fsl,imx8qxp-dc-signature";
        reg = <0x5618d000 0x140>;
        interrupt-parent = <&dc0_intc>;
        interrupts = <22>, <23>, <24>;
        interrupt-names = "shdload", "valid", "error";
    };
```

## Documentation/devicetree/bindings/display/imx/fsl,imx8qxp-dc-store.yaml
```yaml
# SPDX-License-Identifier: (GPL-2.0-only OR BSD-2-Clause)
%YAML 1.2
---
$id: http://devicetree.org/schemas/display/imx/fsl,imx8qxp-dc-store.yaml#
$schema: http://devicetree.org/meta-schemas/core.yaml#

title: Freescale i.MX8qxp Display Controller Store Unit

description: |
  The Store unit is the interface between the internal pixel processing
  pipeline, which is 30-bit RGB plus 8-bit Alpha, and the AXI bus for
  destination buffer access. It is used for the destination of Blit Engines.
  It comprises a set of built-in functions to generate a wide range of buffer
  formats. Note, that these are exactly inverse to corresponding functions in
  the Fetch Unit.

  +------X-------------------------+
  |      |              Store Unit |
  |      V                         |
  |  +-------+                     |
  |  | Gamma | Gamma apply         |
  |  +-------+                     |
  |      |                         |
  |      V                         |
  |  +-------+                     |
  |  | Color | RGB to YUV          |
  |  +-------+                     |
  |      |                         |
  |      V                         |
  |  +-------+                     |
  |  | Chroma| YUV444 to 422       |
  |  +-------+                     |
  |      |                         |
  |      V                         |
  |  +-------+                     |
  |  | Reduce| Bit width reduction |
  |  |       | dithering           |
  |  +-------+                     |
  |      |                         |
  |      V                         |
  |  +-------+                     |
  |  | Pack  | RGBA/YUV to RAW     |
  |  | Encode| or Compression      |
  |  +-------+                     |
  |      |                         |
  |      V                         |
  +------X-------------------------+

maintainers:
  - Liu Ying <victor.liu@nxp.com>

properties:
  compatible:
    const: fsl,imx8qxp-dc-store

  reg:
    maxItems: 2

  reg-names:
    items:
      - const: pec
      - const: cfg

  interrupts:
    maxItems: 3

  interrupt-names:
    items:
      - const: shdload
      - const: framecomplete
      - const: seqcomplete

  fsl,lts:
    $ref: /schemas/types.yaml#/definitions/phandle
    description:
      Optional Linear Tile Store associated with the Store Unit.

required:
  - compatible
  - reg
  - reg-names
  - interrupts
  - interrupt-names

additionalProperties: false

examples:
  - |
    store@56180940 {
        compatible = "fsl,imx8qxp-dc-store";
        reg = <0x56180940 0x1c>, <0x56184000 0x5c>;
        reg-names = "pec", "cfg";
        interrupt-parent = <&dc0_intc>;
        interrupts = <0>, <1>, <2>;
        interrupt-names = "shdload", "framecomplete", "seqcomplete";
    };
```

## Documentation/devicetree/bindings/display/imx/fsl,imx8qxp-dc-tcon.yaml
```yaml
# SPDX-License-Identifier: (GPL-2.0-only OR BSD-2-Clause)
%YAML 1.2
---
$id: http://devicetree.org/schemas/display/imx/fsl,imx8qxp-dc-tcon.yaml#
$schema: http://devicetree.org/meta-schemas/core.yaml#

title: Freescale i.MX8qxp Display Controller Timing Controller

description:
  The TCon can generate a wide range of customized synchronization signals and
  does the mapping of the color bits to the output.

maintainers:
  - Liu Ying <victor.liu@nxp.com>

properties:
  compatible:
    const: fsl,imx8qxp-dc-tcon

  reg:
    maxItems: 1

  port:
    $ref: /schemas/graph.yaml#/properties/port
    description: video output

required:
  - compatible
  - reg
  - port

additionalProperties: false

examples:
  - |
    tcon@5618c800 {
        compatible = "fsl,imx8qxp-dc-tcon";
        reg = <0x5618c800 0x588>;

        port {
            dc0_disp0_dc0_pixel_combiner_ch0: endpoint {
                remote-endpoint = <&dc0_pixel_combiner_ch0_dc0_disp0>;
            };
        };
    };
```
