## Documentation/devicetree/bindings/display/imx/fsl,imx8qxp-dc-framegen.yaml
```yaml
# SPDX-License-Identifier: (GPL-2.0-only OR BSD-2-Clause)
%YAML 1.2
---
$id: http://devicetree.org/schemas/display/imx/fsl,imx8qxp-dc-framegen.yaml#
$schema: http://devicetree.org/meta-schemas/core.yaml#

title: Freescale i.MX8qxp Display Controller Frame Generator

description:
  The Frame Generator (FrameGen) module generates a programmable video timing
  and optionally allows to synchronize the generated video timing to external
  synchronization signals.

maintainers:
  - Liu Ying <victor.liu@nxp.com>

properties:
  compatible:
    const: fsl,imx8qxp-dc-framegen

  reg:
    maxItems: 1

  clocks:
    maxItems: 1

  interrupts:
    maxItems: 8

  interrupt-names:
    items:
      - const: int0
      - const: int1
      - const: int2
      - const: int3
      - const: primsync_on
      - const: primsync_off
      - const: secsync_on
      - const: secsync_off

required:
  - compatible
  - reg
  - clocks
  - interrupts
  - interrupt-names

additionalProperties: false

examples:
  - |
    #include <dt-bindings/clock/imx8-lpcg.h>
    #include <dt-bindings/firmware/imx/rsrc.h>

    framegen@5618b800 {
        compatible = "fsl,imx8qxp-dc-framegen";
        reg = <0x5618b800 0x98>;
        clocks = <&dc0_disp_lpcg IMX_LPCG_CLK_0>;
        interrupt-parent = <&dc0_intc>;
        interrupts = <18>, <19>, <20>, <21>, <41>, <42>, <43>, <44>;
        interrupt-names = "int0", "int1", "int2", "int3",
                          "primsync_on", "primsync_off",
                          "secsync_on", "secsync_off";
    };
```

## Documentation/devicetree/bindings/display/imx/fsl,imx8qxp-dc-gammacor.yaml
```yaml
# SPDX-License-Identifier: (GPL-2.0-only OR BSD-2-Clause)
%YAML 1.2
---
$id: http://devicetree.org/schemas/display/imx/fsl,imx8qxp-dc-gammacor.yaml#
$schema: http://devicetree.org/meta-schemas/core.yaml#

title: Freescale i.MX8qxp Display Controller Gamma Correction Unit

description: The unit supports non-linear color transformation.

maintainers:
  - Liu Ying <victor.liu@nxp.com>

properties:
  compatible:
    const: fsl,imx8qxp-dc-gammacor

  reg:
    maxItems: 1

required:
  - compatible
  - reg

additionalProperties: false

examples:
  - |
    gammacor@5618c000 {
        compatible = "fsl,imx8qxp-dc-gammacor";
        reg = <0x5618c000 0x20>;
    };
```

## Documentation/devicetree/bindings/display/imx/fsl,imx8qxp-dc-layerblend.yaml
```yaml
# SPDX-License-Identifier: (GPL-2.0-only OR BSD-2-Clause)
%YAML 1.2
---
$id: http://devicetree.org/schemas/display/imx/fsl,imx8qxp-dc-layerblend.yaml#
$schema: http://devicetree.org/meta-schemas/core.yaml#

title: Freescale i.MX8qxp Display Controller Layer Blend Unit

description: Combines two input frames to a single output frame.

maintainers:
  - Liu Ying <victor.liu@nxp.com>

properties:
  compatible:
    const: fsl,imx8qxp-dc-layerblend

  reg:
    maxItems: 2

  reg-names:
    items:
      - const: pec
      - const: cfg

required:
  - compatible
  - reg
  - reg-names

additionalProperties: false

examples:
  - |
    layerblend@56180ba0 {
        compatible = "fsl,imx8qxp-dc-layerblend";
        reg = <0x56180ba0 0x10>, <0x5618a400 0x20>;
        reg-names = "pec", "cfg";
    };
```

## Documentation/devicetree/bindings/display/imx/fsl,imx8qxp-dc-matrix.yaml
```yaml
# SPDX-License-Identifier: (GPL-2.0-only OR BSD-2-Clause)
%YAML 1.2
---
$id: http://devicetree.org/schemas/display/imx/fsl,imx8qxp-dc-matrix.yaml#
$schema: http://devicetree.org/meta-schemas/core.yaml#

title: Freescale i.MX8qxp Display Controller Color Matrix

description:
  The unit supports linear color transformation, alpha pre-multiply and
  alpha masking.

maintainers:
  - Liu Ying <victor.liu@nxp.com>

properties:
  compatible:
    const: fsl,imx8qxp-dc-matrix

  reg:
    minItems: 1
    maxItems: 2

  reg-names:
    oneOf:
      - const: cfg      # matrix in display engine
      - items:          # matrix in pixel engine
          - const: pec
          - const: cfg

required:
  - compatible
  - reg
  - reg-names

additionalProperties: false

examples:
  - |
    matrix@5618bc00 {
        compatible = "fsl,imx8qxp-dc-matrix";
        reg = <0x5618bc00 0x3c>;
        reg-names = "cfg";
    };
```

## Documentation/devicetree/bindings/display/imx/fsl,imx8qxp-dc-pixel-engine.yaml
```yaml
# SPDX-License-Identifier: (GPL-2.0-only OR BSD-2-Clause)
%YAML 1.2
---
$id: http://devicetree.org/schemas/display/imx/fsl,imx8qxp-dc-pixel-engine.yaml#
$schema: http://devicetree.org/meta-schemas/core.yaml#

title: Freescale i.MX8qxp Display Controller Pixel Engine

description:
  All Processing Units that operate in the AXI bus clock domain. Pixel
  pipelines have the ability to stall when a destination is busy. Implements
  all communication to memory resources and most of the image processing
  functions. Interconnection of Processing Units is re-configurable.

maintainers:
  - Liu Ying <victor.liu@nxp.com>

properties:
  compatible:
    const: fsl,imx8qxp-dc-pixel-engine

  reg:
    maxItems: 1

  clocks:
    maxItems: 1

  "#address-cells":
    const: 1

  "#size-cells":
    const: 1

  ranges: true

patternProperties:
  "^blit-engine@[0-9a-f]+$":
    type: object
    additionalProperties: true

    properties:
      compatible:
        const: fsl,imx8qxp-dc-blit-engine

  "^constframe@[0-9a-f]+$":
    type: object
    additionalProperties: true

    properties:
      compatible:
        const: fsl,imx8qxp-dc-constframe

  "^extdst@[0-9a-f]+$":
    type: object
    additionalProperties: true

    properties:
      compatible:
        const: fsl,imx8qxp-dc-extdst

  "^fetchdecode@[0-9a-f]+$":
    type: object
    additionalProperties: true

    properties:
      compatible:
        const: fsl,imx8qxp-dc-fetchdecode

  "^fetcheco@[0-9a-f]+$":
    type: object
    additionalProperties: true

    properties:
      compatible:
        const: fsl,imx8qxp-dc-fetcheco

  "^fetchlayer@[0-9a-f]+$":
    type: object
    additionalProperties: true

    properties:
      compatible:
        const: fsl,imx8qxp-dc-fetchlayer

  "^fetchwarp@[0-9a-f]+$":
    type: object
    additionalProperties: true

    properties:
      compatible:
        const: fsl,imx8qxp-dc-fetchwarp

  "^hscaler@[0-9a-f]+$":
    type: object
    additionalProperties: true

    properties:
      compatible:
        const: fsl,imx8qxp-dc-hscaler

  "^layerblend@[0-9a-f]+$":
    type: object
    additionalProperties: true

    properties:
      compatible:
        const: fsl,imx8qxp-dc-layerblend

  "^matrix@[0-9a-f]+$":
    type: object
    additionalProperties: true

    properties:
      compatible:
        const: fsl,imx8qxp-dc-matrix

  "^safety@[0-9a-f]+$":
    type: object
    additionalProperties: true

    properties:
      compatible:
        const: fsl,imx8qxp-dc-safety

  "^vscaler@[0-9a-f]+$":
    type: object
    additionalProperties: true

    properties:
      compatible:
        const: fsl,imx8qxp-dc-vscaler

required:
  - compatible
  - reg
  - clocks
  - "#address-cells"
  - "#size-cells"
  - ranges

additionalProperties: false

examples:
  - |
    #include <dt-bindings/clock/imx8-lpcg.h>

    pixel-engine@56180800 {
        compatible = "fsl,imx8qxp-dc-pixel-engine";
        reg = <0x56180800 0xac00>;
        clocks = <&dc0_lpcg IMX_LPCG_CLK_5>;
        #address-cells = <1>;
        #size-cells = <1>;
        ranges;

        constframe@56180960 {
            compatible = "fsl,imx8qxp-dc-constframe";
            reg = <0x56180960 0xc>, <0x56184400 0x20>;
            reg-names = "pec", "cfg";
        };

        extdst@56180980 {
            compatible = "fsl,imx8qxp-dc-extdst";
            reg = <0x56180980 0x1c>, <0x56184800 0x28>;
            reg-names = "pec", "cfg";
            interrupt-parent = <&dc0_intc>;
            interrupts = <3>, <4>, <5>;
            interrupt-names = "shdload", "framecomplete", "seqcomplete";
        };

        constframe@561809a0 {
            compatible = "fsl,imx8qxp-dc-constframe";
            reg = <0x561809a0 0xc>, <0x56184c00 0x20>;
            reg-names = "pec", "cfg";
        };

        extdst@561809c0 {
            compatible = "fsl,imx8qxp-dc-extdst";
            reg = <0x561809c0 0x1c>, <0x56185000 0x28>;
            reg-names = "pec", "cfg";
            interrupt-parent = <&dc0_intc>;
            interrupts = <6>, <7>, <8>;
            interrupt-names = "shdload", "framecomplete", "seqcomplete";
        };

        constframe@561809e0 {
            compatible = "fsl,imx8qxp-dc-constframe";
            reg = <0x561809e0 0xc>, <0x56185400 0x20>;
            reg-names = "pec", "cfg";
        };

        extdst@56180a00 {
            compatible = "fsl,imx8qxp-dc-extdst";
            reg = <0x56180a00 0x1c>, <0x56185800 0x28>;
            reg-names = "pec", "cfg";
            interrupt-parent = <&dc0_intc>;
            interrupts = <9>, <10>, <11>;
            interrupt-names = "shdload", "framecomplete", "seqcomplete";
        };

        constframe@56180a20 {
            compatible = "fsl,imx8qxp-dc-constframe";
            reg = <0x56180a20 0xc>, <0x56185c00 0x20>;
            reg-names = "pec", "cfg";
        };

        extdst@56180a40 {
            compatible = "fsl,imx8qxp-dc-extdst";
            reg = <0x56180a40 0x1c>, <0x56186000 0x28>;
            reg-names = "pec", "cfg";
            interrupt-parent = <&dc0_intc>;
            interrupts = <12>, <13>, <14>;
            interrupt-names = "shdload", "framecomplete", "seqcomplete";
        };

        fetchwarp@56180a60 {
            compatible = "fsl,imx8qxp-dc-fetchwarp";
            reg = <0x56180a60 0x10>, <0x56186400 0x190>;
            reg-names = "pec", "cfg";
        };

        fetchlayer@56180ac0 {
            compatible = "fsl,imx8qxp-dc-fetchlayer";
            reg = <0x56180ac0 0xc>, <0x56188400 0x404>;
            reg-names = "pec", "cfg";
        };

        layerblend@56180ba0 {
            compatible = "fsl,imx8qxp-dc-layerblend";
            reg = <0x56180ba0 0x10>, <0x5618a400 0x20>;
            reg-names = "pec", "cfg";
        };

        layerblend@56180bc0 {
            compatible = "fsl,imx8qxp-dc-layerblend";
            reg = <0x56180bc0 0x10>, <0x5618a800 0x20>;
            reg-names = "pec", "cfg";
        };

        layerblend@56180be0 {
            compatible = "fsl,imx8qxp-dc-layerblend";
            reg = <0x56180be0 0x10>, <0x5618ac00 0x20>;
            reg-names = "pec", "cfg";
        };

        layerblend@56180c00 {
            compatible = "fsl,imx8qxp-dc-layerblend";
            reg = <0x56180c00 0x10>, <0x5618b000 0x20>;
            reg-names = "pec", "cfg";
        };
    };
```

## Documentation/devicetree/bindings/display/imx/fsl,imx8qxp-dc-rop.yaml
```yaml
# SPDX-License-Identifier: (GPL-2.0-only OR BSD-2-Clause)
%YAML 1.2
---
$id: http://devicetree.org/schemas/display/imx/fsl,imx8qxp-dc-rop.yaml#
$schema: http://devicetree.org/meta-schemas/core.yaml#

title: Freescale i.MX8qxp Display Controller Raster Operation Unit

description: |
  The unit can combine up to three input frames to a single output frame, all
  having the same dimension.

  The unit supports logic operations, arithmetic operations and packing.

maintainers:
  - Liu Ying <victor.liu@nxp.com>

properties:
  compatible:
    const: fsl,imx8qxp-dc-rop

  reg:
    maxItems: 2

  reg-names:
    items:
      - const: pec
      - const: cfg

required:
  - compatible
  - reg
  - reg-names

additionalProperties: false

examples:
  - |
    rop@56180860 {
        compatible = "fsl,imx8qxp-dc-rop";
        reg = <0x56180860 0x10>, <0x56182000 0x20>;
        reg-names = "pec", "cfg";
    };
```

## Documentation/devicetree/bindings/display/imx/fsl,imx8qxp-dc-safety.yaml
```yaml
# SPDX-License-Identifier: (GPL-2.0-only OR BSD-2-Clause)
%YAML 1.2
---
$id: http://devicetree.org/schemas/display/imx/fsl,imx8qxp-dc-safety.yaml#
$schema: http://devicetree.org/meta-schemas/core.yaml#

title: Freescale i.MX8qxp Display Controller Safety Unit

description:
  The unit allows corresponding processing units to be configured in a path
  leading to multiple endpoints.

maintainers:
  - Liu Ying <victor.liu@nxp.com>

properties:
  compatible:
    const: fsl,imx8qxp-dc-safety

  reg:
    maxItems: 1

required:
  - compatible
  - reg

additionalProperties: false

examples:
  - |
    safety@56180800 {
        compatible = "fsl,imx8qxp-dc-safety";
        reg = <0x56180800 0x1c>;
    };
```

## Documentation/devicetree/bindings/display/imx/fsl,imx8qxp-dc-scaling-engine.yaml
```yaml
# SPDX-License-Identifier: (GPL-2.0-only OR BSD-2-Clause)
%YAML 1.2
---
$id: http://devicetree.org/schemas/display/imx/fsl,imx8qxp-dc-scaling-engine.yaml#
$schema: http://devicetree.org/meta-schemas/core.yaml#

title: Freescale i.MX8qxp Display Controller Scaling Engine

description: |
  The unit can change the dimension of the input frame by nearest or linear
  re-sampling with 1/32 sub pixel precision.

  Internally it consist of two independent blocks for horizontal and vertical
  scaling. The sequence of both operations is arbitrary.

  Any frame dimensions between 1 and 16384 pixels in width and height are
  supported, except that the vertical scaler has a frame width maximum
  depending of the system's functional limitations.

  In general all scale factors are supported inside the supported frame
  dimensions. In range of scale factors 1/16..16 the filtered output colors
  are LSBit precise (e.g. DC ripple free).

                       +-----------+
                       |   Line    |
                       |  Buffer   |
                       +-----------+
                             ^
                             |
                             V
                 |\    +-----------+
           ------+ |   |           |
          |      | +-->| Vertical  |----
          |  ----+ |   |  Scaler   |    |
          | |    |/    +-----------+    |
          | |                           |
          | |                           |
          | |                           |     |\
          |  ------------- -------------+-----+ |
  Input --+               X                   | +--> Output
          |  ------------- -------------+-----+ |
          | |                           |     |/
          | |                           |
          | |    |\    +-----------+    |
          |  ----+ |   |           |    |
          |      | +-->| Horizontal|----
           ------+ |   |  Scaler   |
                 |/    +-----------+

  The unit supports downscaling, upscaling, sub pixel translation and bob
  de-interlacing.

maintainers:
  - Liu Ying <victor.liu@nxp.com>

properties:
  compatible:
    enum:
      - fsl,imx8qxp-dc-hscaler
      - fsl,imx8qxp-dc-vscaler

  reg:
    maxItems: 2

  reg-names:
    items:
      - const: pec
      - const: cfg

required:
  - compatible
  - reg
  - reg-names

additionalProperties: false

examples:
  - |
    hscaler@561808c0 {
        compatible = "fsl,imx8qxp-dc-hscaler";
        reg = <0x561808c0 0x10>, <0x56183000 0x18>;
        reg-names = "pec", "cfg";
    };
```
