## Documentation/devicetree/bindings/display/imx/fsl,imx8qxp-dc-constframe.yaml
```yaml
# SPDX-License-Identifier: (GPL-2.0-only OR BSD-2-Clause)
%YAML 1.2
---
$id: http://devicetree.org/schemas/display/imx/fsl,imx8qxp-dc-constframe.yaml#
$schema: http://devicetree.org/meta-schemas/core.yaml#

title: Freescale i.MX8qxp Display Controller Constant Frame

description: |
  The Constant Frame unit is used instead of a Fetch unit where generation of
  constant color frames only is sufficient. This is the case for the background
  planes of content and safety streams in a Display Controller.

  The color can be setup to any RGBA value.

maintainers:
  - Liu Ying <victor.liu@nxp.com>

properties:
  compatible:
    const: fsl,imx8qxp-dc-constframe

  reg:
    maxItems: 2

  reg-names:
    items:
      - const: pec
      - const: cfg

required:
  - compatible
  - reg
  - reg-names

additionalProperties: false

examples:
  - |
    constframe@56180960 {
        compatible = "fsl,imx8qxp-dc-constframe";
        reg = <0x56180960 0xc>, <0x56184400 0x20>;
        reg-names = "pec", "cfg";
    };
```

## Documentation/devicetree/bindings/display/imx/fsl,imx8qxp-dc-display-engine.yaml
```yaml
# SPDX-License-Identifier: (GPL-2.0-only OR BSD-2-Clause)
%YAML 1.2
---
$id: http://devicetree.org/schemas/display/imx/fsl,imx8qxp-dc-display-engine.yaml#
$schema: http://devicetree.org/meta-schemas/core.yaml#

title: Freescale i.MX8qxp Display Controller Display Engine

description:
  All Processing Units that operate in a display clock domain. Pixel pipeline
  is driven by a video timing and cannot be stalled. Implements all display
  specific processing.

maintainers:
  - Liu Ying <victor.liu@nxp.com>

properties:
  compatible:
    const: fsl,imx8qxp-dc-display-engine

  reg:
    maxItems: 2

  reg-names:
    items:
      - const: top
      - const: cfg

  resets:
    maxItems: 1

  interrupts:
    maxItems: 3

  interrupt-names:
    items:
      - const: shdload
      - const: framecomplete
      - const: seqcomplete

  power-domains:
    maxItems: 1

  "#address-cells":
    const: 1

  "#size-cells":
    const: 1

  ranges: true

patternProperties:
  "^dither@[0-9a-f]+$":
    type: object
    additionalProperties: true

    properties:
      compatible:
        const: fsl,imx8qxp-dc-dither

  "^framegen@[0-9a-f]+$":
    type: object
    additionalProperties: true

    properties:
      compatible:
        const: fsl,imx8qxp-dc-framegen

  "^gammacor@[0-9a-f]+$":
    type: object
    additionalProperties: true

    properties:
      compatible:
        const: fsl,imx8qxp-dc-gammacor

  "^matrix@[0-9a-f]+$":
    type: object
    additionalProperties: true

    properties:
      compatible:
        const: fsl,imx8qxp-dc-matrix

  "^signature@[0-9a-f]+$":
    type: object
    additionalProperties: true

    properties:
      compatible:
        const: fsl,imx8qxp-dc-signature

  "^tcon@[0-9a-f]+$":
    type: object
    additionalProperties: true

    properties:
      compatible:
        const: fsl,imx8qxp-dc-tcon

required:
  - compatible
  - reg
  - reg-names
  - interrupts
  - interrupt-names
  - power-domains
  - "#address-cells"
  - "#size-cells"
  - ranges

additionalProperties: false

examples:
  - |
    #include <dt-bindings/clock/imx8-lpcg.h>
    #include <dt-bindings/firmware/imx/rsrc.h>

    display-engine@5618b400 {
        compatible = "fsl,imx8qxp-dc-display-engine";
        reg = <0x5618b400 0x14>, <0x5618b800 0x1c00>;
        reg-names = "top", "cfg";
        interrupt-parent = <&dc0_intc>;
        interrupts = <15>, <16>, <17>;
        interrupt-names = "shdload", "framecomplete", "seqcomplete";
        power-domains = <&pd IMX_SC_R_DC_0_PLL_0>;
        #address-cells = <1>;
        #size-cells = <1>;
        ranges;

        framegen@5618b800 {
            compatible = "fsl,imx8qxp-dc-framegen";
            reg = <0x5618b800 0x98>;
            clocks = <&dc0_disp_lpcg IMX_LPCG_CLK_0>;
            interrupt-parent = <&dc0_intc>;
            interrupts = <18>, <19>, <20>, <21>, <41>, <42>, <43>, <44>;
            interrupt-names = "int0", "int1", "int2", "int3",
                              "primsync_on", "primsync_off",
                              "secsync_on", "secsync_off";
        };

        tcon@5618c800 {
            compatible = "fsl,imx8qxp-dc-tcon";
            reg = <0x5618c800 0x588>;

            port {
                dc0_disp0_dc0_pixel_combiner_ch0: endpoint {
                    remote-endpoint = <&dc0_pixel_combiner_ch0_dc0_disp0>;
                };
            };
        };
    };
```

## Documentation/devicetree/bindings/display/imx/fsl,imx8qxp-dc-dither.yaml
```yaml
# SPDX-License-Identifier: (GPL-2.0-only OR BSD-2-Clause)
%YAML 1.2
---
$id: http://devicetree.org/schemas/display/imx/fsl,imx8qxp-dc-dither.yaml#
$schema: http://devicetree.org/meta-schemas/core.yaml#

title: Freescale i.MX8qxp Display Controller Dither Unit

description: |
  The unit can increase the physical color resolution of a display from 5, 6, 7
  or 8 bits per RGB channel to a virtual resolution of 10 bits. The physical
  resolution can be set individually for each channel.

  The resolution is increased by mixing the two physical colors that are nearest
  to the virtual color code in a variable ratio either by time (temporal
  dithering) or by position (spatial dithering).

  An optimized algorithm for temporal dithering minimizes noise artifacts on the
  output image.

  The dither operation can be individually enabled or disabled for each pixel
  using the alpha input bit.

maintainers:
  - Liu Ying <victor.liu@nxp.com>

properties:
  compatible:
    const: fsl,imx8qxp-dc-dither

  reg:
    maxItems: 1

required:
  - compatible
  - reg

additionalProperties: false

examples:
  - |
    dither@5618c400 {
        compatible = "fsl,imx8qxp-dc-dither";
        reg = <0x5618c400 0x14>;
    };
```

## Documentation/devicetree/bindings/display/imx/fsl,imx8qxp-dc-extdst.yaml
```yaml
# SPDX-License-Identifier: (GPL-2.0-only OR BSD-2-Clause)
%YAML 1.2
---
$id: http://devicetree.org/schemas/display/imx/fsl,imx8qxp-dc-extdst.yaml#
$schema: http://devicetree.org/meta-schemas/core.yaml#

title: Freescale i.MX8qxp Display Controller External Destination Interface

description: |
  The External Destination unit is the interface between the internal pixel
  processing pipeline of the Pixel Engine, which is 30-bit RGB plus 8-bit Alpha,
  and a Display Engine.

  It comprises the following built-in Gamma apply function.

  +------X-----------------------+
  |      |          ExtDst Unit  |
  |      V                       |
  |  +-------+                   |
  |  | Gamma |                   |
  |  +-------+                   |
  |      |                       |
  |      V                       +
  +------X-----------------------+

  The output format is 24-bit RGB plus 1-bit Alpha. Conversion from 10 to 8
  bits is done by LSBit truncation.  Alpha output bit is 1 for input 255, 0
  otherwise.

maintainers:
  - Liu Ying <victor.liu@nxp.com>

properties:
  compatible:
    const: fsl,imx8qxp-dc-extdst

  reg:
    maxItems: 2

  reg-names:
    items:
      - const: pec
      - const: cfg

  interrupts:
    maxItems: 3

  interrupt-names:
    items:
      - const: shdload
      - const: framecomplete
      - const: seqcomplete

required:
  - compatible
  - reg
  - reg-names
  - interrupts
  - interrupt-names

additionalProperties: false

examples:
  - |
    extdst@56180980 {
        compatible = "fsl,imx8qxp-dc-extdst";
        reg = <0x56180980 0x1c>, <0x56184800 0x28>;
        reg-names = "pec", "cfg";
        interrupt-parent = <&dc0_intc>;
        interrupts = <3>, <4>, <5>;
        interrupt-names = "shdload", "framecomplete", "seqcomplete";
    };
```

## Documentation/devicetree/bindings/display/imx/fsl,imx8qxp-dc-fetchunit.yaml
```yaml
# SPDX-License-Identifier: (GPL-2.0-only OR BSD-2-Clause)
%YAML 1.2
---
$id: http://devicetree.org/schemas/display/imx/fsl,imx8qxp-dc-fetchunit.yaml#
$schema: http://devicetree.org/meta-schemas/core.yaml#

title: Freescale i.MX8qxp Display Controller Fetch Unit

description: |
  The Fetch Unit is the interface between the AXI bus for source buffer access
  and the internal pixel processing pipeline, which is 30-bit RGB plus 8-bit
  Alpha.

  It is used to generate foreground planes in Display Controllers and source
  planes in Blit Engines, and comprises the following built-in functions to
  convert a wide range of frame buffer types.

  +---------X-----------------------------------------+
  |         |                           Fetch Unit    |
  |         V                                         |
  |    +---------+                                    |
  |    |         |                                    |
  |    | Decode  | Decompression [Decode]             |
  |    |         |                                    |
  |    +---------+                                    |
  |         |                                         |
  |         V                                         |
  |    +---------+                                    |
  |    | Clip &  | Clip Window [All]                  |
  |    | Overlay | Plane composition [Layer, Warp]    |
  |    |         |                                    |
  |    +---------+                                    |
  |         |                                         |
  |         V                                         |
  |    +---------+                                    |
  |    | Re-     | Flip/Rotate/Repl./Drop [All]       |
  X--> | sample  | Perspective/Affine warping [Persp] |
  | |  |         | Arbitrary warping [Warp, Persp]    |
  | |  +---------+                                    |
  | |       |                                         |
  | |       V                                         |
  | |  +---------+                                    |
  | |  |         |                                    |
  | |  | Palette | Color Palette [Layer, Decode]      |
  | |  |         |                                    |
  | |  +---------+                                    |
  | |       |                                         |
  | |       V                                         |
  | |  +---------+                                    |
  | |  | Extract | Raw to RGBA/YUV [All]              |
  | |  | &       | Bit width expansion [All]          |
  | |  | Expand  |                                    |
  | |  +---------+                                    |
  | |       |                                         |
  | |       V                                         |
  | |  +---------+                                    |
  | |  |         | Planar to packed                   |
  | |->| Combine | [Decode, Warp, Persp]              |
  | |  |         |                                    |
  | |  +---------+                                    |
  | |       |                                         |
  | |       V                                         |
  | |  +---------+                                    |
  | |  |         | YUV422 to YUV444                   |
  | |  | Chroma  | [Decode, Persp]                    |
  | |  |         |                                    |
  | |  +---------+                                    |
  | |       |                                         |
  | |       V                                         |
  | |  +---------+                                    |
  | |  |         | YUV to RGB                         |
  | |  | Color   | [Warp, Persp, Decode, Layer]       |
  | |  |         |                                    |
  | |  +---------+                                    |
  | |       |                                         |
  | |       V                                         |
  | |  +---------+                                    |
  | |  |         | Gamma removal                      |
  | |  | Gamma   | [Warp, Persp, Decode, Layer]       |
  | |  |         |                                    |
  | |  +---------+                                    |
  | |       |                                         |
  | |       V                                         |
  | |  +---------+                                    |
  | |  |         | Alpla multiply, RGB pre-multiply   |
  |  ->| Multiply| [Warp, Persp, Decode, Layer]       |
  |    |         |                                    |
  |     ---------                                     |
  |         |                                         |
  |         V                                         |
  |    +---------+                                    |
  |    |         | Bilinear filter                    |
  |    | Filter  | [Warp, Persp]                      |
  |    |         |                                    |
  |    +---------+                                    |
  |         |                                         |
  |         V                                         |
  +---------X-----------------------------------------+

  Note that different derivatives of the Fetch Unit exist. Each implements a
  specific subset only of the pipeline stages shown above. Restrictions for the
  units are specified in [square brackets].

maintainers:
  - Liu Ying <victor.liu@nxp.com>

properties:
  compatible:
    enum:
      - fsl,imx8qxp-dc-fetchdecode
      - fsl,imx8qxp-dc-fetcheco
      - fsl,imx8qxp-dc-fetchlayer
      - fsl,imx8qxp-dc-fetchwarp

  reg:
    maxItems: 2

  reg-names:
    items:
      - const: pec
      - const: cfg

  fsl,prg:
    $ref: /schemas/types.yaml#/definitions/phandle
    description:
      Optional Prefetch Resolve Gasket associated with the Fetch Unit.

required:
  - compatible
  - reg
  - reg-names

additionalProperties: false

examples:
  - |
    fetchlayer@56180ac0 {
        compatible = "fsl,imx8qxp-dc-fetchlayer";
        reg = <0x56180ac0 0xc>, <0x56188400 0x404>;
        reg-names = "pec", "cfg";
    };
```

## Documentation/devicetree/bindings/display/imx/fsl,imx8qxp-dc-filter.yaml
```yaml
# SPDX-License-Identifier: (GPL-2.0-only OR BSD-2-Clause)
%YAML 1.2
---
$id: http://devicetree.org/schemas/display/imx/fsl,imx8qxp-dc-filter.yaml#
$schema: http://devicetree.org/meta-schemas/core.yaml#

title: Freescale i.MX8qxp Display Controller Filter Unit

description: |
  5x5 FIR filter with 25 programmable coefficients.

  Typical applications are image blurring, sharpening or support for edge
  detection algorithms.

maintainers:
  - Liu Ying <victor.liu@nxp.com>

properties:
  compatible:
    const: fsl,imx8qxp-dc-filter

  reg:
    maxItems: 2

  reg-names:
    items:
      - const: pec
      - const: cfg

required:
  - compatible
  - reg
  - reg-names

additionalProperties: false

examples:
  - |
    filter@56180900 {
        compatible = "fsl,imx8qxp-dc-filter";
        reg = <0x56180900 0x10>, <0x56183800 0x30>;
        reg-names = "pec", "cfg";
    };
```
