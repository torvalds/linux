## Documentation/devicetree/bindings/display/msm/qcom,kaanapali-mdss.yaml
```yaml
# SPDX-License-Identifier: GPL-2.0-only OR BSD-2-Clause
%YAML 1.2
---
$id: http://devicetree.org/schemas/display/msm/qcom,kaanapali-mdss.yaml#
$schema: http://devicetree.org/meta-schemas/core.yaml#

title: Qualcomm Kaanapali Display MDSS

maintainers:
  - Yongxing Mou <yongxing.mou@oss.qualcomm.com>
  - Yuanjie Yang <yuanjie.yang@oss.qualcomm.com>

description:
  Kaanapali MSM Mobile Display Subsystem(MDSS), which encapsulates sub-blocks
  like DPU display controller, DSI and DP interfaces etc.

$ref: /schemas/display/msm/mdss-common.yaml#

properties:
  compatible:
    const: qcom,kaanapali-mdss

  clocks:
    items:
      - description: Display AHB
      - description: Display hf AXI
      - description: Display core
      - description: Display AHB SWI

  iommus:
    maxItems: 1

  interconnects:
    items:
      - description: Interconnect path from mdp0 port to the data bus
      - description: Interconnect path from CPU to the reg bus

  interconnect-names:
    items:
      - const: mdp0-mem
      - const: cpu-cfg

patternProperties:
  "^display-controller@[0-9a-f]+$":
    type: object
    additionalProperties: true
    properties:
      compatible:
        const: qcom,kaanapali-dpu

  "^dsi@[0-9a-f]+$":
    type: object
    additionalProperties: true
    properties:
      compatible:
        contains:
          const: qcom,kaanapali-dsi-ctrl

  "^phy@[0-9a-f]+$":
    type: object
    additionalProperties: true
    properties:
      compatible:
        const: qcom,kaanapali-dsi-phy-3nm

required:
  - compatible

unevaluatedProperties: false

examples:
  - |
    #include <dt-bindings/clock/qcom,rpmh.h>
    #include <dt-bindings/interconnect/qcom,icc.h>
    #include <dt-bindings/interrupt-controller/arm-gic.h>
    #include <dt-bindings/phy/phy-qcom-qmp.h>
    #include <dt-bindings/power/qcom,rpmhpd.h>

    display-subsystem@9800000 {
        compatible = "qcom,kaanapali-mdss";
        reg = <0x09800000 0x1000>;
        reg-names = "mdss";

        interrupts = <GIC_SPI 83 IRQ_TYPE_LEVEL_HIGH>;

        clocks = <&disp_cc_mdss_ahb_clk>,
                 <&gcc_disp_hf_axi_clk>,
                 <&disp_cc_mdss_mdp_clk>,
                 <&disp_cc_mdss_ahb_swi_clk>;
        resets = <&disp_cc_mdss_core_bcr>;

        power-domains = <&mdss_gdsc>;

        iommus = <&apps_smmu 0x800 0x2>;

        interrupt-controller;
        #interrupt-cells = <1>;

        #address-cells = <1>;
        #size-cells = <1>;
        ranges;

        display-controller@9801000 {
            compatible = "qcom,kaanapali-dpu";
            reg = <0x09801000 0x1c8000>,
                  <0x09b16000 0x3000>;
            reg-names = "mdp",
                        "vbif";

            interrupts-extended = <&mdss 0>;

            clocks = <&gcc_disp_hf_axi_clk>,
                     <&disp_cc_mdss_ahb_clk>,
                     <&disp_cc_mdss_mdp_lut_clk>,
                     <&disp_cc_mdss_mdp_clk>,
                     <&disp_cc_mdss_vsync_clk>;
            clock-names = "nrt_bus",
                          "iface",
                          "lut",
                          "core",
                          "vsync";

            assigned-clocks = <&disp_cc_mdss_vsync_clk>;
            assigned-clock-rates = <19200000>;

            operating-points-v2 = <&mdp_opp_table>;

            power-domains = <&rpmhpd RPMHPD_MMCX>;

            ports {
                #address-cells = <1>;
                #size-cells = <0>;

                port@0 {
                    reg = <0>;

                    dpu_intf1_out: endpoint {
                        remote-endpoint = <&mdss_dsi0_in>;
                    };
                };

                port@1 {
                    reg = <1>;

                    dpu_intf2_out: endpoint {
                        remote-endpoint = <&mdss_dsi1_in>;
                    };
                };
            };

            mdp_opp_table: opp-table {
                compatible = "operating-points-v2";

                opp-156000000 {
                    opp-hz = /bits/ 64 <156000000>;
                    required-opps = <&rpmhpd_opp_low_svs_d1>;
                };

                opp-207000000 {
                    opp-hz = /bits/ 64 <207000000>;
                    required-opps = <&rpmhpd_opp_low_svs>;
                };

                opp-337000000 {
                    opp-hz = /bits/ 64 <337000000>;
                    required-opps = <&rpmhpd_opp_svs>;
                };

                opp-417000000 {
                    opp-hz = /bits/ 64 <417000000>;
                    required-opps = <&rpmhpd_opp_svs_l1>;
                };

                opp-532000000 {
                    opp-hz = /bits/ 64 <532000000>;
                    required-opps = <&rpmhpd_opp_nom>;
                };

                opp-600000000 {
                    opp-hz = /bits/ 64 <600000000>;
                    required-opps = <&rpmhpd_opp_nom_l1>;
                };

                opp-650000000 {
                    opp-hz = /bits/ 64 <650000000>;
                    required-opps = <&rpmhpd_opp_turbo>;
                };
            };
        };

        dsi@9ac0000 {
            compatible = "qcom,kaanapali-dsi-ctrl", "qcom,mdss-dsi-ctrl";
            reg = <0x09ac0000 0x1000>;
            reg-names = "dsi_ctrl";

            interrupts-extended = <&mdss 4>;

            clocks = <&disp_cc_mdss_byte0_clk>,
                     <&disp_cc_mdss_byte0_intf_clk>,
                     <&disp_cc_mdss_pclk0_clk>,
                     <&disp_cc_mdss_esc0_clk>,
                     <&disp_cc_mdss_ahb_clk>,
                     <&gcc_disp_hf_axi_clk>,
                     <&mdss_dsi0_phy 1>,
                     <&mdss_dsi0_phy 0>,
                     <&disp_cc_esync0_clk>,
                     <&disp_cc_osc_clk>,
                     <&disp_cc_mdss_byte0_clk_src>,
                     <&disp_cc_mdss_pclk0_clk_src>;
            clock-names = "byte",
                          "byte_intf",
                          "pixel",
                          "core",
                          "iface",
                          "bus",
                          "dsi_pll_pixel",
                          "dsi_pll_byte",
                          "esync",
                          "osc",
                          "byte_src",
                          "pixel_src";

            operating-points-v2 = <&mdss_dsi_opp_table>;

            power-domains = <&rpmhpd RPMHPD_MMCX>;

            phys = <&mdss_dsi0_phy>;
            phy-names = "dsi";

            #address-cells = <1>;
            #size-cells = <0>;

            ports {
                #address-cells = <1>;
                #size-cells = <0>;

                port@0 {
                    reg = <0>;

                    mdss_dsi0_in: endpoint {
                        remote-endpoint = <&dpu_intf1_out>;
                    };
                };

                port@1 {
                    reg = <1>;

                    mdss_dsi0_out: endpoint {
                        remote-endpoint = <&panel0_in>;
                        data-lanes = <0 1 2 3>;
                    };
                };
            };

            mdss_dsi_opp_table: opp-table {
                compatible = "operating-points-v2";

                opp-187500000 {
                    opp-hz = /bits/ 64 <187500000>;
                    required-opps = <&rpmhpd_opp_low_svs_d1>;
                };

                opp-250000000 {
                    opp-hz = /bits/ 64 <250000000>;
                    required-opps = <&rpmhpd_opp_low_svs>;
                };

                opp-312500000 {
                    opp-hz = /bits/ 64 <312500000>;
                    required-opps = <&rpmhpd_opp_svs>;
                };

                opp-358000000 {
                    opp-hz = /bits/ 64 <358000000>;
                    required-opps = <&rpmhpd_opp_svs_l1>;
                };
            };
        };

        mdss_dsi0_phy: phy@9ac1000 {
            compatible = "qcom,kaanapali-dsi-phy-3nm";
            reg = <0x09ac1000 0x1cc>,
                  <0x09ac1200 0x80>,
                  <0x09ac1500 0x400>;
            reg-names = "dsi_phy",
                        "dsi_phy_lane",
                        "dsi_pll";

            clocks = <&disp_cc_mdss_ahb_clk>,
                     <&rpmhcc RPMH_CXO_CLK>;
            clock-names = "iface",
                          "ref";

            #clock-cells = <1>;
            #phy-cells = <0>;
        };
    };
```

## Documentation/devicetree/bindings/display/msm/qcom,mdp5.yaml
```yaml
# SPDX-License-Identifier: GPL-2.0-only or BSD-2-Clause
%YAML 1.2
---
$id: http://devicetree.org/schemas/display/msm/qcom,mdp5.yaml#
$schema: http://devicetree.org/meta-schemas/core.yaml#

title: Qualcomm Adreno/Snapdragon Mobile Display controller (MDP5)

description:
  MDP5 display controller found in SoCs like MSM8974, APQ8084, MSM8916, MSM8994
  and MSM8996.

maintainers:
  - Dmitry Baryshkov <dmitry.baryshkov@linaro.org>
  - Rob Clark <robdclark@gmail.com>

properties:
  compatible:
    oneOf:
      - const: qcom,mdp5
        deprecated: true
      - items:
          - enum:
              - qcom,apq8084-mdp5
              - qcom,msm8916-mdp5
              - qcom,msm8917-mdp5
              - qcom,msm8953-mdp5
              - qcom,msm8974-mdp5
              - qcom,msm8976-mdp5
              - qcom,msm8994-mdp5
              - qcom,msm8996-mdp5
              - qcom,sdm630-mdp5
              - qcom,sdm660-mdp5
          - const: qcom,mdp5

  $nodename:
    pattern: '^display-controller@[0-9a-f]+$'

  reg:
    maxItems: 1

  reg-names:
    items:
      - const: mdp_phys

  interrupts:
    maxItems: 1

  clocks:
    minItems: 4
    maxItems: 7

  clock-names:
    oneOf:
      - minItems: 4
        items:
          - const: iface
          - const: bus
          - const: core
          - const: vsync
          - const: lut
          - const: tbu
          - const: tbu_rt
        # MSM8996 has additional iommu clock
      - items:
          - const: iface
          - const: bus
          - const: core
          - const: iommu
          - const: vsync

  interconnects:
    minItems: 1
    items:
      - description: Interconnect path from mdp0 (or a single mdp) port to the data bus
      - description: Interconnect path from mdp1 port to the data bus
      - description: Interconnect path from rotator port to the data bus

  interconnect-names:
    minItems: 1
    items:
      - const: mdp0-mem
      - const: mdp1-mem
      - const: rotator-mem

  iommus:
    items:
      - description: apps SMMU with the Stream-ID mask for Hard-Fail port0

  power-domains:
    maxItems: 1

  operating-points-v2: true
  opp-table:
    type: object

  ports:
    $ref: /schemas/graph.yaml#/properties/ports
    description: >
      Contains the list of output ports from DPU device. These ports
      connect to interfaces that are external to the DPU hardware,
      such as DSI, DP etc. MDP5 devices support up to 4 ports:
      one or two DSI ports, HDMI and eDP.

    patternProperties:
      "^port@[0-3]+$":
        $ref: /schemas/graph.yaml#/properties/port

    # at least one port is required
    required:
      - port@0

required:
  - compatible
  - reg
  - reg-names
  - clocks
  - clock-names
  - ports

additionalProperties: false

examples:
  - |
    #include <dt-bindings/clock/qcom,gcc-msm8916.h>
    #include <dt-bindings/interrupt-controller/arm-gic.h>
    display-controller@1a01000 {
        compatible = "qcom,mdp5";
        reg = <0x1a01000 0x90000>;
        reg-names = "mdp_phys";

        interrupt-parent = <&mdss>;
        interrupts = <0>;

        clocks = <&gcc GCC_MDSS_AHB_CLK>,
                 <&gcc GCC_MDSS_AXI_CLK>,
                 <&gcc GCC_MDSS_MDP_CLK>,
                 <&gcc GCC_MDSS_VSYNC_CLK>;
        clock-names = "iface",
                      "bus",
                      "core",
                      "vsync";

        ports {
            #address-cells = <1>;
            #size-cells = <0>;

            port@0 {
                reg = <0>;
                endpoint {
                    remote-endpoint = <&dsi0_in>;
                };
            };
        };
    };
...
```
