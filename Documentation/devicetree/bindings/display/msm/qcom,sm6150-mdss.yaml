## Documentation/devicetree/bindings/display/msm/qcom,x1e80100-mdss.yaml
```yaml
# SPDX-License-Identifier: GPL-2.0-only OR BSD-2-Clause
%YAML 1.2
---
$id: http://devicetree.org/schemas/display/msm/qcom,x1e80100-mdss.yaml#
$schema: http://devicetree.org/meta-schemas/core.yaml#

title: Qualcomm X1E80100 Display MDSS

maintainers:
  - Abel Vesa <abel.vesa@linaro.org>

description:
  X1E80100 MSM Mobile Display Subsystem(MDSS), which encapsulates sub-blocks like
  DPU display controller, DP interfaces, etc.

$ref: /schemas/display/msm/mdss-common.yaml#

properties:
  compatible:
    const: qcom,x1e80100-mdss

  clocks:
    items:
      - description: Display AHB
      - description: Display hf AXI
      - description: Display core

  iommus:
    maxItems: 1

  interconnects:
    maxItems: 3

  interconnect-names:
    maxItems: 3

patternProperties:
  "^display-controller@[0-9a-f]+$":
    type: object
    additionalProperties: true
    properties:
      compatible:
        const: qcom,x1e80100-dpu

  "^displayport-controller@[0-9a-f]+$":
    type: object
    additionalProperties: true
    properties:
      compatible:
        const: qcom,x1e80100-dp

  "^phy@[0-9a-f]+$":
    type: object
    additionalProperties: true
    properties:
      compatible:
        const: qcom,x1e80100-dp-phy

required:
  - compatible

unevaluatedProperties: false

examples:
  - |
    #include <dt-bindings/clock/qcom,rpmh.h>
    #include <dt-bindings/interrupt-controller/arm-gic.h>
    #include <dt-bindings/interconnect/qcom,x1e80100-rpmh.h>
    #include <dt-bindings/phy/phy-qcom-qmp.h>
    #include <dt-bindings/power/qcom,rpmhpd.h>

    display-subsystem@ae00000 {
        compatible = "qcom,x1e80100-mdss";
        reg = <0x0ae00000 0x1000>;
        reg-names = "mdss";

        interconnects = <&mmss_noc MASTER_MDP 0 &gem_noc SLAVE_LLCC 0>,
                        <&mc_virt MASTER_LLCC 0 &mc_virt SLAVE_EBI1 0>,
                        <&gem_noc MASTER_APPSS_PROC 0 &config_noc SLAVE_DISPLAY_CFG 0>;
        interconnect-names = "mdp0-mem", "mdp1-mem", "cpu-cfg";

        resets = <&dispcc_core_bcr>;

        power-domains = <&dispcc_gdsc>;

        clocks = <&dispcc_ahb_clk>,
                 <&gcc_disp_hf_axi_clk>,
                 <&dispcc_mdp_clk>;
        clock-names = "bus", "nrt_bus", "core";

        interrupts = <GIC_SPI 83 IRQ_TYPE_LEVEL_HIGH>;
        interrupt-controller;
        #interrupt-cells = <1>;

        iommus = <&apps_smmu 0x1c00 0x2>;

        #address-cells = <1>;
        #size-cells = <1>;
        ranges;

        display-controller@ae01000 {
            compatible = "qcom,x1e80100-dpu";
            reg = <0x0ae01000 0x8f000>,
                  <0x0aeb0000 0x2008>;
            reg-names = "mdp", "vbif";

            clocks = <&gcc_axi_clk>,
                     <&dispcc_ahb_clk>,
                     <&dispcc_mdp_lut_clk>,
                     <&dispcc_mdp_clk>,
                     <&dispcc_mdp_vsync_clk>;
            clock-names = "nrt_bus",
                          "iface",
                          "lut",
                          "core",
                          "vsync";

            assigned-clocks = <&dispcc_mdp_vsync_clk>;
            assigned-clock-rates = <19200000>;

            operating-points-v2 = <&mdp_opp_table>;
            power-domains = <&rpmhpd RPMHPD_MMCX>;

            interrupt-parent = <&mdss>;
            interrupts = <0>;

            ports {
                #address-cells = <1>;
                #size-cells = <0>;

                port@0 {
                    reg = <0>;
                    dpu_intf1_out: endpoint {
                        remote-endpoint = <&dsi0_in>;
                    };
                };

                port@1 {
                    reg = <1>;
                    dpu_intf2_out: endpoint {
                        remote-endpoint = <&dsi1_in>;
                    };
                };
            };

            mdp_opp_table: opp-table {
                compatible = "operating-points-v2";

                opp-200000000 {
                    opp-hz = /bits/ 64 <200000000>;
                    required-opps = <&rpmhpd_opp_low_svs>;
                };

                opp-325000000 {
                    opp-hz = /bits/ 64 <325000000>;
                    required-opps = <&rpmhpd_opp_svs>;
                };

                opp-375000000 {
                    opp-hz = /bits/ 64 <375000000>;
                    required-opps = <&rpmhpd_opp_svs_l1>;
                };

                opp-514000000 {
                    opp-hz = /bits/ 64 <514000000>;
                    required-opps = <&rpmhpd_opp_nom>;
                };
            };
        };

        displayport-controller@ae90000 {
            compatible = "qcom,x1e80100-dp";
            reg = <0xae90000 0x200>,
                  <0xae90200 0x200>,
                  <0xae90400 0x600>,
                  <0xae91000 0x400>,
                  <0xae91400 0x400>;

            interrupt-parent = <&mdss>;
            interrupts = <12>;

            clocks = <&dispcc_mdss_ahb_clk>,
               <&dispcc_dptx0_aux_clk>,
               <&dispcc_dptx0_link_clk>,
               <&dispcc_dptx0_link_intf_clk>,
               <&dispcc_dptx0_pixel0_clk>,
               <&dispcc_dptx0_pixel1_clk>;
            clock-names = "core_iface", "core_aux",
                    "ctrl_link",
                    "ctrl_link_iface",
                    "stream_pixel",
                    "stream_1_pixel";

            assigned-clocks = <&dispcc_mdss_dptx0_link_clk_src>,
                  <&dispcc_mdss_dptx0_pixel0_clk_src>,
                  <&dispcc_mdss_dptx0_pixel1_clk_src>;
            assigned-clock-parents = <&usb_1_ss0_qmpphy QMP_USB43DP_DP_LINK_CLK>,
                  <&usb_1_ss0_qmpphy QMP_USB43DP_DP_VCO_DIV_CLK>,
                  <&usb_1_ss0_qmpphy QMP_USB43DP_DP_VCO_DIV_CLK>;

            operating-points-v2 = <&mdss_dp0_opp_table>;

            power-domains = <&rpmhpd RPMHPD_MMCX>;

            phys = <&usb_1_ss0_qmpphy QMP_USB43DP_DP_PHY>;
            phy-names = "dp";

            #sound-dai-cells = <0>;

            ports {
              #address-cells = <1>;
              #size-cells = <0>;

              port@0 {
                  reg = <0>;

                  mdss_dp0_in: endpoint {
                    remote-endpoint = <&mdss_intf0_out>;
                  };
              };

              port@1 {
                  reg = <1>;

                  mdss_dp0_out: endpoint {
                  };
              };
            };

            mdss_dp0_opp_table: opp-table {
              compatible = "operating-points-v2";

              opp-160000000 {
                 opp-hz = /bits/ 64 <160000000>;
                 required-opps = <&rpmhpd_opp_low_svs>;
              };

              opp-270000000 {
                 opp-hz = /bits/ 64 <270000000>;
                 required-opps = <&rpmhpd_opp_svs>;
              };

              opp-540000000 {
                 opp-hz = /bits/ 64 <540000000>;
                 required-opps = <&rpmhpd_opp_svs_l1>;
              };

              opp-810000000 {
                 opp-hz = /bits/ 64 <810000000>;
                 required-opps = <&rpmhpd_opp_nom>;
              };
            };
        };
    };
...
```

## Documentation/devicetree/bindings/display/multi-inno,mi0283qt.txt
```
Multi-Inanal MI0283QT display panel

Required properties:
- compatible:	"multi-inanal,mi0283qt".

The analde for this driver must be a child analde of a SPI controller, hence
all mandatory properties described in ../spi/spi-bus.txt must be specified.

Optional properties:
- dc-gpios:	D/C pin. The presence/absence of this GPIO determines
		the panel interface mode (IM[3:0] pins):
		- present: IM=x110 4-wire 8-bit data serial interface
		- absent:  IM=x101 3-wire 9-bit data serial interface
- reset-gpios:	Reset pin
- power-supply:	A regulator analde for the supply voltage.
- backlight:	phandle of the backlight device attached to the panel
- rotation:	panel rotation in degrees counter clockwise (0,90,180,270)

Example:
	mi0283qt@0{
		compatible = "multi-inanal,mi0283qt";
		reg = <0>;
		spi-max-frequency = <32000000>;
		rotation = <90>;
		dc-gpios = <&gpio 25 0>;
		backlight = <&backlight>;
	};
```

## Documentation/devicetree/bindings/display/mxsfb.txt
```
* Freescale MXS LCD Interface (LCDIF)

New bindings:
=============
Required properties:
- compatible:	Should be "fsl,imx23-lcdif" for i.MX23.
		Should be "fsl,imx28-lcdif" for i.MX28.
		Should be "fsl,imx6sx-lcdif" for i.MX6SX.
		Should be "fsl,imx8mq-lcdif" for i.MX8MQ.
- reg:		Address and length of the register set for LCDIF
- interrupts:	Should contain LCDIF interrupt
- clocks:	A list of phandle + clock-specifier pairs, one for each
		entry in 'clock-names'.
- clock-names:	A list of clock names. For MXSFB it should contain:
    - "pix" for the LCDIF block clock
    - (MX6SX-only) "axi", "disp_axi" for the bus interface clock

Required sub-nodes:
  - port: The connection to an encoder chip.

Example:

	lcdif1: display-controller@2220000 {
		compatible = "fsl,imx6sx-lcdif", "fsl,imx28-lcdif";
		reg = <0x02220000 0x4000>;
		interrupts = <GIC_SPI 5 IRQ_TYPE_LEVEL_HIGH>;
		clocks = <&clks IMX6SX_CLK_LCDIF1_PIX>,
			 <&clks IMX6SX_CLK_LCDIF_APB>,
			 <&clks IMX6SX_CLK_DISPLAY_AXI>;
		clock-names = "pix", "axi", "disp_axi";

		port {
			parallel_out: endpoint {
				remote-endpoint = <&panel_in_parallel>;
			};
		};
	};

Deprecated bindings:
====================
Required properties:
- compatible:	Should be "fsl,imx23-lcdif" for i.MX23.
		Should be "fsl,imx28-lcdif" for i.MX28.
- reg:		Address and length of the register set for LCDIF
- interrupts:	Should contain LCDIF interrupts
- display:	phandle to display node (see below for details)

* display node

Required properties:
- bits-per-pixel:	<16> for RGB565, <32> for RGB888/666.
- bus-width:		number of data lines.  Could be <8>, <16>, <18> or <24>.

Required sub-node:
- display-timings:	Refer to binding doc display-timing.txt for details.

Examples:

lcdif@80030000 {
	compatible = "fsl,imx28-lcdif";
	reg = <0x80030000 2000>;
	interrupts = <38 86>;

	display: display {
		bits-per-pixel = <32>;
		bus-width = <24>;

		display-timings {
			native-mode = <&timing0>;
			timing0: timing0 {
				clock-frequency = <33500000>;
				hactive = <800>;
				vactive = <480>;
				hfront-porch = <164>;
				hback-porch = <89>;
				hsync-len = <10>;
				vback-porch = <23>;
				vfront-porch = <10>;
				vsync-len = <10>;
				hsync-active = <0>;
				vsync-active = <0>;
				de-active = <1>;
				pixelclk-active = <0>;
			};
		};
	};
};
```

## Documentation/devicetree/bindings/display/panel/abt,y030xx067a.yaml
```yaml
# SPDX-License-Identifier: (GPL-2.0 OR BSD-2-Clause)
%YAML 1.2
---
$id: http://devicetree.org/schemas/display/panel/abt,y030xx067a.yaml#
$schema: http://devicetree.org/meta-schemas/core.yaml#

title: Asia Better Technology 3.0" (320x480 pixels) 24-bit IPS LCD panel

maintainers:
  - Paul Cercueil <paul@crapouillou.net>

allOf:
  - $ref: panel-common.yaml#
  - $ref: /schemas/spi/spi-peripheral-props.yaml#

properties:
  compatible:
    const: abt,y030xx067a

  reg:
    maxItems: 1

  backlight: true
  port: true
  power-supply: true
  reset-gpios: true

required:
  - compatible
  - reg
  - power-supply
  - reset-gpios

unevaluatedProperties: false

examples:
  - |
    #include <dt-bindings/gpio/gpio.h>

    spi {
        #address-cells = <1>;
        #size-cells = <0>;

        panel@0 {
            compatible = "abt,y030xx067a";
            reg = <0>;

            spi-max-frequency = <3125000>;

            reset-gpios = <&gpe 2 GPIO_ACTIVE_LOW>;

            backlight = <&backlight>;
            power-supply = <&vcc>;

            port {
                panel_input: endpoint {
                    remote-endpoint = <&panel_output>;
                };
            };
        };
    };
```

## Documentation/devicetree/bindings/display/panel/advantech,idk-1110wr.yaml
```yaml
# SPDX-License-Identifier: (GPL-2.0-only OR BSD-2-Clause)
%YAML 1.2
---
$id: http://devicetree.org/schemas/display/panel/advantech,idk-1110wr.yaml#
$schema: http://devicetree.org/meta-schemas/core.yaml#

title: Advantech IDK-1110WR 10.1" WSVGA LVDS Display Panel

maintainers:
  - Lad Prabhakar <prabhakar.mahadev-lad.rj@bp.renesas.com>
  - Thierry Reding <thierry.reding@gmail.com>

allOf:
  - $ref: panel-common.yaml#
  - $ref: /schemas/display/lvds.yaml#

select:
  properties:
    compatible:
      contains:
        const: advantech,idk-1110wr

  required:
    - compatible

properties:
  compatible:
    items:
      - const: advantech,idk-1110wr
      - const: panel-lvds

  data-mapping:
    const: jeida-24

  width-mm:
    const: 223

  height-mm:
    const: 125

  panel-timing: true
  port: true

additionalProperties: false

required:
  - compatible
  - data-mapping
  - width-mm
  - height-mm
  - panel-timing
  - port

examples:
  - |+
    panel {
      compatible = "advantech,idk-1110wr", "panel-lvds";

      width-mm = <223>;
      height-mm = <125>;

      data-mapping = "jeida-24";

      panel-timing {
        /* 1024x600 @60Hz */
        clock-frequency = <51200000>;
        hactive = <1024>;
        vactive = <600>;
        hsync-len = <240>;
        hfront-porch = <40>;
        hback-porch = <40>;
        vsync-len = <10>;
        vfront-porch = <15>;
        vback-porch = <10>;
      };

      port {
        panel_in: endpoint {
          remote-endpoint = <&lvds_encoder>;
        };
      };
    };

...
```
