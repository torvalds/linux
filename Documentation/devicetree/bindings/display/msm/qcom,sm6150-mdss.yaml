## Documentation/devicetree/bindings/display/panel/advantech,idk-2121wr.yaml
```yaml
# SPDX-License-Identifier: (GPL-2.0-only OR BSD-2-Clause)
%YAML 1.2
---
$id: http://devicetree.org/schemas/display/panel/advantech,idk-2121wr.yaml#
$schema: http://devicetree.org/meta-schemas/core.yaml#

title: Advantech IDK-2121WR 21.5" Full-HD dual-LVDS panel

maintainers:
  - Lad Prabhakar <prabhakar.mahadev-lad.rj@bp.renesas.com>
  - Thierry Reding <thierry.reding@gmail.com>

description: |
  The IDK-2121WR from Advantech is a Full-HD dual-LVDS panel.
  A dual-LVDS interface is a dual-link connection with even pixels traveling
  on one link, and with odd pixels traveling on the other link.

  The panel expects odd pixels on the first port, and even pixels on the
  second port, therefore the ports must be marked accordingly (with either
  dual-lvds-odd-pixels or dual-lvds-even-pixels).

allOf:
  - $ref: panel-common.yaml#

properties:
  compatible:
    items:
      - const: advantech,idk-2121wr
      - {} # panel-lvds, but not listed here to avoid false select

  width-mm:
    const: 476

  height-mm:
    const: 268

  data-mapping:
    const: vesa-24

  panel-timing: true

  ports:
    $ref: /schemas/graph.yaml#/properties/ports

    properties:
      port@0:
        $ref: /schemas/graph.yaml#/$defs/port-base
        unevaluatedProperties: false
        description: The sink for odd pixels.
        properties:
          dual-lvds-odd-pixels: true

        required:
          - dual-lvds-odd-pixels

      port@1:
        $ref: /schemas/graph.yaml#/$defs/port-base
        unevaluatedProperties: false
        description: The sink for even pixels.
        properties:
          dual-lvds-even-pixels: true

        required:
          - dual-lvds-even-pixels

    required:
      - port@0
      - port@1

additionalProperties: false

required:
  - compatible
  - width-mm
  - height-mm
  - data-mapping
  - panel-timing
  - ports

examples:
  - |+
    panel-lvds {
      compatible = "advantech,idk-2121wr", "panel-lvds";

      width-mm = <476>;
      height-mm = <268>;

      data-mapping = "vesa-24";

      panel-timing {
        clock-frequency = <148500000>;
        hactive = <1920>;
        vactive = <1080>;
        hsync-len = <44>;
        hfront-porch = <88>;
        hback-porch = <148>;
        vfront-porch = <4>;
        vback-porch = <36>;
        vsync-len = <5>;
      };

      ports {
        #address-cells = <1>;
        #size-cells = <0>;

        port@0 {
          reg = <0>;
          dual-lvds-odd-pixels;
          panel_in0: endpoint {
            remote-endpoint = <&lvds0_out>;
          };
        };

        port@1 {
          reg = <1>;
          dual-lvds-even-pixels;
          panel_in1: endpoint {
            remote-endpoint = <&lvds1_out>;
          };
        };
      };
    };

...
```

## Documentation/devicetree/bindings/display/panel/ampire,am-480272h3tmqw-t01h.txt
```
Ampire AM-480272H3TMQW-T01H 4.3" WQVGA TFT LCD panel

This binding is compatible with the simple-panel binding, which is specified
in simple-panel.txt in this directory.

Required properties:
- compatible: should be "ampire,am-480272h3tmqw-t01h"

Optional properties:
- power-supply: regulator to provide the supply voltage
- enable-gpios: GPIO pin to enable or disable the panel
- backlight: phandle of the backlight device attached to the panel

Optional nodes:
- Video port for RGB input.

Example:
	panel_rgb: panel-rgb {
		compatible = "ampire,am-480272h3tmqw-t01h";
		enable-gpios = <&gpioa 8 1>;
		port {
			panel_in_rgb: endpoint {
				remote-endpoint = <&controller_out_rgb>;
			};
		};
	};
```

## Documentation/devicetree/bindings/display/panel/ampire,am-480272h3tmqw-t01h.yaml
```yaml
# SPDX-License-Identifier: GPL-2.0
%YAML 1.2
---
$id: http://devicetree.org/schemas/display/panel/ampire,am-480272h3tmqw-t01h.yaml#
$schema: http://devicetree.org/meta-schemas/core.yaml#

title: Ampire AM-480272H3TMQW-T01H 4.3" WQVGA TFT LCD panel

maintainers:
  - Yannick Fertre <yannick.fertre@st.com>
  - Thierry Reding <treding@nvidia.com>

allOf:
  - $ref: panel-common.yaml#

properties:
  compatible:
    const: ampire,am-480272h3tmqw-t01h

  power-supply: true
  enable-gpios: true
  backlight: true
  port: true

required:
  - compatible

additionalProperties: false

examples:
  - |
    panel_rgb: panel {
      compatible = "ampire,am-480272h3tmqw-t01h";
      enable-gpios = <&gpioa 8 1>;
      port {
        panel_in_rgb: endpoint {
          remote-endpoint = <&controller_out_rgb>;
        };
      };
    };

...
```

## Documentation/devicetree/bindings/display/panel/ampire,am800480r3tmqwa1h.txt
```
Ampire AM-800480R3TMQW-A1H 7.0" WVGA TFT LCD panel

Required properties:
- compatible: should be "ampire,am800480r3tmqwa1h"

This binding is compatible with the simple-panel binding, which is specified
in simple-panel.txt in this directory.
```
