## Documentation/devicetree/bindings/display/tegra/nvidia,tegra20-gr3d.yaml
```yaml
# SPDX-License-Identifier: (GPL-2.0-only OR BSD-2-Clause)
%YAML 1.2
---
$id: http://devicetree.org/schemas/display/tegra/nvidia,tegra20-gr3d.yaml#
$schema: http://devicetree.org/meta-schemas/core.yaml#

title: NVIDIA 3D graphics engine

maintainers:
  - Thierry Reding <thierry.reding@gmail.com>
  - Jon Hunter <jonathanh@nvidia.com>

properties:
  $nodename:
    pattern: "^gr3d@[0-9a-f]+$"

  compatible:
    enum:
      - nvidia,tegra20-gr3d
      - nvidia,tegra30-gr3d
      - nvidia,tegra114-gr3d

  reg:
    maxItems: 1

  clocks:
    minItems: 1
    maxItems: 2

  clock-names:
    minItems: 1
    maxItems: 2

  resets:
    minItems: 2
    maxItems: 4

  reset-names:
    minItems: 2
    maxItems: 4

  iommus:
    minItems: 1
    maxItems: 2

  interconnects:
    minItems: 4
    maxItems: 10

  interconnect-names:
    minItems: 4
    maxItems: 10

  operating-points-v2:
    $ref: "/schemas/types.yaml#/definitions/phandle"

  power-domains:
    minItems: 1
    maxItems: 2

  power-domain-names:
    maxItems: 2

allOf:
  - if:
      properties:
        compatible:
          contains:
            const: nvidia,tegra20-gr2d
    then:
      properties:
        clocks:
          items:
            - description: module clock

        clock-names:
          items:
            - const: 3d

        resets:
          items:
            - description: module reset
            - description: memory client hotflush reset

        reset-names:
          items:
            - const: 3d
            - const: mc

        iommus:
          maxItems: 1

        interconnects:
          minItems: 4
          maxItems: 4

        interconnect-names:
          minItems: 4
          maxItems: 4

        power-domains:
          items:
            - description: phandle to the TD power domain

  - if:
      properties:
        compatible:
          contains:
            const: nvidia,tegra30-gr3d
    then:
      properties:
        clocks:
          items:
            - description: primary module clock
            - description: secondary module clock

        clock-names:
          items:
            - const: 3d
            - const: 3d2

        resets:
          items:
            - description: primary module reset
            - description: secondary module reset
            - description: primary memory client hotflush reset
            - description: secondary memory client hotflush reset

        reset-names:
          items:
            - const: 3d
            - const: 3d2
            - const: mc
            - const: mc2

        iommus:
          minItems: 2
          maxItems: 2

        interconnects:
          minItems: 8
          maxItems: 8

        interconnect-names:
          minItems: 8
          maxItems: 8

        power-domains:
          items:
            - description: phandle to the TD power domain
            - description: phandle to the TD2 power domain

        power-domain-names:
          items:
            - const: 3d0
            - const: 3d1

      dependencies:
        power-domains: [ power-domain-names ]

  - if:
      properties:
        compatible:
          contains:
            const: nvidia,tegra114-gr2d
    then:
      properties:
        clocks:
          items:
            - description: module clock

        clock-names:
          items:
            - const: 3d

        resets:
          items:
            - description: module reset
            - description: memory client hotflush reset

        reset-names:
          items:
            - const: 3d
            - const: mc

        iommus:
          maxItems: 1

        interconnects:
          minItems: 10
          maxItems: 10

        interconnect-names:
          minItems: 10
          maxItems: 10

        power-domains:
          items:
            - description: phandle to the TD power domain

additionalProperties: false

examples:
  - |
    #include <dt-bindings/clock/tegra20-car.h>
    #include <dt-bindings/memory/tegra20-mc.h>

    gr3d@54180000 {
        compatible = "nvidia,tegra20-gr3d";
        reg = <0x54180000 0x00040000>;
        clocks = <&tegra_car TEGRA20_CLK_GR3D>;
        resets = <&tegra_car 24>, <&mc TEGRA20_MC_RESET_3D>;
        reset-names = "3d", "mc";
    };
```

## Documentation/devicetree/bindings/display/tegra/nvidia,tegra20-hdmi.yaml
```yaml
# SPDX-License-Identifier: (GPL-2.0-only OR BSD-2-Clause)
%YAML 1.2
---
$id: http://devicetree.org/schemas/display/tegra/nvidia,tegra20-hdmi.yaml#
$schema: http://devicetree.org/meta-schemas/core.yaml#

title: NVIDIA Tegra HDMI Output Encoder

maintainers:
  - Thierry Reding <thierry.reding@gmail.com>
  - Jon Hunter <jonathanh@nvidia.com>

properties:
  $nodename:
    pattern: "^hdmi@[0-9a-f]+$"

  compatible:
    oneOf:
      - enum:
          - nvidia,tegra20-hdmi
          - nvidia,tegra30-hdmi
          - nvidia,tegra114-hdmi
          - nvidia,tegra124-hdmi

      - items:
          - const: nvidia,tegra132-hdmi
          - const: nvidia,tegra124-hdmi

  reg:
    maxItems: 1

  interrupts:
    maxItems: 1

  clocks:
    items:
      - description: module clock
      - description: parent clock

  clock-names:
    items:
      - const: hdmi
      - const: parent

  resets:
    items:
      - description: module reset

  reset-names:
    items:
      - const: hdmi

  operating-points-v2: true

  power-domains:
    items:
      - description: phandle to the core power domain

  hdmi-supply:
    description: supply for the +5V HDMI connector pin

  vdd-supply:
    description: regulator for supply voltage

  pll-supply:
    description: regulator for PLL

  nvidia,ddc-i2c-bus:
    description: phandle of an I2C controller used for DDC EDID
      probing
    $ref: /schemas/types.yaml#/definitions/phandle

  nvidia,hpd-gpio:
    description: specifies a GPIO used for hotplug detection
    maxItems: 1

  nvidia,edid:
    description: supplies a binary EDID blob
    $ref: /schemas/types.yaml#/definitions/uint8-array

  nvidia,panel:
    description: phandle of a display panel
    $ref: /schemas/types.yaml#/definitions/phandle

  "#sound-dai-cells":
    const: 0

additionalProperties: false

required:
  - compatible
  - reg
  - interrupts
  - clocks
  - clock-names
  - resets
  - reset-names
  - pll-supply
  - vdd-supply
  - nvidia,ddc-i2c-bus
  - nvidia,hpd-gpio

examples:
  - |
    #include <dt-bindings/clock/tegra124-car.h>
    #include <dt-bindings/interrupt-controller/arm-gic.h>
    #include <dt-bindings/gpio/tegra-gpio.h>

    hdmi@54280000 {
        compatible = "nvidia,tegra124-hdmi";
        reg = <0x54280000 0x00040000>;
        interrupts = <GIC_SPI 75 IRQ_TYPE_LEVEL_HIGH>;
        clocks = <&tegra_car TEGRA124_CLK_HDMI>,
                 <&tegra_car TEGRA124_CLK_PLL_D2_OUT0>;
        clock-names = "hdmi", "parent";
        resets = <&tegra_car 51>;
        reset-names = "hdmi";

        hdmi-supply = <&vdd_5v0_hdmi>;
        pll-supply = <&vdd_hdmi_pll>;
        vdd-supply = <&vdd_3v3_hdmi>;

        nvidia,ddc-i2c-bus = <&hdmi_ddc>;
        nvidia,hpd-gpio = <&gpio TEGRA_GPIO(N, 7) GPIO_ACTIVE_HIGH>;
    };
```
