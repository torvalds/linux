## Documentation/devicetree/bindings/display/ti/ti,omap4-dss.txt
```
Texas Instruments OMAP4 Display Subsystem
=========================================

See Documentation/devicetree/bindings/display/ti/ti,omap-dss.txt for generic
description about OMAP Display Subsystem bindings.

DSS Core
--------

Required properties:
- compatible: "ti,omap4-dss"
- reg: address and length of the register space
- ti,hwmods: "dss_core"
- clocks: handle to fclk
- clock-names: "fck"

Required nodes:
- DISPC

Optional nodes:
- DSS Submodules: RFBI, VENC, DSI, HDMI
- Video port for DPI output

DPI Endpoint required properties:
- data-lines: number of lines used


DISPC
-----

Required properties:
- compatible: "ti,omap4-dispc"
- reg: address and length of the register space
- ti,hwmods: "dss_dispc"
- interrupts: the DISPC interrupt
- clocks: handle to fclk
- clock-names: "fck"

Optional properties:
- max-memory-bandwidth: Input memory (from main memory to dispc) bandwidth limit
			in bytes per second


RFBI
----

Required properties:
- compatible: "ti,omap4-rfbi"
- reg: address and length of the register space
- ti,hwmods: "dss_rfbi"
- clocks: handles to fclk and iclk
- clock-names: "fck", "ick"

Optional nodes:
- Video port for RFBI output
- RFBI controlled peripherals


VENC
----

Required properties:
- compatible: "ti,omap4-venc"
- reg: address and length of the register space
- ti,hwmods: "dss_venc"
- vdda-supply: power supply for DAC
- clocks: handle to fclk
- clock-names: "fck"

Optional nodes:
- Video port for VENC output

VENC Endpoint required properties:
- ti,invert-polarity: invert the polarity of the video signal
- ti,channels: 1 for composite, 2 for s-video


DSI
---

Required properties:
- compatible: "ti,omap4-dsi"
- reg: addresses and lengths of the register spaces for 'proto', 'phy' and 'pll'
- reg-names: "proto", "phy", "pll"
- interrupts: the DSI interrupt line
- ti,hwmods: "dss_dsi1" or "dss_dsi2"
- vdd-supply: power supply for DSI
- clocks: handles to fclk and pll clock
- clock-names: "fck", "sys_clk"

Optional nodes:
- Video port for DSI output
- DSI controlled peripherals

DSI Endpoint required properties:
- lanes: list of pin numbers for the DSI lanes: CLK+, CLK-, DATA0+, DATA0-,
  DATA1+, DATA1-, ...


HDMI
----

Required properties:
- compatible: "ti,omap4-hdmi"
- reg: addresses and lengths of the register spaces for 'wp', 'pll', 'phy',
       'core'
- reg-names: "wp", "pll", "phy", "core"
- interrupts: the HDMI interrupt line
- ti,hwmods: "dss_hdmi"
- vdda-supply: vdda power supply
- clocks: handles to fclk and pll clock
- clock-names: "fck", "sys_clk"

Optional nodes:
- Video port for HDMI output

HDMI Endpoint optional properties:
- lanes: list of 8 pin numbers for the HDMI lanes: CLK+, CLK-, D0+, D0-,
  D1+, D1-, D2+, D2-. (default: 0,1,2,3,4,5,6,7)
```

## Documentation/devicetree/bindings/display/ti/ti,opa362.txt
```
OPA362 analog video amplifier

Required properties:
- compatible: "ti,opa362"
- enable-gpios: enable/disable output gpio

Required node:
- Video port 0 for opa362 input
- Video port 1 for opa362 output

Example:

tv_amp: opa362 {
	compatible = "ti,opa362";
	enable-gpios = <&gpio1 23 0>;  /* GPIO to enable video out amplifier */

	ports {
		#address-cells = <1>;
		#size-cells = <0>;

		port@0 {
			reg = <0>;
			opa_in: endpoint@0 {
				remote-endpoint = <&venc_out>;
			};
		};

		port@1 {
			reg = <1>;
			opa_out: endpoint@0 {
				remote-endpoint = <&tv_connector_in>;
			};
		};
	};
};
```

## Documentation/devicetree/bindings/display/ti/ti,tfp410.txt
```
TFP410 DPI to DVI encoder
=========================

Required properties:
- compatible: "ti,tfp410"

Optional properties:
- powerdown-gpios: power-down gpio

Required nodes:
- Video port 0 for DPI input
- Video port 1 for DVI output

Example
-------

tfp410: encoder@0 {
	compatible = "ti,tfp410";
	powerdown-gpios = <&twl_gpio 2 GPIO_ACTIVE_LOW>;

	ports {
		#address-cells = <1>;
		#size-cells = <0>;

		port@0 {
			reg = <0>;

			tfp410_in: endpoint@0 {
				remote-endpoint = <&dpi_out>;
			};
		};

		port@1 {
			reg = <1>;

			tfp410_out: endpoint@0 {
				remote-endpoint = <&dvi_connector_in>;
			};
		};
	};
};
```

## Documentation/devicetree/bindings/display/tilcdc/panel.txt
```
Device-Tree bindings for tilcdc DRM generic panel output driver

Required properties:
 - compatible: value should be "ti,tilcdc,panel".
 - panel-info: configuration info to configure LCDC correctly for the panel
   - ac-bias: AC Bias Pin Frequency
   - ac-bias-intrpt: AC Bias Pin Transitions per Interrupt
   - dma-burst-sz: DMA burst size
   - bpp: Bits per pixel
   - fdd: FIFO DMA Request Delay
   - sync-edge: Horizontal and Vertical Sync Edge: 0=rising 1=falling
   - sync-ctrl: Horizontal and Vertical Sync: Control: 0=ignore
   - raster-order: Raster Data Order Select: 1=Most-to-least 0=Least-to-most
   - fifo-th: DMA FIFO threshold
 - display-timings: typical videomode of lcd panel.  Multiple video modes
   can be listed if the panel supports multiple timings, but the 'native-mode'
   should be the preferred/default resolution.  Refer to
   Documentation/devicetree/bindings/display/display-timing.txt for display
   timing binding details.

Optional properties:
- backlight: phandle of the backlight device attached to the panel
- enable-gpios: GPIO pin to enable or disable the panel

Recommended properties:
 - pinctrl-names, pinctrl-0: the pincontrol settings to configure
   muxing properly for pins that connect to TFP410 device

Example:

	/* Settings for CDTech_S035Q01 / LCD3 cape: */
	lcd3 {
		compatible = "ti,tilcdc,panel";
		pinctrl-names = "default";
		pinctrl-0 = <&bone_lcd3_cape_lcd_pins>;
		backlight = <&backlight>;
		enable-gpios = <&gpio3 19 0>;

		panel-info {
			ac-bias           = <255>;
			ac-bias-intrpt    = <0>;
			dma-burst-sz      = <16>;
			bpp               = <16>;
			fdd               = <0x80>;
			sync-edge         = <0>;
			sync-ctrl         = <1>;
			raster-order      = <0>;
			fifo-th           = <0>;
		};
		display-timings {
			native-mode = <&timing0>;
			timing0: 320x240 {
				hactive         = <320>;
				vactive         = <240>;
				hback-porch     = <21>;
				hfront-porch    = <58>;
				hsync-len       = <47>;
				vback-porch     = <11>;
				vfront-porch    = <23>;
				vsync-len       = <2>;
				clock-frequency = <8000000>;
				hsync-active    = <0>;
				vsync-active    = <0>;
			};
		};
	};
```

## Documentation/devicetree/bindings/display/tilcdc/ti,am33xx-tilcdc.yaml
```yaml
# SPDX-License-Identifier: (GPL-2.0-only OR BSD-2-Clause)
# Copyright 2025 Bootlin
%YAML 1.2
---
$id: http://devicetree.org/schemas/display/tilcdc/ti,am33xx-tilcdc.yaml#
$schema: http://devicetree.org/meta-schemas/core.yaml#

title: TI LCD Controller, found on AM335x, DA850, AM18x and OMAP-L138

maintainers:
  - Kory Maincent <kory.maincent@bootlin.com>

properties:
  compatible:
    enum:
      - ti,am33xx-tilcdc
      - ti,da850-tilcdc

  reg:
    maxItems: 1

  interrupts:
    maxItems: 1

  port:
    $ref: /schemas/graph.yaml#/properties/port

  ti,hwmods:
    $ref: /schemas/types.yaml#/definitions/string
    description:
      Name of the hwmod associated to the LCDC

  max-bandwidth:
    $ref: /schemas/types.yaml#/definitions/uint32
    description:
      The maximum pixels per second that the memory interface / lcd
      controller combination can sustain
    # maximum: 2048*2048*60
    maximum: 251658240

  max-width:
    $ref: /schemas/types.yaml#/definitions/uint32
    description:
      The maximum horizontal pixel width supported by the lcd controller.
    maximum: 2048

  max-pixelclock:
    $ref: /schemas/types.yaml#/definitions/uint32
    description:
      The maximum pixel clock that can be supported by the lcd controller
      in KHz.

  blue-and-red-wiring:
    enum: [straight, crossed]
    description:
      This property deals with the LCDC revision 2 (found on AM335x)
      color errata [1].
       - "straight" indicates normal wiring that supports RGB565,
         BGR888, and XBGR8888 color formats.
       - "crossed" indicates wiring that has blue and red wires
         crossed. This setup supports BGR565, RGB888 and XRGB8888
         formats.
       - If the property is not present or its value is not recognized
         the legacy mode is assumed. This configuration supports RGB565,
         RGB888 and XRGB8888 formats. However, depending on wiring, the red
         and blue colors are swapped in either 16 or 24-bit color modes.

       [1] There is an errata about AM335x color wiring. For 16-bit color
       mode the wires work as they should (LCD_DATA[0:4] is for Blue[3:7]),
       but for 24 bit color modes the wiring of blue and red components is
       crossed and LCD_DATA[0:4] is for Red[3:7] and LCD_DATA[11:15] is
       for Blue[3-7]. For more details see section 3.1.1 in AM335x
       Silicon Errata
       https://www.ti.com/general/docs/lit/getliterature.tsp?baseLiteratureNumber=sprz360

required:
  - compatible
  - interrupts
  - reg
  - port

additionalProperties: false

examples:
  - |
    display-controller@4830e000 {
        compatible = "ti,am33xx-tilcdc";
        reg = <0x4830e000 0x1000>;
        interrupt-parent = <&intc>;
        interrupts = <36>;
        ti,hwmods = "lcdc";

        blue-and-red-wiring = "crossed";

        port {
            endpoint {
                remote-endpoint = <&hdmi_0>;
            };
        };
    };
```

## Documentation/devicetree/bindings/display/tilcdc/tilcdc.txt
```
Device-Tree bindings for tilcdc DRM driver

Required properties:
 - compatible: value should be one of the following:
    - "ti,am33xx-tilcdc" for AM335x based boards
    - "ti,da850-tilcdc" for DA850/AM18x/OMAP-L138 based boards
 - interrupts: the interrupt number
 - reg: base address and size of the LCDC device

Recommended properties:
 - interrupt-parent: the phandle for the interrupt controller that
   services interrupts for this device.
 - ti,hwmods: Name of the hwmod associated to the LCDC

Optional properties:
 - max-bandwidth: The maximum pixels per second that the memory
   interface / lcd controller combination can sustain
 - max-width: The maximum horizontal pixel width supported by
   the lcd controller.
 - max-pixelclock: The maximum pixel clock that can be supported
   by the lcd controller in KHz.
 - blue-and-red-wiring: Recognized values "straight" or "crossed".
   This property deals with the LCDC revision 2 (found on AM335x)
   color errata [1].
    - "straight" indicates normal wiring that supports RGB565,
      BGR888, and XBGR8888 color formats.
    - "crossed" indicates wiring that has blue and red wires
      crossed. This setup supports BGR565, RGB888 and XRGB8888
      formats.
    - If the property is not present or its value is not recognized
      the legacy mode is assumed. This configuration supports RGB565,
      RGB888 and XRGB8888 formats. However, depending on wiring, the red
      and blue colors are swapped in either 16 or 24-bit color modes.

Optional nodes:

 - port/ports: to describe a connection to an external encoder. The
   binding follows Documentation/devicetree/bindings/graph.txt and
   suppors a single port with a single endpoint.

 - See also Documentation/devicetree/bindings/display/tilcdc/panel.txt and
   Documentation/devicetree/bindings/display/tilcdc/tfp410.txt for connecting
   tfp410 DVI encoder or lcd panel to lcdc

[1] There is an errata about AM335x color wiring. For 16-bit color mode
    the wires work as they should (LCD_DATA[0:4] is for Blue[3:7]),
    but for 24 bit color modes the wiring of blue and red components is
    crossed and LCD_DATA[0:4] is for Red[3:7] and LCD_DATA[11:15] is
    for Blue[3-7]. For more details see section 3.1.1 in AM335x
    Silicon Errata:
    http://www.ti.com/general/docs/lit/getliterature.tsp?baseLiteratureNumber=sprz360

Example:

	fb: fb@4830e000 {
		compatible = "ti,am33xx-tilcdc", "ti,da850-tilcdc";
		reg = <0x4830e000 0x1000>;
		interrupt-parent = <&intc>;
		interrupts = <36>;
		ti,hwmods = "lcdc";

		blue-and-red-wiring = "crossed";

		port {
			lcdc_0: endpoint@0 {
				remote-endpoint = <&hdmi_0>;
			};
		};
	};

	tda19988: tda19988 {
		compatible = "nxp,tda998x";
		reg = <0x70>;

		pinctrl-names = "default", "off";
		pinctrl-0 = <&nxp_hdmi_bonelt_pins>;
		pinctrl-1 = <&nxp_hdmi_bonelt_off_pins>;

		port {
			hdmi_0: endpoint@0 {
				remote-endpoint = <&lcdc_0>;
			};
		};
	};
```

## Documentation/devicetree/bindings/display/truly,nt35597.txt
```
Truly model NT35597 DSI display driver

The Truly NT35597 is a generic display driver, currently only configured
for use in the 2K display on the Qualcomm SDM845 MTP board.

Required properties:
- compatible: should be "truly,nt35597-2K-display"
- vdda-supply: phandle of the regulator that provides the supply voltage
  Power IC supply
- vdispp-supply: phandle of the regulator that provides the supply voltage
  for positive LCD bias
- vdispn-supply: phandle of the regulator that provides the supply voltage
  for negative LCD bias
- reset-gpios: phandle of gpio for reset line
  This should be 8mA, gpio can be configured using mux, pinctrl, pinctrl-names
  (active low)
- mode-gpios: phandle of the gpio for choosing the mode of the display
  for single DSI or Dual DSI
  This should be low for dual DSI and high for single DSI mode
- ports: This device has two video ports driven by two DSIs. Their connections
  are modeled using the OF graph bindings specified in
  Documentation/devicetree/bindings/graph.txt.
  - port@0: DSI input port driven by master DSI
  - port@1: DSI input port driven by secondary DSI

Example:

	dsi@ae94000 {
		panel@0 {
			compatible = "truly,nt35597-2K-display";
			reg = <0>;
			vdda-supply = <&pm8998_l14>;
			vdispp-supply = <&lab_regulator>;
			vdispn-supply = <&ibb_regulator>;
			pinctrl-names = "default", "suspend";
			pinctrl-0 = <&dpu_dsi_active>;
			pinctrl-1 = <&dpu_dsi_suspend>;

			reset-gpios = <&tlmm 6 GPIO_ACTIVE_LOW>;
			mode-gpios = <&tlmm 52 GPIO_ACTIVE_HIGH>;
			ports {
				#address-cells = <1>;
				#size-cells = <0>;
				port@0 {
					reg = <0>;
					panel0_in: endpoint {
						remote-endpoint = <&dsi0_out>;
					};
				};

				port@1 {
					reg = <1>;
					panel1_in: endpoint {
						remote-endpoint = <&dsi1_out>;
					};
				};
			};
		};
	};
```
