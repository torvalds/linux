## Documentation/devicetree/bindings/display/tegra/nvidia,tegra20-tvo.yaml
```yaml
# SPDX-License-Identifier: (GPL-2.0-only OR BSD-2-Clause)
%YAML 1.2
---
$id: http://devicetree.org/schemas/display/tegra/nvidia,tegra20-tvo.yaml#
$schema: http://devicetree.org/meta-schemas/core.yaml#

title: NVIDIA Tegra TV Encoder Output

maintainers:
  - Thierry Reding <thierry.reding@gmail.com>
  - Jon Hunter <jonathanh@nvidia.com>

properties:
  $nodename:
    pattern: "^tvo@[0-9a-f]+$"

  compatible:
    enum:
      - nvidia,tegra20-tvo
      - nvidia,tegra30-tvo
      - nvidia,tegra114-tvo

  reg:
    maxItems: 1

  interrupts:
    maxItems: 1

  clocks:
    items:
      - description: module clock

  operating-points-v2:
    $ref: "/schemas/types.yaml#/definitions/phandle"

  power-domains:
    items:
      - description: phandle to the core power domain

additionalProperties: false

required:
  - compatible
  - reg
  - interrupts
  - clocks

examples:
  - |
    #include <dt-bindings/clock/tegra20-car.h>
    #include <dt-bindings/interrupt-controller/arm-gic.h>

    tvo@542c0000 {
        compatible = "nvidia,tegra20-tvo";
        reg = <0x542c0000 0x00040000>;
        interrupts = <GIC_SPI 76 IRQ_TYPE_LEVEL_HIGH>;
        clocks = <&tegra_car TEGRA20_CLK_TVO>;
    };
```

## Documentation/devicetree/bindings/display/tegra/nvidia,tegra20-vi.yaml
```yaml
# SPDX-License-Identifier: (GPL-2.0-only OR BSD-2-Clause)
%YAML 1.2
---
$id: http://devicetree.org/schemas/display/tegra/nvidia,tegra20-vi.yaml#
$schema: http://devicetree.org/meta-schemas/core.yaml#

title: NVIDIA Tegra Video Input controller

maintainers:
  - Thierry Reding <thierry.reding@gmail.com>
  - Jon Hunter <jonathanh@nvidia.com>

properties:
  $nodename:
    pattern: "^vi@[0-9a-f]+$"

  compatible:
    oneOf:
      - const: nvidia,tegra20-vi
      - const: nvidia,tegra30-vi
      - const: nvidia,tegra114-vi
      - const: nvidia,tegra124-vi
      - items:
          - const: nvidia,tegra132-vi
          - const: nvidia,tegra124-vi
      - const: nvidia,tegra210-vi
      - const: nvidia,tegra186-vi
      - const: nvidia,tegra194-vi

  reg:
    maxItems: 1

  interrupts:
    maxItems: 1

  clocks:
    maxItems: 1

  resets:
    items:
      - description: module reset

  reset-names:
    items:
      - const: vi

  iommus:
    maxItems: 1

  interconnects:
    minItems: 4
    maxItems: 5

  interconnect-names:
    minItems: 4
    maxItems: 5

  operating-points-v2: true

  power-domains:
    items:
      - description: phandle to the VENC power domain

  "#address-cells":
    const: 1

  "#size-cells":
    const: 1

  ranges:
    maxItems: 1

  vip:
    $ref: /schemas/display/tegra/nvidia,tegra20-vip.yaml

  ports:
    $ref: /schemas/graph.yaml#/properties/ports

    properties:
      port@0:
        $ref: /schemas/graph.yaml#/properties/port
        description:
          Input from the VIP (parallel input capture) module

patternProperties:
  "^csi@[0-9a-f]+$":
    type: object

additionalProperties: false

required:
  - compatible
  - reg
  - interrupts
  - clocks

allOf:
  - if:
      properties:
        compatible:
          contains:
            enum:
              - nvidia,tegra20-vi
              - nvidia,tegra30-vi
              - nvidia,tegra114-vi
              - nvidia,tegra124-vi
    then:
      required:
        - resets
        - reset-names
    else:
      required:
        - power-domains

examples:
  - |
    #include <dt-bindings/clock/tegra20-car.h>
    #include <dt-bindings/interrupt-controller/arm-gic.h>

    i2c {
        #address-cells = <1>;
        #size-cells = <0>;
        camera@48 {
            compatible = "aptina,mt9v111";
            reg = <0x48>;
            clocks = <&camera_clk>;

            port {
                mt9v111_out: endpoint {
                    remote-endpoint = <&vi_vip_in>;
                };
            };
        };
    };

    vi@54080000 {
        compatible = "nvidia,tegra20-vi";
        reg = <0x54080000 0x00040000>;
        interrupts = <GIC_SPI 69 IRQ_TYPE_LEVEL_HIGH>;
        clocks = <&tegra_car TEGRA20_CLK_VI>;
        resets = <&tegra_car 100>;
        reset-names = "vi";

        vip {
            compatible = "nvidia,tegra20-vip";
            ports {
                #address-cells = <1>;
                #size-cells = <0>;
                port@0 {
                    reg = <0>;
                    vi_vip_in: endpoint {
                        remote-endpoint = <&mt9v111_out>;
                    };
                };
                port@1 {
                    reg = <1>;
                    vi_vip_out: endpoint {
                        remote-endpoint = <&vi_in>;
                    };
                };
            };
        };

        ports {
            #address-cells = <1>;
            #size-cells = <0>;
            port@0 {
                reg = <0>;
                vi_in: endpoint {
                    remote-endpoint = <&vi_vip_out>;
                };
            };
        };
    };

  - |
    #include <dt-bindings/clock/tegra210-car.h>
    #include <dt-bindings/interrupt-controller/arm-gic.h>

    vi@54080000 {
        compatible = "nvidia,tegra210-vi";
        reg = <0x54080000 0x00000700>;
        interrupts = <GIC_SPI 69 IRQ_TYPE_LEVEL_HIGH>;
        assigned-clocks = <&tegra_car TEGRA210_CLK_VI>;
        assigned-clock-parents = <&tegra_car TEGRA210_CLK_PLL_C4_OUT0>;

        clocks = <&tegra_car TEGRA210_CLK_VI>;
        power-domains = <&pd_venc>;

        #address-cells = <1>;
        #size-cells = <1>;

        ranges = <0x0 0x54080000 0x2000>;

        csi@838 {
            compatible = "nvidia,tegra210-csi";
            reg = <0x838 0x1300>;
            assigned-clocks = <&tegra_car TEGRA210_CLK_CILAB>,
                              <&tegra_car TEGRA210_CLK_CILCD>,
                              <&tegra_car TEGRA210_CLK_CILE>,
                              <&tegra_car TEGRA210_CLK_CSI_TPG>;
            assigned-clock-parents = <&tegra_car TEGRA210_CLK_PLL_P>,
                                     <&tegra_car TEGRA210_CLK_PLL_P>,
                                     <&tegra_car TEGRA210_CLK_PLL_P>;
            assigned-clock-rates = <102000000>,
                                   <102000000>,
                                   <102000000>,
                                   <972000000>;

            clocks = <&tegra_car TEGRA210_CLK_CSI>,
                     <&tegra_car TEGRA210_CLK_CILAB>,
                     <&tegra_car TEGRA210_CLK_CILCD>,
                     <&tegra_car TEGRA210_CLK_CILE>,
                     <&tegra_car TEGRA210_CLK_CSI_TPG>;
            clock-names = "csi", "cilab", "cilcd", "cile", "csi_tpg";
            power-domains = <&pd_sor>;
        };
    };
```

## Documentation/devicetree/bindings/display/tegra/nvidia,tegra20-vip.yaml
```yaml
# SPDX-License-Identifier: (GPL-2.0-only OR BSD-2-Clause)
%YAML 1.2
---
$id: http://devicetree.org/schemas/display/tegra/nvidia,tegra20-vip.yaml#
$schema: http://devicetree.org/meta-schemas/core.yaml#

title: NVIDIA Tegra VIP (parallel video capture) controller

maintainers:
  - Luca Ceresoli <luca.ceresoli@bootlin.com>

properties:
  compatible:
    enum:
      - nvidia,tegra20-vip

  ports:
    $ref: /schemas/graph.yaml#/properties/ports

    properties:
      port@0:
        $ref: /schemas/graph.yaml#/properties/port
        description:
          Port receiving the video stream from the sensor

      port@1:
        $ref: /schemas/graph.yaml#/properties/port
        description:
          Port sending the video stream to the VI

    required:
      - port@0
      - port@1

unevaluatedProperties: false

required:
  - compatible
  - ports

# see nvidia,tegra20-vi.yaml for an example
```

## Documentation/devicetree/bindings/display/tegra/nvidia,tegra210-csi.yaml
```yaml
# SPDX-License-Identifier: (GPL-2.0-only OR BSD-2-Clause)
%YAML 1.2
---
$id: http://devicetree.org/schemas/display/tegra/nvidia,tegra210-csi.yaml#
$schema: http://devicetree.org/meta-schemas/core.yaml#

title: NVIDIA Tegra CSI controller

maintainers:
  - Thierry Reding <thierry.reding@gmail.com>
  - Jon Hunter <jonathanh@nvidia.com>

properties:
  $nodename:
    pattern: "^csi@[0-9a-f]+$"

  compatible:
    enum:
      - nvidia,tegra210-csi

  reg:
    maxItems: 1

  clocks:
    items:
      - description: module clock
      - description: A/B lanes clock
      - description: C/D lanes clock
      - description: E lane clock
      - description: test pattern generator clock

  clock-names:
    items:
      - const: csi
      - const: cilab
      - const: cilcd
      - const: cile
      - const: csi_tpg

  power-domains:
    maxItems: 1

additionalProperties: false

required:
  - compatible
  - reg
  - clocks
  - clock-names
  - power-domains

# see nvidia,tegra20-vi.yaml for an example
```

## Documentation/devicetree/bindings/display/ti/ti,am625-oldi.yaml
```yaml
# SPDX-License-Identifier: (GPL-2.0-only OR BSD-2-Clause)
%YAML 1.2
---
$id: http://devicetree.org/schemas/display/ti/ti,am625-oldi.yaml#
$schema: http://devicetree.org/meta-schemas/core.yaml#

title: Texas Instruments AM625 OLDI Transmitter

maintainers:
  - Tomi Valkeinen <tomi.valkeinen@ideasonboard.com>
  - Aradhya Bhatia <aradhya.bhatia@linux.dev>

description:
  The AM625 TI Keystone OpenLDI transmitter (OLDI TX) supports serialized RGB
  pixel data transmission between host and flat panel display over LVDS (Low
  Voltage Differential Sampling) interface. The OLDI TX consists of 7-to-1 data
  serializers, and 4-data and 1-clock LVDS outputs. It supports the LVDS output
  formats "jeida-18", "jeida-24" and "vesa-18", and can accept 24-bit RGB or
  padded and un-padded 18-bit RGB bus formats as input.

properties:
  reg:
    maxItems: 1

  clocks:
    maxItems: 1
    description: serial clock input for the OLDI transmitters

  clock-names:
    const: serial

  ti,companion-oldi:
    $ref: /schemas/types.yaml#/definitions/phandle
    description:
      phandle to companion OLDI transmitter. This property is required for both
      the OLDI TXes if they are expected to work either in dual-lvds mode or in
      clone mode. This property should point to the other OLDI TX's phandle.

  ti,secondary-oldi:
    type: boolean
    description:
      Boolean property to mark the OLDI transmitter as the secondary one, when the
      OLDI hardware is expected to run as a companion HW, in cases of dual-lvds
      mode or clone mode. The primary OLDI hardware is responsible for all the
      hardware configuration.

  ti,oldi-io-ctrl:
    $ref: /schemas/types.yaml#/definitions/phandle
    description:
      phandle to syscon device node mapping OLDI IO_CTRL registers found in the
      control MMR region. These registers are required to toggle the I/O lane
      power, and control its electrical characteristics.

  ports:
    $ref: /schemas/graph.yaml#/properties/ports

    properties:
      port@0:
        $ref: /schemas/graph.yaml#/properties/port
        description: Parallel RGB input port

      port@1:
        $ref: /schemas/graph.yaml#/properties/port
        description: LVDS output port

    required:
      - port@0
      - port@1

required:
  - reg
  - clocks
  - clock-names
  - ti,oldi-io-ctrl
  - ports

additionalProperties: false

...
```
