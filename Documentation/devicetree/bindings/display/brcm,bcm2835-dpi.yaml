## Documentation/devicetree/bindings/display/bridge/analogix,anx7625.yaml
```yaml
# SPDX-License-Identifier: (GPL-2.0 OR BSD-2-Clause)
# Copyright 2019 Analogix Semiconductor, Inc.
%YAML 1.2
---
$id: http://devicetree.org/schemas/display/bridge/analogix,anx7625.yaml#
$schema: http://devicetree.org/meta-schemas/core.yaml#

title: Analogix ANX7625 SlimPort (4K Mobile HD Transmitter)

maintainers:
  - Xin Ji <xji@analogixsemi.com>

description: |
  The ANX7625 is an ultra-low power 4K Mobile HD Transmitter
  designed for portable devices.

properties:
  compatible:
    const: analogix,anx7625

  reg:
    maxItems: 1

  interrupts:
    description: used for interrupt pin B8.
    maxItems: 1

  enable-gpios:
    description: used for power on chip control, POWER_EN pin D2.
    maxItems: 1

  reset-gpios:
    description: used for reset chip control, RESET_N pin B7.
    maxItems: 1

  vdd10-supply:
    description: Regulator that provides the supply 1.0V power.

  vdd18-supply:
    description: Regulator that provides the supply 1.8V power.

  vdd33-supply:
    description: Regulator that provides the supply 3.3V power.

  analogix,lane0-swing:
    $ref: /schemas/types.yaml#/definitions/uint8-array
    minItems: 1
    maxItems: 20
    description:
      an array of swing register setting for DP tx lane0 PHY.
      Registers 0~9 are Swing0_Pre0, Swing1_Pre0, Swing2_Pre0,
      Swing3_Pre0, Swing0_Pre1, Swing1_Pre1, Swing2_Pre1, Swing0_Pre2,
      Swing1_Pre2, Swing0_Pre3, they are for [Boost control] and
      [Swing control] setting.
      Registers 0~9, bit 3:0 is [Boost control], these bits control
      post cursor manual, increase the [Boost control] to increase
      Pre-emphasis value.
      Registers 0~9, bit 6:4 is [Swing control], these bits control
      swing manual, increase [Swing control] setting to add Vp-p value
      for each Swing, Pre.
      Registers 10~19 are Swing0_Pre0, Swing1_Pre0, Swing2_Pre0,
      Swing3_Pre0, Swing0_Pre1, Swing1_Pre1, Swing2_Pre1, Swing0_Pre2,
      Swing1_Pre2, Swing0_Pre3, they are for [R select control] and
      [R Termination control] setting.
      Registers 10~19, bit 4:0 is [R select control], these bits are
      compensation manual, increase it can enhance IO driven strength
      and Vp-p.
      Registers 10~19, bit 5:6 is [R termination control], these bits
      adjust 50ohm impedance of DP tx termination. 00:55 ohm,
      01:50 ohm(default), 10:45 ohm, 11:40 ohm.

  analogix,lane1-swing:
    $ref: /schemas/types.yaml#/definitions/uint8-array
    minItems: 1
    maxItems: 20
    description:
      an array of swing register setting for DP tx lane1 PHY.
      DP TX lane1 swing register setting same with lane0
      swing, please refer lane0-swing property description.

  analogix,audio-enable:
    type: boolean
    description: let the driver enable audio HDMI codec function or not.

  aux-bus:
    $ref: /schemas/display/dp-aux-bus.yaml#

  ports:
    $ref: /schemas/graph.yaml#/properties/ports

    properties:
      port@0:
        $ref: /schemas/graph.yaml#/$defs/port-base
        unevaluatedProperties: false
        description:
          MIPI DSI/DPI input.

        properties:
          endpoint:
            $ref: /schemas/media/video-interfaces.yaml#
            type: object
            additionalProperties: false

            properties:
              remote-endpoint: true

              bus-type:
                enum: [7]
                default: 1

              data-lanes: true

      port@1:
        $ref: /schemas/graph.yaml#/properties/port
        description:
          Video port for panel or connector.

    required:
      - port@0
      - port@1

required:
  - compatible
  - reg
  - vdd10-supply
  - vdd18-supply
  - vdd33-supply
  - ports

additionalProperties: false

examples:
  - |
    #include <dt-bindings/gpio/gpio.h>

    i2c {
        #address-cells = <1>;
        #size-cells = <0>;

        encoder@58 {
            compatible = "analogix,anx7625";
            reg = <0x58>;
            enable-gpios = <&pio 45 GPIO_ACTIVE_HIGH>;
            reset-gpios = <&pio 73 GPIO_ACTIVE_HIGH>;
            vdd10-supply = <&pp1000_mipibrdg>;
            vdd18-supply = <&pp1800_mipibrdg>;
            vdd33-supply = <&pp3300_mipibrdg>;
            analogix,audio-enable;
            analogix,lane0-swing = /bits/ 8 <0x14 0x54 0x64 0x74>;
            analogix,lane1-swing = /bits/ 8 <0x14 0x54 0x64 0x74>;

            ports {
                #address-cells = <1>;
                #size-cells = <0>;

                mipi2dp_bridge_in: port@0 {
                    reg = <0>;
                    anx7625_in: endpoint {
                        remote-endpoint = <&mipi_dsi>;
                        bus-type = <7>;
                        data-lanes = <0 1 2 3>;
                    };
                };

                mipi2dp_bridge_out: port@1 {
                    reg = <1>;
                    anx7625_out: endpoint {
                        remote-endpoint = <&panel_in>;
                    };
                };
            };

            aux-bus {
                panel {
                    compatible = "innolux,n125hce-gn1";
                    power-supply = <&pp3300_disp_x>;
                    backlight = <&backlight_lcd0>;

                    port {
                        panel_in: endpoint {
                            remote-endpoint = <&anx7625_out>;
                        };
                    };
                };
            };
        };
    };
```

## Documentation/devicetree/bindings/display/bridge/analogix,anx7814.yaml
```yaml
# SPDX-License-Identifier: (GPL-2.0-only OR BSD-2-Clause)
%YAML 1.2
---
$id: http://devicetree.org/schemas/display/bridge/analogix,anx7814.yaml#
$schema: http://devicetree.org/meta-schemas/core.yaml#

title: Analogix ANX7814 SlimPort (Full-HD Transmitter)

maintainers:
  - Andrzej Hajda <andrzej.hajda@intel.com>
  - Neil Armstrong <narmstrong@baylibre.com>
  - Robert Foss <robert.foss@linaro.org>

properties:
  compatible:
    enum:
      - analogix,anx7808
      - analogix,anx7812
      - analogix,anx7814
      - analogix,anx7818

  reg:
    maxItems: 1
    description: I2C address of the device.

  interrupts:
    maxItems: 1
    description: Should contain the INTP interrupt.

  hpd-gpios:
    deprecated: true
    maxItems: 1
    description: Which GPIO to use for hpd.

  pd-gpios:
    maxItems: 1
    description: Which GPIO to use for power down.

  reset-gpios:
    maxItems: 1
    description: Which GPIO to use for reset.

  dvdd10-supply:
    description: Regulator for 1.0V digital core power.

  ports:
    $ref: /schemas/graph.yaml#/properties/ports

    properties:
      port@0:
        $ref: /schemas/graph.yaml#/properties/port
        description: Video port for HDMI input.

      port@1:
        $ref: /schemas/graph.yaml#/properties/port
        description:
          Video port for SlimPort, DisplayPort, eDP or MyDP output.

    required:
      - port@0
      - port@1

required:
  - compatible
  - reg
  - ports

additionalProperties: false

examples:
  - |
    #include <dt-bindings/interrupt-controller/arm-gic.h>
    #include <dt-bindings/gpio/gpio.h>

    i2c {
        #address-cells = <1>;
        #size-cells = <0>;

        anx7814: bridge@38 {
            compatible = "analogix,anx7814";
            reg = <0x38>;
            interrupt-parent = <&gpio0>;
            interrupts = <99 IRQ_TYPE_LEVEL_LOW>;   /* INTP */
            pd-gpios = <&pio 33 GPIO_ACTIVE_HIGH>;
            reset-gpios = <&pio 98 GPIO_ACTIVE_HIGH>;

            ports {
                #address-cells = <1>;
                #size-cells = <0>;

                port@0 {
                    reg = <0>;
                    anx7814_in: endpoint {
                        remote-endpoint = <&hdmi0_out>;
                    };
                };

                port@1 {
                    reg = <1>;
                    anx7814_out: endpoint {
                        remote-endpoint = <&edp_out>;
                    };
                };
            };
        };
    };

...
```

## Documentation/devicetree/bindings/display/bridge/analogix_dp.txt
```
Analogix Display Port bridge bindings

Required properties for dp-controller:
	-compatible:
		platform specific such as:
		 * "samsung,exynos5-dp"
		 * "rockchip,rk3288-dp"
		 * "rockchip,rk3399-edp"
	-reg:
		physical base address of the controller and length
		of memory mapped region.
	-interrupts:
		interrupt combiner values.
	-clocks:
		from common clock binding: handle to dp clock.
	-clock-names:
		from common clock binding: Shall be "dp".
	-interrupt-parent:
		phandle to Interrupt combiner node.
	-phys:
		from general PHY binding: the phandle for the PHY device.
	-phy-names:
		from general PHY binding: Should be "dp".

Optional properties for dp-controller:
	-analogix,video-bist-enable:
		Enable video bist pattern for DP_TX debugging.
	-force-hpd:
		Indicate driver need force hpd when hpd detect failed, this
		is used for some eDP screen which don't have hpd signal.
	-hpd-gpios:
		Hotplug detect GPIO.
		Indicates which GPIO should be used for hotplug detection
	-port@[X]: SoC specific port nodes with endpoint definitions as defined
		in Documentation/devicetree/bindings/media/video-interfaces.txt,
		please refer to the SoC specific binding document:
		* Documentation/devicetree/bindings/display/exynos/exynos_dp.txt
		* Documentation/devicetree/bindings/video/analogix_dp-rockchip.txt

[1]: Documentation/devicetree/bindings/media/video-interfaces.txt
-------------------------------------------------------------------------------

Example:

	dp-controller {
		compatible = "samsung,exynos5-dp";
		reg = <0x145b0000 0x10000>;
		interrupts = <10 3>;
		interrupt-parent = <&combiner>;
		clocks = <&clock 342>;
		clock-names = "dp";

		phys = <&dp_phy>;
		phy-names = "dp";
	};
```

## Documentation/devicetree/bindings/display/bridge/anx6345.txt
```
Analogix ANX6345 eDP Transmitter
--------------------------------

The ANX6345 is an ultra-low power Full-HD eDP transmitter designed for
portable devices.

Required properties:

 - compatible		: "analogix,anx6345"
 - reg			: I2C address of the device
 - reset-gpios		: Which GPIO to use for reset

Optional properties:

 - dvdd12-supply	: Regulator for 1.2V digital core power.
 - dvdd25-supply	: Regulator for 2.5V digital core power.
 - panel-supply		: Regulator for the power of the panel.
 - edid			: verbatim EDID data block describing attached
			  panel, only used when the panel has no EDID info.
 - Video port for RGB input, using the DT bindings defined in [1].

[1]: Documentation/devicetree/bindings/media/video-interfaces.txt

Example:

anx6345: anx6345@38 {
	compatible = "analogix,anx6345";
	reg = <0x38>;
	reset-gpios = <&pio 3 24 GPIO_ACTIVE_LOW>; /* PD24 */
	panel-supply = <&reg_dc1sw>;
	dvdd25-supply = <&reg_dldo2>;
	dvdd12-supply = <&reg_fldo1>;

	port {
		anx6345_in: endpoint {
			remote-endpoint = <&tcon0_out_anx6345>;
		};
	};
};
```

## Documentation/devicetree/bindings/display/bridge/anx6345.yaml
```yaml
# SPDX-License-Identifier: GPL-2.0
%YAML 1.2
---
$id: http://devicetree.org/schemas/display/bridge/anx6345.yaml#
$schema: http://devicetree.org/meta-schemas/core.yaml#

title: Analogix ANX6345 eDP Transmitter

maintainers:
  - Torsten Duwe <duwe@lst.de>

description: |
  The ANX6345 is an ultra-low power Full-HD eDP transmitter designed for
  portable devices.

properties:
  compatible:
    const: analogix,anx6345

  reg:
    maxItems: 1
    description: base I2C address of the device

  reset-gpios:
    maxItems: 1
    description: GPIO connected to active low reset

  dvdd12-supply:
    description: Regulator for 1.2V digital core power.

  dvdd25-supply:
    description: Regulator for 2.5V digital core power.

  ports:
    $ref: /schemas/graph.yaml#/properties/ports

    properties:
      port@0:
        $ref: /schemas/graph.yaml#/properties/port
        description:
          Video port for LVTTL input

      port@1:
        $ref: /schemas/graph.yaml#/properties/port
        description:
          Video port for eDP output (panel or connector).
          May be omitted if EDID works reliably.

    required:
      - port@0

required:
  - compatible
  - reg
  - reset-gpios
  - dvdd12-supply
  - dvdd25-supply
  - ports

additionalProperties: false

examples:
  - |
    i2c0 {
      #address-cells = <1>;
      #size-cells = <0>;

      anx6345: anx6345@38 {
        compatible = "analogix,anx6345";
        reg = <0x38>;
        reset-gpios = <&pio42 1 /* GPIO_ACTIVE_LOW */>;
        dvdd25-supply = <&reg_dldo2>;
        dvdd12-supply = <&reg_fldo1>;

        ports {
          #address-cells = <1>;
          #size-cells = <0>;

          anx6345_in: port@0 {
            reg = <0>;
            anx6345_in_tcon0: endpoint {
              remote-endpoint = <&tcon0_out_anx6345>;
            };
          };

          anx6345_out: port@1 {
            reg = <1>;
            anx6345_out_panel: endpoint {
              remote-endpoint = <&panel_in_edp>;
            };
          };
        };
      };
    };
```

## Documentation/devicetree/bindings/display/bridge/anx7814.txt
```
Analogix ANX7814 SlimPort (Full-HD Transmitter)
-----------------------------------------------

The ANX7814 is an ultra-low power Full-HD (1080p60) SlimPort transmitter
designed for portable devices.

Required properties:

 - compatible		: Must be one of:
			  "analogix,anx7808"
			  "analogix,anx7812"
			  "analogix,anx7814"
			  "analogix,anx7818"
 - reg			: I2C address of the device
 - interrupts		: Should contain the INTP interrupt
 - hpd-gpios		: Which GPIO to use for hpd
 - pd-gpios		: Which GPIO to use for power down
 - reset-gpios		: Which GPIO to use for reset

Optional properties:

 - dvdd10-supply	: Regulator for 1.0V digital core power.
 - Video port for HDMI input, using the DT bindings defined in [1].

[1]: Documentation/devicetree/bindings/media/video-interfaces.txt

Example:

	anx7814: anx7814@38 {
		compatible = "analogix,anx7814";
		reg = <0x38>;
		interrupt-parent = <&gpio0>;
		interrupts = <99 IRQ_TYPE_LEVEL_LOW>;   /* INTP */
		hpd-gpios = <&pio 36 GPIO_ACTIVE_HIGH>;
		pd-gpios = <&pio 33 GPIO_ACTIVE_HIGH>;
		reset-gpios = <&pio 98 GPIO_ACTIVE_HIGH>;
		port {
			anx7814_in: endpoint {
				remote-endpoint = <&hdmi0_out>;
			};
		};
	};
```
