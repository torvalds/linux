## Documentation/devicetree/bindings/display/brcm,bcm2835-dpi.yaml
```yaml
# SPDX-License-Identifier: GPL-2.0
%YAML 1.2
---
$id: http://devicetree.org/schemas/display/brcm,bcm2835-dpi.yaml#
$schema: http://devicetree.org/meta-schemas/core.yaml#

title: Broadcom VC4 (VideoCore4) DPI Controller

maintainers:
  - Eric Anholt <eric@anholt.net>

properties:
  compatible:
    const: brcm,bcm2835-dpi

  reg:
    maxItems: 1

  clocks:
    items:
      - description: The core clock the unit runs on
      - description: The pixel clock that feeds the pixelvalve

  clock-names:
    items:
      - const: core
      - const: pixel

  port:
    type: object
    description: >
      Port node with a single endpoint connecting to the panel, as
      defined in Documentation/devicetree/bindings/media/video-interfaces.txt.

required:
  - compatible
  - reg
  - clocks
  - clock-names
  - port

additionalProperties: false

examples:
  - |
    #include <dt-bindings/clock/bcm2835.h>

    panel: panel {
        compatible = "ontat,yx700wv03", "simple-panel";

        port {
            panel_in: endpoint {
                remote-endpoint = <&dpi_out>;
            };
        };
    };

    dpi: dpi@7e208000 {
        compatible = "brcm,bcm2835-dpi";
        reg = <0x7e208000 0x8c>;
        clocks = <&clocks BCM2835_CLOCK_VPU>,
                 <&clocks BCM2835_CLOCK_DPI>;
        clock-names = "core", "pixel";

        port {
            dpi_out: endpoint {
                remote-endpoint = <&panel_in>;
            };
        };
    };

...
```

## Documentation/devicetree/bindings/display/brcm,bcm2835-dsi0.yaml
```yaml
# SPDX-License-Identifier: GPL-2.0
%YAML 1.2
---
$id: http://devicetree.org/schemas/display/brcm,bcm2835-dsi0.yaml#
$schema: http://devicetree.org/meta-schemas/core.yaml#

title: Broadcom VC4 (VideoCore4) DSI Controller

maintainers:
  - Eric Anholt <eric@anholt.net>

allOf:
  - $ref: dsi-controller.yaml#

properties:
  "#clock-cells":
    const: 1

  compatible:
    enum:
      - brcm,bcm2711-dsi1
      - brcm,bcm2835-dsi0
      - brcm,bcm2835-dsi1

  reg:
    maxItems: 1

  clocks:
    items:
      - description: The DSI PLL clock feeding the DSI analog PHY
      - description: The DSI ESC clock
      - description: The DSI pixel clock

  clock-names:
    items:
      - const: phy
      - const: escape
      - const: pixel

  clock-output-names: true
    # FIXME: The meta-schemas don't seem to allow it for now
    # items:
    #   - description: The DSI byte clock for the PHY
    #   - description: The DSI DDR2 clock
    #   - description: The DSI DDR clock

  interrupts:
    maxItems: 1

  power-domains:
    maxItems: 1

required:
  - "#clock-cells"
  - compatible
  - reg
  - clocks
  - clock-names
  - clock-output-names
  - interrupts

unevaluatedProperties: false

examples:
  - |
    #include <dt-bindings/clock/bcm2835.h>

    dsi1: dsi@7e700000 {
        compatible = "brcm,bcm2835-dsi1";
        reg = <0x7e700000 0x8c>;
        interrupts = <2 12>;
        #address-cells = <1>;
        #size-cells = <0>;
        #clock-cells = <1>;

        clocks = <&clocks BCM2835_PLLD_DSI1>,
                 <&clocks BCM2835_CLOCK_DSI1E>,
                 <&clocks BCM2835_CLOCK_DSI1P>;
        clock-names = "phy", "escape", "pixel";

        clock-output-names = "dsi1_byte", "dsi1_ddr2", "dsi1_ddr";

    };

...
```

## Documentation/devicetree/bindings/display/brcm,bcm2835-hdmi.yaml
```yaml
# SPDX-License-Identifier: GPL-2.0
%YAML 1.2
---
$id: http://devicetree.org/schemas/display/brcm,bcm2835-hdmi.yaml#
$schema: http://devicetree.org/meta-schemas/core.yaml#

title: Broadcom VC4 (VideoCore4) HDMI Controller

maintainers:
  - Eric Anholt <eric@anholt.net>

properties:
  compatible:
    const: brcm,bcm2835-hdmi

  reg:
    items:
      - description: HDMI register range
      - description: HD register range

  interrupts:
    minItems: 2

  clocks:
    items:
      - description: The pixel clock
      - description: The HDMI state machine clock

  clock-names:
    items:
      - const: pixel
      - const: hdmi

  ddc:
    $ref: /schemas/types.yaml#/definitions/phandle
    description: >
      Phandle of the I2C controller used for DDC EDID probing

  hpd-gpios:
    maxItems: 1
    description: >
      The GPIO pin for the HDMI hotplug detect (if it doesn't appear
      as an interrupt/status bit in the HDMI controller itself)

  dmas:
    maxItems: 1
    description: >
      Should contain one entry pointing to the DMA channel used to
      transfer audio data.

  dma-names:
    const: audio-rx

required:
  - compatible
  - reg
  - interrupts
  - clocks
  - ddc

additionalProperties: false

examples:
  - |
    #include <dt-bindings/clock/bcm2835.h>
    #include <dt-bindings/gpio/gpio.h>

    hdmi: hdmi@7e902000 {
        compatible = "brcm,bcm2835-hdmi";
        reg = <0x7e902000 0x600>,
              <0x7e808000 0x100>;
        interrupts = <2 8>, <2 9>;
        ddc = <&i2c2>;
        hpd-gpios = <&gpio 46 GPIO_ACTIVE_HIGH>;
        clocks = <&clocks BCM2835_PLLH_PIX>,
                 <&clocks BCM2835_CLOCK_HSM>;
        clock-names = "pixel", "hdmi";
    };

...
```

## Documentation/devicetree/bindings/display/brcm,bcm2835-hvs.yaml
```yaml
# SPDX-License-Identifier: GPL-2.0
%YAML 1.2
---
$id: http://devicetree.org/schemas/display/brcm,bcm2835-hvs.yaml#
$schema: http://devicetree.org/meta-schemas/core.yaml#

title: Broadcom VC4 (VideoCore4) Hardware Video Scaler

maintainers:
  - Eric Anholt <eric@anholt.net>

properties:
  compatible:
    enum:
      - brcm,bcm2711-hvs
      - brcm,bcm2712-hvs
      - brcm,bcm2835-hvs

  reg:
    maxItems: 1

  interrupts:
    minItems: 1
    maxItems: 3

  interrupt-names:
    minItems: 1
    maxItems: 3

  clocks:
    minItems: 1
    maxItems: 2

  clock-names:
    minItems: 1
    maxItems: 2

required:
  - compatible
  - reg
  - interrupts

additionalProperties: false

allOf:
  - if:
      properties:
        compatible:
          contains:
            const: brcm,bcm2711-hvs

    then:
      properties:
        clocks:
          items:
            - description: Core Clock
        interrupts:
          maxItems: 1
        clock-names: false
        interrupt-names: false

      required:
        - clocks

  - if:
      properties:
        compatible:
          contains:
            const: brcm,bcm2712-hvs

    then:
      properties:
        clocks:
          minItems: 2
          maxItems: 2
        clock-names:
          items:
            - const: core
            - const: disp
        interrupts:
          items:
            - description: Channel 0 End of frame
            - description: Channel 1 End of frame
            - description: Channel 2 End of frame
        interrupt-names:
          items:
            - const: ch0-eof
            - const: ch1-eof
            - const: ch2-eof
      required:
        - clocks
        - clock-names
        - interrupt-names

  - if:
      properties:
        compatible:
          contains:
            const: brcm,bcm2835-hvs

    then:
      properties:
        interrupts:
          maxItems: 1
        clock-names: false
        interrupt-names: false

examples:
  - |
    hvs@7e400000 {
        compatible = "brcm,bcm2835-hvs";
        reg = <0x7e400000 0x6000>;
        interrupts = <2 1>;
    };

...
```

## Documentation/devicetree/bindings/display/brcm,bcm2835-pixelvalve0.yaml
```yaml
# SPDX-License-Identifier: GPL-2.0
%YAML 1.2
---
$id: http://devicetree.org/schemas/display/brcm,bcm2835-pixelvalve0.yaml#
$schema: http://devicetree.org/meta-schemas/core.yaml#

title: Broadcom VC4 (VideoCore4) PixelValve

maintainers:
  - Eric Anholt <eric@anholt.net>

properties:
  compatible:
    enum:
      - brcm,bcm2835-pixelvalve0
      - brcm,bcm2835-pixelvalve1
      - brcm,bcm2835-pixelvalve2
      - brcm,bcm2711-pixelvalve0
      - brcm,bcm2711-pixelvalve1
      - brcm,bcm2711-pixelvalve2
      - brcm,bcm2711-pixelvalve3
      - brcm,bcm2711-pixelvalve4

  reg:
    maxItems: 1

  interrupts:
    maxItems: 1

required:
  - compatible
  - reg
  - interrupts

additionalProperties: false

examples:
  - |
    pixelvalve@7e807000 {
        compatible = "brcm,bcm2835-pixelvalve2";
        reg = <0x7e807000 0x100>;
        interrupts = <2 10>; /* pixelvalve */
    };

...
```

## Documentation/devicetree/bindings/display/brcm,bcm2835-txp.yaml
```yaml
# SPDX-License-Identifier: GPL-2.0
%YAML 1.2
---
$id: http://devicetree.org/schemas/display/brcm,bcm2835-txp.yaml#
$schema: http://devicetree.org/meta-schemas/core.yaml#

title: Broadcom VC4 (VideoCore4) TXP (writeback) Controller

maintainers:
  - Eric Anholt <eric@anholt.net>

properties:
  compatible:
    enum:
      - brcm,bcm2712-mop
      - brcm,bcm2835-txp

  reg:
    maxItems: 1

  interrupts:
    maxItems: 1

required:
  - compatible
  - reg
  - interrupts

additionalProperties: false

examples:
  - |
    txp: txp@7e004000 {
        compatible = "brcm,bcm2835-txp";
        reg = <0x7e004000 0x20>;
        interrupts = <1 11>;
    };

...
```

## Documentation/devicetree/bindings/display/brcm,bcm2835-v3d.yaml
```yaml
# SPDX-License-Identifier: GPL-2.0
%YAML 1.2
---
$id: http://devicetree.org/schemas/display/brcm,bcm2835-v3d.yaml#
$schema: http://devicetree.org/meta-schemas/core.yaml#

title: Broadcom VC4 (VideoCore4) V3D GPU

maintainers:
  - Eric Anholt <eric@anholt.net>

properties:
  compatible:
    enum:
      - brcm,bcm2835-v3d
      - brcm,cygnus-v3d

  reg:
    maxItems: 1

  clocks:
    maxItems: 1

  interrupts:
    maxItems: 1

  power-domains:
    maxItems: 1

required:
  - compatible
  - reg
  - interrupts

additionalProperties: false

examples:
  - |
    v3d: v3d@7ec00000 {
        compatible = "brcm,bcm2835-v3d";
        reg = <0x7ec00000 0x1000>;
        interrupts = <1 10>;
    };

...
```

## Documentation/devicetree/bindings/display/brcm,bcm2835-vc4.yaml
```yaml
# SPDX-License-Identifier: GPL-2.0
%YAML 1.2
---
$id: http://devicetree.org/schemas/display/brcm,bcm2835-vc4.yaml#
$schema: http://devicetree.org/meta-schemas/core.yaml#

title: Broadcom VC4 (VideoCore4) GPU

maintainers:
  - Eric Anholt <eric@anholt.net>

description: >
  The VC4 device present on the Raspberry Pi includes a display system
  with HDMI output and the HVS (Hardware Video Scaler) for compositing
  display planes.

properties:
  compatible:
    enum:
      - brcm,bcm2711-vc5
      - brcm,bcm2712-vc6
      - brcm,bcm2835-vc4
      - brcm,cygnus-vc4

required:
  - compatible

additionalProperties: false

examples:
  - |
    vc4: gpu {
        compatible = "brcm,bcm2835-vc4";
    };

...
```

## Documentation/devicetree/bindings/display/brcm,bcm2835-vec.yaml
```yaml
# SPDX-License-Identifier: GPL-2.0
%YAML 1.2
---
$id: http://devicetree.org/schemas/display/brcm,bcm2835-vec.yaml#
$schema: http://devicetree.org/meta-schemas/core.yaml#

title: Broadcom VC4 (VideoCore4) VEC

maintainers:
  - Eric Anholt <eric@anholt.net>

properties:
  compatible:
    enum:
      - brcm,bcm2711-vec
      - brcm,bcm2835-vec

  reg:
    maxItems: 1

  clocks:
    maxItems: 1

  interrupts:
    maxItems: 1

required:
  - compatible
  - reg
  - clocks
  - interrupts

additionalProperties: false

examples:
  - |
    #include <dt-bindings/clock/bcm2835.h>

    vec: vec@7e806000 {
        compatible = "brcm,bcm2835-vec";
        reg = <0x7e806000 0x1000>;
        clocks = <&clocks BCM2835_CLOCK_VEC>;
        interrupts = <2 27>;
    };

...
```

## Documentation/devicetree/bindings/display/bridge/adi,adv7125.txt
```
Analog Device ADV7125 RGB to VGA DAC bridge
-------------------------------

The ADV7125 is a digital-to-analog converter that outputs VGA signals from a
RGB input.

Required properties:

- compatible: Should be "adi,adv7125"

Optional properties:

- psave-gpios: Power save control GPIO

Required nodes:

The ADV7125 has two video ports. Their connections are modeled using the OF
graph bindings specified in Documentation/devicetree/bindings/graph.txt.

- Video port 0 for RGB input
- Video port 1 for VGA output


Example
-------

	adv7125: encoder@0 {
		compatible = "adi,adv7125";
		#address-cells = <1>;
		#size-cells = <0>;

		ports {
			port@0 {
				reg = <0>;

				adv7125_in: endpoint@0 {
					remote-endpoint = <&rgb_out>;
				};
			};

			port@1 {
				reg = <1>;

				adv7125_out: endpoint@0 {
					remote-endpoint = <&vga_connector_in>;
				};
			};
		};
	};
```
