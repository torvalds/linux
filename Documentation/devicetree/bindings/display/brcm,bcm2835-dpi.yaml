## Documentation/devicetree/bindings/display/bridge/chrontel,ch7033.yaml
```yaml
# SPDX-License-Identifier: (GPL-2.0-only OR BSD-2-Clause)
# Copyright (C) 2019,2020 Lubomir Rintel <lkundrak@v3.sk>
%YAML 1.2
---
$id: http://devicetree.org/schemas/display/bridge/chrontel,ch7033.yaml#
$schema: http://devicetree.org/meta-schemas/core.yaml#

title: Chrontel CH7033 Video Encoder

maintainers:
  - Lubomir Rintel <lkundrak@v3.sk>

properties:
  compatible:
    const: chrontel,ch7033

  reg:
    maxItems: 1
    description: I2C address of the device

  ports:
    $ref: /schemas/graph.yaml#/properties/ports

    properties:
      port@0:
        $ref: /schemas/graph.yaml#/properties/port
        description: |
          Video port for RGB input.

      port@1:
        $ref: /schemas/graph.yaml#/properties/port
        description: |
          DVI port, should be connected to a node compatible with the
          dvi-connector binding.

    required:
      - port@0
      - port@1

required:
  - compatible
  - reg
  - ports

additionalProperties: false

examples:
  - |
    i2c {
        #address-cells = <1>;
        #size-cells = <0>;

        vga-dvi-encoder@76 {
            compatible = "chrontel,ch7033";
            reg = <0x76>;

            ports {
                #address-cells = <1>;
                #size-cells = <0>;

                port@0 {
                    reg = <0>;
                    endpoint {
                        remote-endpoint = <&lcd0_rgb_out>;
                    };
                };

                port@1 {
                    reg = <1>;
                    endpoint {
                        remote-endpoint = <&dvi_in>;
                    };
                };

            };
        };
    };
```
