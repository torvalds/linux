## Documentation/devicetree/bindings/display/tegra/nvidia,tegra20-csi.yaml
```yaml
# SPDX-License-Identifier: (GPL-2.0-only OR BSD-2-Clause)
%YAML 1.2
---
$id: http://devicetree.org/schemas/display/tegra/nvidia,tegra20-csi.yaml#
$schema: http://devicetree.org/meta-schemas/core.yaml#

title: NVIDIA Tegra20 CSI controller

maintainers:
  - Svyatoslav Ryhel <clamor95@gmail.com>

properties:
  compatible:
    enum:
      - nvidia,tegra20-csi
      - nvidia,tegra30-csi

  reg:
    maxItems: 1

  clocks:
    minItems: 1
    items:
      - description: module clock
      - description: PAD A clock
      - description: PAD B clock

  clock-names:
    items:
      - const: csi
      - const: csia-pad
      - const: csib-pad

  avdd-dsi-csi-supply:
    description: DSI/CSI power supply. Must supply 1.2 V.

  power-domains:
    maxItems: 1

  "#nvidia,mipi-calibrate-cells":
    description:
      The number of cells in a MIPI calibration specifier. Should be 1.
      The single cell specifies an id of the pad that need to be
      calibrated for a given device. Valid pad ids for receiver would be
      0 for CSI-A; 1 for CSI-B; 2 for DSI-A and 3 for DSI-B.
    $ref: /schemas/types.yaml#/definitions/uint32
    const: 1

  "#address-cells":
    const: 1

  "#size-cells":
    const: 0

patternProperties:
  "^channel@[0-1]$":
    type: object
    description: channel 0 represents CSI-A and 1 represents CSI-B
    additionalProperties: false

    properties:
      reg:
        maximum: 1

      nvidia,mipi-calibrate:
        description: Should contain a phandle and a specifier specifying
          which pad is used by this CSI channel and needs to be calibrated.
        $ref: /schemas/types.yaml#/definitions/phandle-array

      "#address-cells":
        const: 1

      "#size-cells":
        const: 0

      port@0:
        $ref: /schemas/graph.yaml#/$defs/port-base
        unevaluatedProperties: false
        description: port receiving the video stream from the sensor

        properties:
          endpoint:
            $ref: /schemas/media/video-interfaces.yaml#
            unevaluatedProperties: false

            required:
              - data-lanes

      port@1:
        $ref: /schemas/graph.yaml#/properties/port
        description: port sending the video stream to the VI

    required:
      - reg
      - "#address-cells"
      - "#size-cells"
      - port@0
      - port@1

allOf:
  - if:
      properties:
        compatible:
          contains:
            enum:
              - nvidia,tegra20-csi
    then:
      properties:
        clocks:
          maxItems: 1

        clock-names: false

  - if:
      properties:
        compatible:
          contains:
            enum:
              - nvidia,tegra30-csi
    then:
      properties:
        clocks:
          minItems: 3

        clock-names:
          minItems: 3

additionalProperties: false

required:
  - compatible
  - reg
  - clocks
  - power-domains
  - "#address-cells"
  - "#size-cells"

# see nvidia,tegra20-vi.yaml for an example
```

## Documentation/devicetree/bindings/display/tegra/nvidia,tegra20-dc.yaml
```yaml
# SPDX-License-Identifier: (GPL-2.0-only OR BSD-2-Clause)
%YAML 1.2
---
$id: http://devicetree.org/schemas/display/tegra/nvidia,tegra20-dc.yaml#
$schema: http://devicetree.org/meta-schemas/core.yaml#

title: NVIDIA Tegra Display Controller

maintainers:
  - Thierry Reding <thierry.reding@gmail.com>
  - Jon Hunter <jonathanh@nvidia.com>

properties:
  $nodename:
    pattern: "^dc@[0-9a-f]+$"

  compatible:
    oneOf:
      - enum:
          - nvidia,tegra20-dc
          - nvidia,tegra30-dc
          - nvidia,tegra114-dc
          - nvidia,tegra124-dc
          - nvidia,tegra210-dc

      - items:
          - const: nvidia,tegra124-dc
          - const: nvidia,tegra132-dc

  reg:
    maxItems: 1

  interrupts:
    maxItems: 1

  clocks:
    minItems: 1
    items:
      - description: display controller pixel clock
      - description: parent clock # optional

  clock-names:
    minItems: 1
    items:
      - const: dc
      - const: parent # optional

  resets:
    items:
      - description: module reset

  reset-names:
    items:
      - const: dc

  interconnect-names: true
  interconnects: true

  iommus:
    maxItems: 1

  operating-points-v2:
    $ref: "/schemas/types.yaml#/definitions/phandle"

  power-domains:
    items:
      - description: phandle to the core power domain

  memory-region: true

  nvidia,head:
    $ref: /schemas/types.yaml#/definitions/uint32
    description: The number of the display controller head. This is used to setup the various
      types of output to receive video data from the given head.

  nvidia,outputs:
    $ref: /schemas/types.yaml#/definitions/phandle-array
    description: A list of phandles of outputs that this display controller can drive.

  rgb:
    type: object

allOf:
  - if:
      properties:
        compatible:
          contains:
            enum:
              - nvidia,tegra20-dc
              - nvidia,tegra30-dc
              - nvidia,tegra114-dc
    then:
      properties:
        interconnects:
          items:
            - description: window A memory client
            - description: window B memory client
            - description: window B memory client (vertical filter)
            - description: window C memory client
            - description: cursor memory client

        interconnect-names:
          items:
            - const: wina
            - const: winb
            - const: winb-vfilter
            - const: winc
            - const: cursor

        rgb:
          description: Each display controller node has a child node, named "rgb", that represents
            the RGB output associated with the controller.
          type: object
          properties:
            nvidia,ddc-i2c-bus:
              $ref: /schemas/types.yaml#/definitions/phandle
              description: phandle of an I2C controller used for DDC EDID probing

            nvidia,hpd-gpio:
              description: specifies a GPIO used for hotplug detection
              maxItems: 1

            nvidia,edid:
              $ref: /schemas/types.yaml#/definitions/uint8-array
              description: supplies a binary EDID blob

            nvidia,panel:
              $ref: /schemas/types.yaml#/definitions/phandle
              description: phandle of a display panel

  - if:
      properties:
        compatible:
          contains:
            enum:
              - nvidia,tegra124-dc
    then:
      properties:
        interconnects:
          minItems: 4
          items:
            - description: window A memory client
            - description: window B memory client
            - description: window C memory client
            - description: cursor memory client
            - description: window D memory client
            - description: window T memory client

        interconnect-names:
          minItems: 4
          items:
            - const: wina
            - const: winb
            - const: winc
            - const: cursor
            - const: wind
            - const: wint

additionalProperties: false

required:
  - compatible
  - reg
  - interrupts
  - clocks
  - clock-names
  - resets
  - reset-names

examples:
  - |
    #include <dt-bindings/clock/tegra20-car.h>
    #include <dt-bindings/interrupt-controller/arm-gic.h>

    dc@54200000 {
        compatible = "nvidia,tegra20-dc";
        reg = <0x54200000 0x00040000>;
        interrupts = <GIC_SPI 73 IRQ_TYPE_LEVEL_HIGH>;
        clocks = <&tegra_car TEGRA20_CLK_DISP1>;
        clock-names = "dc";
        resets = <&tegra_car 27>;
        reset-names = "dc";
    };
```

## Documentation/devicetree/bindings/display/tegra/nvidia,tegra20-dsi.yaml
```yaml
# SPDX-License-Identifier: (GPL-2.0-only OR BSD-2-Clause)
%YAML 1.2
---
$id: http://devicetree.org/schemas/display/tegra/nvidia,tegra20-dsi.yaml#
$schema: http://devicetree.org/meta-schemas/core.yaml#

title: NVIDIA Tegra Display Serial Interface

maintainers:
  - Thierry Reding <thierry.reding@gmail.com>
  - Jon Hunter <jonathanh@nvidia.com>

properties:
  compatible:
    oneOf:
      - enum:
          - nvidia,tegra20-dsi
          - nvidia,tegra30-dsi
          - nvidia,tegra114-dsi
          - nvidia,tegra124-dsi
          - nvidia,tegra210-dsi
          - nvidia,tegra186-dsi

      - items:
          - const: nvidia,tegra132-dsi
          - const: nvidia,tegra124-dsi

  reg:
    maxItems: 1

  interrupts:
    maxItems: 1

  clocks:
    minItems: 2
    maxItems: 3

  clock-names:
    minItems: 2
    maxItems: 3

  resets:
    items:
      - description: module reset

  reset-names:
    items:
      - const: dsi

  operating-points-v2: true

  power-domains:
    maxItems: 1

  avdd-dsi-csi-supply:
    description: phandle of a supply that powers the DSI controller

  nvidia,mipi-calibrate:
    description: Should contain a phandle and a specifier specifying
      which pads are used by this DSI output and need to be
      calibrated. See nvidia,tegra114-mipi.yaml for details.
    $ref: /schemas/types.yaml#/definitions/phandle-array

  nvidia,ddc-i2c-bus:
    description: phandle of an I2C controller used for DDC EDID
      probing
    $ref: /schemas/types.yaml#/definitions/phandle

  nvidia,hpd-gpio:
    description: specifies a GPIO used for hotplug detection
    maxItems: 1

  nvidia,edid:
    description: supplies a binary EDID blob
    $ref: /schemas/types.yaml#/definitions/uint8-array

  nvidia,panel:
    description: phandle of a display panel
    $ref: /schemas/types.yaml#/definitions/phandle

  nvidia,ganged-mode:
    description: contains a phandle to a second DSI controller to
      gang up with in order to support up to 8 data lanes
    $ref: /schemas/types.yaml#/definitions/phandle

allOf:
  - $ref: ../dsi-controller.yaml#
  - if:
      properties:
        compatible:
          contains:
            enum:
              - nvidia,tegra20-dsi
              - nvidia,tegra30-dsi
    then:
      properties:
        clocks:
          items:
            - description: DSI module clock
            - description: input for the pixel clock

        clock-names:
          items:
            - const: dsi
            - const: parent
    else:
      properties:
        clocks:
          items:
            - description: DSI module clock
            - description: low-power module clock
            - description: input for the pixel clock

        clock-names:
          items:
            - const: dsi
            - const: lp
            - const: parent

  - if:
      properties:
        compatible:
          contains:
            const: nvidia,tegra186-dsi
    then:
      required:
        - interrupts

unevaluatedProperties: false

required:
  - compatible
  - reg
  - clocks
  - clock-names
  - resets
  - reset-names

examples:
  - |
    #include <dt-bindings/clock/tegra186-clock.h>
    #include <dt-bindings/interrupt-controller/arm-gic.h>
    #include <dt-bindings/power/tegra186-powergate.h>
    #include <dt-bindings/reset/tegra186-reset.h>

    dsi@15300000 {
        compatible = "nvidia,tegra186-dsi";
        reg = <0x15300000 0x10000>;
        interrupts = <GIC_SPI 20 IRQ_TYPE_LEVEL_HIGH>;
        clocks = <&bpmp TEGRA186_CLK_DSI>,
                 <&bpmp TEGRA186_CLK_DSIA_LP>,
                 <&bpmp TEGRA186_CLK_PLLD>;
        clock-names = "dsi", "lp", "parent";
        resets = <&bpmp TEGRA186_RESET_DSI>;
        reset-names = "dsi";

        power-domains = <&bpmp TEGRA186_POWER_DOMAIN_DISP>;
    };
```

## Documentation/devicetree/bindings/display/tegra/nvidia,tegra20-epp.yaml
```yaml
# SPDX-License-Identifier: (GPL-2.0-only OR BSD-2-Clause)
%YAML 1.2
---
$id: http://devicetree.org/schemas/display/tegra/nvidia,tegra20-epp.yaml#
$schema: http://devicetree.org/meta-schemas/core.yaml#

title: NVIDIA Tegra Encoder Pre-Processor

maintainers:
  - Thierry Reding <thierry.reding@gmail.com>
  - Jon Hunter <jonathanh@nvidia.com>

properties:
  $nodename:
    pattern: "^epp@[0-9a-f]+$"

  compatible:
    enum:
      - nvidia,tegra20-epp
      - nvidia,tegra30-epp
      - nvidia,tegra114-epp

  reg:
    maxItems: 1

  interrupts:
    maxItems: 1

  clocks:
    maxItems: 1

  resets:
    items:
      - description: module reset

  reset-names:
    items:
      - const: epp

  iommus:
    maxItems: 1

  interconnects:
    maxItems: 4

  interconnect-names:
    maxItems: 4

  operating-points-v2: true

  power-domains:
    items:
      - description: phandle to the core power domain

additionalProperties: false

examples:
  - |
    #include <dt-bindings/clock/tegra20-car.h>
    #include <dt-bindings/interrupt-controller/arm-gic.h>

    epp@540c0000 {
        compatible = "nvidia,tegra20-epp";
        reg = <0x540c0000 0x00040000>;
        interrupts = <GIC_SPI 70 IRQ_TYPE_LEVEL_HIGH>;
        clocks = <&tegra_car TEGRA20_CLK_EPP>;
        resets = <&tegra_car 19>;
        reset-names = "epp";
    };
```

## Documentation/devicetree/bindings/display/tegra/nvidia,tegra20-gr2d.yaml
```yaml
# SPDX-License-Identifier: (GPL-2.0-only OR BSD-2-Clause)
%YAML 1.2
---
$id: http://devicetree.org/schemas/display/tegra/nvidia,tegra20-gr2d.yaml#
$schema: http://devicetree.org/meta-schemas/core.yaml#

title: NVIDIA 2D graphics engine

maintainers:
  - Thierry Reding <thierry.reding@gmail.com>
  - Jon Hunter <jonathanh@nvidia.com>

properties:
  $nodename:
    pattern: "^gr2d@[0-9a-f]+$"

  compatible:
    enum:
      - nvidia,tegra20-gr2d
      - nvidia,tegra30-gr2d
      - nvidia,tegra114-gr2d

  reg:
    maxItems: 1

  interrupts:
    maxItems: 1

  clocks:
    items:
      - description: module clock

  resets:
    items:
      - description: module reset
      - description: memory client hotflush reset

  reset-names:
    items:
      - const: 2d
      - const: mc

  iommus:
    maxItems: 1

  interconnects:
    maxItems: 4

  interconnect-names:
    maxItems: 4

  operating-points-v2: true

  power-domains:
    items:
      - description: phandle to the HEG or core power domain

additionalProperties: false

examples:
  - |
    #include <dt-bindings/clock/tegra20-car.h>
    #include <dt-bindings/interrupt-controller/arm-gic.h>
    #include <dt-bindings/memory/tegra20-mc.h>

    gr2d@54140000 {
        compatible = "nvidia,tegra20-gr2d";
        reg = <0x54140000 0x00040000>;
        interrupts = <GIC_SPI 72 IRQ_TYPE_LEVEL_HIGH>;
        clocks = <&tegra_car TEGRA20_CLK_GR2D>;
        resets = <&tegra_car 21>, <&mc TEGRA20_MC_RESET_2D>;
        reset-names = "2d", "mc";
    };
```
