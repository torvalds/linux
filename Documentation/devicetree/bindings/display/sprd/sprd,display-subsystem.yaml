## Documentation/devicetree/bindings/display/sunxi/sun6i-dsi.txt
```
Allwinner A31 DSI Encoder
=========================

The DSI pipeline consists of two separate blocks: the DSI controller
itself, and its associated D-PHY.

DSI Encoder
-----------

The DSI Encoder generates the DSI signal from the TCON's.

Required properties:
  - compatible: value must be one of:
    * allwinner,sun6i-a31-mipi-dsi
  - reg: base address and size of memory-mapped region
  - interrupts: interrupt associated to this IP
  - clocks: phandles to the clocks feeding the DSI encoder
    * bus: the DSI interface clock
    * mod: the DSI module clock
  - clock-names: the clock names mentioned above
  - phys: phandle to the D-PHY
  - phy-names: must be "dphy"
  - resets: phandle to the reset controller driving the encoder

  - ports: A ports node with endpoint definitions as defined in
    Documentation/devicetree/bindings/media/video-interfaces.txt. The
    first port should be the input endpoint, usually coming from the
    associated TCON.

Any MIPI-DSI device attached to this should be described according to
the bindings defined in ../mipi-dsi-bus.txt

D-PHY
-----

Required properties:
  - compatible: value must be one of:
    * allwinner,sun6i-a31-mipi-dphy
  - reg: base address and size of memory-mapped region
  - clocks: phandles to the clocks feeding the DSI encoder
    * bus: the DSI interface clock
    * mod: the DSI module clock
  - clock-names: the clock names mentioned above
  - resets: phandle to the reset controller driving the encoder

Example:

dsi0: dsi@1ca0000 {
	compatible = "allwinner,sun6i-a31-mipi-dsi";
	reg = <0x01ca0000 0x1000>;
	interrupts = <GIC_SPI 89 IRQ_TYPE_LEVEL_HIGH>;
	clocks = <&ccu CLK_BUS_MIPI_DSI>,
		 <&ccu CLK_DSI_SCLK>;
	clock-names = "bus", "mod";
	resets = <&ccu RST_BUS_MIPI_DSI>;
	phys = <&dphy0>;
	phy-names = "dphy";
	#address-cells = <1>;
	#size-cells = <0>;

	panel@0 {
		compatible = "bananapi,lhr050h41", "ilitek,ili9881c";
		reg = <0>;
		power-gpios = <&pio 1 7 GPIO_ACTIVE_HIGH>; /* PB07 */
		reset-gpios = <&r_pio 0 5 GPIO_ACTIVE_LOW>; /* PL05 */
		backlight = <&pwm_bl>;
	};

	ports {
		#address-cells = <1>;
		#size-cells = <0>;

		port@0 {
			#address-cells = <1>;
			#size-cells = <0>;
			reg = <0>;

			dsi0_in_tcon0: endpoint {
				remote-endpoint = <&tcon0_out_dsi0>;
			};
		};
	};
};

dphy0: d-phy@1ca1000 {
	compatible = "allwinner,sun6i-a31-mipi-dphy";
	reg = <0x01ca1000 0x1000>;
	clocks = <&ccu CLK_BUS_MIPI_DSI>,
		 <&ccu CLK_DSI_DPHY>;
	clock-names = "bus", "mod";
	resets = <&ccu RST_BUS_MIPI_DSI>;
	#phy-cells = <0>;
};
```

## Documentation/devicetree/bindings/display/tegra/nvidia,tegra114-mipi.yaml
```yaml
# SPDX-License-Identifier: (GPL-2.0-only OR BSD-2-Clause)
%YAML 1.2
---
$id: http://devicetree.org/schemas/display/tegra/nvidia,tegra114-mipi.yaml#
$schema: http://devicetree.org/meta-schemas/core.yaml#

title: NVIDIA Tegra MIPI pad calibration controller

maintainers:
  - Thierry Reding <thierry.reding@gmail.com>
  - Jon Hunter <jonathanh@nvidia.com>

properties:
  $nodename:
    pattern: "^mipi@[0-9a-f]+$"

  compatible:
    enum:
      - nvidia,tegra114-mipi
      - nvidia,tegra124-mipi
      - nvidia,tegra210-mipi
      - nvidia,tegra186-mipi

  reg:
    maxItems: 1

  clocks:
    items:
      - description: module clock

  clock-names:
    items:
      - const: mipi-cal

  power-domains:
    maxItems: 1

  "#nvidia,mipi-calibrate-cells":
    description: The number of cells in a MIPI calibration specifier.
      Should be 1. The single cell specifies a bitmask of the pads that
      need to be calibrated for a given device.
    $ref: /schemas/types.yaml#/definitions/uint32
    const: 1

additionalProperties: false

required:
  - compatible
  - reg
  - clocks
  - "#nvidia,mipi-calibrate-cells"

examples:
  - |
    #include <dt-bindings/clock/tegra114-car.h>

    mipi@700e3000 {
        compatible = "nvidia,tegra114-mipi";
        reg = <0x700e3000 0x100>;
        clocks = <&tegra_car TEGRA114_CLK_MIPI_CAL>;
        clock-names = "mipi-cal";
        #nvidia,mipi-calibrate-cells = <1>;
    };

    dsia: dsi@54300000 {
        compatible = "nvidia,tegra114-dsi";
        reg = <0x54300000 0x00040000>;
        clocks = <&tegra_car TEGRA114_CLK_DSIA>,
                 <&tegra_car TEGRA114_CLK_DSIALP>,
                 <&tegra_car TEGRA114_CLK_PLL_D_OUT0>;
        clock-names = "dsi", "lp", "parent";
        resets = <&tegra_car 48>;
        reset-names = "dsi";
        nvidia,mipi-calibrate = <&mipi 0x060>; /* DSIA & DSIB pads */
    };
```

## Documentation/devicetree/bindings/display/tegra/nvidia,tegra114-tsec.yaml
```yaml
# SPDX-License-Identifier: (GPL-2.0-only OR BSD-2-Clause)
%YAML 1.2
---
$id: http://devicetree.org/schemas/display/tegra/nvidia,tegra114-tsec.yaml#
$schema: http://devicetree.org/meta-schemas/core.yaml#

title: NVIDIA Tegra Security co-processor

maintainers:
  - Svyatoslav Ryhel <clamor95@gmail.com>
  - Thierry Reding <thierry.reding@gmail.com>

description: Tegra Security co-processor, an embedded security processor used
  mainly to manage the HDCP encryption and keys on the HDMI link.

properties:
  compatible:
    oneOf:
      - enum:
          - nvidia,tegra114-tsec
          - nvidia,tegra124-tsec
          - nvidia,tegra210-tsec

      - items:
          - const: nvidia,tegra132-tsec
          - const: nvidia,tegra124-tsec

  reg:
    maxItems: 1

  interrupts:
    maxItems: 1

  clocks:
    maxItems: 1

  resets:
    maxItems: 1

  iommus:
    maxItems: 1

  operating-points-v2: true

  power-domains:
    maxItems: 1

additionalProperties: false

required:
  - compatible
  - reg
  - interrupts
  - clocks
  - resets

examples:
  - |
    #include <dt-bindings/clock/tegra114-car.h>
    #include <dt-bindings/interrupt-controller/arm-gic.h>

    tsec@54500000 {
        compatible = "nvidia,tegra114-tsec";
        reg = <0x54500000 0x00040000>;
        interrupts = <GIC_SPI 50 IRQ_TYPE_LEVEL_HIGH>;
        clocks = <&tegra_car TEGRA114_CLK_TSEC>;
        resets = <&tegra_car TEGRA114_CLK_TSEC>;
    };
```

## Documentation/devicetree/bindings/display/tegra/nvidia,tegra124-dpaux.yaml
```yaml
# SPDX-License-Identifier: (GPL-2.0-only OR BSD-2-Clause)
%YAML 1.2
---
$id: http://devicetree.org/schemas/display/tegra/nvidia,tegra124-dpaux.yaml#
$schema: http://devicetree.org/meta-schemas/core.yaml#

title: NVIDIA Tegra DisplayPort AUX Interface

maintainers:
  - Thierry Reding <thierry.reding@gmail.com>
  - Jon Hunter <jonathanh@nvidia.com>

description: |
  The Tegra Display Port Auxiliary (DPAUX) pad controller manages two
  pins which can be assigned to either the DPAUX channel or to an I2C
  controller.

  When configured for DisplayPort AUX operation, the DPAUX controller
  can also be used to communicate with a DisplayPort device using the
  AUX channel.

properties:
  $nodename:
    pattern: "^dpaux@[0-9a-f]+$"

  compatible:
    oneOf:
      - enum:
          - nvidia,tegra124-dpaux
          - nvidia,tegra210-dpaux
          - nvidia,tegra186-dpaux
          - nvidia,tegra194-dpaux

      - items:
          - const: nvidia,tegra132-dpaux
          - const: nvidia,tegra124-dpaux

  reg:
    maxItems: 1

  interrupts:
    maxItems: 1

  clocks:
    items:
      - description: clock input for the DPAUX hardware
      - description: reference clock

  clock-names:
    items:
      - const: dpaux
      - const: parent

  resets:
    items:
      - description: module reset

  reset-names:
    items:
      - const: dpaux

  power-domains:
    maxItems: 1

  i2c-bus:
    description: Subnode where I2C slave devices are listed. This
      subnode must be always present. If there are no I2C slave
      devices, an empty node should be added. See ../../i2c/i2c.yaml
      for more information.
    type: object

  aux-bus:
    $ref: /schemas/display/dp-aux-bus.yaml#

  vdd-supply:
    description: phandle of a supply that powers the DisplayPort
      link

patternProperties:
  "^pinmux-[a-z0-9]+$":
    description:
      Since only three configurations are possible, only three child
      nodes are needed to describe the pin mux'ing options for the
      DPAUX pads. Furthermore, given that the pad functions are only
      applicable to a single set of pads, the child nodes only need
      to describe the pad group the functions are being applied to
      rather than the individual pads.
    type: object
    properties:
      groups:
        const: dpaux-io

      function:
        enum:
          - aux
          - i2c
          - off

    additionalProperties: false

    required:
      - groups
      - function

additionalProperties: false

required:
  - compatible
  - reg
  - interrupts
  - clocks
  - clock-names
  - resets
  - reset-names

examples:
  - |
    #include <dt-bindings/clock/tegra210-car.h>
    #include <dt-bindings/interrupt-controller/arm-gic.h>

    dpaux: dpaux@545c0000 {
        compatible = "nvidia,tegra210-dpaux";
        reg = <0x545c0000 0x00040000>;
        interrupts = <GIC_SPI 159 IRQ_TYPE_LEVEL_HIGH>;
        clocks = <&tegra_car TEGRA210_CLK_DPAUX>,
                 <&tegra_car TEGRA210_CLK_PLL_DP>;
        clock-names = "dpaux", "parent";
        resets = <&tegra_car 181>;
        reset-names = "dpaux";
        power-domains = <&pd_sor>;

        state_dpaux_aux: pinmux-aux {
            groups = "dpaux-io";
            function = "aux";
        };

        state_dpaux_i2c: pinmux-i2c {
            groups = "dpaux-io";
            function = "i2c";
        };

        state_dpaux_off: pinmux-off {
            groups = "dpaux-io";
            function = "off";
        };

        i2c-bus {
            #address-cells = <1>;
            #size-cells = <0>;
        };
    };
```

## Documentation/devicetree/bindings/display/tegra/nvidia,tegra124-sor.yaml
```yaml
# SPDX-License-Identifier: (GPL-2.0-only OR BSD-2-Clause)
%YAML 1.2
---
$id: http://devicetree.org/schemas/display/tegra/nvidia,tegra124-sor.yaml#
$schema: http://devicetree.org/meta-schemas/core.yaml#

title: NVIDIA Tegra SOR Output Encoder

maintainers:
  - Thierry Reding <thierry.reding@gmail.com>
  - Jon Hunter <jonathanh@nvidia.com>

description: |
  The Serial Output Resource (SOR) can be used to drive HDMI, LVDS, eDP
  and DP outputs.

properties:
  $nodename:
    pattern: "^sor@[0-9a-f]+$"

  compatible:
    oneOf:
      - enum:
          - nvidia,tegra124-sor
          - nvidia,tegra210-sor
          - nvidia,tegra210-sor1
          - nvidia,tegra186-sor
          - nvidia,tegra186-sor1
          - nvidia,tegra194-sor

      - items:
          - const: nvidia,tegra132-sor
          - const: nvidia,tegra124-sor

  reg:
    maxItems: 1

  interrupts:
    maxItems: 1

  clocks:
    minItems: 5
    maxItems: 6

  clock-names:
    minItems: 5
    maxItems: 6

  resets:
    items:
      - description: module reset

  reset-names:
    items:
      - const: sor

  power-domains:
    maxItems: 1

  avdd-io-hdmi-dp-supply:
    description: I/O supply for HDMI/DP

  vdd-hdmi-dp-pll-supply:
    description: PLL supply for HDMI/DP

  hdmi-supply:
    description: +5.0V HDMI connector supply, required for HDMI

  # Tegra186 and later
  nvidia,interface:
    description: index of the SOR interface
    $ref: /schemas/types.yaml#/definitions/uint32

  nvidia,ddc-i2c-bus:
    description: phandle of an I2C controller used for DDC EDID
      probing
    $ref: /schemas/types.yaml#/definitions/phandle

  nvidia,hpd-gpio:
    description: specifies a GPIO used for hotplug detection
    maxItems: 1

  nvidia,edid:
    description: supplies a binary EDID blob
    $ref: /schemas/types.yaml#/definitions/uint8-array

  nvidia,panel:
    description: phandle of a display panel, required for eDP
    $ref: /schemas/types.yaml#/definitions/phandle

  nvidia,xbar-cfg:
    description: 5 cells containing the crossbar configuration.
      Each lane of the SOR, identified by the cell's index, is
      mapped via the crossbar to the pad specified by the cell's
      value.
    $ref: /schemas/types.yaml#/definitions/uint32-array

  # optional when driving an eDP output
  nvidia,dpaux:
    description: phandle to a DispayPort AUX interface
    $ref: /schemas/types.yaml#/definitions/phandle

allOf:
  - if:
      properties:
        compatible:
          contains:
            enum:
              - nvidia,tegra186-sor
              - nvidia,tegra194-sor
    then:
      properties:
        clocks:
          items:
            - description: clock input for the SOR hardware
            - description: SOR output clock
            - description: input for the pixel clock
            - description: reference clock for the SOR clock
            - description: safe reference clock for the SOR clock
                during power up
            - description: SOR pad output clock

        clock-names:
          items:
            - const: sor
            - enum:
                - source # deprecated
                - out
            - const: parent
            - const: dp
            - const: safe
            - const: pad
    else:
      properties:
        clocks:
          items:
            - description: clock input for the SOR hardware
            - description: SOR output clock
            - description: input for the pixel clock
            - description: reference clock for the SOR clock
            - description: safe reference clock for the SOR clock
                during power up

        clock-names:
          items:
            - const: sor
            - enum:
                - source # deprecated
                - out
            - const: parent
            - const: dp
            - const: safe

additionalProperties: false

required:
  - compatible
  - reg
  - interrupts
  - clocks
  - clock-names
  - resets
  - reset-names
  - avdd-io-hdmi-dp-supply
  - vdd-hdmi-dp-pll-supply

examples:
  - |
    #include <dt-bindings/clock/tegra210-car.h>
    #include <dt-bindings/gpio/tegra-gpio.h>
    #include <dt-bindings/interrupt-controller/arm-gic.h>

    sor0: sor@54540000 {
        compatible = "nvidia,tegra210-sor";
        reg = <0x54540000 0x00040000>;
        interrupts = <GIC_SPI 76 IRQ_TYPE_LEVEL_HIGH>;
        clocks = <&tegra_car TEGRA210_CLK_SOR0>,
                 <&tegra_car TEGRA210_CLK_SOR0_OUT>,
                 <&tegra_car TEGRA210_CLK_PLL_D_OUT0>,
                 <&tegra_car TEGRA210_CLK_PLL_DP>,
                 <&tegra_car TEGRA210_CLK_SOR_SAFE>;
        clock-names = "sor", "out", "parent", "dp", "safe";
        resets = <&tegra_car 182>;
        reset-names = "sor";
        pinctrl-0 = <&state_dpaux_aux>;
        pinctrl-1 = <&state_dpaux_i2c>;
        pinctrl-2 = <&state_dpaux_off>;
        pinctrl-names = "aux", "i2c", "off";
        power-domains = <&pd_sor>;

        avdd-io-hdmi-dp-supply = <&avdd_1v05>;
        vdd-hdmi-dp-pll-supply = <&vdd_1v8>;
        hdmi-supply = <&vdd_hdmi>;

        nvidia,ddc-i2c-bus = <&hdmi_ddc>;
        nvidia,hpd-gpio = <&gpio TEGRA_GPIO(CC, 1) GPIO_ACTIVE_LOW>;
    };
```
