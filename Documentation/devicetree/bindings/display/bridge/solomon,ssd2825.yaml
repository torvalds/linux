## Documentation/devicetree/bindings/display/bridge/solomon,ssd2825.yaml
```yaml
# SPDX-License-Identifier: (GPL-2.0-only OR BSD-2-Clause)
%YAML 1.2
---
$id: http://devicetree.org/schemas/display/bridge/solomon,ssd2825.yaml#
$schema: http://devicetree.org/meta-schemas/core.yaml#

title: Solomon SSD2825 RGB to MIPI-DSI bridge

maintainers:
  - Svyatoslav Ryhel <clamor95@gmail.com>

allOf:
  - $ref: /schemas/spi/spi-peripheral-props.yaml#

properties:
  compatible:
    const: solomon,ssd2825

  reg:
    maxItems: 1

  reset-gpios: true

  dvdd-supply:
    description: Regulator for 1.2V digital power supply.

  avdd-supply:
    description: Regulator for 1.2V analog power supply.

  vddio-supply:
    description: Regulator for 1.8V IO power supply.

  spi-max-frequency:
    maximum: 1000000

  spi-cpha: true
  spi-cpol: true

  clocks:
    maxItems: 1
    description: Reference TX_CLK used before PLL is locked.

  solomon,hs-zero-delay-ns:
    description:
      HS zero delay period
    minimum: 0
    maximum: 1700
    default: 133

  solomon,hs-prep-delay-ns:
    description:
      HS prep delay period
    minimum: 0
    maximum: 1728
    default: 40

  ports:
    $ref: /schemas/graph.yaml#/properties/ports

    properties:
      port@0:
        $ref: /schemas/graph.yaml#/$defs/port-base
        unevaluatedProperties: false
        description:
          Video port for RGB input

        properties:
          endpoint:
            $ref: /schemas/graph.yaml#/$defs/endpoint-base
            unevaluatedProperties: false

            properties:
              bus-width:
                enum: [ 16, 18, 24 ]

      port@1:
        $ref: /schemas/graph.yaml#/properties/port
        description:
          Video port for DSI output (panel or connector)

    required:
      - port@0
      - port@1

required:
  - compatible
  - ports

additionalProperties: false

examples:
  - |
    #include <dt-bindings/gpio/gpio.h>

    spi {
        #address-cells = <1>;
        #size-cells = <0>;

        dsi@2 {
            compatible = "solomon,ssd2825";
            reg = <2>;

            spi-max-frequency = <1000000>;

            spi-cpha;
            spi-cpol;

            reset-gpios = <&gpio 114 GPIO_ACTIVE_LOW>;

            dvdd-supply = <&vdd_1v2>;
            avdd-supply = <&vdd_1v2>;
            vddio-supply = <&vdd_1v8_io>;

            solomon,hs-zero-delay-ns = <300>;
            solomon,hs-prep-delay-ns = <65>;

            clocks = <&ssd2825_tx_clk>;

            ports {
                #address-cells = <1>;
                #size-cells = <0>;

                port@0 {
                    reg = <0>;

                    bridge_input: endpoint {
                        remote-endpoint = <&dpi_output>;
                        bus-width = <24>;
                    };
                };

                port@1 {
                    reg = <1>;

                    bridge_output: endpoint {
                        remote-endpoint = <&panel_input>;
                    };
                };
            };
        };
    };
```

## Documentation/devicetree/bindings/display/bridge/synopsys,dw-hdmi.yaml
```yaml
# SPDX-License-Identifier: (GPL-2.0-only OR BSD-2-Clause)
%YAML 1.2
---
$id: http://devicetree.org/schemas/display/bridge/synopsys,dw-hdmi.yaml#
$schema: http://devicetree.org/meta-schemas/core.yaml#

title: Common Properties for Synopsys DesignWare HDMI TX Controller

maintainers:
  - Laurent Pinchart <laurent.pinchart+renesas@ideasonboard.com>

description: |
  This document defines device tree properties for the Synopsys DesignWare HDMI
  TX controller (DWC HDMI TX) IP core. It doesn't constitute a full device tree
  binding specification by itself but is meant to be referenced by device tree
  bindings for the platform-specific integrations of the DWC HDMI TX.

  When referenced from platform device tree bindings the properties defined in
  this document are defined as follows. The platform device tree bindings are
  responsible for defining whether each property is required or optional.

properties:
  reg:
    maxItems: 1

  reg-io-width:
    description:
      Width (in bytes) of the registers specified by the reg property.
    enum: [1, 4]
    default: 1

  clocks:
    minItems: 2
    maxItems: 5
    items:
      - description: The bus clock for either AHB and APB
      - description: The internal register configuration clock
    additionalItems: true

  clock-names:
    minItems: 2
    maxItems: 5
    items:
      - const: iahb
      - const: isfr
    additionalItems: true

  ddc-i2c-bus:
    $ref: /schemas/types.yaml#/definitions/phandle
    deprecated: true
    description:
      The HDMI DDC bus can be connected to either a system I2C master or the
      functionally-reduced I2C master contained in the DWC HDMI. When connected
      to a system I2C master this property contains a phandle to that I2C
      master controller.

      This property is deprecated, the system I2C master controller should
      be referenced through the ddc-i2c-bus property of the HDMI connector
      node.

  interrupts:
    maxItems: 1

additionalProperties: true

...
```

## Documentation/devicetree/bindings/display/bridge/tda998x.txt
```
Device-Tree bindings for the NXP TDA998x HDMI transmitter

Required properties;
  - compatible: must be "nxp,tda998x"

  - reg: I2C address

Required node:
  - port: Input port node with endpoint definition, as described
        in Documentation/devicetree/bindings/graph.txt

Optional properties:
  - interrupts: interrupt number and trigger type
	default: polling

  - pinctrl-0: pin control group to be used for
	screen plug/unplug interrupt.

  - pinctrl-names: must contain a "default" entry.

  - video-ports: 24 bits value which defines how the video controller
	output is wired to the TDA998x input - default: <0x230145>

  - audio-ports: array of 8-bit values, 2 values per one DAI[1].
	The first value defines the DAI type: TDA998x_SPDIF or TDA998x_I2S[2].
	The second value defines the tda998x AP_ENA reg content when the DAI
	in question is used. The implementation allows one or two DAIs. If two
	DAIs are defined, they must be of different type.

[1] Documentation/sound/alsa/soc/DAI.txt
[2] include/dt-bindings/display/tda998x.h

Example:

#include <dt-bindings/display/tda998x.h>

	tda998x: hdmi-encoder {
		compatible = "nxp,tda998x";
		reg = <0x70>;
		interrupt-parent = <&gpio0>;
		interrupts = <27 2>;		/* falling edge */
		pinctrl-0 = <&pmx_camera>;
		pinctrl-names = "default";
		video-ports = <0x230145>;

		#sound-dai-cells = <2>;
			     /*	DAI-format	AP_ENA reg value */
		audio-ports = <	TDA998x_SPDIF	0x04
				TDA998x_I2S	0x03>;

	};
```

## Documentation/devicetree/bindings/display/bridge/thead,th1520-dw-hdmi.yaml
```yaml
# SPDX-License-Identifier: (GPL-2.0-only OR BSD-2-Clause)
%YAML 1.2
---
$id: http://devicetree.org/schemas/display/bridge/thead,th1520-dw-hdmi.yaml#
$schema: http://devicetree.org/meta-schemas/core.yaml#

title: T-Head TH1520 DesignWare HDMI TX Encoder

maintainers:
  - Icenowy Zheng <uwu@icenowy.me>

description:
  The HDMI transmitter is a Synopsys DesignWare HDMI TX controller
  paired with a DesignWare HDMI Gen2 TX PHY.

allOf:
  - $ref: /schemas/display/bridge/synopsys,dw-hdmi.yaml#

properties:
  compatible:
    enum:
      - thead,th1520-dw-hdmi

  reg-io-width:
    const: 4

  clocks:
    maxItems: 4

  clock-names:
    items:
      - const: iahb
      - const: isfr
      - const: cec
      - const: pix

  resets:
    items:
      - description: Main reset
      - description: Configuration APB reset

  reset-names:
    items:
      - const: main
      - const: apb

  ports:
    $ref: /schemas/graph.yaml#/properties/ports

    properties:
      port@0:
        $ref: /schemas/graph.yaml#/properties/port
        description: Input port connected to DC8200 DPU "DP" output

      port@1:
        $ref: /schemas/graph.yaml#/properties/port
        description: HDMI output port

    required:
      - port@0
      - port@1

required:
  - compatible
  - reg
  - reg-io-width
  - clocks
  - clock-names
  - resets
  - reset-names
  - interrupts
  - ports

unevaluatedProperties: false

examples:
  - |
    #include <dt-bindings/interrupt-controller/irq.h>
    #include <dt-bindings/clock/thead,th1520-clk-ap.h>
    #include <dt-bindings/reset/thead,th1520-reset.h>

    soc {
      #address-cells = <2>;
      #size-cells = <2>;

      hdmi@ffef540000 {
        compatible = "thead,th1520-dw-hdmi";
        reg = <0xff 0xef540000 0x0 0x40000>;
        reg-io-width = <4>;
        interrupts = <111 IRQ_TYPE_LEVEL_HIGH>;
        clocks = <&clk_vo CLK_HDMI_PCLK>,
                 <&clk_vo CLK_HDMI_SFR>,
                 <&clk_vo CLK_HDMI_CEC>,
                 <&clk_vo CLK_HDMI_PIXCLK>;
        clock-names = "iahb", "isfr", "cec", "pix";
        resets = <&rst_vo TH1520_RESET_ID_HDMI>,
                 <&rst_vo TH1520_RESET_ID_HDMI_APB>;
        reset-names = "main", "apb";

        ports {
          #address-cells = <1>;
          #size-cells = <0>;
          port@0 {
            reg = <0>;

            hdmi_in: endpoint {
              remote-endpoint = <&dpu_out_dp1>;
            };
          };

          port@1 {
            reg = <1>;

            hdmi_out_conn: endpoint {
              remote-endpoint = <&hdmi_conn_in>;
            };
          };
        };
      };
    };
```

## Documentation/devicetree/bindings/display/bridge/thine,thc63lvd1024.txt
```
Thine Electronics THC63LVD1024 LVDS decoder
-------------------------------------------

The THC63LVD1024 is a dual link LVDS receiver designed to convert LVDS streams
to parallel data outputs. The chip supports single/dual input/output modes,
handling up to two LVDS input streams and up to two digital CMOS/TTL outputs.

Single or dual operation mode, output data mapping and DDR output modes are
configured through input signals and the chip does not expose any control bus.

Required properties:
- compatible: Shall be "thine,thc63lvd1024"
- vcc-supply: Power supply for TTL output, TTL CLOCKOUT signal, LVDS input,
  PPL and digital circuitry

Optional properties:
- powerdown-gpios: Power down GPIO signal, pin name "/PDWN". Active low
- oe-gpios: Output enable GPIO signal, pin name "OE". Active high

The THC63LVD1024 video port connections are modeled according
to OF graph bindings specified by Documentation/devicetree/bindings/graph.txt

Required video port nodes:
- port@0: First LVDS input port
- port@2: First digital CMOS/TTL parallel output

Optional video port nodes:
- port@1: Second LVDS input port
- port@3: Second digital CMOS/TTL parallel output

The device can operate in single-link mode or dual-link mode. In single-link
mode, all pixels are received on port@0, and port@1 shall not contain any
endpoint. In dual-link mode, even-numbered pixels are received on port@0 and
odd-numbered pixels on port@1, and both port@0 and port@1 shall contain
endpoints.

Example:
--------

	thc63lvd1024: lvds-decoder {
		compatible = "thine,thc63lvd1024";

		vcc-supply = <&reg_lvds_vcc>;
		powerdown-gpios = <&gpio4 15 GPIO_ACTIVE_LOW>;

		ports {
			#address-cells = <1>;
			#size-cells = <0>;

			port@0 {
				reg = <0>;

				lvds_dec_in_0: endpoint {
					remote-endpoint = <&lvds_out>;
				};
			};

			port@2{
				reg = <2>;

				lvds_dec_out_2: endpoint {
					remote-endpoint = <&adv7511_in>;
				};
			};
		};
	};
```

## Documentation/devicetree/bindings/display/bridge/thine,thc63lvd1024.yaml
```yaml
# SPDX-License-Identifier: (GPL-2.0-only OR BSD-2-Clause)
%YAML 1.2
---
$id: http://devicetree.org/schemas/display/bridge/thine,thc63lvd1024.yaml#
$schema: http://devicetree.org/meta-schemas/core.yaml#

title: Thine Electronics THC63LVD1024 LVDS Decoder

maintainers:
  - Jacopo Mondi <jacopo+renesas@jmondi.org>
  - Laurent Pinchart <laurent.pinchart+renesas@ideasonboard.com>

description: |
  The THC63LVD1024 is a dual link LVDS receiver designed to convert LVDS
  streams to parallel data outputs. The chip supports single/dual input/output
  modes, handling up to two LVDS input streams and up to two digital CMOS/TTL
  outputs.

  Single or dual operation mode, output data mapping and DDR output modes are
  configured through input signals and the chip does not expose any control
  bus.

properties:
  compatible:
    const: thine,thc63lvd1024

  ports:
    $ref: /schemas/graph.yaml#/properties/ports
    description: |
      The device can operate in single or dual input and output modes.

      When operating in single input mode, all pixels are received on port@0,
      and port@1 shall not contain any endpoint. In dual input mode,
      even-numbered pixels are received on port@0 and odd-numbered pixels on
      port@1, and both port@0 and port@1 shall contain endpoints.

      When operating in single output mode all pixels are output from the first
      CMOS/TTL port and port@3 shall not contain any endpoint. In dual output
      mode pixels are output from both CMOS/TTL ports and both port@2 and
      port@3 shall contain endpoints.

    properties:
      port@0:
        $ref: /schemas/graph.yaml#/properties/port
        description: First LVDS input port

      port@1:
        $ref: /schemas/graph.yaml#/properties/port
        description: Second LVDS input port

      port@2:
        $ref: /schemas/graph.yaml#/properties/port
        description: First digital CMOS/TTL parallel output

      port@3:
        $ref: /schemas/graph.yaml#/properties/port
        description: Second digital CMOS/TTL parallel output

    required:
      - port@0
      - port@2

  oe-gpios:
    maxItems: 1
    description: Output enable GPIO signal, pin name "OE", active high.

  powerdown-gpios:
    maxItems: 1
    description: Power down GPIO signal, pin name "/PDWN", active low.

  vcc-supply:
    description:
      Power supply for the TTL output, TTL CLOCKOUT signal, LVDS input, PLL and
      digital circuitry.

required:
  - compatible
  - ports
  - vcc-supply

additionalProperties: false

examples:
  - |
    #include <dt-bindings/gpio/gpio.h>

    lvds-decoder {
        compatible = "thine,thc63lvd1024";

        vcc-supply = <&reg_lvds_vcc>;
        powerdown-gpios = <&gpio4 15 GPIO_ACTIVE_LOW>;

        ports {
            #address-cells = <1>;
            #size-cells = <0>;

            port@0 {
                reg = <0>;

                lvds_dec_in_0: endpoint {
                    remote-endpoint = <&lvds_out>;
                };
            };

            port@2 {
                reg = <2>;

                lvds_dec_out_2: endpoint {
                    remote-endpoint = <&adv7511_in>;
                };
            };
        };
    };

...
```

## Documentation/devicetree/bindings/display/bridge/thine,thc63lvdm83d.txt
```
THine Electronics THC63LVDM83D LVDS serializer
----------------------------------------------

The THC63LVDM83D is an LVDS serializer designed to support pixel data
transmission between a host and a flat panel.

Required properties:

- compatible: Should be "thine,thc63lvdm83d"

Optional properties:

- pwdn-gpios: Power down control GPIO

Required nodes:

The THC63LVDM83D has two video ports. Their connections are modeled using the
OFgraph bindings specified in Documentation/devicetree/bindings/graph.txt.

- Video port 0 for CMOS/TTL input
- Video port 1 for LVDS output


Example
-------

	lvds_enc: encoder@0 {
		compatible = "thine,thc63lvdm83d";

		ports {
			#address-cells = <1>;
			#size-cells = <0>;

			port@0 {
				reg = <0>;

				lvds_enc_in: endpoint@0 {
					remote-endpoint = <&rgb_out>;
				};
			};

			port@1 {
				reg = <1>;

				lvds_enc_out: endpoint@0 {
					remote-endpoint = <&panel_in>;
				};
			};
		};
	};
```
