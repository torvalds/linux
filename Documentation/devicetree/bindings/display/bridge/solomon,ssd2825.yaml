## Documentation/devicetree/bindings/display/bridge/toshiba,tc358762.yaml
```yaml
# SPDX-License-Identifier: (GPL-2.0-only OR BSD-2-Clause)
%YAML 1.2
---
$id: http://devicetree.org/schemas/display/bridge/toshiba,tc358762.yaml#
$schema: http://devicetree.org/meta-schemas/core.yaml#

title: Toshiba TC358762 MIPI DSI to MIPI DPI bridge

maintainers:
  - Marek Vasut <marex@denx.de>

description: |
  The TC358762 is bridge device which converts MIPI DSI to MIPI DPI.

properties:
  compatible:
    enum:
      - toshiba,tc358762

  reg:
    maxItems: 1
    description: virtual channel number of a DSI peripheral

  vddc-supply:
    description: Regulator for 1.2V internal core power.

  ports:
    type: object

    properties:
      "#address-cells":
        const: 1

      "#size-cells":
        const: 0

      port@0:
        type: object
        additionalProperties: false

        description: |
          Video port for MIPI DSI input

        properties:
          reg:
            const: 0

        patternProperties:
          endpoint:
            type: object
            additionalProperties: false

            properties:
              remote-endpoint: true

        required:
          - reg

      port@1:
        type: object
        additionalProperties: false

        description: |
          Video port for MIPI DPI output (panel or connector).

        properties:
          reg:
            const: 1

        patternProperties:
          endpoint:
            type: object
            additionalProperties: false

            properties:
              remote-endpoint: true

        required:
          - reg

    required:
      - "#address-cells"
      - "#size-cells"
      - port@0
      - port@1

required:
  - compatible
  - reg
  - vddc-supply
  - ports

additionalProperties: false

examples:
  - |
    i2c1 {
      #address-cells = <1>;
      #size-cells = <0>;

      bridge@0 {
        reg = <0>;
        compatible = "toshiba,tc358762";
        vddc-supply = <&vcc_1v2_reg>;

        ports {
          #address-cells = <1>;
          #size-cells = <0>;

          port@0 {
            reg = <0>;
            bridge_in: endpoint {
              remote-endpoint = <&dsi_out>;
            };
          };

          port@1 {
            reg = <1>;
            bridge_out: endpoint {
              remote-endpoint = <&panel_in>;
            };
          };
        };
      };
    };

...
```

## Documentation/devicetree/bindings/display/bridge/toshiba,tc358764.txt
```
TC358764 MIPI-DSI to LVDS panel bridge

Required properties:
  - compatible: "toshiba,tc358764"
  - reg: the virtual channel number of a DSI peripheral
  - vddc-supply: core voltage supply, 1.2V
  - vddio-supply: I/O voltage supply, 1.8V or 3.3V
  - vddlvds-supply: LVDS1/2 voltage supply, 3.3V
  - reset-gpios: a GPIO spec for the reset pin

The device node can contain following 'port' child nodes,
according to the OF graph bindings defined in [1]:
  0: DSI Input, not required, if the bridge is DSI controlled
  1: LVDS Output, mandatory

[1]: Documentation/devicetree/bindings/media/video-interfaces.txt

Example:

	bridge@0 {
		reg = <0>;
		compatible = "toshiba,tc358764";
		vddc-supply = <&vcc_1v2_reg>;
		vddio-supply = <&vcc_1v8_reg>;
		vddlvds-supply = <&vcc_3v3_reg>;
		reset-gpios = <&gpd1 6 GPIO_ACTIVE_LOW>;
		#address-cells = <1>;
		#size-cells = <0>;
		port@1 {
			reg = <1>;
			lvds_ep: endpoint {
				remote-endpoint = <&panel_ep>;
			};
		};
	};
```

## Documentation/devicetree/bindings/display/bridge/toshiba,tc358764.yaml
```yaml
# SPDX-License-Identifier: (GPL-2.0-only OR BSD-2-Clause)
%YAML 1.2
---
$id: http://devicetree.org/schemas/display/bridge/toshiba,tc358764.yaml#
$schema: http://devicetree.org/meta-schemas/core.yaml#

title: Toshiba TC358764 MIPI-DSI to LVDS bridge

maintainers:
  - Andrzej Hajda <andrzej.hajda@intel.com>

properties:
  compatible:
    const: toshiba,tc358764

  reg:
    description: Virtual channel number of a DSI peripheral
    maxItems: 1

  reset-gpios:
    maxItems: 1

  vddc-supply:
    description: Core voltage supply, 1.2V

  vddio-supply:
    description: I/O voltage supply, 1.8V or 3.3V

  vddlvds-supply:
    description: LVDS1/2 voltage supply, 3.3V

  ports:
    $ref: /schemas/graph.yaml#/properties/ports

    properties:
      port@0:
        $ref: /schemas/graph.yaml#/properties/port
        description:
          Video port for MIPI DSI input, if the bridge DSI controlled

      port@1:
        $ref: /schemas/graph.yaml#/properties/port
        description:
          Video port for LVDS output (panel or connector).

    required:
      - port@1

required:
  - compatible
  - reg
  - reset-gpios
  - vddc-supply
  - vddio-supply
  - vddlvds-supply
  - ports

additionalProperties: false

examples:
  - |
    #include <dt-bindings/gpio/gpio.h>

    i2c {
        #address-cells = <1>;
        #size-cells = <0>;

        bridge@0 {
            compatible = "toshiba,tc358764";
            reg = <0>;

            reset-gpios = <&gpd1 6 GPIO_ACTIVE_LOW>;
            vddc-supply = <&vcc_1v2_reg>;
            vddio-supply = <&vcc_1v8_reg>;
            vddlvds-supply = <&vcc_3v3_reg>;

            ports {
                #address-cells = <1>;
                #size-cells = <0>;

                port@1 {
                    reg = <1>;
                    lvds_ep: endpoint {
                      remote-endpoint = <&panel_ep>;
                    };
                };
            };
        };
    };
```

## Documentation/devicetree/bindings/display/bridge/toshiba,tc358767.txt
```
Toshiba TC358767 eDP bridge bindings

Required properties:
 - compatible: "toshiba,tc358767"
 - reg: i2c address of the bridge, 0x68 or 0x0f, depending on bootstrap pins
 - clock-names: should be "ref"
 - clocks: OF device-tree clock specification for refclk input. The reference
   clock rate must be 13 MHz, 19.2 MHz, 26 MHz, or 38.4 MHz.

Optional properties:
 - shutdown-gpios: OF device-tree gpio specification for SD pin
                   (active high shutdown input)
 - reset-gpios: OF device-tree gpio specification for RSTX pin
                (active low system reset)
 - ports: the ports node can contain video interface port nodes to connect
   to a DPI/DSI source and to an eDP/DP sink according to [1][2]:
    - port@0: DSI input port
    - port@1: DPI input port
    - port@2: eDP/DP output port

[1]: Documentation/devicetree/bindings/graph.txt
[2]: Documentation/devicetree/bindings/media/video-interfaces.txt

Example:
	edp-bridge@68 {
		compatible = "toshiba,tc358767";
		reg = <0x68>;
		shutdown-gpios = <&gpio3 23 GPIO_ACTIVE_HIGH>;
		reset-gpios = <&gpio3 24 GPIO_ACTIVE_LOW>;
		clock-names = "ref";
		clocks = <&edp_refclk>;

		ports {
			#address-cells = <1>;
			#size-cells = <0>;

			port@1 {
				reg = <1>;

				bridge_in: endpoint {
					remote-endpoint = <&dpi_out>;
				};
			};

			port@2 {
				reg = <2>;

				bridge_out: endpoint {
					remote-endpoint = <&panel_in>;
				};
			};
		};
	};
```

## Documentation/devicetree/bindings/display/bridge/toshiba,tc358767.yaml
```yaml
# SPDX-License-Identifier: (GPL-2.0-only OR BSD-2-Clause)
%YAML 1.2
---
$id: http://devicetree.org/schemas/display/bridge/toshiba,tc358767.yaml#
$schema: http://devicetree.org/meta-schemas/core.yaml#

title: Toshiba TC358767 eDP bridge

maintainers:
  - Andrey Gusakov <andrey.gusakov@cogentembedded.com>

description: The TC358767 is bridge device which converts DSI/DPI to eDP/DP

properties:
  compatible:
    const: toshiba,tc358767

  reg:
    enum:
      - 0x68
      - 0x0f
    description: |
        i2c address of the bridge, 0x68 or 0x0f, depending on bootstrap pins

  clock-names:
    const: ref

  clocks:
    maxItems: 1
    description: |
        OF device-tree clock specification for refclk input. The reference.
        clock rate must be 13 MHz, 19.2 MHz, 26 MHz, or 38.4 MHz.

  shutdown-gpios:
    maxItems: 1
    description: |
        OF device-tree gpio specification for SD pin(active high shutdown input)

  reset-gpios:
    maxItems: 1
    description: |
        OF device-tree gpio specification for RSTX pin(active low system reset)

  toshiba,hpd-pin:
    $ref: /schemas/types.yaml#/definitions/uint32
    enum:
      - 0
      - 1
    description: TC358767 GPIO pin number to which HPD is connected to (0 or 1)

  ports:
    $ref: /schemas/graph.yaml#/properties/ports

    properties:
      port@0:
        $ref: /schemas/graph.yaml#/$defs/port-base
        unevaluatedProperties: false
        description: |
            DSI input port. The remote endpoint phandle should be a
            reference to a valid DSI output endpoint node

        properties:
          endpoint:
            $ref: /schemas/media/video-interfaces.yaml#
            unevaluatedProperties: false

            properties:
              data-lanes:
                description: array of physical DSI data lane indexes.
                minItems: 1
                items:
                  - const: 1
                  - const: 2
                  - const: 3
                  - const: 4

      port@1:
        $ref: /schemas/graph.yaml#/properties/port
        description: |
            DPI input/output port. The remote endpoint phandle should be a
            reference to a valid DPI output or input endpoint node.

      port@2:
        $ref: /schemas/graph.yaml#/properties/port
        description: |
            eDP/DP output port. The remote endpoint phandle should be a
            reference to a valid eDP panel input endpoint node. This port is
            optional, treated as DP panel if not defined

    oneOf:
      - required:
          - port@0
      - required:
          - port@1


required:
  - compatible
  - reg
  - clock-names
  - clocks
  - ports

additionalProperties: false

examples:
  - |
    #include <dt-bindings/gpio/gpio.h>

    /* DPI input and eDP output */

    i2c {
        #address-cells = <1>;
        #size-cells = <0>;

        edp-bridge@68 {
            compatible = "toshiba,tc358767";
            reg = <0x68>;
            shutdown-gpios = <&gpio3 23 GPIO_ACTIVE_HIGH>;
            reset-gpios = <&gpio3 24 GPIO_ACTIVE_LOW>;
            clock-names = "ref";
            clocks = <&edp_refclk>;

            ports {
                #address-cells = <1>;
                #size-cells = <0>;

                port@1 {
                    reg = <1>;

                    bridge_in_0: endpoint {
                        remote-endpoint = <&dpi_out>;
                    };
                };

                port@2 {
                    reg = <2>;

                    bridge_out: endpoint {
                        remote-endpoint = <&panel_in>;
                    };
                };
            };
        };
    };
  - |
    /* DPI input and DP output */

    i2c {
        #address-cells = <1>;
        #size-cells = <0>;

        edp-bridge@68 {
            compatible = "toshiba,tc358767";
            reg = <0x68>;
            shutdown-gpios = <&gpio3 23 GPIO_ACTIVE_HIGH>;
            reset-gpios = <&gpio3 24 GPIO_ACTIVE_LOW>;
            clock-names = "ref";
            clocks = <&edp_refclk>;

            ports {
                #address-cells = <1>;
                #size-cells = <0>;

                port@1 {
                    reg = <1>;

                    bridge_in_1: endpoint {
                        remote-endpoint = <&dpi_out>;
                    };
                };
            };
        };
    };
```

## Documentation/devicetree/bindings/display/bridge/toshiba,tc358768.yaml
```yaml
# SPDX-License-Identifier: (GPL-2.0-only OR BSD-2-Clause)
%YAML 1.2
---
$id: http://devicetree.org/schemas/display/bridge/toshiba,tc358768.yaml#
$schema: http://devicetree.org/meta-schemas/core.yaml#

title: Toschiba TC358768/TC358778 Parallel RGB to MIPI DSI bridge

maintainers:
  - Peter Ujfalusi <peter.ujfalusi@ti.com>

description: |
  The TC358768/TC358778 is bridge device which converts RGB to DSI.

properties:
  compatible:
    enum:
      - toshiba,tc358768
      - toshiba,tc358778

  reg:
    maxItems: 1
    description: base I2C address of the device

  reset-gpios:
    maxItems: 1
    description: GPIO connected to active low RESX pin

  vddc-supply:
    description: Regulator for 1.2V internal core power.

  vddmipi-supply:
    description: Regulator for 1.2V for the MIPI.

  vddio-supply:
    description: Regulator for 1.8V - 3.3V IO power.

  clocks:
    maxItems: 1

  clock-names:
    const: refclk

  ports:
    $ref: /schemas/graph.yaml#/properties/ports

    properties:
      port@0:
        $ref: /schemas/graph.yaml#/$defs/port-base
        unevaluatedProperties: false
        description: |
          Video port for RGB input

        properties:
          endpoint:
            $ref: /schemas/graph.yaml#/$defs/endpoint-base
            unevaluatedProperties: false

            properties:
              data-lines:
                enum: [ 16, 18, 24 ]

      port@1:
        $ref: /schemas/graph.yaml#/properties/port
        description: |
          Video port for DSI output (panel or connector).

    required:
      - port@0
      - port@1

required:
  - compatible
  - reg
  - vddc-supply
  - vddmipi-supply
  - vddio-supply
  - ports

additionalProperties: false

examples:
  - |
    #include <dt-bindings/gpio/gpio.h>

    i2c1 {
      #address-cells = <1>;
      #size-cells = <0>;

      dsi_bridge: dsi-bridge@e {
        compatible = "toshiba,tc358768";
        reg = <0xe>;

        clocks = <&tc358768_refclk>;
        clock-names = "refclk";

        reset-gpios = <&pcf_display_board 0 GPIO_ACTIVE_LOW>;

        vddc-supply = <&v1_2d>;
        vddmipi-supply = <&v1_2d>;
        vddio-supply = <&v3_3d>;

        dsi_bridge_ports: ports {
          #address-cells = <1>;
          #size-cells = <0>;

          port@0 {
            reg = <0>;
            rgb_in: endpoint {
              remote-endpoint = <&dpi_out>;
              data-lines = <24>;
            };
          };

          port@1 {
            reg = <1>;
            dsi_out: endpoint {
              remote-endpoint = <&lcd_in>;
            };
          };
        };
      };
    };
```
