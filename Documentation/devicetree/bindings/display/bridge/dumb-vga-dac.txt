## Documentation/devicetree/bindings/display/bridge/ingenic,jz4780-hdmi.yaml
```yaml
# SPDX-License-Identifier: (GPL-2.0 OR BSD-2-Clause)
%YAML 1.2
---
$id: http://devicetree.org/schemas/display/bridge/ingenic,jz4780-hdmi.yaml#
$schema: http://devicetree.org/meta-schemas/core.yaml#

title: Bindings for Ingenic JZ4780 HDMI Transmitter

maintainers:
  - H. Nikolaus Schaller <hns@goldelico.com>

description: |
  The HDMI Transmitter in the Ingenic JZ4780 is a Synopsys DesignWare HDMI 1.4
  TX controller IP with accompanying PHY IP.

allOf:
  - $ref: synopsys,dw-hdmi.yaml#

properties:
  compatible:
    const: ingenic,jz4780-dw-hdmi

  reg-io-width:
    const: 4

  clocks:
    maxItems: 2

  ports:
    $ref: /schemas/graph.yaml#/properties/ports

    properties:
      port@0:
        $ref: /schemas/graph.yaml#/properties/port
        description: Input from LCD controller output.

      port@1:
        $ref: /schemas/graph.yaml#/properties/port
        description: Link to the HDMI connector.

required:
  - compatible
  - clocks
  - clock-names
  - ports
  - reg-io-width

unevaluatedProperties: false

examples:
  - |
    #include <dt-bindings/clock/ingenic,jz4780-cgu.h>

    hdmi: hdmi@10180000 {
        compatible = "ingenic,jz4780-dw-hdmi";
        reg = <0x10180000 0x8000>;
        reg-io-width = <4>;
        interrupt-parent = <&intc>;
        interrupts = <3>;
        clocks = <&cgu JZ4780_CLK_AHB0>, <&cgu JZ4780_CLK_HDMI>;
        clock-names = "iahb", "isfr";

        ports {
            #address-cells = <1>;
            #size-cells = <0>;
            hdmi_in: port@0 {
                reg = <0>;
                dw_hdmi_in: endpoint {
                    remote-endpoint = <&jz4780_lcd_out>;
                };
            };
            hdmi_out: port@1 {
                reg = <1>;
                dw_hdmi_out: endpoint {
                    remote-endpoint = <&hdmi_con>;
                };
            };
        };
    };

...
```

## Documentation/devicetree/bindings/display/bridge/intel,keembay-dsi.yaml
```yaml
# SPDX-License-Identifier: (GPL-2.0-only OR BSD-2-Clause)
%YAML 1.2
---
$id: http://devicetree.org/schemas/display/bridge/intel,keembay-dsi.yaml#
$schema: http://devicetree.org/meta-schemas/core.yaml#

title: Intel Keem Bay mipi dsi controller

maintainers:
  - Anitha Chrisanthus <anitha.chrisanthus@intel.com>
  - Edmond J Dea <edmund.j.dea@intel.com>

properties:
  compatible:
    const: intel,keembay-dsi

  reg:
    items:
      - description: MIPI registers range

  reg-names:
    items:
      - const: mipi

  clocks:
    items:
      - description: MIPI DSI clock
      - description: MIPI DSI econfig clock
      - description: MIPI DSI config clock

  clock-names:
    items:
      - const: clk_mipi
      - const: clk_mipi_ecfg
      - const: clk_mipi_cfg

  ports:
    $ref: /schemas/graph.yaml#/properties/ports

    properties:
      port@0:
        $ref: /schemas/graph.yaml#/properties/port
        description: MIPI DSI input port.

      port@1:
        $ref: /schemas/graph.yaml#/properties/port
        description: DSI output port.

    required:
      - port@0
      - port@1

required:
  - compatible
  - reg
  - reg-names
  - clocks
  - clock-names
  - ports

additionalProperties: false

examples:
  - |
    mipi-dsi@20900000 {
        compatible = "intel,keembay-dsi";
        reg = <0x20900000 0x4000>;
        reg-names = "mipi";
        clocks = <&scmi_clk 0x86>,
                 <&scmi_clk 0x88>,
                 <&scmi_clk 0x89>;
        clock-names = "clk_mipi", "clk_mipi_ecfg",
                      "clk_mipi_cfg";

        ports {
            #address-cells = <1>;
            #size-cells = <0>;

            port@0 {
                reg = <0>;
                dsi_in: endpoint {
                    remote-endpoint = <&disp_out>;
                };
            };

            port@1 {
                reg = <1>;
                dsi_out: endpoint {
                    remote-endpoint = <&adv7535_input>;
                };
            };
        };
    };
```

## Documentation/devicetree/bindings/display/bridge/ite,it6263.yaml
```yaml
# SPDX-License-Identifier: (GPL-2.0-only OR BSD-2-Clause)
%YAML 1.2
---
$id: http://devicetree.org/schemas/display/bridge/ite,it6263.yaml#
$schema: http://devicetree.org/meta-schemas/core.yaml#

title: ITE IT6263 LVDS to HDMI converter

maintainers:
  - Liu Ying <victor.liu@nxp.com>

description: |
  The IT6263 is a high-performance single-chip De-SSC(De-Spread Spectrum) LVDS
  to HDMI converter.  Combined with LVDS receiver and HDMI 1.4a transmitter,
  the IT6263 supports LVDS input and HDMI 1.4 output by conversion function.
  The built-in LVDS receiver can support single-link and dual-link LVDS inputs,
  and the built-in HDMI transmitter is fully compliant with HDMI 1.4a/3D, HDCP
  1.2 and backward compatible with DVI 1.0 specification.

  The IT6263 also encodes and transmits up to 8 channels of I2S digital audio,
  with sampling rate up to 192KHz and sample size up to 24 bits. In addition,
  an S/PDIF input port takes in compressed audio of up to 192KHz frame rate.

  The newly supported High-Bit Rate(HBR) audio by HDMI specifications v1.3 is
  provided by the IT6263 in two interfaces: the four I2S input ports or the
  S/PDIF input port.  With both interfaces the highest possible HBR frame rate
  is supported at up to 768KHz.

allOf:
  - $ref: /schemas/display/lvds-dual-ports.yaml#
  - $ref: /schemas/sound/dai-common.yaml#

properties:
  compatible:
    const: ite,it6263

  reg:
    maxItems: 1

  clocks:
    maxItems: 1
    description: audio master clock

  clock-names:
    const: mclk

  data-mapping:
    enum:
      - jeida-18
      - jeida-24
      - jeida-30
      - vesa-24
      - vesa-30

  reset-gpios:
    maxItems: 1

  ivdd-supply:
    description: 1.8V digital logic power

  ovdd-supply:
    description: 3.3V I/O pin power

  txavcc18-supply:
    description: 1.8V HDMI analog frontend power

  txavcc33-supply:
    description: 3.3V HDMI analog frontend power

  pvcc1-supply:
    description: 1.8V HDMI frontend core PLL power

  pvcc2-supply:
    description: 1.8V HDMI frontend filter PLL power

  avcc-supply:
    description: 3.3V LVDS frontend power

  anvdd-supply:
    description: 1.8V LVDS frontend analog power

  apvdd-supply:
    description: 1.8V LVDS frontend PLL power

  "#sound-dai-cells":
    const: 0

  ite,i2s-audio-fifo-sources:
    $ref: /schemas/types.yaml#/definitions/uint32-array
    minItems: 1
    maxItems: 4
    items:
      enum: [0, 1, 2, 3]
    description:
      Each array element indicates the pin number of an I2S serial data input
      line which is connected to an audio FIFO, from audio FIFO0 to FIFO3.

  ite,rl-channel-swap-audio-sources:
    $ref: /schemas/types.yaml#/definitions/uint32-array
    minItems: 1
    maxItems: 4
    uniqueItems: true
    items:
      enum: [0, 1, 2, 3]
    description:
      Each array element indicates an audio source whose right channel and left
      channel are swapped by this converter. For I2S, the element is the pin
      number of an I2S serial data input line. For S/PDIF, the element is always
      0.

  ports:
    $ref: /schemas/graph.yaml#/properties/ports

    properties:
      port@0: true

      port@1:
        oneOf:
          - required: [dual-lvds-odd-pixels]
          - required: [dual-lvds-even-pixels]

      port@2:
        $ref: /schemas/graph.yaml#/properties/port
        description: video port for the HDMI output

      port@3:
        $ref: /schemas/graph.yaml#/properties/port
        description: sound input port

    required:
      - port@0
      - port@2

required:
  - compatible
  - reg
  - data-mapping
  - ivdd-supply
  - ovdd-supply
  - txavcc18-supply
  - txavcc33-supply
  - pvcc1-supply
  - pvcc2-supply
  - avcc-supply
  - anvdd-supply
  - apvdd-supply

unevaluatedProperties: false

examples:
  - |
    /* single-link LVDS input */
    #include <dt-bindings/gpio/gpio.h>

    i2c {
        #address-cells = <1>;
        #size-cells = <0>;

        hdmi@4c {
            compatible = "ite,it6263";
            reg = <0x4c>;
            data-mapping = "jeida-24";
            reset-gpios = <&gpio1 10 GPIO_ACTIVE_LOW>;
            ivdd-supply = <&reg_buck5>;
            ovdd-supply = <&reg_vext_3v3>;
            txavcc18-supply = <&reg_buck5>;
            txavcc33-supply = <&reg_vext_3v3>;
            pvcc1-supply = <&reg_buck5>;
            pvcc2-supply = <&reg_buck5>;
            avcc-supply = <&reg_vext_3v3>;
            anvdd-supply = <&reg_buck5>;
            apvdd-supply = <&reg_buck5>;

            ports {
                #address-cells = <1>;
                #size-cells = <0>;

                port@0 {
                    reg = <0>;

                    it6263_lvds_link1: endpoint {
                        remote-endpoint = <&ldb_lvds_ch0>;
                    };
                };

                port@2 {
                    reg = <2>;

                    it6263_out: endpoint {
                        remote-endpoint = <&hdmi_in>;
                    };
                };
            };
        };
    };

  - |
    /* dual-link LVDS input */
    #include <dt-bindings/gpio/gpio.h>

    i2c {
        #address-cells = <1>;
        #size-cells = <0>;

        hdmi@4c {
            compatible = "ite,it6263";
            reg = <0x4c>;
            data-mapping = "jeida-24";
            reset-gpios = <&gpio1 10 GPIO_ACTIVE_LOW>;
            ivdd-supply = <&reg_buck5>;
            ovdd-supply = <&reg_vext_3v3>;
            txavcc18-supply = <&reg_buck5>;
            txavcc33-supply = <&reg_vext_3v3>;
            pvcc1-supply = <&reg_buck5>;
            pvcc2-supply = <&reg_buck5>;
            avcc-supply = <&reg_vext_3v3>;
            anvdd-supply = <&reg_buck5>;
            apvdd-supply = <&reg_buck5>;

            ports {
                #address-cells = <1>;
                #size-cells = <0>;

                port@0 {
                    reg = <0>;
                    dual-lvds-odd-pixels;

                    it6263_lvds_link1_dual: endpoint {
                        remote-endpoint = <&ldb_lvds_ch0>;
                    };
                };

                port@1 {
                    reg = <1>;
                    dual-lvds-even-pixels;

                    it6263_lvds_link2_dual: endpoint {
                        remote-endpoint = <&ldb_lvds_ch1>;
                    };
                };

                port@2 {
                    reg = <2>;

                    it6263_out_dual: endpoint {
                        remote-endpoint = <&hdmi_in>;
                    };
                };
            };
        };
    };
```

## Documentation/devicetree/bindings/display/bridge/ite,it6505.yaml
```yaml
# SPDX-License-Identifier: (GPL-2.0-only OR BSD-2-Clause)
%YAML 1.2
---
$id: http://devicetree.org/schemas/display/bridge/ite,it6505.yaml#
$schema: http://devicetree.org/meta-schemas/core.yaml#

title: ITE it6505

maintainers:
  - Allen Chen <allen.chen@ite.com.tw>

allOf:
  - $ref: /schemas/sound/dai-common.yaml#

description: |
  The IT6505 is a high-performance DisplayPort 1.1a transmitter,
  fully compliant with DisplayPort 1.1a, HDCP 1.3 specifications.
  The IT6505 supports color depth of up to 36 bits (12 bits/color)
  and ensures robust transmission of high-quality uncompressed video
  content, along with uncompressed and compressed digital audio content.

  Aside from the various video output formats supported, the IT6505
  also encodes and transmits up to 8 channels of I2S digital audio,
  with sampling rate up to 192kHz and sample size up to 24 bits.
  In addition, an S/PDIF input port takes in compressed audio of up to
  192kHz frame rate.

  Each IT6505 chip comes preprogrammed with an unique HDCP key,
  in compliance with the HDCP 1.3 standard so as to provide secure
  transmission of high-definition content. Users of the IT6505 need not
  purchase any HDCP keys or ROMs.

properties:
  compatible:
    const: ite,it6505

  reg:
    maxItems: 1

  ovdd-supply:
    description: I/O voltage

  pwr18-supply:
    description: core voltage

  interrupts:
    maxItems: 1
    description: interrupt specifier of INT pin

  reset-gpios:
    maxItems: 1
    description: gpio specifier of RESET pin

  extcon:
    maxItems: 1
    description: extcon specifier for the Power Delivery

  "#sound-dai-cells":
    const: 0

  ports:
    $ref: /schemas/graph.yaml#/properties/ports

    properties:
      port@0:
        $ref: /schemas/graph.yaml#/$defs/port-base
        unevaluatedProperties: false
        description: A port node pointing to DPI host port node

        properties:
          endpoint:
            $ref: /schemas/graph.yaml#/$defs/endpoint-base
            unevaluatedProperties: false

            properties:
              link-frequencies:
                minItems: 1
                maxItems: 1
                description: Allowed max link frequencies in Hz

      port@1:
        $ref: /schemas/graph.yaml#/$defs/port-base
        unevaluatedProperties: false
        description: Video port for DP output

        properties:
          endpoint:
            $ref: /schemas/graph.yaml#/$defs/endpoint-base
            unevaluatedProperties: false

            properties:
              data-lanes:
                minItems: 1
                uniqueItems: true
                items:
                  - enum: [ 0, 1 ]
                  - const: 1
                  - const: 2
                  - const: 3

    required:
      - port@0
      - port@1

required:
  - compatible
  - ovdd-supply
  - pwr18-supply
  - interrupts
  - reset-gpios
  - extcon
  - ports

unevaluatedProperties: false

examples:
  - |
    #include <dt-bindings/interrupt-controller/irq.h>

    i2c {
        #address-cells = <1>;
        #size-cells = <0>;

        dp-bridge@5c {
            compatible = "ite,it6505";
            interrupts = <152 IRQ_TYPE_EDGE_FALLING 152 0>;
            reg = <0x5c>;
            pinctrl-names = "default";
            pinctrl-0 = <&it6505_pins>;
            ovdd-supply = <&mt6358_vsim1_reg>;
            pwr18-supply = <&it6505_pp18_reg>;
            reset-gpios = <&pio 179 1>;
            extcon = <&usbc_extcon>;

            ports {
                #address-cells = <1>;
                #size-cells = <0>;

                port@0 {
                    reg = <0>;
                    it6505_in: endpoint {
                        remote-endpoint = <&dpi_out>;
                        link-frequencies = /bits/ 64 <150000000>;
                    };
                };

                port@1 {
                    reg = <1>;
                    it6505_out: endpoint {
                        remote-endpoint = <&dp_in>;
                        data-lanes = <0 1>;
                    };
                };
            };
        };
    };
```
