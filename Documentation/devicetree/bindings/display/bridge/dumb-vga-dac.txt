## Documentation/devicetree/bindings/display/bridge/dumb-vga-dac.txt
```
Dumb RGB to VGA DAC bridge
---------------------------

This binding is aimed for dumb RGB to VGA DAC based bridges that do not require
any configuration.

Required properties:

- compatible: Must be "dumb-vga-dac"

Required nodes:

This device has two video ports. Their connections are modelled using the OF
graph bindings specified in Documentation/devicetree/bindings/graph.txt.

- Video port 0 for RGB input
- Video port 1 for VGA output

Optional properties:
- vdd-supply: Power supply for DAC

Example
-------

bridge {
	compatible = "dumb-vga-dac";
	#address-cells = <1>;
	#size-cells = <0>;

	ports {
		#address-cells = <1>;
		#size-cells = <0>;

		port@0 {
			reg = <0>;

			vga_bridge_in: endpoint {
				remote-endpoint = <&tcon0_out_vga>;
			};
		};

		port@1 {
			reg = <1>;

			vga_bridge_out: endpoint {
				remote-endpoint = <&vga_con_in>;
			};
		};
	};
};
```

## Documentation/devicetree/bindings/display/bridge/dw-hdmi-hdcp2.txt
```
Device-Tree bindings for dw hdmi hdcp2

Required properties:
- compatible : Should be "rockchip,rk3399-hdmi-hdcp2".

Example:
	hdmi_hdcp2: hdmi-hdcp2@ff988000 {
		compatible = "rockchip,rk3399-hdmi-hdcp2";
		reg = <0x0 0xff988000 0x0 0x2000>;
		interrupts = <GIC_SPI 22 IRQ_TYPE_LEVEL_HIGH 0>;
		clocks = <&cru ACLK_HDCP22>, <&cru PCLK_HDCP22>,
			 <&cru HCLK_HDCP22>;
		clock-names ="aclk_hdcp2", "pclk_hdcp2", "hdcp2_clk_hdmi";
		status = "disabled";
	};
```

## Documentation/devicetree/bindings/display/bridge/dw_hdmi.txt
```
Synopsys DesignWare HDMI TX Encoder
===================================

This document defines device tree properties for the Synopsys DesignWare HDMI
TX Encoder (DWC HDMI TX). It doesn't constitue a device tree binding
specification by itself but is meant to be referenced by platform-specific
device tree bindings.

When referenced from platform device tree bindings the properties defined in
this document are defined as follows. The platform device tree bindings are
responsible for defining whether each property is required or optional.

- reg: Memory mapped base address and length of the DWC HDMI TX registers.

- reg-io-width: Width of the registers specified by the reg property. The
  value is expressed in bytes and must be equal to 1 or 4 if specified. The
  register width defaults to 1 if the property is not present.

- interrupts: Reference to the DWC HDMI TX interrupt.

- clocks: References to all the clocks specified in the clock-names property
  as specified in Documentation/devicetree/bindings/clock/clock-bindings.txt.

- clock-names: The DWC HDMI TX uses the following clocks.

  - "iahb" is the bus clock for either AHB and APB (mandatory).
  - "isfr" is the internal register configuration clock (mandatory).
  - "cec" is the HDMI CEC controller main clock (optional).

- ports: The connectivity of the DWC HDMI TX with the rest of the system is
  expressed in using ports as specified in the device graph bindings defined
  in Documentation/devicetree/bindings/graph.txt. The numbering of the ports
  is platform-specific.
```

## Documentation/devicetree/bindings/display/bridge/dw_mipi_dsi.txt
```
Synopsys DesignWare MIPI DSI host controller
============================================

This document defines device tree properties for the Synopsys DesignWare MIPI
DSI host controller. It doesn't constitue a device tree binding specification
by itself but is meant to be referenced by platform-specific device tree
bindings.

When referenced from platform device tree bindings the properties defined in
this document are defined as follows. The platform device tree bindings are
responsible for defining whether each optional property is used or not.

- reg: Memory mapped base address and length of the DesignWare MIPI DSI
  host controller registers. (mandatory)

- clocks: References to all the clocks specified in the clock-names property
  as specified in [1]. (mandatory)

- clock-names:
  - "pclk" is the peripheral clock for either AHB and APB. (mandatory)
  - "px_clk" is the pixel clock for the DPI/RGB input. (optional)

- resets: References to all the resets specified in the reset-names property
  as specified in [2]. (optional)

- reset-names: string reset name, must be "apb" if used. (optional)

- panel or bridge node: see [3]. (mandatory)

[1] Documentation/devicetree/bindings/clock/clock-bindings.txt
[2] Documentation/devicetree/bindings/reset/reset.txt
[3] Documentation/devicetree/bindings/display/mipi-dsi-bus.txt
```

## Documentation/devicetree/bindings/display/bridge/fsl,imx8mp-hdmi-tx.yaml
```yaml
# SPDX-License-Identifier: (GPL-2.0-only OR BSD-2-Clause)
%YAML 1.2
---
$id: http://devicetree.org/schemas/display/bridge/fsl,imx8mp-hdmi-tx.yaml#
$schema: http://devicetree.org/meta-schemas/core.yaml#

title: Freescale i.MX8MP DWC HDMI TX Encoder

maintainers:
  - Lucas Stach <l.stach@pengutronix.de>

description:
  The i.MX8MP HDMI transmitter is a Synopsys DesignWare
  HDMI 2.0a TX controller IP.

allOf:
  - $ref: /schemas/display/bridge/synopsys,dw-hdmi.yaml#

properties:
  compatible:
    enum:
      - fsl,imx8mp-hdmi-tx

  reg-io-width:
    const: 1

  clocks:
    maxItems: 4

  clock-names:
    items:
      - const: iahb
      - const: isfr
      - const: cec
      - const: pix

  power-domains:
    maxItems: 1

  ports:
    $ref: /schemas/graph.yaml#/properties/ports

    properties:
      port@0:
        $ref: /schemas/graph.yaml#/properties/port
        description: Parallel RGB input port

      port@1:
        $ref: /schemas/graph.yaml#/properties/port
        description: HDMI output port

    required:
      - port@0
      - port@1

required:
  - compatible
  - reg
  - clocks
  - clock-names
  - interrupts
  - power-domains
  - ports

unevaluatedProperties: false

examples:
  - |
    #include <dt-bindings/clock/imx8mp-clock.h>
    #include <dt-bindings/interrupt-controller/irq.h>
    #include <dt-bindings/power/imx8mp-power.h>

    hdmi@32fd8000 {
        compatible = "fsl,imx8mp-hdmi-tx";
        reg = <0x32fd8000 0x7eff>;
        interrupts = <0 IRQ_TYPE_LEVEL_HIGH>;
        clocks = <&clk IMX8MP_CLK_HDMI_APB>,
                 <&clk IMX8MP_CLK_HDMI_REF_266M>,
                 <&clk IMX8MP_CLK_32K>,
                 <&hdmi_tx_phy>;
        clock-names = "iahb", "isfr", "cec", "pix";
        power-domains = <&hdmi_blk_ctrl IMX8MP_HDMIBLK_PD_HDMI_TX>;
        reg-io-width = <1>;
        ports {
            #address-cells = <1>;
            #size-cells = <0>;
            port@0 {
                reg = <0>;

                endpoint {
                    remote-endpoint = <&pvi_to_hdmi_tx>;
                };
            };

            port@1 {
                reg = <1>;
                endpoint {
                    remote-endpoint = <&hdmi0_con>;
                };
            };
        };
    };
```

## Documentation/devicetree/bindings/display/bridge/fsl,imx8qxp-ldb.yaml
```yaml
# SPDX-License-Identifier: (GPL-2.0-only OR BSD-2-Clause)
%YAML 1.2
---
$id: http://devicetree.org/schemas/display/bridge/fsl,imx8qxp-ldb.yaml#
$schema: http://devicetree.org/meta-schemas/core.yaml#

title: Freescale i.MX8qm/qxp LVDS Display Bridge

maintainers:
  - Liu Ying <victor.liu@nxp.com>

description: |
  The Freescale i.MX8qm/qxp LVDS Display Bridge(LDB) has two channels.

  The i.MX8qm/qxp LDB is controlled by Control and Status Registers(CSR) module.
  The CSR module, as a system controller, contains the LDB's configuration
  registers.

  For i.MX8qxp LDB, each channel supports up to 24bpp parallel input color
  format and can map the input to VESA or JEIDA standards.  The two channels
  cannot be used simultaneously, that is to say, the user should pick one of
  them to use.  Two LDB channels from two LDB instances can work together in
  LDB split mode to support a dual link LVDS display.  The channel indexes
  have to be different.  Channel0 outputs odd pixels and channel1 outputs
  even pixels.

  For i.MX8qm LDB, each channel additionally supports up to 30bpp parallel
  input color format.  The two channels can be used simultaneously, either
  in dual mode or split mode.  In dual mode, the two channels output identical
  data.  In split mode, channel0 outputs odd pixels and channel1 outputs even
  pixels.

  A side note is that i.MX8qm/qxp LDB is officially called pixel mapper in
  the SoC reference manuals.  The pixel mapper uses logic of LDBs embedded in
  i.MX6qdl/sx SoCs, i.e., it is essentially based on them.  To keep the naming
  consistency, this binding calls it LDB.

properties:
  compatible:
    enum:
      - fsl,imx8qm-ldb
      - fsl,imx8qxp-ldb

  "#address-cells":
    const: 1

  "#size-cells":
    const: 0

  clocks:
    items:
      - description: pixel clock
      - description: bypass clock

  clock-names:
    items:
      - const: pixel
      - const: bypass

  power-domains:
    maxItems: 1

  fsl,companion-ldb:
    $ref: /schemas/types.yaml#/definitions/phandle
    description: |
      A phandle which points to companion LDB which is used in LDB split mode.

patternProperties:
  "^channel@[0-1]$":
    type: object
    description: Represents a channel of LDB.

    properties:
      "#address-cells":
        const: 1

      "#size-cells":
        const: 0

      reg:
        description: The channel index.
        enum: [ 0, 1 ]

      phys:
        description: A phandle to the phy module representing the LVDS PHY.
        maxItems: 1

      phy-names:
        const: lvds_phy

      port@0:
        $ref: /schemas/graph.yaml#/properties/port
        description: Input port of the channel.

      port@1:
        $ref: /schemas/graph.yaml#/properties/port
        description: Output port of the channel.

    required:
      - "#address-cells"
      - "#size-cells"
      - reg
      - phys
      - phy-names

    additionalProperties: false

required:
  - compatible
  - "#address-cells"
  - "#size-cells"
  - clocks
  - clock-names
  - power-domains
  - channel@0
  - channel@1

allOf:
  - if:
      properties:
        compatible:
          contains:
            const: fsl,imx8qm-ldb
    then:
      properties:
        fsl,companion-ldb: false

additionalProperties: false

examples:
  - |
    #include <dt-bindings/firmware/imx/rsrc.h>
    ldb {
        #address-cells = <1>;
        #size-cells = <0>;
        compatible = "fsl,imx8qxp-ldb";
        clocks = <&clk IMX_SC_R_LVDS_0 IMX_SC_PM_CLK_MISC2>,
                 <&clk IMX_SC_R_LVDS_0 IMX_SC_PM_CLK_BYPASS>;
        clock-names = "pixel", "bypass";
        power-domains = <&pd IMX_SC_R_LVDS_0>;

        channel@0 {
            #address-cells = <1>;
            #size-cells = <0>;
            reg = <0>;
            phys = <&mipi_lvds_0_phy>;
            phy-names = "lvds_phy";

            port@0 {
                reg = <0>;

                mipi_lvds_0_ldb_ch0_mipi_lvds_0_pxl2dpi: endpoint {
                    remote-endpoint = <&mipi_lvds_0_pxl2dpi_mipi_lvds_0_ldb_ch0>;
                };
            };
        };

        channel@1 {
            #address-cells = <1>;
            #size-cells = <0>;
            reg = <1>;
            phys = <&mipi_lvds_0_phy>;
            phy-names = "lvds_phy";

            port@0 {
                reg = <0>;

                mipi_lvds_0_ldb_ch1_mipi_lvds_0_pxl2dpi: endpoint {
                    remote-endpoint = <&mipi_lvds_0_pxl2dpi_mipi_lvds_0_ldb_ch1>;
                };
            };
        };
    };
```

## Documentation/devicetree/bindings/display/bridge/fsl,imx8qxp-pixel-combiner.yaml
```yaml
# SPDX-License-Identifier: (GPL-2.0-only OR BSD-2-Clause)
%YAML 1.2
---
$id: http://devicetree.org/schemas/display/bridge/fsl,imx8qxp-pixel-combiner.yaml#
$schema: http://devicetree.org/meta-schemas/core.yaml#

title: Freescale i.MX8qm/qxp Pixel Combiner

maintainers:
  - Liu Ying <victor.liu@nxp.com>

description: |
  The Freescale i.MX8qm/qxp Pixel Combiner takes two output streams from a
  single display controller and manipulates the two streams to support a number
  of modes(bypass, pixel combine, YUV444 to YUV422, split_RGB) configured as
  either one screen, two screens, or virtual screens.  The pixel combiner is
  also responsible for generating some of the control signals for the pixel link
  output channel.

properties:
  compatible:
    enum:
      - fsl,imx8qm-pixel-combiner
      - fsl,imx8qxp-pixel-combiner

  "#address-cells":
    const: 1

  "#size-cells":
    const: 0

  reg:
    maxItems: 1

  clocks:
    maxItems: 1

  clock-names:
    const: apb

  power-domains:
    maxItems: 1

patternProperties:
  "^channel@[0-1]$":
    type: object
    description: Represents a display stream of pixel combiner.

    properties:
      "#address-cells":
        const: 1

      "#size-cells":
        const: 0

      reg:
        description: The display stream index.
        enum: [ 0, 1 ]

      port@0:
        $ref: /schemas/graph.yaml#/properties/port
        description: Input endpoint of the display stream.

      port@1:
        $ref: /schemas/graph.yaml#/properties/port
        description: Output endpoint of the display stream.

    required:
      - "#address-cells"
      - "#size-cells"
      - reg
      - port@0
      - port@1

    additionalProperties: false

required:
  - compatible
  - "#address-cells"
  - "#size-cells"
  - reg
  - clocks
  - clock-names
  - power-domains

additionalProperties: false

examples:
  - |
    #include <dt-bindings/clock/imx8-lpcg.h>
    #include <dt-bindings/firmware/imx/rsrc.h>
    pixel-combiner@56020000 {
        compatible = "fsl,imx8qxp-pixel-combiner";
        #address-cells = <1>;
        #size-cells = <0>;
        reg = <0x56020000 0x10000>;
        clocks = <&dc0_pixel_combiner_lpcg IMX_LPCG_CLK_4>;
        clock-names = "apb";
        power-domains = <&pd IMX_SC_R_DC_0>;

        channel@0 {
            #address-cells = <1>;
            #size-cells = <0>;
            reg = <0>;

            port@0 {
                reg = <0>;

                dc0_pixel_combiner_ch0_dc0_dpu_disp0: endpoint {
                    remote-endpoint = <&dc0_dpu_disp0_dc0_pixel_combiner_ch0>;
                };
            };

            port@1 {
                reg = <1>;

                dc0_pixel_combiner_ch0_dc0_pixel_link0: endpoint {
                    remote-endpoint = <&dc0_pixel_link0_dc0_pixel_combiner_ch0>;
                };
            };
        };

        channel@1 {
            #address-cells = <1>;
            #size-cells = <0>;
            reg = <1>;

            port@0 {
                reg = <0>;

                dc0_pixel_combiner_ch1_dc0_dpu_disp1: endpoint {
                    remote-endpoint = <&dc0_dpu_disp1_dc0_pixel_combiner_ch1>;
                };
            };

            port@1 {
                reg = <1>;

                dc0_pixel_combiner_ch1_dc0_pixel_link1: endpoint {
                    remote-endpoint = <&dc0_pixel_link1_dc0_pixel_combiner_ch1>;
                };
            };
        };
    };
```
