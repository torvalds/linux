## Documentation/devicetree/bindings/display/bridge/fsl,imx8qxp-pixel-link.yaml
```yaml
# SPDX-License-Identifier: (GPL-2.0-only OR BSD-2-Clause)
%YAML 1.2
---
$id: http://devicetree.org/schemas/display/bridge/fsl,imx8qxp-pixel-link.yaml#
$schema: http://devicetree.org/meta-schemas/core.yaml#

title: Freescale i.MX8qm/qxp Display Pixel Link

maintainers:
  - Liu Ying <victor.liu@nxp.com>

description: |
  The Freescale i.MX8qm/qxp Display Pixel Link(DPL) forms a standard
  asynchronous linkage between pixel sources(display controller or
  camera module) and pixel consumers(imaging or displays).
  It consists of two distinct functions, a pixel transfer function and a
  control interface.  Multiple pixel channels can exist per one control channel.
  This binding documentation is only for pixel links whose pixel sources are
  display controllers.

  The i.MX8qm/qxp Display Pixel Link is accessed via System Controller Unit(SCU)
  firmware.

properties:
  compatible:
    enum:
      - fsl,imx8qm-dc-pixel-link
      - fsl,imx8qxp-dc-pixel-link

  fsl,dc-id:
    $ref: /schemas/types.yaml#/definitions/uint8
    description: |
      u8 value representing the display controller index that the pixel link
      connects to.

  fsl,dc-stream-id:
    $ref: /schemas/types.yaml#/definitions/uint8
    description: |
      u8 value representing the display controller stream index that the pixel
      link connects to.
    enum: [0, 1]

  ports:
    $ref: /schemas/graph.yaml#/properties/ports

    properties:
      port@0:
        $ref: /schemas/graph.yaml#/properties/port
        description: The pixel link input port node from upstream video source.

    patternProperties:
      "^port@[1-4]$":
        $ref: /schemas/graph.yaml#/properties/port
        description: The pixel link output port node to downstream bridge.

    required:
      - port@0
      - port@1
      - port@2
      - port@3
      - port@4

allOf:
  - if:
      properties:
        compatible:
          contains:
            const: fsl,imx8qxp-dc-pixel-link
    then:
      properties:
        fsl,dc-id:
          const: 0

  - if:
      properties:
        compatible:
          contains:
            const: fsl,imx8qm-dc-pixel-link
    then:
      properties:
        fsl,dc-id:
          enum: [0, 1]

required:
  - compatible
  - fsl,dc-id
  - fsl,dc-stream-id
  - ports

additionalProperties: false

examples:
  - |
    dc0-pixel-link0 {
        compatible = "fsl,imx8qxp-dc-pixel-link";
        fsl,dc-id = /bits/ 8 <0>;
        fsl,dc-stream-id = /bits/ 8 <0>;

        ports {
            #address-cells = <1>;
            #size-cells = <0>;

            /* from dc0 pixel combiner channel0 */
            port@0 {
                reg = <0>;

                dc0_pixel_link0_dc0_pixel_combiner_ch0: endpoint {
                    remote-endpoint = <&dc0_pixel_combiner_ch0_dc0_pixel_link0>;
                };
            };

            /* to PXL2DPIs in MIPI/LVDS combo subsystems */
            port@1 {
                #address-cells = <1>;
                #size-cells = <0>;
                reg = <1>;

                dc0_pixel_link0_mipi_lvds_0_pxl2dpi: endpoint@0 {
                    reg = <0>;
                    remote-endpoint = <&mipi_lvds_0_pxl2dpi_dc0_pixel_link0>;
                };

                dc0_pixel_link0_mipi_lvds_1_pxl2dpi: endpoint@1 {
                    reg = <1>;
                    remote-endpoint = <&mipi_lvds_1_pxl2dpi_dc0_pixel_link0>;
                };
            };

            /* unused */
            port@2 {
                reg = <2>;
            };

            /* unused */
            port@3 {
                reg = <3>;
            };

            /* to imaging subsystem */
            port@4 {
                reg = <4>;
            };
        };
    };
```

## Documentation/devicetree/bindings/display/bridge/fsl,imx8qxp-pxl2dpi.yaml
```yaml
# SPDX-License-Identifier: (GPL-2.0-only OR BSD-2-Clause)
%YAML 1.2
---
$id: http://devicetree.org/schemas/display/bridge/fsl,imx8qxp-pxl2dpi.yaml#
$schema: http://devicetree.org/meta-schemas/core.yaml#

title: Freescale i.MX8qxp Pixel Link to Display Pixel Interface

maintainers:
  - Liu Ying <victor.liu@nxp.com>

description: |
  The Freescale i.MX8qxp Pixel Link to Display Pixel Interface(PXL2DPI)
  interfaces the pixel link 36-bit data output and the DSI controller’s
  MIPI-DPI 24-bit data input, and inputs of LVDS Display Bridge(LDB) module
  used in LVDS mode, to remap the pixel color codings between those modules.
  This module is purely combinatorial.

  The i.MX8qxp PXL2DPI is controlled by Control and Status Registers(CSR) module.
  The CSR module, as a system controller, contains the PXL2DPI's configuration
  register.

properties:
  compatible:
    const: fsl,imx8qxp-pxl2dpi

  fsl,sc-resource:
    $ref: /schemas/types.yaml#/definitions/uint32
    description: The SCU resource ID associated with this PXL2DPI instance.

  power-domains:
    maxItems: 1

  fsl,companion-pxl2dpi:
    $ref: /schemas/types.yaml#/definitions/phandle
    description: |
      A phandle which points to companion PXL2DPI which is used by downstream
      LVDS Display Bridge(LDB) in split mode.

  ports:
    $ref: /schemas/graph.yaml#/properties/ports

    properties:
      port@0:
        $ref: /schemas/graph.yaml#/properties/port
        description: The PXL2DPI input port node from pixel link.

      port@1:
        $ref: /schemas/graph.yaml#/properties/port
        description: The PXL2DPI output port node to downstream bridge.

    required:
      - port@0
      - port@1

required:
  - compatible
  - fsl,sc-resource
  - power-domains
  - ports

additionalProperties: false

examples:
  - |
    #include <dt-bindings/firmware/imx/rsrc.h>
    pxl2dpi {
        compatible = "fsl,imx8qxp-pxl2dpi";
        fsl,sc-resource = <IMX_SC_R_MIPI_0>;
        power-domains = <&pd IMX_SC_R_MIPI_0>;

        ports {
            #address-cells = <1>;
            #size-cells = <0>;

            port@0 {
                #address-cells = <1>;
                #size-cells = <0>;
                reg = <0>;

                mipi_lvds_0_pxl2dpi_dc_pixel_link0: endpoint@0 {
                    reg = <0>;
                    remote-endpoint = <&dc_pixel_link0_mipi_lvds_0_pxl2dpi>;
                };

                mipi_lvds_0_pxl2dpi_dc_pixel_link1: endpoint@1 {
                     reg = <1>;
                     remote-endpoint = <&dc_pixel_link1_mipi_lvds_0_pxl2dpi>;
                };
            };

            port@1 {
                #address-cells = <1>;
                #size-cells = <0>;
                reg = <1>;

                mipi_lvds_0_pxl2dpi_mipi_lvds_0_ldb_ch0: endpoint@0 {
                    reg = <0>;
                    remote-endpoint = <&mipi_lvds_0_ldb_ch0_mipi_lvds_0_pxl2dpi>;
                };

                mipi_lvds_0_pxl2dpi_mipi_lvds_0_ldb_ch1: endpoint@1 {
                    reg = <1>;
                    remote-endpoint = <&mipi_lvds_0_ldb_ch1_mipi_lvds_0_pxl2dpi>;
                };
            };
        };
    };
```

## Documentation/devicetree/bindings/display/bridge/fsl,imx93-mipi-dsi.yaml
```yaml
# SPDX-License-Identifier: (GPL-2.0-only OR BSD-2-Clause)
%YAML 1.2
---
$id: http://devicetree.org/schemas/display/bridge/fsl,imx93-mipi-dsi.yaml#
$schema: http://devicetree.org/meta-schemas/core.yaml#

title: Freescale i.MX93 specific extensions to Synopsys Designware MIPI DSI

maintainers:
  - Liu Ying <victor.liu@nxp.com>

description: |
  There is a Synopsys Designware MIPI DSI Host Controller and a Synopsys
  Designware MIPI DPHY embedded in Freescale i.MX93 SoC.  Some configurations
  and extensions to them are controlled by i.MX93 media blk-ctrl.

allOf:
  - $ref: snps,dw-mipi-dsi.yaml#

properties:
  compatible:
    const: fsl,imx93-mipi-dsi

  clocks:
    items:
      - description: apb clock
      - description: pixel clock
      - description: PHY configuration clock
      - description: PHY reference clock

  clock-names:
    items:
      - const: pclk
      - const: pix
      - const: phy_cfg
      - const: phy_ref

  interrupts:
    maxItems: 1

  fsl,media-blk-ctrl:
    $ref: /schemas/types.yaml#/definitions/phandle
    description:
      i.MX93 media blk-ctrl, as a syscon, controls pixel component bit map
      configurations from LCDIF display controller to the MIPI DSI host
      controller and MIPI DPHY PLL related configurations through PLL SoC
      interface.

  power-domains:
    maxItems: 1

required:
  - compatible
  - interrupts
  - fsl,media-blk-ctrl
  - power-domains

unevaluatedProperties: false

examples:
  - |
    #include <dt-bindings/clock/imx93-clock.h>
    #include <dt-bindings/gpio/gpio.h>
    #include <dt-bindings/interrupt-controller/arm-gic.h>
    #include <dt-bindings/power/fsl,imx93-power.h>

    dsi@4ae10000 {
        compatible = "fsl,imx93-mipi-dsi";
        reg = <0x4ae10000 0x10000>;
        interrupts = <GIC_SPI 177 IRQ_TYPE_LEVEL_HIGH>;
        clocks = <&clk IMX93_CLK_MIPI_DSI_GATE>,
                 <&clk IMX93_CLK_MEDIA_DISP_PIX>,
                 <&clk IMX93_CLK_MIPI_PHY_CFG>,
                 <&clk IMX93_CLK_24M>;
        clock-names = "pclk", "pix", "phy_cfg", "phy_ref";
        fsl,media-blk-ctrl = <&media_blk_ctrl>;
        power-domains = <&media_blk_ctrl IMX93_MEDIABLK_PD_MIPI_DSI>;
        #address-cells = <1>;
        #size-cells = <0>;

        panel@0 {
            compatible = "raydium,rm67191";
            reg = <0>;
            reset-gpios = <&adp5585gpio 6 GPIO_ACTIVE_LOW>;
            dsi-lanes = <4>;
            video-mode = <2>;

            port {
                panel_in: endpoint {
                    remote-endpoint = <&dsi_out>;
                };
            };
        };

        ports {
            #address-cells = <1>;
            #size-cells = <0>;

            port@0 {
                reg = <0>;

                dsi_to_lcdif: endpoint {
                    remote-endpoint = <&lcdif_to_dsi>;
                };
            };

            port@1 {
                reg = <1>;

                dsi_out: endpoint {
                    remote-endpoint = <&panel_in>;
                };
            };
        };
    };
```

## Documentation/devicetree/bindings/display/bridge/fsl,ldb.yaml
```yaml
# SPDX-License-Identifier: (GPL-2.0-only OR BSD-2-Clause)
%YAML 1.2
---
$id: http://devicetree.org/schemas/display/bridge/fsl,ldb.yaml#
$schema: http://devicetree.org/meta-schemas/core.yaml#

title: Freescale i.MX8MP DPI to LVDS bridge chip

maintainers:
  - Marek Vasut <marex@denx.de>

description: |
  The i.MX8MP mediamix contains two registers which are responsible
  for configuring the on-SoC DPI-to-LVDS serializer. This describes
  those registers as bridge within the DT.

properties:
  compatible:
    const: fsl,imx8mp-ldb

  clocks:
    maxItems: 1

  clock-names:
    const: ldb

  reg:
    minItems: 2
    maxItems: 2

  reg-names:
    items:
      - const: ldb
      - const: lvds

  ports:
    $ref: /schemas/graph.yaml#/properties/ports

    properties:
      port@0:
        $ref: /schemas/graph.yaml#/properties/port
        description: Video port for DPI input.

      port@1:
        $ref: /schemas/graph.yaml#/properties/port
        description: Video port for LVDS Channel-A output (panel or bridge).

      port@2:
        $ref: /schemas/graph.yaml#/properties/port
        description: Video port for LVDS Channel-B output (panel or bridge).

    required:
      - port@0
      - port@1

required:
  - compatible
  - clocks
  - ports

additionalProperties: false

examples:
  - |
    #include <dt-bindings/clock/imx8mp-clock.h>

    blk-ctrl {
        #address-cells = <1>;
        #size-cells = <1>;

        bridge@5c {
            compatible = "fsl,imx8mp-ldb";
            clocks = <&clk IMX8MP_CLK_MEDIA_LDB>;
            clock-names = "ldb";
            reg = <0x5c 0x4>, <0x128 0x4>;
            reg-names = "ldb", "lvds";

            ports {
                #address-cells = <1>;
                #size-cells = <0>;

                port@0 {
                    reg = <0>;

                    ldb_from_lcdif2: endpoint {
                        remote-endpoint = <&lcdif2_to_ldb>;
                    };
                };

                port@1 {
                    reg = <1>;

                    ldb_lvds_ch0: endpoint {
                        remote-endpoint = <&ldb_to_lvdsx4panel>;
                    };
                };

                port@2 {
                    reg = <2>;

                    ldb_lvds_ch1: endpoint {
                    };
                };
            };
        };
    };
```

## Documentation/devicetree/bindings/display/bridge/google,cros-ec-anx7688.yaml
```yaml
# SPDX-License-Identifier: (GPL-2.0-only OR BSD-2-Clause)
%YAML 1.2
---
$id: http://devicetree.org/schemas/display/bridge/google,cros-ec-anx7688.yaml#
$schema: http://devicetree.org/meta-schemas/core.yaml#

title: ChromeOS EC ANX7688 HDMI to DP Converter through Type-C Port

maintainers:
  - Nicolas Boichat <drinkcat@chromium.org>

description: |
  ChromeOS EC ANX7688 is a display bridge that converts HDMI 2.0 to
  DisplayPort 1.3 Ultra-HDi (4096x2160p60). It is an Analogix ANX7688 chip
  which is connected to and operated by the ChromeOS Embedded Controller
  (See google,cros-ec.yaml). It is accessed using I2C tunneling through
  the EC and therefore its node should be a child of an EC I2C tunnel node
  (See google,cros-ec-i2c-tunnel.yaml).

properties:
  compatible:
    const: google,cros-ec-anx7688

  reg:
    maxItems: 1
    description: I2C address of the device.

  ports:
    $ref: /schemas/graph.yaml#/properties/ports

    properties:
      port@0:
        $ref: /schemas/graph.yaml#/properties/port
        description: Video port for HDMI input.

      port@1:
        $ref: /schemas/graph.yaml#/properties/port
        description: USB Type-c connector.

    required:
      - port@0
      - port@1

required:
  - compatible
  - reg
  - ports

additionalProperties: false

examples:
  - |
    i2c_tunnel_b: i2c-tunnel1 {
        compatible = "google,cros-ec-i2c-tunnel";
        google,remote-bus = <1>;
        #address-cells = <1>;
        #size-cells = <0>;

        anx7688: anx7688@2c {
            compatible = "google,cros-ec-anx7688";
            reg = <0x2c>;

            ports {
                #address-cells = <1>;
                #size-cells = <0>;
                port@0 {
                    reg = <0>;
                    anx7688_in: endpoint {
                        remote-endpoint = <&hdmi0_out>;
                    };
                };
                port@1 {
                    reg = <1>;
                    anx7688_out: endpoint {
                        remote-endpoint = <&typec_connector>;
                    };
                };
            };
        };
    };
```
