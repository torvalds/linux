## Documentation/devicetree/bindings/display/bridge/samsung,mipi-dsim.yaml
```yaml
# SPDX-License-Identifier: (GPL-2.0-only OR BSD-2-Clause)
%YAML 1.2
---
$id: http://devicetree.org/schemas/display/bridge/samsung,mipi-dsim.yaml#
$schema: http://devicetree.org/meta-schemas/core.yaml#

title: Samsung MIPI DSIM bridge controller

maintainers:
  - Inki Dae <inki.dae@samsung.com>
  - Jagan Teki <jagan@amarulasolutions.com>
  - Marek Szyprowski <m.szyprowski@samsung.com>

description: |
  Samsung MIPI DSIM bridge controller can be found it on Exynos
  and i.MX8M Mini/Nano/Plus SoC's.

properties:
  compatible:
    oneOf:
      - enum:
          - samsung,exynos3250-mipi-dsi
          - samsung,exynos4210-mipi-dsi
          - samsung,exynos5410-mipi-dsi
          - samsung,exynos5422-mipi-dsi
          - samsung,exynos5433-mipi-dsi
          - samsung,exynos7870-mipi-dsi
          - fsl,imx8mm-mipi-dsim
          - fsl,imx8mp-mipi-dsim
      - items:
          - enum:
              - fsl,imx7d-mipi-dsim
              - fsl,imx8mn-mipi-dsim
          - const: fsl,imx8mm-mipi-dsim

  reg:
    maxItems: 1

  interrupts:
    maxItems: 1

  '#address-cells':
    const: 1

  '#size-cells':
    const: 0

  clocks:
    minItems: 2
    maxItems: 5

  clock-names:
    minItems: 2
    maxItems: 5

  samsung,phy-type:
    $ref: /schemas/types.yaml#/definitions/uint32
    description: phandle to the samsung phy-type

  power-domains:
    maxItems: 1

  samsung,power-domain:
    $ref: /schemas/types.yaml#/definitions/phandle
    description: phandle to the associated samsung power domain

  vddcore-supply:
    description: MIPI DSIM Core voltage supply (e.g. 1.1V)

  vddio-supply:
    description: MIPI DSIM I/O and PLL voltage supply (e.g. 1.8V)

  samsung,burst-clock-frequency:
    $ref: /schemas/types.yaml#/definitions/uint32
    description:
      DSIM high speed burst mode frequency.  If absent,
      the pixel clock from the attached device or bridge
      will be used instead.

  samsung,esc-clock-frequency:
    $ref: /schemas/types.yaml#/definitions/uint32
    description:
      DSIM escape mode frequency.

  samsung,pll-clock-frequency:
    $ref: /schemas/types.yaml#/definitions/uint32
    description:
      DSIM oscillator clock frequency. If absent, the clock frequency
      of sclk_mipi will be used instead.

  phys:
    maxItems: 1

  phy-names:
    const: dsim

  ports:
    $ref: /schemas/graph.yaml#/properties/ports

    properties:
      port@0:
        $ref: /schemas/graph.yaml#/properties/port
        description:
          Input port node to receive pixel data from the
          display controller. Exactly one endpoint must be
          specified.

      port@1:
        $ref: /schemas/graph.yaml#/$defs/port-base
        unevaluatedProperties: false
        description:
          DSI output port node to the panel or the next bridge
          in the chain.

        properties:
          endpoint:
            $ref: /schemas/media/video-interfaces.yaml#
            unevaluatedProperties: false

            properties:
              data-lanes:
                minItems: 1
                maxItems: 4
                uniqueItems: true
                items:
                  enum: [ 1, 2, 3, 4 ]

              lane-polarities:
                minItems: 1
                maxItems: 5
                description:
                  The Samsung MIPI DSI IP requires that all the data lanes have
                  the same polarity.

            dependencies:
              lane-polarities: [data-lanes]

required:
  - clock-names
  - clocks
  - compatible
  - interrupts
  - reg
  - samsung,esc-clock-frequency

allOf:
  - $ref: ../dsi-controller.yaml#
  - if:
      properties:
        compatible:
          contains:
            const: samsung,exynos7870-mipi-dsi

    then:
      properties:
        clocks:
          minItems: 4
          maxItems: 4

        clock-names:
          items:
            - const: bus
            - const: pll
            - const: byte
            - const: esc

        ports:
          required:
            - port@0

      required:
        - ports

  - if:
      properties:
        compatible:
          contains:
            const: samsung,exynos5433-mipi-dsi

    then:
      properties:
        clocks:
          minItems: 5

        clock-names:
          items:
            - const: bus_clk
            - const: phyclk_mipidphy0_bitclkdiv8
            - const: phyclk_mipidphy0_rxclkesc0
            - const: sclk_rgb_vclk_to_dsim0
            - const: sclk_mipi

        ports:
          required:
            - port@0

      required:
        - ports
        - vddcore-supply
        - vddio-supply

  - if:
      properties:
        compatible:
          contains:
            const: samsung,exynos5410-mipi-dsi

    then:
      properties:
        clocks:
          minItems: 2

        clock-names:
          items:
            - const: bus_clk
            - const: pll_clk

      required:
        - vddcore-supply
        - vddio-supply

  - if:
      properties:
        compatible:
          contains:
            const: samsung,exynos4210-mipi-dsi

    then:
      properties:
        clocks:
          minItems: 2

        clock-names:
          items:
            - const: bus_clk
            - const: sclk_mipi

      required:
        - vddcore-supply
        - vddio-supply

  - if:
      properties:
        compatible:
          contains:
            const: samsung,exynos3250-mipi-dsi

    then:
      properties:
        clocks:
          minItems: 2

        clock-names:
          items:
            - const: bus_clk
            - const: pll_clk

      required:
        - vddcore-supply
        - vddio-supply
        - samsung,phy-type

additionalProperties:
  type: object

examples:
  - |
    #include <dt-bindings/clock/exynos5433.h>
    #include <dt-bindings/gpio/gpio.h>
    #include <dt-bindings/interrupt-controller/arm-gic.h>

    dsi@13900000 {
        compatible = "samsung,exynos5433-mipi-dsi";
        reg = <0x13900000 0xC0>;
        interrupts = <GIC_SPI 205 IRQ_TYPE_LEVEL_HIGH>;
        phys = <&mipi_phy 1>;
        phy-names = "dsim";
        clocks = <&cmu_disp CLK_PCLK_DSIM0>,
                 <&cmu_disp CLK_PHYCLK_MIPIDPHY0_BITCLKDIV8>,
                 <&cmu_disp CLK_PHYCLK_MIPIDPHY0_RXCLKESC0>,
                 <&cmu_disp CLK_SCLK_RGB_VCLK_TO_DSIM0>,
                 <&cmu_disp CLK_SCLK_DSIM0>;
        clock-names = "bus_clk",
                      "phyclk_mipidphy0_bitclkdiv8",
                      "phyclk_mipidphy0_rxclkesc0",
                      "sclk_rgb_vclk_to_dsim0",
                      "sclk_mipi";
        power-domains = <&pd_disp>;
        vddcore-supply = <&ldo6_reg>;
        vddio-supply = <&ldo7_reg>;
        samsung,burst-clock-frequency = <512000000>;
        samsung,esc-clock-frequency = <16000000>;
        samsung,pll-clock-frequency = <24000000>;
        pinctrl-names = "default";
        pinctrl-0 = <&te_irq>;

        ports {
            #address-cells = <1>;
            #size-cells = <0>;

            port@0 {
                reg = <0>;

                dsi_to_mic: endpoint {
                    remote-endpoint = <&mic_to_dsi>;
                };
            };
        };
    };
```

## Documentation/devicetree/bindings/display/bridge/sii902x.txt
```
sii902x HDMI bridge bindings

Required properties:
	- compatible: "sil,sii9022"
	- reg: i2c address of the bridge

Optional properties:
	- interrupts: describe the interrupt line used to inform the host
	  about hotplug events.
	- reset-gpios: OF device-tree gpio specification for RST_N pin.
	- iovcc-supply: I/O Supply Voltage (1.8V or 3.3V)
	- cvcc12-supply: Digital Core Supply Voltage (1.2V)

	HDMI audio properties:
	- #sound-dai-cells: <0> or <1>. <0> if only i2s or spdif pin
	   is wired, <1> if the both are wired. HDMI audio is
	   configured only if this property is found.
	- sil,i2s-data-lanes: Array of up to 4 integers with values of 0-3
	   Each integer indicates which i2s pin is connected to which
	   audio fifo. The first integer selects i2s audio pin for the
	   first audio fifo#0 (HDMI channels 1&2), second for fifo#1
	   (HDMI channels 3&4), and so on. There is 4 fifos and 4 i2s
	   pins (SD0 - SD3). Any i2s pin can be connected to any fifo,
	   but there can be no gaps. E.g. an i2s pin must be mapped to
	   fifo#0 and fifo#1 before mapping a channel to fifo#2. Default
	   value is <0>, describing SD0 pin beiging routed to hdmi audio
	   fifo #0.
	- clocks: phandle and clock specifier for each clock listed in
           the clock-names property
	- clock-names: "mclk"
	   Describes SII902x MCLK input. MCLK can be used to produce
	   HDMI audio CTS values. This property follows
	   Documentation/devicetree/bindings/clock/clock-bindings.txt
	   consumer binding.

	If HDMI audio is configured the sii902x device becomes an I2S
	and/or spdif audio codec component (e.g a digital audio sink),
	that can be used in configuring a full audio devices with
	simple-card or audio-graph-card binding. See their binding
	documents on how to describe the way the sii902x device is
	connected to the rest of the audio system:
	Documentation/devicetree/bindings/sound/simple-card.yaml
	Documentation/devicetree/bindings/sound/audio-graph-card.yaml
	Note: In case of the audio-graph-card binding the used port
	index should be 3.

Optional subnodes:
	- video input: this subnode can contain a video input port node
	  to connect the bridge to a display controller output (See this
	  documentation [1]).

[1]: Documentation/devicetree/bindings/media/video-interfaces.txt

Example:
	hdmi-bridge@39 {
		compatible = "sil,sii9022";
		reg = <0x39>;
		reset-gpios = <&pioA 1 0>;
		iovcc-supply = <&v3v3_hdmi>;
		cvcc12-supply = <&v1v2_hdmi>;

		#sound-dai-cells = <0>;
		sil,i2s-data-lanes = < 0 1 2 >;
		clocks = <&mclk>;
		clock-names = "mclk";

		ports {
			#address-cells = <1>;
			#size-cells = <0>;

			port@0 {
				reg = <0>;
				bridge_in: endpoint {
					remote-endpoint = <&dc_out>;
				};
			};
		};
	};
```

## Documentation/devicetree/bindings/display/bridge/sii9234.txt
```
Silicon Image SiI9234 HDMI/MHL bridge bindings

Required properties:
	- compatible : "sil,sii9234".
	- reg : I2C address for TPI interface, use 0x39
	- avcc33-supply : MHL/USB Switch Supply Voltage (3.3V)
	- iovcc18-supply : I/O Supply Voltage (1.8V)
	- avcc12-supply : TMDS Analog Supply Voltage (1.2V)
	- cvcc12-supply : Digital Core Supply Voltage (1.2V)
	- interrupts: interrupt specifier of INT pin
	- reset-gpios: gpio specifier of RESET pin (active low)
	- video interfaces: Device node can contain two video interface port
			    nodes for HDMI encoder and connector according to [1].
			    - port@0 - MHL to HDMI
			    - port@1 - MHL to connector

[1]: Documentation/devicetree/bindings/media/video-interfaces.txt


Example:
	sii9234@39 {
		compatible = "sil,sii9234";
		reg = <0x39>;
		avcc33-supply = <&vcc33mhl>;
		iovcc18-supply = <&vcc18mhl>;
		avcc12-supply = <&vsil12>;
		cvcc12-supply = <&vsil12>;
		reset-gpios = <&gpf3 4 GPIO_ACTIVE_LOW>;
		interrupt-parent = <&gpf3>;
		interrupts = <5 IRQ_TYPE_LEVEL_HIGH>;

		ports {
			#address-cells = <1>;
			#size-cells = <0>;

			port@0 {
				reg = <0>;
				mhl_to_hdmi: endpoint {
					remote-endpoint = <&hdmi_to_mhl>;
				};
			};
			port@1 {
				reg = <1>;
				mhl_to_connector: endpoint {
					remote-endpoint = <&connector_to_mhl>;
				};
			};
		};
	};
```

## Documentation/devicetree/bindings/display/bridge/sil,sii8620.yaml
```yaml
# SPDX-License-Identifier: GPL-2.0-only OR BSD-2-Clause
%YAML 1.2
---
$id: http://devicetree.org/schemas/display/bridge/sil,sii8620.yaml#
$schema: http://devicetree.org/meta-schemas/core.yaml#

title: Silicon Image SiI8620 HDMI/MHL bridge

maintainers:
  - Krzysztof Kozlowski <krzysztof.kozlowski@linaro.org>

properties:
  compatible:
    const: sil,sii8620

  reg:
    maxItems: 1

  clocks:
    maxItems: 1

  clock-names:
    items:
      - const: xtal

  cvcc10-supply:
    description: Digital Core Supply Voltage (1.0V)

  interrupts:
    maxItems: 1

  iovcc18-supply:
    description: I/O Supply Voltage (1.8V)

  reset-gpios:
    maxItems: 1

  ports:
    $ref: /schemas/graph.yaml#/properties/ports
    unevaluatedProperties: false

    properties:
      port@0:
        $ref: /schemas/graph.yaml#/properties/port
        description:
          Video port for HDMI (encoder) input

      port@1:
        $ref: /schemas/graph.yaml#/properties/port
        description:
          MHL to connector port

    required:
      - port@0
      - port@1

required:
  - compatible
  - reg
  - clocks
  - cvcc10-supply
  - interrupts
  - iovcc18-supply
  - reset-gpios
  - ports

additionalProperties: false

examples:
  - |
    #include <dt-bindings/gpio/gpio.h>
    #include <dt-bindings/interrupt-controller/irq.h>

    i2c {
        #address-cells = <1>;
        #size-cells = <0>;

        bridge@39 {
            reg = <0x39>;
            compatible = "sil,sii8620";
            cvcc10-supply = <&ldo36_reg>;
            iovcc18-supply = <&ldo34_reg>;
            interrupt-parent = <&gpf0>;
            interrupts = <2 IRQ_TYPE_LEVEL_HIGH>;
            reset-gpios = <&gpv7 0 GPIO_ACTIVE_LOW>;
            clocks = <&pmu_system_controller 0>;
            clock-names = "xtal";

            ports {
                #address-cells = <1>;
                #size-cells = <0>;

                port@0 {
                    reg = <0>;
                    mhl_to_hdmi: endpoint {
                        remote-endpoint = <&hdmi_to_mhl>;
                    };
                };

                port@1 {
                    reg = <1>;
                    mhl_to_musb_con: endpoint {
                        remote-endpoint = <&musb_con_to_mhl>;
                    };
                };
            };
        };
    };
```
