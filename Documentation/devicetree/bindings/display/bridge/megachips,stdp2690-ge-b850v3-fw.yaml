## Documentation/devicetree/bindings/display/bridge/sil,sii9022.yaml
```yaml
# SPDX-License-Identifier: (GPL-2.0-only OR BSD-2-Clause)
%YAML 1.2
---
$id: http://devicetree.org/schemas/display/bridge/sil,sii9022.yaml#
$schema: http://devicetree.org/meta-schemas/core.yaml#

title: Silicon Image sii902x HDMI bridge

maintainers:
  - Boris Brezillon <bbrezillon@kernel.org>

properties:
  compatible:
    oneOf:
      - items:
          - enum:
              - sil,sii9022-cpi # CEC Programming Interface
              - sil,sii9022-tpi # Transmitter Programming Interface
          - const: sil,sii9022
      - const: sil,sii9022

  reg:
    maxItems: 1

  interrupts:
    maxItems: 1
    description: Interrupt line used to inform the host about hotplug events.

  reset-gpios:
    maxItems: 1

  iovcc-supply:
    description: I/O Supply Voltage (1.8V or 3.3V)

  cvcc12-supply:
    description: Digital Core Supply Voltage (1.2V)

  '#sound-dai-cells':
    enum: [ 0, 1 ]
    description: |
      <0> if only I2S or S/PDIF pin is wired,
      <1> if both are wired.
      HDMI audio is configured only if this property is found.
      If HDMI audio is configured, the sii902x device becomes an I2S and/or
      S/PDIF audio codec component (e.g. a digital audio sink), that can be
      used in configuring full audio devices with simple-card or
      audio-graph-card bindings. See their binding documents on how to describe
      the way the
      sii902x device is connected to the rest of the audio system:
      Documentation/devicetree/bindings/sound/simple-card.yaml
      Documentation/devicetree/bindings/sound/audio-graph-card.yaml
      Note: In case of the audio-graph-card binding the used port index should
      be 3.

  sil,i2s-data-lanes:
    $ref: /schemas/types.yaml#/definitions/uint32-array
    minItems: 1
    maxItems: 4
    uniqueItems: true
    items:
      enum: [ 0, 1, 2, 3 ]
    description:
      Each integer indicates which I2S pin is connected to which audio FIFO.
      The first integer selects the I2S audio pin for the first audio FIFO#0
      (HDMI channels 1&2), the second for FIFO#1 (HDMI channels 3&4), and so
      on. There are 4 FIFOs and 4 I2S pins (SD0 - SD3). Any I2S pin can be
      connected to any FIFO, but there can be no gaps. E.g. an I2S pin must be
      mapped to FIFO#0 and FIFO#1 before mapping a channel to FIFO#2. The
      default value is <0>, describing SD0 pin being routed to HDMI audio
      FIFO#0.

  clocks:
    maxItems: 1
    description: MCLK input. MCLK can be used to produce HDMI audio CTS values.

  clock-names:
    const: mclk

  ports:
    $ref: /schemas/graph.yaml#/properties/ports

    properties:
      port@0:
        unevaluatedProperties: false
        $ref: /schemas/graph.yaml#/$defs/port-base
        description: Parallel RGB input port

        properties:
          endpoint:
            $ref: /schemas/graph.yaml#/$defs/endpoint-base
            unevaluatedProperties: false

            properties:
              bus-width:
                description:
                  Endpoint bus width.
                enum: [ 16, 18, 24 ]
                default: 24

      port@1:
        $ref: /schemas/graph.yaml#/properties/port
        description: HDMI output port

      port@3:
        $ref: /schemas/graph.yaml#/properties/port
        description: Sound input port

required:
  - compatible
  - reg

additionalProperties: false

examples:
  - |
    i2c {
        #address-cells = <1>;
        #size-cells = <0>;

        hdmi-bridge@39 {
            compatible = "sil,sii9022";
            reg = <0x39>;
            reset-gpios = <&pioA 1 0>;
            iovcc-supply = <&v3v3_hdmi>;
            cvcc12-supply = <&v1v2_hdmi>;

            #sound-dai-cells = <0>;
            sil,i2s-data-lanes = < 0 1 2 >;
            clocks = <&mclk>;
            clock-names = "mclk";

            ports {
                #address-cells = <1>;
                #size-cells = <0>;

                port@0 {
                    reg = <0>;
                    bridge_in: endpoint {
                        remote-endpoint = <&dc_out>;
                    };
                };
            };
        };
    };
```

## Documentation/devicetree/bindings/display/bridge/sil,sii9234.yaml
```yaml
# SPDX-License-Identifier: (GPL-2.0-only OR BSD-2-Clause)
%YAML 1.2
---
$id: http://devicetree.org/schemas/display/bridge/sil,sii9234.yaml#
$schema: http://devicetree.org/meta-schemas/core.yaml#

title: Silicon Image SiI9234 HDMI/MHL bridge

maintainers:
  - Maciej Purski <m.purski@samsung.com>

properties:
  compatible:
    const: sil,sii9234

  reg:
    description: I2C address for TPI interface
    maxItems: 1

  avcc12-supply:
    description: TMDS Analog Supply Voltage, 1.2V

  avcc33-supply:
    description: MHL/USB Switch Supply Voltage, 3.3V

  cvcc12-supply:
    description: Digital Core Supply Voltage, 1.2V

  iovcc18-supply:
    description: I/O voltage supply, 1.8V

  interrupts:
    maxItems: 1

  reset-gpios:
    description: GPIO connected to the reset pin.
    maxItems: 1

  ports:
    $ref: /schemas/graph.yaml#/properties/ports

    properties:
      port@0:
        $ref: /schemas/graph.yaml#/properties/port
        description:
          Video port for HDMI (encoder) input

      port@1:
        $ref: /schemas/graph.yaml#/properties/port
        description:
          MHL to connector port

    required:
      - port@0

required:
  - compatible
  - reg
  - avcc12-supply
  - avcc33-supply
  - cvcc12-supply
  - iovcc18-supply
  - interrupts
  - reset-gpios
  - ports

additionalProperties: false

examples:
  - |
    #include <dt-bindings/gpio/gpio.h>
    #include <dt-bindings/interrupt-controller/irq.h>

    i2c1 {
      #address-cells = <1>;
      #size-cells = <0>;

      bridge@39 {
        compatible = "sil,sii9234";
        reg = <0x39>;
        avcc12-supply = <&vsil12>;
        avcc33-supply = <&vcc33mhl>;
        cvcc12-supply = <&vsil12>;
        iovcc18-supply = <&vcc18mhl>;
        interrupt-parent = <&gpf3>;
        interrupts = <5 IRQ_TYPE_LEVEL_HIGH>;
        reset-gpios = <&gpf3 4 GPIO_ACTIVE_LOW>;

        ports {
          #address-cells = <1>;
          #size-cells = <0>;

          port@0 {
            reg = <0>;
            mhl_to_hdmi: endpoint {
              remote-endpoint = <&hdmi_to_mhl>;
            };
          };

          port@1 {
            reg = <1>;
            mhl_to_connector: endpoint {
              remote-endpoint = <&connector_to_mhl>;
            };
          };
        };
      };
    };

...
```

## Documentation/devicetree/bindings/display/bridge/sil-sii8620.txt
```
Silicon Image SiI8620 HDMI/MHL bridge bindings

Required properties:
	- compatible: "sil,sii8620"
	- reg: i2c address of the bridge
	- cvcc10-supply: Digital Core Supply Voltage (1.0V)
	- iovcc18-supply: I/O Supply Voltage (1.8V)
	- interrupts, interrupt-parent: interrupt specifier of INT pin
	- reset-gpios: gpio specifier of RESET pin
	- clocks, clock-names: specification and name of "xtal" clock
	- video interfaces: Device node can contain video interface port
			    node for HDMI encoder according to [1].

[1]: Documentation/devicetree/bindings/media/video-interfaces.txt

Example:
	sii8620@39 {
		reg = <0x39>;
		compatible = "sil,sii8620";
		cvcc10-supply = <&ldo36_reg>;
		iovcc18-supply = <&ldo34_reg>;
		interrupt-parent = <&gpf0>;
		interrupts = <2 0>;
		reset-gpio = <&gpv7 0 0>;
		clocks = <&pmu_system_controller 0>;
		clock-names = "xtal";

		port {
			mhl_to_hdmi: endpoint {
				remote-endpoint = <&hdmi_to_mhl>;
			};
		};
	};
```

## Documentation/devicetree/bindings/display/bridge/simple-bridge.yaml
```yaml
# SPDX-License-Identifier: (GPL-2.0-only OR BSD-2-Clause)
%YAML 1.2
---
$id: http://devicetree.org/schemas/display/bridge/simple-bridge.yaml#
$schema: http://devicetree.org/meta-schemas/core.yaml#

title: Transparent non-programmable DRM bridges

maintainers:
  - Laurent Pinchart <laurent.pinchart+renesas@ideasonboard.com>
  - Maxime Ripard <mripard@kernel.org>

description: |
  This binding supports transparent non-programmable bridges that don't require
  any configuration, with a single input and a single output.

properties:
  compatible:
    oneOf:
      - items:
          - enum:
              - ti,ths8134a
              - ti,ths8134b
          - const: ti,ths8134
      - items:
          - const: corpro,gm7123
          - const: adi,adv7123
      - enum:
          - adi,adv7123
          - dumb-vga-dac
          - radxa,ra620
          - realtek,rtd2171
          - ti,opa362
          - ti,ths8134
          - ti,ths8135

  ports:
    $ref: /schemas/graph.yaml#/properties/ports

    properties:
      port@0:
        $ref: /schemas/graph.yaml#/properties/port
        description: The bridge input

      port@1:
        $ref: /schemas/graph.yaml#/properties/port
        description: The bridge output

    required:
      - port@0
      - port@1

  enable-gpios:
    maxItems: 1
    description: GPIO controlling bridge enable

  vdd-supply:
    description: Power supply for the bridge

required:
  - compatible
  - ports

additionalProperties: false

examples:
  - |
    bridge {
        compatible = "ti,ths8134a", "ti,ths8134";

        ports {
            #address-cells = <1>;
            #size-cells = <0>;

            port@0 {
                reg = <0>;

                vga_bridge_in: endpoint {
                    remote-endpoint = <&tcon0_out_vga>;
                };
            };

            port@1 {
                reg = <1>;

                vga_bridge_out: endpoint {
                    remote-endpoint = <&vga_con_in>;
                };
            };
        };
    };

...
```

## Documentation/devicetree/bindings/display/bridge/snps,dw-mipi-dsi.yaml
```yaml
# SPDX-License-Identifier: (GPL-2.0-only OR BSD-2-Clause)
%YAML 1.2
---
$id: http://devicetree.org/schemas/display/bridge/snps,dw-mipi-dsi.yaml#
$schema: http://devicetree.org/meta-schemas/core.yaml#

title: Synopsys DesignWare MIPI DSI host controller

maintainers:
  - Philippe CORNU <philippe.cornu@foss.st.com>

description: |
  This document defines device tree properties for the Synopsys DesignWare MIPI
  DSI host controller. It doesn't constitue a device tree binding specification
  by itself but is meant to be referenced by platform-specific device tree
  bindings.

  When referenced from platform device tree bindings the properties defined in
  this document are defined as follows. The platform device tree bindings are
  responsible for defining whether each property is required or optional.

allOf:
  - $ref: ../dsi-controller.yaml#

properties:
  reg:
    maxItems: 1

  clocks:
    items:
      - description: Module clock
      - description: DSI bus clock for either AHB and APB
      - description: Pixel clock for the DPI/RGB input
    minItems: 2

  clock-names:
    items:
      - const: ref
      - const: pclk
      - const: px_clk
    minItems: 2

  resets:
    maxItems: 1

  reset-names:
    const: apb

  ports:
    $ref: /schemas/graph.yaml#/properties/ports

    properties:
      port@0:
        $ref: /schemas/graph.yaml#/properties/port
        description: Input node to receive pixel data.

      port@1:
        $ref: /schemas/graph.yaml#/properties/port
        description: DSI output node to panel.

    required:
      - port@0
      - port@1

required:
  - clock-names
  - clocks
  - ports
  - reg

additionalProperties: true
```
