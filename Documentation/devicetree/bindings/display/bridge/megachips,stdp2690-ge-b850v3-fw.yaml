## Documentation/devicetree/bindings/display/bridge/megachips,stdp2690-ge-b850v3-fw.yaml
```yaml
# SPDX-License-Identifier: (GPL-2.0-only OR BSD-2-Clause)
%YAML 1.2
---
$id: http://devicetree.org/schemas/display/bridge/megachips,stdp2690-ge-b850v3-fw.yaml#
$schema: http://devicetree.org/meta-schemas/core.yaml#

title: GE B850v3 video bridge

maintainers:
  - Frank Li <Frank.Li@nxp.com>

description: |
   STDP4028-ge-b850v3-fw bridges (LVDS-DP)
   STDP2690-ge-b850v3-fw bridges (DP-DP++)

   The video processing pipeline on the second output on the GE B850v3:

   Host -> LVDS|--(STDP4028)--|DP -> DP|--(STDP2690)--|DP++ -> Video output

   Each bridge has a dedicated flash containing firmware for supporting the custom
   design. The result is that, in this design, neither the STDP4028 nor the
   STDP2690 behave as the stock bridges would. The compatible strings include the
   suffix "-ge-b850v3-fw" to make it clear that the driver is for the bridges with
   the firmware specific for the GE B850v3.

   The hardware do not provide control over the video processing pipeline, as the
   two bridges behaves as a single one. The only interfaces exposed by the
   hardware are EDID, HPD, and interrupts.

properties:
  compatible:
    enum:
      - megachips,stdp4028-ge-b850v3-fw
      - megachips,stdp2690-ge-b850v3-fw

  reg:
    maxItems: 1

  interrupts:
    maxItems: 1

  ports:
    $ref: /schemas/graph.yaml#/properties/ports
    properties:
      port@0:
        description: sink port
        $ref: /schemas/graph.yaml#/properties/port

      port@1:
        description: source port
        $ref: /schemas/graph.yaml#/properties/port

    required:
      - port@0
      - port@1

required:
  - compatible
  - reg
  - ports

allOf:
  - if:
      properties:
        compatible:
          contains:
            const: megachips,stdp4028-ge-b850v3-fw
    then:
      required:
        - interrupts

additionalProperties: false

examples:
  - |
    #include <dt-bindings/interrupt-controller/irq.h>

    i2c {
        #address-cells = <1>;
        #size-cells = <0>;

        bridge@73 {
            compatible = "megachips,stdp4028-ge-b850v3-fw";
            reg = <0x73>;
            interrupt-parent = <&gpio2>;
            interrupts = <0 IRQ_TYPE_LEVEL_HIGH>;

            ports {
                #address-cells = <1>;
                #size-cells = <0>;

                port@0 {
                    reg = <0>;

                    endpoint {
                        remote-endpoint = <&lvds0_out>;
                    };

                };

                port@1 {
                    reg = <1>;

                    endpoint {
                        remote-endpoint = <&stdp2690_in>;
                    };
               };
            };
        };
    };
```

## Documentation/devicetree/bindings/display/bridge/megachips-stdpxxxx-ge-b850v3-fw.txt
```
Drivers for the second video output of the GE B850v3:
   STDP4028-ge-b850v3-fw bridges (LVDS-DP)
   STDP2690-ge-b850v3-fw bridges (DP-DP++)

The video processing pipeline on the second output on the GE B850v3:

   Host -> LVDS|--(STDP4028)--|DP -> DP|--(STDP2690)--|DP++ -> Video output

Each bridge has a dedicated flash containing firmware for supporting the custom
design. The result is that, in this design, neither the STDP4028 nor the
STDP2690 behave as the stock bridges would. The compatible strings include the
suffix "-ge-b850v3-fw" to make it clear that the driver is for the bridges with
the firmware specific for the GE B850v3.

The hardware do not provide control over the video processing pipeline, as the
two bridges behaves as a single one. The only interfaces exposed by the
hardware are EDID, HPD, and interrupts.

stdp4028-ge-b850v3-fw required properties:
  - compatible : "megachips,stdp4028-ge-b850v3-fw"
  - reg : I2C bus address
  - interrupts : one interrupt should be described here, as in
    <0 IRQ_TYPE_LEVEL_HIGH>
  - ports : One input port(reg = <0>) and one output port(reg = <1>)

stdp2690-ge-b850v3-fw required properties:
    compatible : "megachips,stdp2690-ge-b850v3-fw"
  - reg : I2C bus address
  - ports : One input port(reg = <0>) and one output port(reg = <1>)

Example:

&mux2_i2c2 {
	clock-frequency = <100000>;

	stdp4028@73 {
		compatible = "megachips,stdp4028-ge-b850v3-fw";
		#address-cells = <1>;
		#size-cells = <0>;

		reg = <0x73>;

		interrupt-parent = <&gpio2>;
		interrupts = <0 IRQ_TYPE_LEVEL_HIGH>;

		ports {
			#address-cells = <1>;
			#size-cells = <0>;

			port@0 {
				reg = <0>;
				stdp4028_in: endpoint {
					remote-endpoint = <&lvds0_out>;
				};
			};
			port@1 {
				reg = <1>;
				stdp4028_out: endpoint {
					remote-endpoint = <&stdp2690_in>;
				};
			};
		};
	};

	stdp2690@72 {
		compatible = "megachips,stdp2690-ge-b850v3-fw";
		#address-cells = <1>;
		#size-cells = <0>;

		reg = <0x72>;

		ports {
			#address-cells = <1>;
			#size-cells = <0>;

			port@0 {
				reg = <0>;
				stdp2690_in: endpoint {
					remote-endpoint = <&stdp4028_out>;
				};
			};

			port@1 {
				reg = <1>;
				stdp2690_out: endpoint {
					/* Connector for external display */
				};
			};
		};
	};
};
```

## Documentation/devicetree/bindings/display/bridge/microchip,sam9x75-lvds.yaml
```yaml
# SPDX-License-Identifier: (GPL-2.0-only OR BSD-2-Clause)
%YAML 1.2
---
$id: http://devicetree.org/schemas/display/bridge/microchip,sam9x75-lvds.yaml#
$schema: http://devicetree.org/meta-schemas/core.yaml#

title: Microchip SAM9X75 LVDS Controller

maintainers:
  - Dharma Balasubiramani <dharma.b@microchip.com>

description:
  The Low Voltage Differential Signaling Controller (LVDSC) manages data
  format conversion from the LCD Controller internal DPI bus to OpenLDI
  LVDS output signals. LVDSC functions include bit mapping, balanced mode
  management, and serializer.

properties:
  compatible:
    const: microchip,sam9x75-lvds

  reg:
    maxItems: 1

  interrupts:
    maxItems: 1

  clocks:
    items:
      - description: Peripheral Bus Clock

  clock-names:
    items:
      - const: pclk

required:
  - compatible
  - reg
  - interrupts
  - clocks
  - clock-names

additionalProperties: false

examples:
  - |
    #include <dt-bindings/interrupt-controller/irq.h>
    #include <dt-bindings/clock/at91.h>
    lvds-controller@f8060000 {
      compatible = "microchip,sam9x75-lvds";
      reg = <0xf8060000 0x100>;
      interrupts = <56 IRQ_TYPE_LEVEL_HIGH 0>;
      clocks = <&pmc PMC_TYPE_PERIPHERAL 56>;
      clock-names = "pclk";
    };
```

## Documentation/devicetree/bindings/display/bridge/nwl-dsi.yaml
```yaml
# SPDX-License-Identifier: (GPL-2.0-only OR BSD-2-Clause)
%YAML 1.2
---
$id: http://devicetree.org/schemas/display/bridge/nwl-dsi.yaml#
$schema: http://devicetree.org/meta-schemas/core.yaml#

title: Northwest Logic MIPI-DSI controller on i.MX SoCs

maintainers:
  - Guido Gúnther <agx@sigxcpu.org>
  - Robert Chiras <robert.chiras@nxp.com>

description: |
  NWL MIPI-DSI host controller found on i.MX8 platforms. This is a dsi bridge for
  the SOCs NWL MIPI-DSI host controller.

allOf:
  - $ref: ../dsi-controller.yaml#

properties:
  compatible:
    const: fsl,imx8mq-nwl-dsi

  reg:
    maxItems: 1

  interrupts:
    maxItems: 1

  '#address-cells':
    const: 1

  '#size-cells':
    const: 0

  assigned-clock-parents: true
  assigned-clock-rates: true
  assigned-clocks: true

  clocks:
    items:
      - description: DSI core clock
      - description: RX_ESC clock (used in escape mode)
      - description: TX_ESC clock (used in escape mode)
      - description: PHY_REF clock
      - description: LCDIF clock

  clock-names:
    items:
      - const: core
      - const: rx_esc
      - const: tx_esc
      - const: phy_ref
      - const: lcdif

  mux-controls:
    description:
      mux controller node to use for operating the input mux

  phys:
    maxItems: 1
    description:
      A phandle to the phy module representing the DPHY

  phy-names:
    items:
      - const: dphy

  power-domains:
    maxItems: 1

  resets:
    items:
      - description: dsi byte reset line
      - description: dsi dpi reset line
      - description: dsi esc reset line
      - description: dsi pclk reset line

  reset-names:
    items:
      - const: byte
      - const: dpi
      - const: esc
      - const: pclk

  ports:
    type: object
    description:
      A node containing DSI input & output port nodes with endpoint
      definitions as documented in
      Documentation/devicetree/bindings/graph.txt.
    properties:
      port@0:
        type: object
        description:
          Input port node to receive pixel data from the
          display controller. Exactly one endpoint must be
          specified.
        properties:
          '#address-cells':
            const: 1

          '#size-cells':
            const: 0

          endpoint@0:
            description: sub-node describing the input from LCDIF
            type: object

          endpoint@1:
            description: sub-node describing the input from DCSS
            type: object

          reg:
            const: 0

        required:
          - '#address-cells'
          - '#size-cells'
          - reg

        oneOf:
          - required:
              - endpoint@0
          - required:
              - endpoint@1

        additionalProperties: false

      port@1:
        type: object
        description:
          DSI output port node to the panel or the next bridge
          in the chain

      '#address-cells':
        const: 1

      '#size-cells':
        const: 0

    required:
      - '#address-cells'
      - '#size-cells'
      - port@0
      - port@1

    additionalProperties: false

required:
  - '#address-cells'
  - '#size-cells'
  - clock-names
  - clocks
  - compatible
  - interrupts
  - mux-controls
  - phy-names
  - phys
  - ports
  - reg
  - reset-names
  - resets

unevaluatedProperties: false

examples:
  - |
    #include <dt-bindings/clock/imx8mq-clock.h>
    #include <dt-bindings/gpio/gpio.h>
    #include <dt-bindings/interrupt-controller/arm-gic.h>
    #include <dt-bindings/reset/imx8mq-reset.h>

    dsi@30a00000 {
              #address-cells = <1>;
              #size-cells = <0>;
              compatible = "fsl,imx8mq-nwl-dsi";
              reg = <0x30A00000 0x300>;
              clocks = <&clk IMX8MQ_CLK_DSI_CORE>,
                       <&clk IMX8MQ_CLK_DSI_AHB>,
                       <&clk IMX8MQ_CLK_DSI_IPG_DIV>,
                       <&clk IMX8MQ_CLK_DSI_PHY_REF>,
                       <&clk IMX8MQ_CLK_LCDIF_PIXEL>;
              clock-names = "core", "rx_esc", "tx_esc", "phy_ref", "lcdif";
              interrupts = <GIC_SPI 34 IRQ_TYPE_LEVEL_HIGH>;
              mux-controls = <&mux 0>;
              power-domains = <&pgc_mipi>;
              resets = <&src IMX8MQ_RESET_MIPI_DSI_RESET_BYTE_N>,
                       <&src IMX8MQ_RESET_MIPI_DSI_DPI_RESET_N>,
                       <&src IMX8MQ_RESET_MIPI_DSI_ESC_RESET_N>,
                       <&src IMX8MQ_RESET_MIPI_DSI_PCLK_RESET_N>;
              reset-names = "byte", "dpi", "esc", "pclk";
              phys = <&dphy>;
              phy-names = "dphy";

              panel@0 {
                      compatible = "rocktech,jh057n00900";
                      reg = <0>;
                      vcc-supply = <&reg_2v8_p>;
                      iovcc-supply = <&reg_1v8_p>;
                      reset-gpios = <&gpio3 13 GPIO_ACTIVE_LOW>;
                      port {
                           panel_in: endpoint {
                                     remote-endpoint = <&mipi_dsi_out>;
                           };
                      };
              };

              ports {
                    #address-cells = <1>;
                    #size-cells = <0>;

                    port@0 {
                           #size-cells = <0>;
                           #address-cells = <1>;
                           reg = <0>;
                           mipi_dsi_in: endpoint@0 {
                                        reg = <0>;
                                        remote-endpoint = <&lcdif_mipi_dsi>;
                           };
                    };
                    port@1 {
                           reg = <1>;
                           mipi_dsi_out: endpoint {
                                         remote-endpoint = <&panel_in>;
                           };
                    };
              };
    };
```

## Documentation/devicetree/bindings/display/bridge/nxp,ptn3460.yaml
```yaml
# SPDX-License-Identifier: (GPL-2.0-only OR BSD-2-Clause)
%YAML 1.2
---
$id: http://devicetree.org/schemas/display/bridge/nxp,ptn3460.yaml#
$schema: http://devicetree.org/meta-schemas/core.yaml#

title: NXP PTN3460 eDP to LVDS bridge

maintainers:
  - Sean Paul <seanpaul@chromium.org>

properties:
  compatible:
    const: nxp,ptn3460

  reg:
    description: I2C address of the bridge
    maxItems: 1

  edid-emulation:
    $ref: /schemas/types.yaml#/definitions/uint32
    description:
      The EDID emulation entry to use
      Value  Resolution  Description
        0     1024x768   NXP Generic
        1     1920x1080  NXP Generic
        2     1920x1080  NXP Generic
        3     1600x900   Samsung LTM200KT
        4     1920x1080  Samsung LTM230HT
        5     1366x768   NXP Generic
        6     1600x900   ChiMei M215HGE
    enum: [0, 1, 2, 3, 4, 5, 6]

  powerdown-gpios:
    description: GPIO connected to the PD_N signal.
    maxItems: 1

  reset-gpios:
    description: GPIO connected to the RST_N signal.
    maxItems: 1

  ports:
    $ref: /schemas/graph.yaml#/properties/ports

    properties:
      port@0:
        $ref: /schemas/graph.yaml#/properties/port
        description:
          Video port for LVDS output

      port@1:
        $ref: /schemas/graph.yaml#/properties/port
        description:
          Video port for eDP input

    required:
      - port@0
      - port@1

required:
  - compatible
  - reg
  - edid-emulation
  - powerdown-gpios
  - reset-gpios
  - ports

additionalProperties: false

examples:
  - |
    #include <dt-bindings/gpio/gpio.h>

    i2c {
      #address-cells = <1>;
      #size-cells = <0>;

      bridge@20 {
        compatible = "nxp,ptn3460";
        reg = <0x20>;
        edid-emulation = <5>;
        powerdown-gpios = <&gpy2 5 GPIO_ACTIVE_HIGH>;
        reset-gpios = <&gpx1 5 GPIO_ACTIVE_LOW>;

        ports {
          #address-cells = <1>;
          #size-cells = <0>;

          port@0 {
            reg = <0>;
            bridge_out: endpoint {
              remote-endpoint = <&panel_in>;
            };
          };

          port@1 {
            reg = <1>;
            bridge_in: endpoint {
              remote-endpoint = <&dp_out>;
            };
          };
        };
      };
    };

...
```
