## Documentation/devicetree/bindings/display/panel/ilitek,ili9163.yaml
```yaml
# SPDX-License-Identifier: (GPL-2.0-only OR BSD-2-Clause)
%YAML 1.2
---
$id: http://devicetree.org/schemas/display/panel/ilitek,ili9163.yaml#
$schema: http://devicetree.org/meta-schemas/core.yaml#

title: Ilitek ILI9163 display panels

maintainers:
  - Daniel Mack <daniel@zonque.org>

description:
  This binding is for display panels using an Ilitek ILI9163 controller in SPI
  mode.

allOf:
  - $ref: panel-common.yaml#
  - $ref: /schemas/spi/spi-peripheral-props.yaml#

properties:
  compatible:
    items:
      - enum:
          - newhaven,1.8-128160EF
      - const: ilitek,ili9163

  reg:
    maxItems: 1

  spi-max-frequency:
    maximum: 32000000

  dc-gpios:
    maxItems: 1
    description: Display data/command selection (D/CX)

  backlight: true
  reset-gpios: true
  rotation: true

required:
  - compatible
  - reg
  - dc-gpios
  - reset-gpios

unevaluatedProperties: false

examples:
  - |
    #include <dt-bindings/gpio/gpio.h>

    spi {
            #address-cells = <1>;
            #size-cells = <0>;

            display@0 {
                    compatible = "newhaven,1.8-128160EF", "ilitek,ili9163";
                    reg = <0>;
                    spi-max-frequency = <32000000>;
                    dc-gpios = <&gpio0 24 GPIO_ACTIVE_HIGH>;
                    reset-gpios = <&gpio0 25 GPIO_ACTIVE_HIGH>;
                    rotation = <180>;
                    backlight = <&backlight>;
            };
    };

...
```

## Documentation/devicetree/bindings/display/panel/ilitek,ili9322.txt
```
Ilitek ILI9322 TFT panel driver with SPI control bus

This is a driver for 320x240 TFT panels, accepting a variety of input
streams that get adapted and scaled to the panel. The panel output has
960 TFT source driver pins and 240 TFT gate driver pins, VCOM, VCOML and
VCOMH outputs.

Required properties:
  - compatible: "dlink,dir-685-panel", "ilitek,ili9322"
    (full system-specific compatible is always required to look up configuration)
  - reg: address of the panel on the SPI bus

Optional properties:
  - vcc-supply: core voltage supply, see regulator/regulator.txt
  - iovcc-supply: voltage supply for the interface input/output signals,
    see regulator/regulator.txt
  - vci-supply: voltage supply for analog parts, see regulator/regulator.txt
  - reset-gpios: a GPIO spec for the reset pin, see gpio/gpio.txt

  The following optional properties only apply to RGB and YUV input modes and
  can be omitted for BT.656 input modes:

  - pixelclk-active: see display/panel/display-timing.txt
  - de-active: see display/panel/display-timing.txt
  - hsync-active: see display/panel/display-timing.txt
  - vsync-active: see display/panel/display-timing.txt

The panel must obey the rules for a SPI slave device as specified in
spi/spi-bus.txt

The device node can contain one 'port' child node with one child
'endpoint' node, according to the bindings defined in
media/video-interfaces.txt. This node should describe panel's video bus.

Example:

panel: display@0 {
	compatible = "dlink,dir-685-panel", "ilitek,ili9322";
	reg = <0>;
	vcc-supply = <&vdisp>;
	iovcc-supply = <&vdisp>;
	vci-supply = <&vdisp>;

	port {
		panel_in: endpoint {
			remote-endpoint = <&display_out>;
		};
	};
};
```

## Documentation/devicetree/bindings/display/panel/ilitek,ili9322.yaml
```yaml
# SPDX-License-Identifier: GPL-2.0
%YAML 1.2
---
$id: http://devicetree.org/schemas/display/panel/ilitek,ili9322.yaml#
$schema: http://devicetree.org/meta-schemas/core.yaml#

title: Ilitek ILI9322 TFT panel driver with SPI control bus

maintainers:
  - Linus Walleij <linus.walleij@linaro.org>

description: |
  This is a driver for 320x240 TFT panels, accepting a variety of input
  streams that get adapted and scaled to the panel. The panel output has
  960 TFT source driver pins and 240 TFT gate driver pins, VCOM, VCOML and
  VCOMH outputs.

allOf:
  - $ref: panel-common.yaml#
  - $ref: /schemas/spi/spi-peripheral-props.yaml#

properties:
  compatible:
    items:
      - enum:
          - dlink,dir-685-panel
      - const: ilitek,ili9322

  reg:
    maxItems: 1

  reset-gpios: true
  port: true

  vcc-supply:
    description: Core voltage supply

  iovcc-supply:
    description: Voltage supply for the interface input/output signals

  vci-supply:
    description: Voltage supply for analog parts

required:
  - compatible
  - reg

unevaluatedProperties: false

examples:
  - |
    spi {
        #address-cells = <1>;
        #size-cells = <0>;

        panel: display@0 {
            compatible = "dlink,dir-685-panel", "ilitek,ili9322";
            reg = <0>;
            vcc-supply = <&vdisp>;
            iovcc-supply = <&vdisp>;
            vci-supply = <&vdisp>;

            port {
                panel_in: endpoint {
                    remote-endpoint = <&display_out>;
                };
            };
        };
    };

...
```

## Documentation/devicetree/bindings/display/panel/ilitek,ili9341.yaml
```yaml
# SPDX-License-Identifier: (GPL-2.0-only OR BSD-2-Clause)
%YAML 1.2
---
$id: http://devicetree.org/schemas/display/panel/ilitek,ili9341.yaml#
$schema: http://devicetree.org/meta-schemas/core.yaml#

title: Ilitek-9341 Display Panel

maintainers:
  - Dillon Min <dillon.minfei@gmail.com>

description: |
  Ilitek ILI9341 TFT panel driver with SPI control bus
  This is a driver for 320x240 TFT panels, accepting a rgb input
  streams with 16 bits or 18 bits.

allOf:
  - $ref: panel-common.yaml#

properties:
  compatible:
    items:
      - enum:
          - adafruit,yx240qv29
          # ili9341 240*320 Color on stm32f429-disco board
          - st,sf-tc240t-9370-t
          - canaan,kd233-tft
      - const: ilitek,ili9341

  reg: true

  dc-gpios:
    maxItems: 1
    description: Display data/command selection (D/CX) of this DBI panel

  spi-3wire: true

  spi-max-frequency:
    const: 10000000

  port: true

  vci-supply:
    description: Analog voltage supply (2.5 .. 3.3V)

  vddi-supply:
    description: Voltage supply for interface logic (1.65 .. 3.3 V)

  vddi-led-supply:
    description: Voltage supply for the LED driver (1.65 .. 3.3 V)

unevaluatedProperties: false

required:
  - compatible
  - reg
  - dc-gpios

if:
  properties:
    compatible:
      contains:
        enum:
          - st,sf-tc240t-9370-t
then:
  required:
    - port

examples:
  - |+
    #include <dt-bindings/gpio/gpio.h>
    spi {
        #address-cells = <1>;
        #size-cells = <0>;
        panel: display@0 {
            compatible = "st,sf-tc240t-9370-t",
                         "ilitek,ili9341";
            reg = <0>;
            spi-3wire;
            spi-max-frequency = <10000000>;
            dc-gpios = <&gpiod 13 0>;
            port {
                panel_in: endpoint {
                    remote-endpoint = <&display_out>;
                };
            };
        };
        display@1{
            compatible = "adafruit,yx240qv29", "ilitek,ili9341";
            reg = <1>;
            spi-max-frequency = <10000000>;
            dc-gpios = <&gpio0 9 GPIO_ACTIVE_HIGH>;
            reset-gpios = <&gpio0 8 GPIO_ACTIVE_HIGH>;
            rotation = <270>;
            backlight = <&backlight>;
        };
    };
...
```

## Documentation/devicetree/bindings/display/panel/ilitek,ili9488.yaml
```yaml
# SPDX-License-Identifier: (GPL-2.0-only OR BSD-2-Clause)
%YAML 1.2
---
$id: http://devicetree.org/schemas/display/panel/ilitek,ili9488.yaml#
$schema: http://devicetree.org/meta-schemas/core.yaml#

title: Ilitek ILI9488 based MIPI-DSI panels

maintainers:
  - Igor Reznichenko <igor@reznichenko.net>

allOf:
  - $ref: panel-common.yaml#

properties:
  compatible:
    items:
      - enum:
          - focuslcds,e35gh-i-mw800cb
      - const: ilitek,ili9488

  reg:
    maxItems: 1

  vci-supply: true
  iovcc-supply: true

required:
  - compatible
  - reg
  - vci-supply
  - iovcc-supply
  - reset-gpios
  - backlight
  - port

unevaluatedProperties: false

examples:
  - |
    #include <dt-bindings/gpio/gpio.h>

    dsi {
        #address-cells = <1>;
        #size-cells = <0>;

        panel@0 {
            compatible = "focuslcds,e35gh-i-mw800cb", "ilitek,ili9488";
            reg = <0>;
            vci-supply = <&reg_vci_panel>;
            iovcc-supply = <&reg_iovcc_panel>;
            reset-gpios = <&gpio3 6 GPIO_ACTIVE_LOW>;
            backlight = <&pwm_bl>;

            port {
                panel_in: endpoint {
                    remote-endpoint = <&dsi_out>;
                };
            };
        };
    };

...
```

## Documentation/devicetree/bindings/display/panel/ilitek,ili9805.yaml
```yaml
# SPDX-License-Identifier: (GPL-2.0-only OR BSD-2-Clause)
%YAML 1.2
---
$id: http://devicetree.org/schemas/display/panel/ilitek,ili9805.yaml#
$schema: http://devicetree.org/meta-schemas/core.yaml#

title: Ilitek ILI9805 based MIPI-DSI panels

maintainers:
  - Michael Trimarchi <michael@amarulasolutions.com>

allOf:
  - $ref: panel-common.yaml#

properties:
  compatible:
    items:
      - enum:
          - giantplus,gpm1790a0
          - tianma,tm041xdhg01
      - const: ilitek,ili9805

  avdd-supply: true
  dvdd-supply: true
  reg: true

required:
  - compatible
  - avdd-supply
  - dvdd-supply
  - reg
  - reset-gpios
  - port
  - backlight

unevaluatedProperties: false

examples:
  - |
    #include <dt-bindings/gpio/gpio.h>

    dsi {
        #address-cells = <1>;
        #size-cells = <0>;

        panel@0 {
            compatible = "giantplus,gpm1790a0", "ilitek,ili9805";
            reg = <0>;
            avdd-supply = <&avdd_display>;
            dvdd-supply = <&dvdd_display>;
            reset-gpios = <&r_pio 0 5 GPIO_ACTIVE_LOW>; /* PL05 */
            backlight = <&backlight>;

            port {
                panel_in: endpoint {
                    remote-endpoint = <&mipi_dsi_out>;
                };
            };
        };
    };

...
```

## Documentation/devicetree/bindings/display/panel/ilitek,ili9806e.yaml
```yaml
# SPDX-License-Identifier: (GPL-2.0-only OR BSD-2-Clause)
%YAML 1.2
---
$id: http://devicetree.org/schemas/display/panel/ilitek,ili9806e.yaml#
$schema: http://devicetree.org/meta-schemas/core.yaml#

title: Ilitek ILI9806E based MIPI-DSI panels

maintainers:
  - Michael Walle <mwalle@kernel.org>

allOf:
  - $ref: panel-common.yaml#

properties:
  compatible:
    items:
      - enum:
          - ortustech,com35h3p70ulc
      - const: ilitek,ili9806e

  reg:
    maxItems: 1

  vdd-supply: true
  vccio-supply: true

required:
  - compatible
  - reg
  - vdd-supply
  - vccio-supply
  - reset-gpios
  - backlight
  - port

unevaluatedProperties: false

examples:
  - |
    #include <dt-bindings/gpio/gpio.h>

    dsi {
        #address-cells = <1>;
        #size-cells = <0>;

        panel@0 {
            compatible = "ortustech,com35h3p70ulc", "ilitek,ili9806e";
            reg = <0>;
            vdd-supply = <&reg_vdd_panel>;
            vccio-supply = <&reg_vccio_panel>;
            reset-gpios = <&gpio3 6 GPIO_ACTIVE_LOW>;
            backlight = <&backlight>;

            port {
                panel_in: endpoint {
                    remote-endpoint = <&dsi_out>;
                };
            };
        };
    };

...
```

## Documentation/devicetree/bindings/display/panel/ilitek,ili9881c.txt
```
Ilitek ILI9881c based MIPI-DSI panels

Required properties:
  - compatible: must be "ilitek,ili9881c" and one of:
    * "bananapi,lhr050h41"
  - reg: DSI virtual channel used by that screen
  - power-supply: phandle to the power regulator
  - reset-gpios: a GPIO phandle for the reset pin

Optional properties:
  - backlight: phandle to the backlight used

Example:
panel@0 {
	compatible = "bananapi,lhr050h41", "ilitek,ili9881c";
	reg = <0>;
	power-supply = <&reg_display>;
	reset-gpios = <&r_pio 0 5 GPIO_ACTIVE_LOW>; /* PL05 */
	backlight = <&pwm_bl>;
};
```

## Documentation/devicetree/bindings/display/panel/ilitek,ili9881c.yaml
```yaml
# SPDX-License-Identifier: GPL-2.0
%YAML 1.2
---
$id: http://devicetree.org/schemas/display/panel/ilitek,ili9881c.yaml#
$schema: http://devicetree.org/meta-schemas/core.yaml#

title: Ilitek ILI9881c based MIPI-DSI panels

maintainers:
  - Maxime Ripard <mripard@kernel.org>

properties:
  compatible:
    items:
      - enum:
          - bananapi,lhr050h41
          - feixin,k101-im2byl02
      - const: ilitek,ili9881c

  backlight: true
  power-supply: true
  reg: true
  reset-gpios: true

required:
  - compatible
  - power-supply
  - reg
  - reset-gpios

additionalProperties: false

examples:
  - |
    #include <dt-bindings/gpio/gpio.h>

    dsi {
        #address-cells = <1>;
        #size-cells = <0>;

        panel@0 {
            compatible = "bananapi,lhr050h41", "ilitek,ili9881c";
            reg = <0>;
            power-supply = <&reg_display>;
            reset-gpios = <&r_pio 0 5 GPIO_ACTIVE_LOW>; /* PL05 */
            backlight = <&pwm_bl>;
        };
    };

...
```

## Documentation/devicetree/bindings/display/panel/innolux,at043tn24.txt
```
Inyeslux AT043TN24 4.3" WQVGA TFT LCD panel

Required properties:
- compatible: should be "inyeslux,at043tn24"

This binding is compatible with the simple-panel binding, which is specified
in simple-panel.txt in this directory.
```

## Documentation/devicetree/bindings/display/panel/innolux,at070tn92.txt
```
Innolux AT070TN92 7.0" WQVGA TFT LCD panel

Required properties:
- compatible: should be "innolux,at070tn92"

This binding is compatible with the simple-panel binding, which is specified
in simple-panel.txt in this directory.
```

## Documentation/devicetree/bindings/display/panel/innolux,ee101ia-01d.txt
```
Innolux Corporation 10.1" EE101IA-01D WXGA (1280x800) LVDS panel

Required properties:
- compatible: should be "innolux,ee101ia-01d"

This binding is compatible with the lvds-panel binding, which is specified
in panel-lvds.txt in this directory.
```

## Documentation/devicetree/bindings/display/panel/innolux,ee101ia-01d.yaml
```yaml
# SPDX-License-Identifier: GPL-2.0
%YAML 1.2
---
$id: http://devicetree.org/schemas/display/panel/innolux,ee101ia-01d.yaml#
$schema: http://devicetree.org/meta-schemas/core.yaml#

title: Innolux Corporation 10.1" EE101IA-01D WXGA (1280x800) LVDS panel

maintainers:
  - Heiko Stuebner <heiko.stuebner@bq.com>
  - Thierry Reding <thierry.reding@gmail.com>

allOf:
  - $ref: panel-common.yaml#
  - $ref: /schemas/display/lvds.yaml#

select:
  properties:
    compatible:
      contains:
        const: innolux,ee101ia-01d

  required:
    - compatible

properties:
  compatible:
    items:
      - const: innolux,ee101ia-01d
      - const: panel-lvds

  backlight: true
  data-mapping: true
  enable-gpios: true
  power-supply: true
  width-mm: true
  height-mm: true
  panel-timing: true
  port: true

required:
  - compatible
  - data-mapping
  - width-mm
  - height-mm
  - panel-timing
  - port

additionalProperties: false
...
```
