## Documentation/devicetree/bindings/display/panel/innolux,ej030na.yaml
```yaml
# SPDX-License-Identifier: (GPL-2.0 OR BSD-2-Clause)
%YAML 1.2
---
$id: http://devicetree.org/schemas/display/panel/innolux,ej030na.yaml#
$schema: http://devicetree.org/meta-schemas/core.yaml#

title: Innolux EJ030NA 3.0" (320x480 pixels) 24-bit TFT LCD panel

maintainers:
  - Paul Cercueil <paul@crapouillou.net>

allOf:
  - $ref: panel-common.yaml#
  - $ref: /schemas/spi/spi-peripheral-props.yaml#

properties:
  compatible:
    const: innolux,ej030na

  backlight: true
  port: true
  power-supply: true
  reg: true
  reset-gpios: true

required:
  - compatible
  - reg
  - power-supply
  - reset-gpios

unevaluatedProperties: false

examples:
  - |
    #include <dt-bindings/gpio/gpio.h>

    spi {
        #address-cells = <1>;
        #size-cells = <0>;

        panel@0 {
            compatible = "innolux,ej030na";
            reg = <0>;

            spi-max-frequency = <10000000>;

            reset-gpios = <&gpe 4 GPIO_ACTIVE_LOW>;
            power-supply = <&lcd_power>;

            backlight = <&backlight>;

            port {
                panel_input: endpoint {
                    remote-endpoint = <&panel_output>;
                };
            };
        };
    };
```

## Documentation/devicetree/bindings/display/panel/innolux,g070y2-l01.txt
```
Innolux G070Y2-L01 7" WVGA (800x480) TFT LCD panel

Required properties:
- compatible: should be "innolux,g070y2-l01"
- power-supply: as specified in the base binding

Optional properties:
- backlight: as specified in the base binding
- enable-gpios: as specified in the base binding

This binding is compatible with the simple-panel binding, which is specified
in simple-panel.txt in this directory.
```

## Documentation/devicetree/bindings/display/panel/innolux,g101ice-l01.txt
```
Innolux Corporation 10.1" G101ICE-L01 WXGA (1280x800) LVDS panel

Required properties:
- compatible: should be "innolux,g101ice-l01"

This binding is compatible with the simple-panel binding, which is specified
in simple-panel.txt in this directory.
```

## Documentation/devicetree/bindings/display/panel/innolux,g121i1-l01.txt
```
Inyeslux Corporation 12.1" WXGA (1280x800) TFT LCD panel

Required properties:
- compatible: should be "inyeslux,g121i1-l01"

This binding is compatible with the simple-panel binding, which is specified
in simple-panel.txt in this directory.
```

## Documentation/devicetree/bindings/display/panel/innolux,g121x1-l03.txt
```
Innolux Corporation 12.1" G121X1-L03 XGA (1024x768) TFT LCD panel

Required properties:
- compatible: should be "innolux,g121x1-l03"

This binding is compatible with the simple-panel binding, which is specified
in simple-panel.txt in this directory.
```

## Documentation/devicetree/bindings/display/panel/innolux,n116bge.txt
```
Innolux Corporation 11.6" WXGA (1366x768) TFT LCD panel

Required properties:
- compatible: should be "innolux,n116bge"

This binding is compatible with the simple-panel binding, which is specified
in simple-panel.txt in this directory.
```

## Documentation/devicetree/bindings/display/panel/innolux,n125hce.txt
```
Innolux Corporation 12.5" FHD (1920x1080) TFT LCD panel

Required properties:
- compatible: should be "innolux,n125hce"

This binding is compatible with the simple-panel binding, which is specified
in simple-panel.txt in this directory.
```

## Documentation/devicetree/bindings/display/panel/innolux,p079zca.txt
```
Innolux P079ZCA 7.85" 768x1024 TFT LCD panel

Required properties:
- compatible: should be "innolux,p079zca"
- reg: DSI virtual channel of the peripheral
- power-supply: phandle of the regulator that provides the supply voltage
- enable-gpios: panel enable gpio

Optional properties:
- backlight: phandle of the backlight device attached to the panel

Example:

	&mipi_dsi {
		panel {
			compatible = "innolux,p079zca";
			reg = <0>;
			power-supply = <...>;
			backlight = <&backlight>;
			enable-gpios = <&gpio1 13 GPIO_ACTIVE_HIGH>;
			status = "okay";
		};
	};
```

## Documentation/devicetree/bindings/display/panel/innolux,p097pfg.txt
```
Innolux P097PFG 9.7" 1536x2048 TFT LCD panel

Required properties:
- compatible: should be "innolux,p097pfg"
- reg: DSI virtual channel of the peripheral
- avdd-supply: phandle of the regulator that provides positive voltage
- avee-supply: phandle of the regulator that provides negative voltage
- enable-gpios: panel enable gpio

Optional properties:
- backlight: phandle of the backlight device attached to the panel

Example:

	&mipi_dsi {
		panel@0 {
			compatible = "innolux,p079zca";
			reg = <0>;
			avdd-supply = <...>;
			avee-supply = <...>;
			backlight = <&backlight>;
			enable-gpios = <&gpio1 13 GPIO_ACTIVE_HIGH>;
		};
	};
```

## Documentation/devicetree/bindings/display/panel/innolux,p097pfg.yaml
```yaml
# SPDX-License-Identifier: GPL-2.0
%YAML 1.2
---
$id: http://devicetree.org/schemas/display/panel/innolux,p097pfg.yaml#
$schema: http://devicetree.org/meta-schemas/core.yaml#

title: Innolux P097PFG 9.7" 1536x2048 TFT LCD panel

maintainers:
  - Lin Huang <hl@rock-chips.com>

allOf:
  - $ref: panel-common.yaml#

properties:
  compatible:
    const: innolux,p097pfg

  reg:
    maxItems: 1

  backlight: true
  enable-gpios: true

  avdd-supply:
    description: The regulator that provides positive voltage

  avee-supply:
    description: The regulator that provides negative voltage

required:
  - compatible
  - reg
  - avdd-supply
  - avee-supply
  - enable-gpios

additionalProperties: false

examples:
  - |
    #include <dt-bindings/gpio/gpio.h>

    dsi {
        #address-cells = <1>;
        #size-cells = <0>;

        panel@0 {
            compatible = "innolux,p097pfg";
            reg = <0>;
            avdd-supply = <&avdd>;
            avee-supply = <&avee>;
            backlight = <&backlight>;
            enable-gpios = <&gpio1 13 GPIO_ACTIVE_HIGH>;
        };
    };

...
```

## Documentation/devicetree/bindings/display/panel/innolux,p120zdg-bf1.txt
```
Innolux P120ZDG-BF1 12.02 inch eDP 2K display panel

This binding is compatible with the simple-panel binding, which is specified
in simple-panel.txt in this directory.

Required properties:
- compatible: should be "innolux,p120zdg-bf1"
- power-supply: regulator to provide the supply voltage

Optional properties:
- enable-gpios: GPIO pin to enable or disable the panel
- backlight: phandle of the backlight device attached to the panel
- no-hpd: If HPD isn't hooked up; add this property.

Example:
	panel_edp: panel-edp {
		compatible = "innolux,p120zdg-bf1";
		enable-gpios = <&msmgpio 31 GPIO_ACTIVE_LOW>;
		power-supply = <&pm8916_l2>;
		backlight = <&backlight>;
		no-hpd;
	};
```

## Documentation/devicetree/bindings/display/panel/innolux,p120zdg-bf1.yaml
```yaml
# SPDX-License-Identifier: GPL-2.0
%YAML 1.2
---
$id: http://devicetree.org/schemas/display/panel/innolux,p120zdg-bf1.yaml#
$schema: http://devicetree.org/meta-schemas/core.yaml#

title: Innolux P120ZDG-BF1 12.02 inch eDP 2K display panel

maintainers:
  - Sandeep Panda <spanda@codeaurora.org>
  - Douglas Anderson <dianders@chromium.org>

allOf:
  - $ref: panel-common.yaml#

properties:
  compatible:
    const: innolux,p120zdg-bf1

  enable-gpios: true
  power-supply: true
  backlight: true
  no-hpd: true

required:
  - compatible
  - power-supply

additionalProperties: false

examples:
  - |
    #include <dt-bindings/gpio/gpio.h>

    panel_edp: panel-edp {
        compatible = "innolux,p120zdg-bf1";
        enable-gpios = <&msmgpio 31 GPIO_ACTIVE_LOW>;
        power-supply = <&pm8916_l2>;
        backlight = <&backlight>;
        no-hpd;
    };

...
```
