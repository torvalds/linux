## Documentation/devicetree/bindings/display/panel/samsung,s6e63m0.yaml
```yaml
# SPDX-License-Identifier: GPL-2.0
%YAML 1.2
---
$id: http://devicetree.org/schemas/display/panel/samsung,s6e63m0.yaml#
$schema: http://devicetree.org/meta-schemas/core.yaml#

title: Samsung s6e63m0 AMOLED LCD panel

maintainers:
  - Jonathan Bakker <xc-racer2@live.ca>

allOf:
  - $ref: panel-common.yaml#
  - $ref: /schemas/leds/backlight/common.yaml#
  - $ref: /schemas/spi/spi-peripheral-props.yaml#

properties:
  compatible:
    const: samsung,s6e63m0

  reg: true
  reset-gpios: true
  port: true
  default-brightness: true
  max-brightness: true

  spi-3wire: true
  spi-cpha: true
  spi-cpol: true

  vdd3-supply:
    description: VDD regulator

  vci-supply:
    description: VCI regulator

required:
  - compatible
  - reset-gpios
  - vdd3-supply
  - vci-supply

unevaluatedProperties: false

examples:
  - |
    spi {
        #address-cells = <1>;
        #size-cells = <0>;

        display@0 {
            compatible = "samsung,s6e63m0";
            reg = <0>;
            reset-gpios = <&mp05 5 1>;
            vdd3-supply = <&ldo12_reg>;
            vci-supply = <&ldo11_reg>;
            spi-max-frequency = <1200000>;

            port {
                lcd_ep: endpoint {
                    remote-endpoint = <&fimd_ep>;
                };
            };
        };
    };

...
```

## Documentation/devicetree/bindings/display/panel/samsung,s6e88a0-ams427ap24.yaml
```yaml
# SPDX-License-Identifier: (GPL-2.0-only OR BSD-2-Clause)
%YAML 1.2
---
$id: http://devicetree.org/schemas/display/panel/samsung,s6e88a0-ams427ap24.yaml#
$schema: http://devicetree.org/meta-schemas/core.yaml#

title: Samsung AMS427AP24 panel with S6E88A0 controller

maintainers:
  - Jakob Hauser <jahau@rocketmail.com>

allOf:
  - $ref: panel-common.yaml#

properties:
  compatible:
    const: samsung,s6e88a0-ams427ap24

  reg:
    maxItems: 1

  port: true
  reset-gpios: true
  flip-horizontal: true

  vdd3-supply:
    description: core voltage supply

  vci-supply:
    description: voltage supply for analog circuits

required:
  - compatible
  - reg
  - port
  - reset-gpios
  - vdd3-supply
  - vci-supply

additionalProperties: false

examples:
  - |
    #include <dt-bindings/gpio/gpio.h>

    dsi {
        #address-cells = <1>;
        #size-cells = <0>;

        panel@0 {
            compatible = "samsung,s6e88a0-ams427ap24";
            reg = <0>;

            vdd3-supply = <&pm8916_l17>;
            vci-supply = <&pm8916_l6>;
            reset-gpios = <&tlmm 25 GPIO_ACTIVE_LOW>;
            flip-horizontal;

            port {
                panel_in: endpoint {
                    remote-endpoint = <&mdss_dsi0_out>;
                };
            };
        };
    };
```

## Documentation/devicetree/bindings/display/panel/samsung,s6e88a0-ams452ef01.yaml
```yaml
# SPDX-License-Identifier: (GPL-2.0-only OR BSD-2-Clause)
%YAML 1.2
---
$id: http://devicetree.org/schemas/display/panel/samsung,s6e88a0-ams452ef01.yaml#
$schema: http://devicetree.org/meta-schemas/core.yaml#

title: Samsung AMS452EF01 AMOLED panel with S6E88A0 video mode DSI controller

maintainers:
  - Michael Srba <Michael.Srba@seznam.cz>

allOf:
  - $ref: panel-common.yaml#

properties:
  compatible:
    const: samsung,s6e88a0-ams452ef01

  reg:
    maxItems: 1

  port: true
  reset-gpios: true
  vdd3-supply:
    description: core voltage supply
  vci-supply:
    description: voltage supply for analog circuits

required:
  - compatible
  - reg
  - port
  - vdd3-supply
  - vci-supply
  - reset-gpios

additionalProperties: false

examples:
  - |
    #include <dt-bindings/gpio/gpio.h>

    dsi {
            #address-cells = <1>;
            #size-cells = <0>;
            panel@0 {
                    reg = <0>;

                    compatible = "samsung,s6e88a0-ams452ef01";

                    vdd3-supply = <&pm8916_l17>;
                    vci-supply = <&reg_vlcd_vci>;
                    reset-gpios = <&msmgpio 25 GPIO_ACTIVE_HIGH>;

                    port {
                            panel_in: endpoint {
                                    remote-endpoint = <&dsi0_out>;
                            };
                    };
            };
    };
```

## Documentation/devicetree/bindings/display/panel/samsung,s6e8aa0.txt
```
Samsung S6E8AA0 AMOLED LCD 5.3 inch panel

Required properties:
  - compatible: "samsung,s6e8aa0"
  - reg: the virtual channel number of a DSI peripheral
  - vdd3-supply: core voltage supply
  - vci-supply: voltage supply for analog circuits
  - reset-gpios: a GPIO spec for the reset pin
  - display-timings: timings for the connected panel as described by [1]

Optional properties:
  - power-on-delay: delay after turning regulators on [ms]
  - reset-delay: delay after reset sequence [ms]
  - init-delay: delay after initialization sequence [ms]
  - panel-width-mm: physical panel width [mm]
  - panel-height-mm: physical panel height [mm]
  - flip-horizontal: boolean to flip image horizontally
  - flip-vertical: boolean to flip image vertically

The device node can contain one 'port' child node with one child
'endpoint' node, according to the bindings defined in [2]. This
node should describe panel's video bus.

[1]: Documentation/devicetree/bindings/display/display-timing.txt
[2]: Documentation/devicetree/bindings/media/video-interfaces.txt

Example:

	panel {
		compatible = "samsung,s6e8aa0";
		reg = <0>;
		vdd3-supply = <&vcclcd_reg>;
		vci-supply = <&vlcd_reg>;
		reset-gpios = <&gpy4 5 0>;
		power-on-delay= <50>;
		reset-delay = <100>;
		init-delay = <100>;
		panel-width-mm = <58>;
		panel-height-mm = <103>;
		flip-horizontal;
		flip-vertical;

		display-timings {
			timing0: timing-0 {
				clock-frequency = <57153600>;
				hactive = <720>;
				vactive = <1280>;
				hfront-porch = <5>;
				hback-porch = <5>;
				hsync-len = <5>;
				vfront-porch = <13>;
				vback-porch = <1>;
				vsync-len = <2>;
			};
		};
	};
```

## Documentation/devicetree/bindings/display/panel/samsung,s6e8aa0.yaml
```yaml
# SPDX-License-Identifier: GPL-2.0
%YAML 1.2
---
$id: http://devicetree.org/schemas/display/panel/samsung,s6e8aa0.yaml#
$schema: http://devicetree.org/meta-schemas/core.yaml#

title: Samsung S6E8AA0 AMOLED LCD 5.3 inch panel

maintainers:
  - Andrzej Hajda <a.hajda@samsung.com>

allOf:
  - $ref: panel-common.yaml#

properties:
  compatible:
    const: samsung,s6e8aa0

  reg: true
  reset-gpios: true
  display-timings: true

  vdd3-supply:
    description: core voltage supply

  vci-supply:
    description: voltage supply for analog circuits

  power-on-delay:
    description: delay after turning regulators on [ms]
    $ref: /schemas/types.yaml#/definitions/uint32

  reset-delay:
    description: delay after reset sequence [ms]
    $ref: /schemas/types.yaml#/definitions/uint32

  init-delay:
    description: delay after initialization sequence [ms]
    $ref: /schemas/types.yaml#/definitions/uint32

  panel-width-mm:
    description: physical panel width [mm]

  panel-height-mm:
    description: physical panel height [mm]

  flip-horizontal:
    description: boolean to flip image horizontally
    type: boolean

  flip-vertical:
    description: boolean to flip image vertically
    type: boolean

required:
  - compatible
  - reg
  - vdd3-supply
  - vci-supply
  - reset-gpios
  - display-timings

additionalProperties: false

examples:
  - |
    dsi {
        #address-cells = <1>;
        #size-cells = <0>;

        panel@0 {
            compatible = "samsung,s6e8aa0";
            reg = <0>;
            vdd3-supply = <&vcclcd_reg>;
            vci-supply = <&vlcd_reg>;
            reset-gpios = <&gpy4 5 0>;
            power-on-delay= <50>;
            reset-delay = <100>;
            init-delay = <100>;
            panel-width-mm = <58>;
            panel-height-mm = <103>;
            flip-horizontal;
            flip-vertical;

            display-timings {
                timing0: timing-0 {
                    clock-frequency = <57153600>;
                    hactive = <720>;
                    vactive = <1280>;
                    hfront-porch = <5>;
                    hback-porch = <5>;
                    hsync-len = <5>;
                    vfront-porch = <13>;
                    vback-porch = <1>;
                    vsync-len = <2>;
                };
            };
        };
    };

...
```

## Documentation/devicetree/bindings/display/panel/samsung,s6e8aa5x01-ams561ra01.yaml
```yaml
# SPDX-License-Identifier: (GPL-2.0-only OR BSD-2-Clause)
%YAML 1.2
---
$id: http://devicetree.org/schemas/display/panel/samsung,s6e8aa5x01-ams561ra01.yaml#
$schema: http://devicetree.org/meta-schemas/core.yaml#

title: Samsung AMS561RA01 panel with S6E8AA5X01 controller

maintainers:
  - Kaustabh Chakraborty <kauschluss@disroot.org>
  - Yedaya Katsman <yedaya.ka@gmail.com>

allOf:
  - $ref: panel-common.yaml#

properties:
  compatible:
    enum:
      - samsung,s6e8aa5x01-ams561ra01
      - samsung,s6e8fc0-m1906f9

  reg:
    maxItems: 1

  vdd-supply:
    description: core voltage supply

  vci-supply:
    description: voltage supply for analog circuits

  reset-gpios: true

required:
  - compatible
  - reg

additionalProperties: false

examples:
  - |
    #include <dt-bindings/gpio/gpio.h>

    dsi {
        #address-cells = <1>;
        #size-cells = <0>;

        panel@0 {
            compatible = "samsung,s6e8aa5x01-ams561ra01";
            reg = <0>;

            vdd-supply = <&panel_vdd_reg>;
            vci-supply = <&panel_vci_reg>;

            reset-gpios = <&gpd3 4 GPIO_ACTIVE_HIGH>;
        };
    };

...
```

## Documentation/devicetree/bindings/display/panel/samsung,sofef00.yaml
```yaml
# SPDX-License-Identifier: GPL-2.0-only OR BSD-2-Clause
%YAML 1.2
---
$id: http://devicetree.org/schemas/display/panel/samsung,sofef00.yaml#
$schema: http://devicetree.org/meta-schemas/core.yaml#

title: Samsung SOFEF00 AMOLED DDIC

description: The SOFEF00 is display driver IC with connected panel.

maintainers:
  - David Heidelberg <david@ixit.cz>

allOf:
  - $ref: panel-common.yaml#

properties:
  compatible:
    items:
      - enum:
            # Samsung 6.01 inch, 1080x2160 pixels, 18:9 ratio
          - samsung,sofef00-ams601nt22
            # Samsung 6.28 inch, 1080x2280 pixels, 19:9 ratio
          - samsung,sofef00-ams628nw01
      - const: samsung,sofef00

  reg:
    maxItems: 1

  poc-supply:
    description: POC regulator

  vci-supply:
    description: VCI regulator

  vddio-supply:
    description: VDD regulator

required:
  - compatible
  - reset-gpios
  - poc-supply
  - vci-supply
  - vddio-supply

unevaluatedProperties: false

examples:
  - |
    #include <dt-bindings/gpio/gpio.h>

    dsi {
        #address-cells = <1>;
        #size-cells = <0>;

        panel@0 {
            compatible = "samsung,sofef00-ams628nw01", "samsung,sofef00";
            reg = <0>;

            vddio-supply = <&vreg_l14a_1p88>;
            vci-supply = <&s2dos05_buck1>;
            poc-supply = <&s2dos05_ldo1>;

            te-gpios = <&tlmm 10 GPIO_ACTIVE_HIGH>;
            reset-gpios = <&tlmm 6 GPIO_ACTIVE_HIGH>;

            pinctrl-0 = <&panel_active>;
            pinctrl-1 = <&panel_suspend>;
            pinctrl-names = "default", "sleep";

            port {
                panel_in: endpoint {
                    remote-endpoint = <&mdss_dsi0_out>;
                };
            };
        };
    };

...
```

## Documentation/devicetree/bindings/display/panel/samsung,sofef01-m.yaml
```yaml
# SPDX-License-Identifier: (GPL-2.0-only OR BSD-2-Clause)
%YAML 1.2
---
$id: http://devicetree.org/schemas/display/panel/samsung,sofef01-m.yaml#
$schema: http://devicetree.org/meta-schemas/core.yaml#

title: Samsung SOFEF01-M DDI for 1080x2520@60Hz 6.0"/6.1" OLED DSI panels

maintainers:
  - Marijn Suijten <marijn.suijten@somainline.org>

description: |
  Samsung SOFEF01-M Display-Driver-IC found in multiple Sony smartphones, paired with
  the following panel:
   - Sony Xperia 5 (kumano bahamut): amb609tc01
   - Sony Xperia 10 II (seine pdx201): ams597ut01
   - Sony Xperia 10 III (lena pdx213): ams597ut04
   - Sony Xperia 10 IV (murray pdx225): ams597ut05
   - Sony Xperia 10 V (zambezi pdx235): ams605dk01
   - Sony Xperia 10 VI (columbia pdx246): ams605dk01

  The assembly features a Samsung touchscreen compatible with
  samsung,s6sy761.

properties:
  compatible:
    enum:
      - samsung,sofef01-m-amb609tc01 # 6.1"
      - samsung,sofef01-m-ams597ut01 # 6.0"
      - samsung,sofef01-m-ams597ut04 # 6.0"
      - samsung,sofef01-m-ams597ut05 # 6.0"
      - samsung,sofef01-m-ams605dk01 # 6.1"

  port: true

  reg:
    maxItems: 1
    description: DSI virtual channel

  reset-gpios: true

  vci-supply:
    description: DisplayIC Operation supply (3.0V)

  vddio-supply:
    description: I/O voltage supply (1.8V)

required:
  - compatible
  - port
  - reg
  - reset-gpios
  - vddio-supply

allOf:
  - $ref: panel-common.yaml#
  - if:
      properties:
        compatible:
          contains:
            const: samsung,sofef01-m-amb609tc01
    then:
      required:
        - vci-supply
    else:
      properties:
        vci-supply: false

unevaluatedProperties: false

examples:
  - |
    #include <dt-bindings/gpio/gpio.h>

    dsi {
        #address-cells = <1>;
        #size-cells = <0>;
        panel@0 {
            compatible = "samsung,sofef01-m-amb609tc01";
            reg = <0>;

            reset-gpios = <&tlmm 6 GPIO_ACTIVE_LOW>;

            vci-supply = <&vreg_l17a_3p0>;
            vddio-supply = <&vreg_l14a_1p8>;

            port {
                endpoint {
                    remote-endpoint = <&dsi0_out>;
                };
            };
        };
    };
...
```

## Documentation/devicetree/bindings/display/panel/seiko,43wvf1g.txt
```
Seiko Instruments Inc. 4.3" WVGA (800 x RGB x 480) TFT with Touch-Panel

Required properties:
- compatible: should be "sii,43wvf1g".
- "dvdd-supply": 3v3 digital regulator.
- "avdd-supply": 5v analog regulator.

Optional properties:
- backlight: phandle for the backlight control.

Example:

	panel {
		compatible = "sii,43wvf1g";
		backlight = <&backlight_display>;
		dvdd-supply = <&reg_lcd_3v3>;
		avdd-supply = <&reg_lcd_5v>;
		port {
			panel_in: endpoint {
				remote-endpoint = <&display_out>;
			};
		};
	};
```

## Documentation/devicetree/bindings/display/panel/seiko,43wvf1g.yaml
```yaml
# SPDX-License-Identifier: GPL-2.0
%YAML 1.2
---
$id: http://devicetree.org/schemas/display/panel/seiko,43wvf1g.yaml#
$schema: http://devicetree.org/meta-schemas/core.yaml#

title: Seiko Instruments Inc. 4.3" WVGA (800 x RGB x 480) TFT with Touch-Panel

maintainers:
  - Fabio Estevam <festevam@gmail.com>

allOf:
  - $ref: panel-common.yaml#

properties:
  compatible:
    const: sii,43wvf1g

  backlight: true
  port: true

  dvdd-supply:
    description: 3v3 digital regulator

  avdd-supply:
    description: 5v analog regulator

  enable-gpios: true

required:
  - compatible
  - dvdd-supply
  - avdd-supply

additionalProperties: false

examples:
  - |
    panel {
        compatible = "sii,43wvf1g";

        backlight = <&backlight_display>;
        dvdd-supply = <&reg_lcd_3v3>;
        avdd-supply = <&reg_lcd_5v>;
        port {
            panel_in: endpoint {
                remote-endpoint = <&display_out>;
            };
        };
    };

...
```
