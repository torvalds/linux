## Documentation/devicetree/bindings/display/panel/sgd,gktw70sdae4se.txt
```
Solomon Goldentek Display GKTW70SDAE4SE LVDS Display Panel
==========================================================

The GKTW70SDAE4SE is a 7" WVGA TFT-LCD display panel.

These DT bindings follow the LVDS panel bindings defined in panel-lvds.txt
with the following device-specific properties.

Required properties:

- compatible: Shall contain "sgd,gktw70sdae4se" and "panel-lvds", in that order.

Example
-------

panel {
	compatible = "sgd,gktw70sdae4se", "panel-lvds";

	width-mm = <153>;
	height-mm = <86>;

	data-mapping = "jeida-18";

	panel-timing {
		clock-frequency = <32000000>;
		hactive = <800>;
		vactive = <480>;
		hback-porch = <39>;
		hfront-porch = <39>;
		vback-porch = <29>;
		vfront-porch = <13>;
		hsync-len = <47>;
		vsync-len = <2>;
	};

	port {
		panel_in: endpoint {
			remote-endpoint = <&lvds_encoder>;
		};
	};
};
```

## Documentation/devicetree/bindings/display/panel/sgd,gktw70sdae4se.yaml
```yaml
# SPDX-License-Identifier: GPL-2.0
%YAML 1.2
---
$id: http://devicetree.org/schemas/display/panel/sgd,gktw70sdae4se.yaml#
$schema: http://devicetree.org/meta-schemas/core.yaml#

title: Solomon Goldentek Display GKTW70SDAE4SE 7" WVGA LVDS Display Panel

maintainers:
  - Neil Armstrong <narmstrong@baylibre.com>
  - Thierry Reding <thierry.reding@gmail.com>

allOf:
  - $ref: panel-common.yaml#
  - $ref: /schemas/display/lvds.yaml/#

select:
  properties:
    compatible:
      contains:
        const: sgd,gktw70sdae4se

  required:
    - compatible

properties:
  compatible:
    items:
      - const: sgd,gktw70sdae4se
      - const: panel-lvds

  data-mapping:
    const: jeida-18

  width-mm:
    const: 153

  height-mm:
    const: 86

  panel-timing: true
  port: true

additionalProperties: false

required:
  - compatible
  - port
  - data-mapping
  - width-mm
  - height-mm
  - panel-timing

examples:
  - |+
    panel {
      compatible = "sgd,gktw70sdae4se", "panel-lvds";

      width-mm = <153>;
      height-mm = <86>;

      data-mapping = "jeida-18";

      panel-timing {
        clock-frequency = <32000000>;
        hactive = <800>;
        vactive = <480>;
        hback-porch = <39>;
        hfront-porch = <39>;
        vback-porch = <29>;
        vfront-porch = <13>;
        hsync-len = <47>;
        vsync-len = <2>;
      };

      port {
        panel_in: endpoint {
          remote-endpoint = <&lvds_encoder>;
        };
      };
    };

...
```

## Documentation/devicetree/bindings/display/panel/sharp,lcd-f402.txt
```
Sharp F402 (2048x1536 pexels) TFT LCD panel

Required properties:
- compatible: should be "sharp,lcd-f402"

This binding is compatible with the simple-panel binding, which is specified
in simple-panel.txt in this directory.
```

## Documentation/devicetree/bindings/display/panel/sharp,ld-d5116z01b.txt
```
Sharp LD-D5116Z01B 12.3" WUXGA+ eDP panel

Required properties:
- compatible: should be "sharp,ld-d5116z01b"
- power-supply: regulator to provide the VCC supply voltage (3.3 volts)

This binding is compatible with the simple-panel binding.

The device node can contain one 'port' child node with one child
'endpoint' node, according to the bindings defined in [1]. This
node should describe panel's video bus.

[1]: Documentation/devicetree/bindings/media/video-interfaces.txt

Example:

	panel: panel {
		compatible = "sharp,ld-d5116z01b";
		power-supply = <&vlcd_3v3>;

		port {
			panel_ep: endpoint {
				remote-endpoint = <&bridge_out_ep>;
			};
		};
	};
```

## Documentation/devicetree/bindings/display/panel/sharp,ld-d5116z01b.yaml
```yaml
# SPDX-License-Identifier: GPL-2.0
%YAML 1.2
---
$id: http://devicetree.org/schemas/display/panel/sharp,ld-d5116z01b.yaml#
$schema: http://devicetree.org/meta-schemas/core.yaml#

title: Sharp LD-D5116Z01B 12.3" WUXGA+ eDP panel

maintainers:
  - Jeffrey Hugo <jeffrey.l.hugo@gmail.com>

allOf:
  - $ref: panel-common.yaml#

properties:
  compatible:
    const: sharp,ld-d5116z01b

  power-supply: true
  backlight: true
  port: true
  no-hpd: true

additionalProperties: false

required:
  - compatible
  - power-supply

...
```

## Documentation/devicetree/bindings/display/panel/sharp,lq035q7db03.txt
```
Sharp LQ035Q7DB03 3.5" QVGA TFT LCD panel

Required properties:
- compatible: should be "sharp,lq035q7db03"
- power-supply: phandle of the regulator that provides the supply voltage

Optional properties:
- enable-gpios: GPIO pin to enable or disable the panel
- backlight: phandle of the backlight device attached to the panel

This binding is compatible with the simple-panel binding, which is specified
in simple-panel.txt in this directory.
```

## Documentation/devicetree/bindings/display/panel/sharp,lq070y3dg3b.txt
```
Sharp LQ070Y3DG3B 7.0" WVGA landscape TFT LCD panel

Required properties:
- compatible: should be "sharp,lq070y3dg3b"

Optional properties:
- enable-gpios: GPIO pin to enable or disable the panel
- backlight: phandle of the backlight device attached to the panel
- power-supply: phandle of the regulator that provides the supply voltage

This binding is compatible with the simple-panel binding, which is specified
in simple-panel.txt in this directory.
```

## Documentation/devicetree/bindings/display/panel/sharp,lq079l1sx01.yaml
```yaml
# SPDX-License-Identifier: (GPL-2.0-only OR BSD-2-Clause)
%YAML 1.2
---
$id: http://devicetree.org/schemas/display/panel/sharp,lq079l1sx01.yaml#
$schema: http://devicetree.org/meta-schemas/core.yaml#

title: Sharp Microelectronics 7.9" WQXGA TFT LCD panel

maintainers:
  - Svyatoslav Ryhel <clamor95@gmail.com>

description: >
  This panel requires a dual-channel DSI host to operate and it supports
  only left-right split mode, where each channel drives the left or right
  half of the screen and only video mode.

  Each of the DSI channels controls a separate DSI peripheral.
  The peripheral driven by the first link (DSI-LINK1), left one, is
  considered the primary peripheral and controls the device.

allOf:
  - $ref: panel-common-dual.yaml#

properties:
  compatible:
    const: sharp,lq079l1sx01

  reg:
    maxItems: 1

  avdd-supply:
    description: regulator that supplies the analog voltage

  vddio-supply:
    description: regulator that supplies the I/O voltage

  vsp-supply:
    description: positive boost supply regulator

  vsn-supply:
    description: negative boost supply regulator

  reset-gpios:
    maxItems: 1

  backlight: true
  ports: true

required:
  - compatible
  - reg
  - avdd-supply
  - vddio-supply
  - ports

additionalProperties: false

examples:
  - |
    #include <dt-bindings/gpio/gpio.h>

    dsi {
        #address-cells = <1>;
        #size-cells = <0>;

        panel@0 {
            compatible = "sharp,lq079l1sx01";
            reg = <0>;

            reset-gpios = <&gpio 59 GPIO_ACTIVE_LOW>;

            avdd-supply = <&avdd_lcd>;
            vddio-supply = <&vdd_lcd_io>;
            vsp-supply = <&vsp_5v5_lcd>;
            vsn-supply = <&vsn_5v5_lcd>;

            backlight = <&backlight>;

            ports {
                #address-cells = <1>;
                #size-cells = <0>;

                port@0 {
                    reg = <0>;
                    panel_in0: endpoint {
                        remote-endpoint = <&dsi0_out>;
                    };
                };

                port@1 {
                    reg = <1>;
                    panel_in1: endpoint {
                        remote-endpoint = <&dsi1_out>;
                    };
                };
            };
        };
    };
...
```

## Documentation/devicetree/bindings/display/panel/sharp,lq101k1ly04.txt
```
Sharp Display Corp. LQ101K1LY04 10.07" WXGA TFT LCD panel

Required properties:
- compatible: should be "sharp,lq101k1ly04"

This binding is compatible with the simple-panel binding, which is specified
in simple-panel.txt in this directory.
```

## Documentation/devicetree/bindings/display/panel/sharp,lq101r1sx01.txt
```
Sharp Microelectronics 10.1" WQXGA TFT LCD panel

This panel requires a dual-channel DSI host to operate. It supports two modes:
- left-right: each channel drives the left or right half of the screen
- even-odd: each channel drives the even or odd lines of the screen

Each of the DSI channels controls a separate DSI peripheral. The peripheral
driven by the first link (DSI-LINK1), left or even, is considered the primary
peripheral and controls the device. The 'link2' property contains a phandle
to the peripheral driven by the second link (DSI-LINK2, right or odd).

Note that in video mode the DSI-LINK1 interface always provides the left/even
pixels and DSI-LINK2 always provides the right/odd pixels. In command mode it
is possible to program either link to drive the left/even or right/odd pixels
but for the sake of consistency this binding assumes that the same assignment
is chosen as for video mode.

Required properties:
- compatible: should be "sharp,lq101r1sx01"
- reg: DSI virtual channel of the peripheral

Required properties (for DSI-LINK1 only):
- link2: phandle to the DSI peripheral on the secondary link. Note that the
  presence of this property marks the containing node as DSI-LINK1.
- power-supply: phandle of the regulator that provides the supply voltage

Optional properties (for DSI-LINK1 only):
- backlight: phandle of the backlight device attached to the panel

Example:

	dsi@54300000 {
		panel: panel@0 {
			compatible = "sharp,lq101r1sx01";
			reg = <0>;

			link2 = <&secondary>;

			power-supply = <...>;
			backlight = <...>;
		};
	};

	dsi@54400000 {
		secondary: panel@0 {
			compatible = "sharp,lq101r1sx01";
			reg = <0>;
		};
	};
```

## Documentation/devicetree/bindings/display/panel/sharp,lq101r1sx01.yaml
```yaml
# SPDX-License-Identifier: GPL-2.0
%YAML 1.2
---
$id: http://devicetree.org/schemas/display/panel/sharp,lq101r1sx01.yaml#
$schema: http://devicetree.org/meta-schemas/core.yaml#

title: Sharp Microelectronics 10.1" WQXGA TFT LCD panel

maintainers:
  - Thierry Reding <treding@nvidia.com>

description: |
  This panel requires a dual-channel DSI host to operate. It supports two modes:
  - left-right: each channel drives the left or right half of the screen
  - even-odd: each channel drives the even or odd lines of the screen

  Each of the DSI channels controls a separate DSI peripheral. The peripheral
  driven by the first link (DSI-LINK1), left or even, is considered the primary
  peripheral and controls the device. The 'link2' property contains a phandle
  to the peripheral driven by the second link (DSI-LINK2, right or odd).

  Note that in video mode the DSI-LINK1 interface always provides the left/even
  pixels and DSI-LINK2 always provides the right/odd pixels. In command mode it
  is possible to program either link to drive the left/even or right/odd pixels
  but for the sake of consistency this binding assumes that the same assignment
  is chosen as for video mode.

allOf:
  - $ref: panel-common.yaml#

properties:
  compatible:
    oneOf:
      - items:
          - const: sharp,lq101r1sx03
          - const: sharp,lq101r1sx01
      - enum:
          - sharp,lq101r1sx01

  reg: true
  power-supply: true
  backlight: true

  link2:
    $ref: /schemas/types.yaml#/definitions/phandle
    description: |
      phandle to the DSI peripheral on the secondary link. Note that the
      presence of this property marks the containing node as DSI-LINK1

required:
  - compatible
  - reg

if:
  required:
    - link2
then:
  required:
    - power-supply

additionalProperties: false

examples:
  - |
    dsi0: dsi@fd922800 {
        #address-cells = <1>;
        #size-cells = <0>;
        reg = <0xfd922800 0x200>;

        panel: panel@0 {
            compatible = "sharp,lq101r1sx01";
            reg = <0>;

            link2 = <&secondary>;

            power-supply = <&power>;
            backlight = <&backlight>;
        };
    };

    dsi1: dsi@fd922a00 {
        #address-cells = <1>;
        #size-cells = <0>;
        reg = <0xfd922a00 0x200>;

        secondary: panel@0 {
            compatible = "sharp,lq101r1sx01";
            reg = <0>;
        };
    };

...
```

## Documentation/devicetree/bindings/display/panel/sharp,lq123p1jx31.txt
```
Sharp 12.3" (2400x1600 pixels) TFT LCD panel

Required properties:
- compatible: should be "sharp,lq123p1jx31"

This binding is compatible with the simple-panel binding, which is specified
in simple-panel.txt in this directory.
```

## Documentation/devicetree/bindings/display/panel/sharp,lq150x1lg11.txt
```
Sharp 15" LQ150X1LG11 XGA TFT LCD panel

Required properties:
- compatible: should be "sharp,lq150x1lg11"
- power-supply: regulator to provide the VCC supply voltage (3.3 volts)

Optional properties:
- backlight: phandle of the backlight device
- rlud-gpios: a single GPIO for the RL/UD (rotate 180 degrees) pin.
- sellvds-gpios: a single GPIO for the SELLVDS pin.

If rlud-gpios and/or sellvds-gpios are not specified, the RL/UD and/or SELLVDS
pins are assumed to be handled appropriately by the hardware.

Example:

	backlight: backlight {
		compatible = "pwm-backlight";
		pwms = <&pwm 0 100000>;                      /* VBR */

		brightness-levels = <0 20 40 60 80 100>;
		default-brightness-level = <2>;

		power-supply = <&vdd_12v_reg>;               /* VDD */
		enable-gpios = <&gpio 42 GPIO_ACTIVE_HIGH>;  /* XSTABY */
	};

	panel {
		compatible = "sharp,lq150x1lg11";

		power-supply = <&vcc_3v3_reg>;               /* VCC */

		backlight = <&backlight>;
		rlud-gpios = <&gpio 17 GPIO_ACTIVE_HIGH>;    /* RL/UD */
		sellvds-gpios = <&gpio 18 GPIO_ACTIVE_HIGH>; /* SELLVDS */
	};
```

## Documentation/devicetree/bindings/display/panel/sharp,lq150x1lg11.yaml
```yaml
# SPDX-License-Identifier: GPL-2.0
%YAML 1.2
---
$id: http://devicetree.org/schemas/display/panel/sharp,lq150x1lg11.yaml#
$schema: http://devicetree.org/meta-schemas/core.yaml#

title: Sharp 15" LQ150X1LG11 XGA TFT LCD panel

maintainers:
  - Peter Rosin <peda@axentia.se>

allOf:
  - $ref: panel-common.yaml#

properties:
  compatible:
    const: sharp,lq150x1lg11

  power-supply: true
  backlight: true

  rlud-gpios:
    maxItems: 1
    description: |
      GPIO for the RL/UD (rotate 180 degrees) pin.
      If rlud-gpios and/or sellvds-gpios are not specified,
      the RL/UD and/or SELLVDS pins are assumed to be handled
      appropriately by the hardware.

  sellvds-gpios:
    maxItems: 1
    description: |
      GPIO for the SELLVDS pin.
      If rlud-gpios and/or sellvds-gpios are not specified,
      the RL/UD and/or SELLVDS pins are assumed to be handled
      appropriately by the hardware.

required:
  - compatible
  - power-supply

additionalProperties: false

examples:
  - |
    #include <dt-bindings/gpio/gpio.h>

    panel {
        compatible = "sharp,lq150x1lg11";

        power-supply = <&vcc_3v3_reg>;               /* VCC */

        backlight = <&backlight>;
        rlud-gpios = <&gpio 17 GPIO_ACTIVE_HIGH>;    /* RL/UD */
        sellvds-gpios = <&gpio 18 GPIO_ACTIVE_HIGH>; /* SELLVDS */
    };

...
```

## Documentation/devicetree/bindings/display/panel/sharp,ls020b1dd01d.txt
```
Sharp 2.0" (240x160 pixels) 16-bit TFT LCD panel

Required properties:
- compatible: should be "sharp,ls020b1dd01d"
- power-supply: as specified in the base binding

Optional properties:
- backlight: as specified in the base binding
- enable-gpios: as specified in the base binding

This binding is compatible with the simple-panel binding, which is specified
in simple-panel.txt in this directory.
```
