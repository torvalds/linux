## Documentation/devicetree/bindings/display/panel/innolux,tv123wam.txt
```
Innolux TV123WAM 12.3 inch eDP 2K display panel

This binding is compatible with the simple-panel binding, which is specified
in simple-panel.txt in this directory.

Required properties:
- compatible: should be "innolux,tv123wam"
- power-supply: regulator to provide the supply voltage

Optional properties:
- enable-gpios: GPIO pin to enable or disable the panel
- backlight: phandle of the backlight device attached to the panel

Example:
	panel_edp: panel-edp {
		compatible = "innolux,tv123wam";
		enable-gpios = <&msmgpio 31 GPIO_ACTIVE_LOW>;
		power-supply = <&pm8916_l2>;
		backlight = <&backlight>;
	};
```

## Documentation/devicetree/bindings/display/panel/innolux,zj070na-01p.txt
```
Innolux Corporation 7.0" WSVGA (1024x600) TFT LCD panel

Required properties:
- compatible: should be "innolux,zj070na-01p"

This binding is compatible with the simple-panel binding, which is specified
in simple-panel.txt in this directory.
```

## Documentation/devicetree/bindings/display/panel/jadard,jd9365da-h3.yaml
```yaml
# SPDX-License-Identifier: (GPL-2.0-only OR BSD-2-Clause)
%YAML 1.2
---
$id: http://devicetree.org/schemas/display/panel/jadard,jd9365da-h3.yaml#
$schema: http://devicetree.org/meta-schemas/core.yaml#

title: Jadard JD9365DA-HE WXGA DSI panel

maintainers:
  - Jagan Teki <jagan@edgeble.ai>

allOf:
  - $ref: panel-common.yaml#

properties:
  compatible:
    items:
      - enum:
          - chongzhou,cz101b4001
          - kingdisplay,kd101ne3-40ti
          - radxa,display-10hd-ad001
          - radxa,display-8hd-ad002
      - const: jadard,jd9365da-h3

  reg:
    maxItems: 1

  vdd-supply:
    description: supply regulator for VDD, usually 3.3V

  vccio-supply:
    description: supply regulator for VCCIO, usually 1.8V

  reset-gpios: true

  backlight: true

  port: true

required:
  - compatible
  - reg
  - vdd-supply
  - vccio-supply
  - reset-gpios

additionalProperties: false

examples:
  - |
    #include <dt-bindings/gpio/gpio.h>
    #include <dt-bindings/pinctrl/rockchip.h>

    dsi {
        #address-cells = <1>;
        #size-cells = <0>;

        panel@0 {
            compatible = "chongzhou,cz101b4001", "jadard,jd9365da-h3";
            reg = <0>;
            vdd-supply = <&lcd_3v3>;
            vccio-supply = <&vcca_1v8>;
            reset-gpios = <&gpio1 RK_PC2 GPIO_ACTIVE_HIGH>;
            backlight = <&backlight>;

            port {
                mipi_in_panel: endpoint {
                    remote-endpoint = <&mipi_out_panel>;
                };
            };
        };
    };

...
```

## Documentation/devicetree/bindings/display/panel/jdi,lpm102a188a.yaml
```yaml
# SPDX-License-Identifier: GPL-2.0-only OR BSD-2-Clause
%YAML 1.2
---
$id: http://devicetree.org/schemas/display/panel/jdi,lpm102a188a.yaml#
$schema: http://devicetree.org/meta-schemas/core.yaml#

title: JDI LPM102A188A 2560x1800 10.2" DSI Panel

maintainers:
  - Diogo Ivo <diogo.ivo@tecnico.ulisboa.pt>

description: |
  This panel requires a dual-channel DSI host to operate. It supports two modes:
  - left-right: each channel drives the left or right half of the screen
  - even-odd: each channel drives the even or odd lines of the screen

  Each of the DSI channels controls a separate DSI peripheral. The peripheral
  driven by the first link (DSI-LINK1) is considered the primary peripheral
  and controls the device. The 'link2' property contains a phandle to the
  peripheral driven by the second link (DSI-LINK2).

allOf:
  - $ref: panel-common.yaml#

properties:
  compatible:
    const: jdi,lpm102a188a

  reg: true
  enable-gpios: true
  reset-gpios: true
  power-supply: true
  backlight: true

  ddi-supply:
    description: The regulator that provides IOVCC (1.8V).

  link2:
    $ref: /schemas/types.yaml#/definitions/phandle
    description: |
      phandle to the DSI peripheral on the secondary link. Note that the
      presence of this property marks the containing node as DSI-LINK1.

required:
  - compatible
  - reg

if:
  required:
    - link2
then:
  required:
    - power-supply
    - ddi-supply
    - enable-gpios
    - reset-gpios

additionalProperties: false

examples:
  - |
    #include <dt-bindings/gpio/gpio.h>
    #include <dt-bindings/gpio/tegra-gpio.h>

    dsia: dsi@54300000 {
        #address-cells = <1>;
        #size-cells = <0>;
        reg = <0x0 0x54300000 0x0 0x00040000>;

        link2: panel@0 {
            compatible = "jdi,lpm102a188a";
            reg = <0>;
        };
    };

    dsib: dsi@54400000{
        #address-cells = <1>;
        #size-cells = <0>;
        reg = <0x0 0x54400000 0x0 0x00040000>;
        nvidia,ganged-mode = <&dsia>;

        link1: panel@0 {
            compatible = "jdi,lpm102a188a";
            reg = <0>;
            power-supply = <&pplcd_vdd>;
            ddi-supply = <&pp1800_lcdio>;
            enable-gpios = <&gpio TEGRA_GPIO(V, 1) GPIO_ACTIVE_HIGH>;
            reset-gpios = <&gpio TEGRA_GPIO(V, 2) GPIO_ACTIVE_LOW>;
            link2 = <&link2>;
            backlight = <&backlight>;
        };
    };

...
```

## Documentation/devicetree/bindings/display/panel/jdi,lt070me05000.txt
```
JDI model LT070ME05000 1200x1920 7" DSI Panel

Required properties:
- compatible: should be "jdi,lt070me05000"
- vddp-supply: phandle of the regulator that provides the supply voltage
  Power IC supply (3-5V)
- iovcc-supply: phandle of the regulator that provides the supply voltage
  IOVCC , power supply for LCM (1.8V)
- enable-gpios: phandle of gpio for enable line
  LED_EN, LED backlight enable, High active
- reset-gpios: phandle of gpio for reset line
  This should be 8mA, gpio can be configured using mux, pinctrl, pinctrl-names
  XRES, Reset, Low active
- dcdc-en-gpios: phandle of the gpio for power ic line
  Power IC supply enable, High active

Example:

	dsi0: qcom,mdss_dsi@4700000 {
		panel@0 {
			compatible = "jdi,lt070me05000";
			reg = <0>;

			vddp-supply = <&pm8921_l17>;
			iovcc-supply = <&pm8921_lvs7>;

			enable-gpios = <&pm8921_gpio 36 GPIO_ACTIVE_HIGH>;
			reset-gpios = <&tlmm_pinmux 54 GPIO_ACTIVE_LOW>;
			dcdc-en-gpios = <&pm8921_gpio 23 GPIO_ACTIVE_HIGH>;
		};
	};
```

## Documentation/devicetree/bindings/display/panel/jdi,lt070me05000.yaml
```yaml
# SPDX-License-Identifier: GPL-2.0
%YAML 1.2
---
$id: http://devicetree.org/schemas/display/panel/jdi,lt070me05000.yaml#
$schema: http://devicetree.org/meta-schemas/core.yaml#

title: JDI model LT070ME05000 1200x1920 7" DSI Panel

maintainers:
  - Vinay Simha BN <simhavcs@gmail.com>

allOf:
  - $ref: panel-common.yaml#

properties:
  compatible:
    const: jdi,lt070me05000

  reg:
    maxItems: 1

  enable-gpios: true
  reset-gpios: true

  vddp-supply:
    description: |
      The regulator that provides the supply voltage Power IC supply (3-5V)

  iovcc-supply:
    description: |
      The regulator that provides the supply voltage IOVCC,
      power supply for LCM (1.8V)

  dcdc-en-gpios:
    maxItems: 1
    description: |
      phandle of the gpio for power ic line
      Power IC supply enable, High active

  port: true

required:
  - compatible
  - reg
  - vddp-supply
  - iovcc-supply
  - enable-gpios
  - reset-gpios
  - dcdc-en-gpios

additionalProperties: false

examples:
  - |
    #include <dt-bindings/gpio/gpio.h>

    dsi {
        #address-cells = <1>;
        #size-cells = <0>;

        panel@0 {
            compatible = "jdi,lt070me05000";
            reg = <0>;

            vddp-supply = <&pm8921_l17>;
            iovcc-supply = <&pm8921_lvs7>;

            enable-gpios = <&pm8921_gpio 36 GPIO_ACTIVE_HIGH>;
            reset-gpios = <&tlmm_pinmux 54 GPIO_ACTIVE_LOW>;
            dcdc-en-gpios = <&pm8921_gpio 23 GPIO_ACTIVE_HIGH>;
        };
    };

...
```

## Documentation/devicetree/bindings/display/panel/kingdisplay,kd035g6-54nt.txt
```
King Display KD035G6-54NT 3.5" (320x240 pixels) 24-bit TFT LCD panel

Required properties:
- compatible: should be "kingdisplay,kd035g6-54nt"
- power-supply: See panel-common.txt
- reset-gpios: See panel-common.txt

Optional properties:
- backlight: see panel-common.txt

The generic bindings for the SPI slaves documented in [1] also apply.

The device node can contain one 'port' child node with one child
'endpoint' node, according to the bindings defined in [2]. This
node should describe panel's video bus.

[1]: Documentation/devicetree/bindings/spi/spi-bus.txt
[2]: Documentation/devicetree/bindings/graph.txt

Example:

&spi {
	panel@0 {
		compatible = "kingdisplay,kd035g6-54nt";
		reg = <0>;

		spi-max-frequency = <3125000>;
		spi-3wire;
		spi-cs-high;

		reset-gpios = <&gpe 2 GPIO_ACTIVE_LOW>;

		backlight = <&backlight>;
		power-supply = <&ldo6>;

		port {
			panel_input: endpoint {
				remote-endpoint = <&panel_output>;
			};
		};
	};
};
```

## Documentation/devicetree/bindings/display/panel/kingdisplay,kd035g6-54nt.yaml
```yaml
# SPDX-License-Identifier: GPL-2.0
%YAML 1.2
---
$id: http://devicetree.org/schemas/display/panel/kingdisplay,kd035g6-54nt.yaml#
$schema: http://devicetree.org/meta-schemas/core.yaml#

title: King Display KD035G6-54NT 3.5" (320x240 pixels) 24-bit TFT LCD panel

description: |
  The panel must obey the rules for a SPI slave device as specified in
  spi/spi-controller.yaml

maintainers:
  - Paul Cercueil <paul@crapouillou.net>

allOf:
  - $ref: panel-common.yaml#

properties:
  compatible:
    const: kingdisplay,kd035g6-54nt

  backlight: true
  port: true
  power-supply: true
  reg: true
  reset-gpios: true

required:
  - compatible
  - power-supply
  - reset-gpios

unevaluatedProperties: false

examples:
  - |
    #include <dt-bindings/gpio/gpio.h>

    spi {
        #address-cells = <1>;
        #size-cells = <0>;

        panel@0 {
            compatible = "kingdisplay,kd035g6-54nt";
            reg = <0>;

            spi-max-frequency = <3125000>;
            spi-3wire;

            reset-gpios = <&gpe 2 GPIO_ACTIVE_LOW>;

            backlight = <&backlight>;
            power-supply = <&ldo6>;

            port {
                panel_input: endpoint {
                    remote-endpoint = <&panel_output>;
                };
            };
        };
    };

...
```

## Documentation/devicetree/bindings/display/panel/kingdisplay,kd097d04.txt
```
Kingdisplay KD097D04 9.7" 1536x2048 TFT LCD panel

Required properties:
- compatible: should be "kingdisplay,kd097d04"
- reg: DSI virtual channel of the peripheral
- power-supply: phandle of the regulator that provides the supply voltage
- enable-gpios: panel enable gpio

Optional properties:
- backlight: phandle of the backlight device attached to the panel

Example:

	&mipi_dsi {
		panel {
			compatible = "kingdisplay,kd097d04";
			reg = <0>;
			power-supply = <...>;
			backlight = <&backlight>;
			enable-gpios = <&gpio1 13 GPIO_ACTIVE_HIGH>;
		};
	};
```

## Documentation/devicetree/bindings/display/panel/koe,tx14d24vm1bpa.txt
```
Kaohsiung Opto-Electronics Inc. 5.7" QVGA (320 x 240) TFT LCD panel

Required properties:
- compatible: should be "koe,tx14d24vm1bpa"
- backlight: phandle of the backlight device attached to the panel
- power-supply: single regulator to provide the supply voltage

Required nodes:
- port: Parallel port mapping to connect this display

This panel needs single power supply voltage. Its backlight is conntrolled
via PWM signal.

Example:
--------

Example device-tree definition when connected to iMX53 based board

	lcd_panel: lcd-panel {
		compatible = "koe,tx14d24vm1bpa";
		backlight = <&backlight_lcd>;
		power-supply = <&reg_3v3>;

		port {
			lcd_panel_in: endpoint {
				remote-endpoint = <&lcd_display_out>;
			};
		};
	};

Then one needs to extend the dispX node:

	lcd_display: disp1 {

		port@1 {
			reg = <1>;

			lcd_display_out: endpoint {
				remote-endpoint = <&lcd_panel_in>;
			};
		};
	};
```

## Documentation/devicetree/bindings/display/panel/koe,tx31d200vm0baa.txt
```
Kaohsiung Opto-Electronics. TX31D200VM0BAA 12.3" HSXGA LVDS panel

This binding is compatible with the simple-panel binding, which is specified
in simple-panel.txt in this directory.

Required properties:
- compatible: should be "koe,tx31d200vm0baa"

Optional properties:
- backlight: phandle of the backlight device attached to the panel

Optional nodes:
- Video port for LVDS panel input.

Example:
	panel {
		compatible = "koe,tx31d200vm0baa";
		backlight = <&backlight_lvds>;

		port {
			panel_in: endpoint {
				remote-endpoint = <&lvds0_out>;
			};
		};
	};
```

## Documentation/devicetree/bindings/display/panel/kyo,tcg121xglp.txt
```
Kyocera Corporation 12.1" XGA (1024x768) TFT LCD panel

Required properties:
- compatible: should be "kyo,tcg121xglp"

This binding is compatible with the simple-panel binding, which is specified
in simple-panel.txt in this directory.
```

## Documentation/devicetree/bindings/display/panel/leadtek,ltk035c5444t.yaml
```yaml
# SPDX-License-Identifier: (GPL-2.0-only OR BSD-2-Clause)
%YAML 1.2
---
$id: http://devicetree.org/schemas/display/panel/leadtek,ltk035c5444t.yaml#
$schema: http://devicetree.org/meta-schemas/core.yaml#

title: Leadtek ltk035c5444t 3.5" (640x480 pixels) 24-bit IPS LCD panel

maintainers:
  - Paul Cercueil <paul@crapouillou.net>
  - Christophe Branchereau <cbranchereau@gmail.com>

allOf:
  - $ref: panel-common.yaml#
  - $ref: /schemas/spi/spi-peripheral-props.yaml#

properties:
  compatible:
    const: leadtek,ltk035c5444t

  backlight: true
  port: true
  power-supply: true
  reg: true
  reset-gpios: true

required:
  - compatible
  - power-supply
  - reset-gpios

unevaluatedProperties: false

examples:
  - |
    #include <dt-bindings/gpio/gpio.h>

    spi {
        #address-cells = <1>;
        #size-cells = <0>;
        panel@0 {
            compatible = "leadtek,ltk035c5444t";
            reg = <0>;

            spi-3wire;
            spi-max-frequency = <3125000>;

            reset-gpios = <&gpe 2 GPIO_ACTIVE_LOW>;

            backlight = <&backlight>;
            power-supply = <&vcc>;

            port {
                panel_input: endpoint {
                    remote-endpoint = <&panel_output>;
                };
            };
        };
    };
```

## Documentation/devicetree/bindings/display/panel/leadtek,ltk050h3146w.yaml
```yaml
# SPDX-License-Identifier: (GPL-2.0-only OR BSD-2-Clause)
%YAML 1.2
---
$id: http://devicetree.org/schemas/display/panel/leadtek,ltk050h3146w.yaml#
$schema: http://devicetree.org/meta-schemas/core.yaml#

title: Leadtek LTK050H3146W 5.0in 720x1280 DSI panel

maintainers:
  - Heiko Stuebner <heiko.stuebner@theobroma-systems.com>

allOf:
  - $ref: panel-common.yaml#

properties:
  compatible:
    enum:
      - leadtek,ltk050h3146w
      - leadtek,ltk050h3146w-a2
  reg: true
  backlight: true
  reset-gpios: true
  iovcc-supply:
     description: regulator that supplies the iovcc voltage
  vci-supply:
     description: regulator that supplies the vci voltage

required:
  - compatible
  - reg
  - backlight
  - iovcc-supply
  - vci-supply

additionalProperties: false

examples:
  - |
    dsi {
        #address-cells = <1>;
        #size-cells = <0>;
        panel@0 {
            compatible = "leadtek,ltk050h3146w";
            reg = <0>;
            backlight = <&backlight>;
            iovcc-supply = <&vcc_1v8>;
            vci-supply = <&vcc3v3_lcd>;
        };
    };

...
```
