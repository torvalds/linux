## Documentation/devicetree/bindings/display/panel/leadtek,ltk500hd1829.yaml
```yaml
# SPDX-License-Identifier: (GPL-2.0-only OR BSD-2-Clause)
%YAML 1.2
---
$id: http://devicetree.org/schemas/display/panel/leadtek,ltk500hd1829.yaml#
$schema: http://devicetree.org/meta-schemas/core.yaml#

title: Leadtek LTK500HD1829 5.0in 720x1280 DSI panel

maintainers:
  - Heiko Stuebner <heiko.stuebner@theobroma-systems.com>

allOf:
  - $ref: panel-common.yaml#

properties:
  compatible:
    const: leadtek,ltk500hd1829
  reg: true
  backlight: true
  reset-gpios: true
  iovcc-supply:
    description: regulator that supplies the iovcc voltage
  vcc-supply:
    description: regulator that supplies the vcc voltage

required:
  - compatible
  - reg
  - backlight
  - iovcc-supply
  - vcc-supply

additionalProperties: false

examples:
  - |
    dsi {
        #address-cells = <1>;
        #size-cells = <0>;

        panel@0 {
            compatible = "leadtek,ltk500hd1829";
            reg = <0>;
            backlight = <&backlight>;
            iovcc-supply = <&vcc_1v8>;
            vcc-supply = <&vcc_2v8>;
        };
    };

...
```

## Documentation/devicetree/bindings/display/panel/lemaker,bl035-rgb-002.txt
```
LeMaker BL035-RGB-002 3.5" QVGA TFT LCD panel

Required properties:
- compatible: should be "lemaker,bl035-rgb-002"
- power-supply: as specified in the base binding

Optional properties:
- backlight: as specified in the base binding
- enable-gpios: as specified in the base binding

This binding is compatible with the simple-panel binding, which is specified
in simple-panel.txt in this directory.
```

## Documentation/devicetree/bindings/display/panel/lg,acx467akm-7.txt
```
LG ACX467AKM-7 4.95" 1080×1920 LCD Panel

Required properties:
- compatible: must be "lg,acx467akm-7"

This binding is compatible with the simple-panel binding, which is specified
in simple-panel.txt in this directory.
```

## Documentation/devicetree/bindings/display/panel/lg,lb070wv8.txt
```
LG 7" (800x480 pixels) TFT LCD panel

Required properties:
- compatible: should be "lg,lb070wv8"

This binding is compatible with the simple-panel binding, which is specified
in simple-panel.txt in this directory.
```

## Documentation/devicetree/bindings/display/panel/lg,ld070wx3-sl01.yaml
```yaml
# SPDX-License-Identifier: (GPL-2.0-only OR BSD-2-Clause)
%YAML 1.2
---
$id: http://devicetree.org/schemas/display/panel/lg,ld070wx3-sl01.yaml#
$schema: http://devicetree.org/meta-schemas/core.yaml#

title: LG Corporation 7" WXGA TFT LCD panel

maintainers:
  - Svyatoslav Ryhel <clamor95@gmail.com>

allOf:
  - $ref: panel-common.yaml#

properties:
  compatible:
    items:
      - const: lg,ld070wx3-sl01

  reg:
    maxItems: 1

  vdd-supply: true
  vcc-supply: true

  backlight: true
  port: true

required:
  - compatible
  - vdd-supply
  - vcc-supply

additionalProperties: false

examples:
  - |
    #include <dt-bindings/gpio/gpio.h>

    dsi {
        #address-cells = <1>;
        #size-cells = <0>;

        panel@0 {
            compatible = "lg,ld070wx3-sl01";
            reg = <0>;

            vdd-supply = <&vdd_3v3_lcd>;
            vcc-supply = <&vcc_1v8_lcd>;

            backlight = <&backlight>;

            port {
                endpoint {
                    remote-endpoint = <&dsi0_out>;
                };
            };
        };
    };
...
```

## Documentation/devicetree/bindings/display/panel/lg,lg4573.txt
```
LG LG4573 TFT Liquid Crystal Display with SPI control bus

Required properties:
  - compatible: "lg,lg4573"
  - reg: address of the panel on the SPI bus

The panel must obey rules for SPI slave device specified in document [1].

[1]: Documentation/devicetree/bindings/spi/spi-bus.txt

Example:

	lcd_panel: display@0 {
		#address-cells = <1>;
		#size-cells = <1>;
		compatible = "lg,lg4573";
		spi-max-frequency = <10000000>;
		reg = <0>;
	};
```

## Documentation/devicetree/bindings/display/panel/lg,lg4573.yaml
```yaml
# SPDX-License-Identifier: GPL-2.0
%YAML 1.2
---
$id: http://devicetree.org/schemas/display/panel/lg,lg4573.yaml#
$schema: http://devicetree.org/meta-schemas/core.yaml#

title: LG LG4573 TFT Liquid Crystal Display with SPI control bus

description: |
  The panel must obey the rules for a SPI slave device as specified in
  spi/spi-controller.yaml

maintainers:
  - Heiko Schocher <hs@denx.de>

allOf:
  - $ref: panel-common.yaml#

properties:
  compatible:
    const: lg,lg4573

  reg: true
  spi-max-frequency: true

required:
  - compatible
  - reg

unevaluatedProperties: false

examples:
  - |
    spi {
        #address-cells = <1>;
        #size-cells = <0>;

        lcd_panel: display@0 {
            compatible = "lg,lg4573";
            spi-max-frequency = <10000000>;
            reg = <0>;
        };
    };

...
```

## Documentation/devicetree/bindings/display/panel/lg,lh500wx1-sd03.txt
```
LG Corporation 5" HD TFT LCD panel

Required properties:
- compatible: should be "lg,lh500wx1-sd03"

This binding is compatible with the simple-panel binding, which is specified
in simple-panel.txt in this directory.
```

## Documentation/devicetree/bindings/display/panel/lg,lm238wr2-spa1.txt
```
LG Corporation 23.8" UHD TFT LCD panel

It has been designed to apply eDP(HBR2, 5.4Gbps) interface.

Required properties:
- compatible: should be "lg,lm238wr2-spa1"

This binding is compatible with the simple-panel binding, which is specified
in simple-panel.txt in this directory.
```

## Documentation/devicetree/bindings/display/panel/lg,lm270wr3-ssa1.txt
```
LG Corporation 27" UHD TFT LCD panel

It has been designed to apply eDP(HBR2, 5.4Gbps) interface.

Required properties:
- compatible: should be "lg,lm270wr3-ssa1"

This binding is compatible with the simple-panel binding, which is specified
in simple-panel.txt in this directory.
```

## Documentation/devicetree/bindings/display/panel/lg,lp079qx1-sp0v.txt
```
LG LP079QX1-SP0V 7.9" (1536x2048 pixels) TFT LCD panel

Required properties:
- compatible: should be "lg,lp079qx1-sp0v"

This binding is compatible with the simple-panel binding, which is specified
in simple-panel.txt in this directory.
```
