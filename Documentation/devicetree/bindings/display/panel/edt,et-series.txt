## Documentation/devicetree/bindings/display/panel/himax,hx8279.yaml
```yaml
# SPDX-License-Identifier: (GPL-2.0-only OR BSD-2-Clause)
%YAML 1.2
---
$id: http://devicetree.org/schemas/display/panel/himax,hx8279.yaml#
$schema: http://devicetree.org/meta-schemas/core.yaml#

title: Himax HX8279/HX8279-D based MIPI-DSI panels

maintainers:
  - AngeloGioacchino Del Regno <angelogioacchino.delregno@collabora.com>

description:
  The Himax HX8279 is a 1803 channel outputs source driver with MIPI
  TCON, which generates the horizontal and vertical control timing to
  the source and gate drivers.
  This DriverIC is most suitable for 1200x1920, 1080x1920, 1200x1600,
  and 600x1024 panels and outputs full RGB888 over two or four lanes,
  single or dual, MIPI-DSI video interface.

allOf:
  - $ref: panel-common-dual.yaml#

properties:
  compatible:
    items:
      - enum:
          - aoly,sl101pm1794fog-v15
          - startek,kd070fhfid078
      - const: himax,hx8279

  reg:
    maxItems: 1

  iovcc-supply:
    description: I/O voltage supply

  vdd-supply:
    description: Panel power supply

required:
  - compatible
  - reg
  - backlight
  - reset-gpios
  - iovcc-supply
  - vdd-supply

unevaluatedProperties: false

examples:
  - |
    #include <dt-bindings/gpio/gpio.h>

    dsi {
        #address-cells = <1>;
        #size-cells = <0>;

        panel@0 {
            compatible = "startek,kd070fhfid078", "himax,hx8279";
            reg = <0>;
            backlight = <&backlight>;
            enable-gpios = <&pio 25 GPIO_ACTIVE_HIGH>;
            reset-gpios = <&pio 45 GPIO_ACTIVE_HIGH>;
            iovcc-supply = <&vreg_lcm_vio>;
            vdd-supply = <&vreg_lcm_vdd>;

            port {
                panel_in: endpoint {
                    remote-endpoint = <&dsi_out>;
                };
            };
        };
    };

...
```

## Documentation/devicetree/bindings/display/panel/himax,hx83102.yaml
```yaml
# SPDX-License-Identifier: (GPL-2.0-only OR BSD-2-Clause)
%YAML 1.2
---
$id: http://devicetree.org/schemas/display/panel/himax,hx83102.yaml#
$schema: http://devicetree.org/meta-schemas/core.yaml#

title: Himax HX83102 MIPI-DSI LCD panel controller

maintainers:
  - Cong Yang <yangcong5@huaqin.corp-partner.google.com>

allOf:
  - $ref: panel-common.yaml#

properties:
  compatible:
    items:
      - enum:
          # Boe nv110wum-l60 11.0" WUXGA TFT LCD panel
          - boe,nv110wum-l60
          # IVO t109nw41 11.0" WUXGA TFT LCD panel
          - ivo,t109nw41
          # STARRY himax83102-j02 10.51" WUXGA TFT LCD panel
          - starry,himax83102-j02
      - const: himax,hx83102

  reg:
    description: the virtual channel number of a DSI peripheral

  enable-gpios:
    description: a GPIO spec for the enable pin

  pp1800-supply:
    description: core voltage supply

  avdd-supply:
    description: phandle of the regulator that provides positive voltage

  avee-supply:
    description: phandle of the regulator that provides negative voltage

  backlight: true
  port: true
  rotation: true

required:
  - compatible
  - reg
  - enable-gpios
  - pp1800-supply
  - avdd-supply
  - avee-supply

additionalProperties: false

examples:
  - |
    dsi {
        #address-cells = <1>;
        #size-cells = <0>;
        panel@0 {
            compatible = "starry,himax83102-j02", "himax,hx83102";
            reg = <0>;
            enable-gpios = <&pio 45 0>;
            avdd-supply = <&ppvarn_lcd>;
            avee-supply = <&ppvarp_lcd>;
            pp1800-supply = <&pp1800_lcd>;
            backlight = <&backlight_lcd0>;
            port {
                panel_in: endpoint {
                    remote-endpoint = <&dsi_out>;
                };
            };
        };
    };

...
```

## Documentation/devicetree/bindings/display/panel/himax,hx83112a.yaml
```yaml
# SPDX-License-Identifier: GPL-2.0-only OR BSD-2-Clause
%YAML 1.2
---
$id: http://devicetree.org/schemas/display/panel/himax,hx83112a.yaml#
$schema: http://devicetree.org/meta-schemas/core.yaml#

title: Himax HX83112A-based DSI display panels

maintainers:
  - Luca Weiss <luca.weiss@fairphone.com>

description:
  The Himax HX83112A is a generic DSI Panel IC used to control
  LCD panels.

allOf:
  - $ref: panel-common.yaml#

properties:
  compatible:
    contains:
      const: djn,9a-3r063-1102b

  vdd1-supply:
    description: Digital voltage rail

  vsn-supply:
    description: Positive source voltage rail

  vsp-supply:
    description: Negative source voltage rail

  reg: true
  port: true

required:
  - compatible
  - reg
  - reset-gpios
  - vdd1-supply
  - vsn-supply
  - vsp-supply
  - port

unevaluatedProperties: false

examples:
  - |
    #include <dt-bindings/gpio/gpio.h>

    dsi {
        #address-cells = <1>;
        #size-cells = <0>;

        panel@0 {
            compatible = "djn,9a-3r063-1102b";
            reg = <0>;

            backlight = <&pm6150l_wled>;
            reset-gpios = <&pm6150l_gpios 9 GPIO_ACTIVE_LOW>;

            vdd1-supply = <&vreg_l1e>;
            vsn-supply = <&pm6150l_lcdb_ncp>;
            vsp-supply = <&pm6150l_lcdb_ldo>;

            port {
                panel_in_0: endpoint {
                    remote-endpoint = <&dsi0_out>;
                };
            };
        };
    };

...
```

## Documentation/devicetree/bindings/display/panel/himax,hx83112b.yaml
```yaml
# SPDX-License-Identifier: GPL-2.0-only OR BSD-2-Clause
%YAML 1.2
---
$id: http://devicetree.org/schemas/display/panel/himax,hx83112b.yaml#
$schema: http://devicetree.org/meta-schemas/core.yaml#

title: Himax HX83112B-based DSI display panels

maintainers:
  - Luca Weiss <luca@lucaweiss.eu>

description:
  The Himax HX83112B is a generic DSI Panel IC used to control
  LCD panels.

allOf:
  - $ref: panel-common.yaml#

properties:
  compatible:
    contains:
      const: djn,98-03057-6598b-i

  reg:
    maxItems: 1

  iovcc-supply:
    description: I/O voltage rail

  vsn-supply:
    description: Positive source voltage rail

  vsp-supply:
    description: Negative source voltage rail

required:
  - compatible
  - reg
  - reset-gpios
  - iovcc-supply
  - vsn-supply
  - vsp-supply
  - port

unevaluatedProperties: false

examples:
  - |
    #include <dt-bindings/gpio/gpio.h>

    dsi {
        #address-cells = <1>;
        #size-cells = <0>;

        panel@0 {
            compatible = "djn,98-03057-6598b-i";
            reg = <0>;

            reset-gpios = <&tlmm 61 GPIO_ACTIVE_LOW>;

            iovcc-supply = <&pm8953_l6>;
            vsn-supply = <&pmi632_lcdb_ncp>;
            vsp-supply = <&pmi632_lcdb_ldo>;

            port {
                panel_in_0: endpoint {
                    remote-endpoint = <&dsi0_out>;
                };
            };
        };
    };

...
```

## Documentation/devicetree/bindings/display/panel/himax,hx83121a.yaml
```yaml
# SPDX-License-Identifier: GPL-2.0-only OR BSD-2-Clause
%YAML 1.2
---
$id: http://devicetree.org/schemas/display/panel/himax,hx83121a.yaml#
$schema: http://devicetree.org/meta-schemas/core.yaml#

title: Himax HX83121A based DSI display Panels

maintainers:
  - Pengyu Luo <mitltlatltl@gmail.com>

description:
  The Himax HX83121A is a generic DSI Panel IC used to drive dsi
  panels. Support video mode panels from China Star Optoelectronics
  Technology (CSOT) and BOE Technology.

allOf:
  - $ref: panel-common-dual.yaml#

properties:
  compatible:
    items:
      - enum:
          - boe,ppc357db1-4
          - csot,ppc357db1-4
      - const: himax,hx83121a

  reg:
    maxItems: 1

  reset-gpios:
    maxItems: 1

  avdd-supply:
    description: analog positive supply for IC

  avee-supply:
    description: analog negative supply for IC

  vddi-supply:
    description: power supply for IC

  backlight: true
  ports: true

required:
  - compatible
  - reg
  - vddi-supply
  - reset-gpios
  - ports

additionalProperties: false

examples:
  - |
    #include <dt-bindings/gpio/gpio.h>

    dsi {
        #address-cells = <1>;
        #size-cells = <0>;

        panel@0 {
            compatible = "csot,ppc357db1-4", "himax,hx83121a";
            reg = <0>;

            vddi-supply = <&vreg_l2b>;
            reset-gpios = <&tlmm 38 GPIO_ACTIVE_LOW>;

            ports {
                #address-cells = <1>;
                #size-cells = <0>;

                port@0 {
                    reg = <0>;
                    panel_in_0: endpoint {
                        remote-endpoint = <&dsi0_out>;
                    };
                };

                port@1{
                    reg = <1>;
                    panel_in_1: endpoint {
                        remote-endpoint = <&dsi1_out>;
                    };
                };
            };
        };
    };

...
```

## Documentation/devicetree/bindings/display/panel/himax,hx8394.yaml
```yaml
# SPDX-License-Identifier: (GPL-2.0-only OR BSD-2-Clause)
%YAML 1.2
---
$id: http://devicetree.org/schemas/display/panel/himax,hx8394.yaml#
$schema: http://devicetree.org/meta-schemas/core.yaml#

title: Himax HX8394 MIPI-DSI LCD panel controller

maintainers:
  - Ondrej Jirman <megi@xff.cz>
  - Javier Martinez Canillas <javierm@redhat.com>

description:
  Device tree bindings for panels based on the Himax HX8394 controller,
  such as the HannStar HSD060BHW4 720x1440 TFT LCD panel connected with
  a MIPI-DSI video interface.

properties:
  compatible:
    oneOf:
      - items:
          - enum:
              - hannstar,hsd060bhw4
              - microchip,ac40t08a-mipi-panel
              - powkiddy,x55-panel
          - const: himax,hx8394
      - items:
          - enum:
              - huiling,hl055fhav028c
          - const: himax,hx8399c

  reg:
    maxItems: 1

  reset-gpios: true

  backlight: true

  rotation: true

  port: true

  vcc-supply:
    description: Panel power supply

  iovcc-supply:
    description: I/O voltage supply

required:
  - compatible
  - reg
  - backlight
  - port
  - vcc-supply
  - iovcc-supply

additionalProperties: false

allOf:
  - $ref: panel-common.yaml#
  - if:
      not:
        properties:
          compatible:
            enum:
              - microchip,ac40t08a-mipi-panel
    then:
      required:
        - reset-gpios

examples:
  - |
    #include <dt-bindings/gpio/gpio.h>

    dsi {
        #address-cells = <1>;
        #size-cells = <0>;
        panel@0 {
            compatible = "hannstar,hsd060bhw4", "himax,hx8394";
            reg = <0>;
            vcc-supply = <&reg_2v8_p>;
            iovcc-supply = <&reg_1v8_p>;
            reset-gpios = <&gpio3 13 GPIO_ACTIVE_LOW>;
            backlight = <&backlight>;

            port {
                mipi_in_panel: endpoint {
                    remote-endpoint = <&mipi_out_panel>;
                };
            };
        };
    };

...
```

## Documentation/devicetree/bindings/display/panel/hit,tx23d38vm0caa.txt
```
Hitachi Ltd. Corporation 9" WVGA (800x480) TFT LCD panel

Required properties:
- compatible: should be "hit,tx23d38vm0caa"

This binding is compatible with the simple-panel binding, which is specified
in simple-panel.txt in this directory.
```

## Documentation/devicetree/bindings/display/panel/hydis,hv101hd1.yaml
```yaml
# SPDX-License-Identifier: (GPL-2.0-only OR BSD-2-Clause)
%YAML 1.2
---
$id: http://devicetree.org/schemas/display/panel/hydis,hv101hd1.yaml#
$schema: http://devicetree.org/meta-schemas/core.yaml#

title: Hydis HV101HD1 DSI Display Panel

maintainers:
  - Svyatoslav Ryhel <clamor95@gmail.com>

allOf:
  - $ref: panel-common.yaml#

properties:
  compatible:
    const: hydis,hv101hd1

  reg:
    maxItems: 1

  vdd-supply: true
  vio-supply: true

  backlight: true
  port: true

required:
  - compatible
  - vdd-supply
  - vio-supply
  - backlight

additionalProperties: false

examples:
  - |
    #include <dt-bindings/gpio/gpio.h>

    dsi {
        #address-cells = <1>;
        #size-cells = <0>;

        panel@0 {
            compatible = "hydis,hv101hd1";
            reg = <0>;

            vdd-supply = <&vdd_lcd>;
            vio-supply = <&vddio_lcd>;

            backlight = <&backlight>;

            port {
                panel_in: endpoint {
                    remote-endpoint = <&dsi_out>;
                };
            };
        };
    };
...
```

## Documentation/devicetree/bindings/display/panel/ilitek,il79900a.yaml
```yaml
# SPDX-License-Identifier: (GPL-2.0-only OR BSD-2-Clause)
%YAML 1.2
---
$id: http://devicetree.org/schemas/display/panel/ilitek,il79900a.yaml#
$schema: http://devicetree.org/meta-schemas/core.yaml#

title: Ilitek IL79900a based MIPI-DSI panels

maintainers:
  - Langyan Ye <yelangyan@huaqin.corp-partner.google.com>

allOf:
  - $ref: panel-common.yaml#

properties:
  compatible:
    items:
      - enum:
          - tianma,tl121bvms07-00
      - const: ilitek,il79900a

  reg:
    maxItems: 1
    description: DSI virtual channel used by the panel

  enable-gpios:
    maxItems: 1
    description: GPIO specifier for the enable pin

  avdd-supply:
    description: Positive analog voltage supply (AVDD)

  avee-supply:
    description: Negative analog voltage supply (AVEE)

  pp1800-supply:
    description: 1.8V logic voltage supply

  backlight: true

required:
  - compatible
  - reg
  - enable-gpios
  - avdd-supply
  - avee-supply
  - pp1800-supply

additionalProperties: false

examples:
  - |
    dsi {
        #address-cells = <1>;
        #size-cells = <0>;

        panel@0 {
            compatible = "tianma,tl121bvms07-00", "ilitek,il79900a";
            reg = <0>;
            enable-gpios = <&pio 25 0>;
            avdd-supply = <&reg_avdd>;
            avee-supply = <&reg_avee>;
            pp1800-supply = <&reg_pp1800>;
            backlight = <&backlight>;
        };
    };

...
```

## Documentation/devicetree/bindings/display/panel/ilitek,ili7807s.yaml
```yaml
# SPDX-License-Identifier: GPL-2.0-only OR BSD-2-Clause
%YAML 1.2
---
$id: http://devicetree.org/schemas/display/panel/ilitek,ili7807s.yaml#
$schema: http://devicetree.org/meta-schemas/core.yaml#

title: Ilitek ILI7807S-based DSI panels

maintainers:
  - Arpit Saini <arpit.saini@oss.qualcomm.com>

allOf:
  - $ref: panel-common.yaml#

properties:
  compatible:
    items:
      - enum:
          - dlc,dlc0697
      - const: ilitek,ili7807s

  reg:
    maxItems: 1
    description: DSI virtual channel

  vddi-supply:
    description: I/O voltage supply (1.8V)

  avdd-supply:
    description: Positive LCD bias supply (AVDD), typically +5.5V
      (range 4.5V to 6.3V)

  avee-supply:
    description: Negative LCD bias supply (AVEE), typically -5.5V
      (range -6.3V to -4.5V)

required:
  - compatible
  - reg
  - reset-gpios
  - vddi-supply
  - avdd-supply
  - avee-supply
  - port

unevaluatedProperties: false

examples:
  - |
    #include <dt-bindings/gpio/gpio.h>

    dsi {
        #address-cells = <1>;
        #size-cells = <0>;

        panel@0 {
            compatible = "dlc,dlc0697", "ilitek,ili7807s";
            reg = <0>;

            reset-gpios = <&tlmm 3 GPIO_ACTIVE_LOW>;
            vddi-supply = <&pm4125_l15>;
            avdd-supply = <&avdd>;
            avee-supply = <&avee>;

            port {
                panel_in: endpoint {
                    remote-endpoint = <&dsi0_out>;
                };
            };
        };
    };
```
