## Documentation/devicetree/bindings/display/panel/edt,et-series.txt
```
Emerging Display Technology Corp. Displays
==========================================


Display bindings for EDT Display Technology Corp. Displays which are
compatible with the simple-panel binding, which is specified in
simple-panel.txt

3,5" QVGA TFT Panels
--------------------
+-----------------+---------------------+-------------------------------------+
| Identifier      | compatbile          | description                         |
+=================+=====================+=====================================+
| ET035012DM6     | edt,et035012dm6     | 3.5" QVGA TFT LCD panel             |
+-----------------+---------------------+-------------------------------------+

4,3" WVGA TFT Panels
--------------------

+-----------------+---------------------+-------------------------------------+
| Identifier      | compatbile          | description                         |
+=================+=====================+=====================================+
| ETM0430G0DH6    | edt,etm0430g0dh6    | 480x272 TFT Display                 |
+-----------------+---------------------+-------------------------------------+

5,7" WVGA TFT Panels
--------------------

+-----------------+---------------------+-------------------------------------+
| Identifier      | compatbile          | description                         |
+=================+=====================+=====================================+
| ET057090DHU     | edt,et057090dhu     | 5.7" VGA TFT LCD panel              |
+-----------------+---------------------+-------------------------------------+


7,0" WVGA TFT Panels
--------------------

+-----------------+---------------------+-------------------------------------+
| Identifier      | compatbile          | description                         |
+=================+=====================+=====================================+
| ETM0700G0DH6    | edt,etm070080dh6    | WVGA TFT Display with capacitive    |
|                 | edt,etm0700g0dh6    | Touchscreen                         |
+-----------------+---------------------+-------------------------------------+
| ETM0700G0BDH6   | edt,etm070080bdh6   | Same as ETM0700G0DH6 but with       |
|                 |                     | inverted pixel clock.               |
+-----------------+---------------------+-------------------------------------+
| ETM0700G0EDH6   | edt,etm070080edh6   | Same display as the ETM0700G0BDH6,  |
|                 |                     | but with changed Hardware for the   |
|                 |                     | backlight and the touch interface   |
+-----------------+---------------------+-------------------------------------+
| ET070080DH6     | edt,etm070080dh6    | Same timings as the ETM0700G0DH6,   |
|                 |                     | but with resistive touch.           |
+-----------------+---------------------+-------------------------------------+
```

## Documentation/devicetree/bindings/display/panel/edt,et057090dhu.txt
```
Emerging Display Technology Corp. 5.7" VGA TFT LCD panel

Required properties:
- compatible: should be "edt,et057090dhu"

This binding is compatible with the simple-panel binding, which is specified
in simple-panel.txt in this directory.
```

## Documentation/devicetree/bindings/display/panel/elida,kd35t133.yaml
```yaml
# SPDX-License-Identifier: (GPL-2.0-only OR BSD-2-Clause)
%YAML 1.2
---
$id: http://devicetree.org/schemas/display/panel/elida,kd35t133.yaml#
$schema: http://devicetree.org/meta-schemas/core.yaml#

title: Elida KD35T133 3.5in 320x480 DSI panel

maintainers:
  - Heiko Stuebner <heiko.stuebner@theobroma-systems.com>

allOf:
  - $ref: panel-common.yaml#

properties:
  compatible:
    const: elida,kd35t133
  reg: true
  backlight: true
  port: true
  reset-gpios: true
  rotation: true
  iovcc-supply:
    description: regulator that supplies the iovcc voltage
  vdd-supply:
    description: regulator that supplies the vdd voltage

required:
  - compatible
  - reg
  - backlight
  - port
  - iovcc-supply
  - vdd-supply

additionalProperties: false

examples:
  - |
    dsi {
        #address-cells = <1>;
        #size-cells = <0>;
        panel@0 {
            compatible = "elida,kd35t133";
            reg = <0>;
            backlight = <&backlight>;
            iovcc-supply = <&vcc_1v8>;
            vdd-supply = <&vcc3v3_lcd>;

            port {
                mipi_in_panel: endpoint {
                    remote-endpoint = <&mipi_out_panel>;
                };
            };
        };
    };

...
```

## Documentation/devicetree/bindings/display/panel/evervision,vgg804821.txt
```
Evervision Electronics Co. Ltd. VGG804821 5.0" WVGA TFT LCD Panel

Required properties:
- compatible: should be "evervision,vgg804821"
- power-supply: See simple-panel.txt

Optional properties:
- backlight: See simple-panel.txt
- enable-gpios: See simple-panel.txt

This binding is compatible with the simple-panel binding, which is specified
in simple-panel.txt in this directory.
```

## Documentation/devicetree/bindings/display/panel/fascontek,fs035vg158.yaml
```yaml
# SPDX-License-Identifier: (GPL-2.0-only OR BSD-2-Clause)
%YAML 1.2
---
$id: http://devicetree.org/schemas/display/panel/fascontek,fs035vg158.yaml#
$schema: http://devicetree.org/meta-schemas/core.yaml#

title: Fascontek FS035VG158 3.5" (640x480 pixels) 24-bit IPS LCD panel

maintainers:
  - John Watts <contact@jookia.org>

allOf:
  - $ref: panel-common.yaml#
  - $ref: /schemas/spi/spi-peripheral-props.yaml#

properties:
  compatible:
    const: fascontek,fs035vg158

  reg:
    maxItems: 1

  spi-3wire: true

required:
  - compatible
  - reg
  - port
  - power-supply
  - reset-gpios

unevaluatedProperties: false

examples:
  - |
    #include <dt-bindings/gpio/gpio.h>

    spi {
        #address-cells = <1>;
        #size-cells = <0>;
        panel@0 {
            compatible = "fascontek,fs035vg158";
            reg = <0>;

            spi-3wire;
            spi-max-frequency = <3125000>;

            reset-gpios = <&gpe 2 GPIO_ACTIVE_LOW>;

            backlight = <&backlight>;
            power-supply = <&vcc>;

            port {
                panel_input: endpoint {
                    remote-endpoint = <&panel_output>;
                };
            };
        };
    };
```

## Documentation/devicetree/bindings/display/panel/feixin,k101-im2ba02.yaml
```yaml
# SPDX-License-Identifier: (GPL-2.0-only OR BSD-2-Clause)
%YAML 1.2
---
$id: http://devicetree.org/schemas/display/panel/feixin,k101-im2ba02.yaml#
$schema: http://devicetree.org/meta-schemas/core.yaml#

title: Feixin K101 IM2BA02 10.1" MIPI-DSI LCD panel

maintainers:
  - Icenowy Zheng <icenowy@aosc.io>

allOf:
  - $ref: panel-common.yaml#

properties:
  compatible:
    const: feixin,k101-im2ba02
  reg: true
  backlight: true
  reset-gpios: true
  avdd-supply:
     description: regulator that supplies the AVDD voltage
  dvdd-supply:
     description: regulator that supplies the DVDD voltage
  cvdd-supply:
     description: regulator that supplies the CVDD voltage

required:
  - compatible
  - reg
  - avdd-supply
  - dvdd-supply
  - cvdd-supply

additionalProperties: false

examples:
  - |
    #include <dt-bindings/gpio/gpio.h>

    dsi {
        #address-cells = <1>;
        #size-cells = <0>;
        panel@0 {
            compatible = "feixin,k101-im2ba02";
            reg = <0>;
            avdd-supply = <&reg_dc1sw>;
            dvdd-supply = <&reg_dc1sw>;
            cvdd-supply = <&reg_ldo_io1>;
            reset-gpios = <&pio 3 24 GPIO_ACTIVE_HIGH>;
            backlight = <&backlight>;
        };
    };

...
```

## Documentation/devicetree/bindings/display/panel/feiyang,fy07024di26a30d.txt
```
Feiyang FY07024DI26A30-D 7" MIPI-DSI LCD Panel

Required properties:
- compatible: must be "feiyang,fy07024di26a30d"
- reg: DSI virtual channel used by that screen
- avdd-supply: analog regulator dc1 switch
- dvdd-supply: 3v3 digital regulator
- reset-gpios: a GPIO phandle for the reset pin

Optional properties:
- backlight: phandle for the backlight control.

panel@0 {
	compatible = "feiyang,fy07024di26a30d";
	reg = <0>;
	avdd-supply = <&reg_dc1sw>;
	dvdd-supply = <&reg_dldo2>;
	reset-gpios = <&pio 3 24 GPIO_ACTIVE_HIGH>; /* LCD-RST: PD24 */
	backlight = <&backlight>;
};
```

## Documentation/devicetree/bindings/display/panel/feiyang,fy07024di26a30d.yaml
```yaml
# SPDX-License-Identifier: (GPL-2.0-only OR BSD-2-Clause)
%YAML 1.2
---
$id: http://devicetree.org/schemas/display/panel/feiyang,fy07024di26a30d.yaml#
$schema: http://devicetree.org/meta-schemas/core.yaml#

title: Feiyang FY07024DI26A30-D 7" MIPI-DSI LCD Panel

maintainers:
  - Jagan Teki <jagan@amarulasolutions.com>

allOf:
  - $ref: panel-common.yaml#

properties:
  compatible:
    const: feiyang,fy07024di26a30d

  reg:
    description: DSI virtual channel used by that screen
    maxItems: 1

  avdd-supply:
    description: analog regulator dc1 switch

  dvdd-supply:
    description: 3v3 digital regulator

  reset-gpios: true

  backlight: true

required:
  - compatible
  - reg
  - avdd-supply
  - dvdd-supply
  - reset-gpios

additionalProperties: false

examples:
  - |
    #include <dt-bindings/gpio/gpio.h>

    dsi {
        #address-cells = <1>;
        #size-cells = <0>;

        panel@0 {
            compatible = "feiyang,fy07024di26a30d";
            reg = <0>;
            avdd-supply = <&reg_dc1sw>;
            dvdd-supply = <&reg_dldo2>;
            reset-gpios = <&pio 3 24 GPIO_ACTIVE_HIGH>; /* LCD-RST: PD24 */
            backlight = <&backlight>;
        };
    };
```

## Documentation/devicetree/bindings/display/panel/focaltech,gpt3.yaml
```yaml
# SPDX-License-Identifier: (GPL-2.0 OR BSD-2-Clause)
%YAML 1.2
---
$id: http://devicetree.org/schemas/display/panel/focaltech,gpt3.yaml#
$schema: http://devicetree.org/meta-schemas/core.yaml#

title: Focaltech GPT3 3.0" (640x480 pixels) IPS LCD panel

maintainers:
  - Christophe Branchereau <cbranchereau@gmail.com>

allOf:
  - $ref: panel-common.yaml#
  - $ref: /schemas/spi/spi-peripheral-props.yaml#

properties:
  compatible:
    const: focaltech,gpt3

  reg:
    maxItems: 1

required:
  - compatible
  - reg
  - power-supply
  - reset-gpios

unevaluatedProperties: false

examples:
  - |
    #include <dt-bindings/gpio/gpio.h>

    spi {
        #address-cells = <1>;
        #size-cells = <0>;

        panel@0 {
            compatible = "focaltech,gpt3";
            reg = <0>;

            spi-max-frequency = <3125000>;

            reset-gpios = <&gpe 2 GPIO_ACTIVE_LOW>;

            backlight = <&backlight>;
            power-supply = <&vcc>;

            port {
                panel_input: endpoint {
                    remote-endpoint = <&panel_output>;
                };
            };
        };
    };
```

## Documentation/devicetree/bindings/display/panel/focaltech,ota7290b.yaml
```yaml
# SPDX-License-Identifier: (GPL-2.0-only OR BSD-2-Clause)
%YAML 1.2
---
$id: http://devicetree.org/schemas/display/panel/focaltech,ota7290b.yaml#
$schema: http://devicetree.org/meta-schemas/core.yaml#

title: Focaltech OTA7290B DSI panels

maintainers:
  - Dmitry Baryshkov <dmitry.baryshkov@oss.qualcomm.com>

allOf:
  - $ref: panel-common.yaml#

properties:
  compatible:
    const: waveshare,8.8-dsi-touch-a

  reg:
    maxItems: 1

  vdd-supply:
    description: supply regulator for VDD, usually 3.3V

  vdda-supply:
    description: supply regulator for VDDA, 7-10V

  vcc-supply:
    description: supply regulator for VCCIO, usually 1.5V

  reset-gpios: true
  backlight: true
  rotation: true
  port: true

required:
  - compatible
  - reg
  - vdd-supply
  - vcc-supply
  - reset-gpios

additionalProperties: false

examples:
  - |
    #include <dt-bindings/gpio/gpio.h>

    dsi {
        #address-cells = <1>;
        #size-cells = <0>;

        panel@0 {
            compatible = "waveshare,8.8-dsi-touch-a";
            reg = <0>;
            vdd-supply = <&vdd>;
            vcc-supply = <&vccio>;
            reset-gpios = <&gpio 1 GPIO_ACTIVE_HIGH>;
            backlight = <&backlight>;

            port {
                endpoint {
                    remote-endpoint = <&mipi_out_panel>;
                };
            };
        };
    };

...
```

## Documentation/devicetree/bindings/display/panel/friendlyarm,hd702e.txt
```
FriendlyELEC HD702E 800x1280 LCD panel

HD702E lcd is FriendlyELEC developed eDP LCD panel with 800x1280
resolution. It has built in Goodix, GT9271 captive touchscreen
with backlight adjustable via PWM.

Required properties:
- compatible: should be "friendlyarm,hd702e"
- power-supply: regulator to provide the supply voltage

Optional properties:
- backlight: phandle of the backlight device attached to the panel

Optional nodes:
- Video port for LCD panel input.

This binding is compatible with the simple-panel binding, which is specified
in simple-panel.txt in this directory.

Example:

	panel {
		compatible ="friendlyarm,hd702e", "simple-panel";
		backlight = <&backlight>;
		power-supply = <&vcc3v3_sys>;

		port {
			panel_in_edp: endpoint {
				remote-endpoint = <&edp_out_panel>;
			};
		};
	};
```

## Documentation/devicetree/bindings/display/panel/giantplus,gpg482739qs5.txt
```
GiantPlus GPG48273QS5 4.3" (480x272) WQVGA TFT LCD panel

Required properties:
- compatible: should be "giantplus,gpg48273qs5"

This binding is compatible with the simple-panel binding, which is specified
in simple-panel.txt in this directory.
```

## Documentation/devicetree/bindings/display/panel/giantplus,gpm940b0.txt
```
GiantPlus 3.0" (320x240 pixels) 24-bit TFT LCD panel

Required properties:
- compatible: should be "giantplus,gpm940b0"
- power-supply: as specified in the base binding

Optional properties:
- backlight: as specified in the base binding
- enable-gpios: as specified in the base binding

This binding is compatible with the simple-panel binding, which is specified
in simple-panel.txt in this directory.
```

## Documentation/devicetree/bindings/display/panel/hannstar,hsd070pww1.txt
```
HannStar Display Corp. HSD070PWW1 7.0" WXGA TFT LCD panel

Required properties:
- compatible: should be "hannstar,hsd070pww1"

This binding is compatible with the simple-panel binding, which is specified
in simple-panel.txt in this directory.
```

## Documentation/devicetree/bindings/display/panel/hannstar,hsd100pxn1.txt
```
HannStar Display Corp. HSD100PXN1 10.1" XGA LVDS panel

Required properties:
- compatible: should be "hannstar,hsd100pxn1"

This binding is compatible with the simple-panel binding, which is specified
in simple-panel.txt in this directory.
```
