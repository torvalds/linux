## Documentation/devicetree/bindings/display/panel/chipwealth,ch13726a.yaml
```yaml
# SPDX-License-Identifier: (GPL-2.0-only OR BSD-2-Clause)
%YAML 1.2
---
$id: http://devicetree.org/schemas/display/panel/chipwealth,ch13726a.yaml#
$schema: http://devicetree.org/meta-schemas/core.yaml#

title: Chip Wealth Technology CH13726A AMOLED driver

maintainers:
  - Neil Armstrong <neil.armstrong@linaro.org>

description:
  Chip Wealth Technology CH13726A is a single-chip solution
  for AMOLED connected using a MIPI-DSI video interface.

allOf:
  - $ref: panel-common.yaml#

properties:
  compatible:
    items:
      - const: ayntec,thor-panel-bottom
      - const: chipwealth,ch13726a

  reg:
    maxItems: 1
    description: DSI virtual channel

  vdd-supply: true
  vddio-supply: true
  vdd1v2-supply: true
  avdd-supply: true

  port: true
  reset-gpios: true
  rotation: true

required:
  - compatible
  - reg
  - vdd-supply
  - vddio-supply
  - vdd1v2-supply
  - avdd-supply
  - reset-gpios

additionalProperties: false

examples:
  - |
    #include <dt-bindings/gpio/gpio.h>

    dsi {
        #address-cells = <1>;
        #size-cells = <0>;
        panel@0 {
            compatible = "ayntec,thor-panel-bottom", "chipwealth,ch13726a";
            reg = <0>;
            vdd1v2-supply = <&vreg_l11b_1p2>;
            vddio-supply = <&vdd_disp_1v8>;
            vdd-supply = <&vreg_l13b_3p0>;
            avdd-supply = <&vdd_disp2_2v8>;
            reset-gpios = <&tlmm 133 GPIO_ACTIVE_HIGH>;
        };
    };

...
```

## Documentation/devicetree/bindings/display/panel/chunghwa,claa070wp03xg.txt
```
Chunghwa Picture Tubes Ltd. 7" WXGA TFT LCD panel

Required properties:
- compatible: should be "chunghwa,claa070wp03xg"

This binding is compatible with the simple-panel binding, which is specified
in simple-panel.txt in this directory.
```

## Documentation/devicetree/bindings/display/panel/chunghwa,claa101wa01a.txt
```
Chunghwa Picture Tubes Ltd. 10.1" WXGA TFT LCD panel

Required properties:
- compatible: should be "chunghwa,claa101wa01a"

This binding is compatible with the simple-panel binding, which is specified
in simple-panel.txt in this directory.
```

## Documentation/devicetree/bindings/display/panel/dataimage,scf0700c48ggu18.txt
```
DataImage, Inc. 7" WVGA (800x480) TFT LCD panel with 24-bit parallel interface.

Required properties:
- compatible: should be "dataimage,scf0700c48ggu18"
- power-supply: as specified in the base binding

This binding is compatible with the simple-panel binding, which is specified
in simple-panel.txt in this directory.
```

## Documentation/devicetree/bindings/display/panel/display-timings.yaml
```yaml
# SPDX-License-Identifier: (GPL-2.0-only OR BSD-2-Clause)
%YAML 1.2
---
$id: http://devicetree.org/schemas/display/panel/display-timings.yaml#
$schema: http://devicetree.org/meta-schemas/core.yaml#

title: display timings bindings

maintainers:
  - Thierry Reding <thierry.reding@gmail.com>
  - Laurent Pinchart <laurent.pinchart+renesas@ideasonboard.com>
  - Sam Ravnborg <sam@ravnborg.org>

description: |
  A display panel may be able to handle several display timings,
  with different resolutions.
  The display-timings node makes it possible to specify the timings
  and to specify the timing that is native for the display.

properties:
  $nodename:
    const: display-timings

  native-mode:
    $ref: /schemas/types.yaml#/definitions/phandle
    description: |
      The default display timing is the one specified as native-mode.
      If no native-mode is specified then the first node is assumed
      to be the native mode.

patternProperties:
  "^timing":
    type: object
    allOf:
      - $ref: panel-timing.yaml#

additionalProperties: false

examples:
  - |+

    /*
     * Example that specifies panel timing using minimum, typical,
     * maximum values as commonly used in datasheet description.
     * timing1 is the native-mode.
     */
    display-timings {
        native-mode = <&timing1>;
        timing0 {
            /* 1920x1080p24 */
            clock-frequency = <148500000>;
            hactive = <1920>;
            vactive = <1080>;
            hsync-len = <0 44 60>;
            hfront-porch = <80 88 95>;
            hback-porch = <100 148 160>;
            vfront-porch = <0 4 6>;
            vback-porch = <0 36 50>;
            vsync-len = <0 5 6>;
        };
        timing1 {
            /* 1920x1080p24 */
            clock-frequency = <52000000>;
            hactive = <1920>;
            vactive = <1080>;
            hfront-porch = <25>;
            hback-porch = <25>;
            hsync-len = <0 25 25>;
            vback-porch = <2>;
            vfront-porch = <2>;
            vsync-len = <2>;
            hsync-active = <1>;
            pixelclk-active = <1>;
        };
    };

...
```

## Documentation/devicetree/bindings/display/panel/dlc,dlc0700yzg-1.txt
```
DLC Display Co. DLC0700YZG-1 7.0" WSVGA TFT LCD panel

Required properties:
- compatible: should be "dlc,dlc0700yzg-1"
- power-supply: See simple-panel.txt

Optional properties:
- reset-gpios: See panel-common.txt
- enable-gpios: See simple-panel.txt
- backlight: See simple-panel.txt

This binding is compatible with the simple-panel binding, which is specified
in simple-panel.txt in this directory.
```

## Documentation/devicetree/bindings/display/panel/dlc,dlc0700yzg-1.yaml
```yaml
# SPDX-License-Identifier: GPL-2.0
%YAML 1.2
---
$id: http://devicetree.org/schemas/display/panel/dlc,dlc0700yzg-1.yaml#
$schema: http://devicetree.org/meta-schemas/core.yaml#

title: DLC Display Co. DLC0700YZG-1 7.0" WSVGA TFT LCD panel

maintainers:
  - Philipp Zabel <p.zabel@pengutronix.de>
  - Thierry Reding <thierry.reding@gmail.com>

allOf:
  - $ref: panel-common.yaml#

properties:
  compatible:
    const: dlc,dlc0700yzg-1

  reset-gpios: true
  enable-gpios: true
  backlight: true
  port: true

additionalProperties: false

required:
  - compatible
  - power-supply

...
```

## Documentation/devicetree/bindings/display/panel/dlc,dlc1010gig.txt
```
DLC Display Co. DLC1010GIG 10.1" WXGA TFT LCD Panel

Required properties:
- compatible: should be "dlc,dlc1010gig"
- power-supply: See simple-panel.txt

Optional properties:
- enable-gpios: See simple-panel.txt
- backlight: See simple-panel.txt

This binding is compatible with the simple-panel binding, which is specified
in simple-panel.txt in this directory.
```

## Documentation/devicetree/bindings/display/panel/ebbg,ft8719.yaml
```yaml
# SPDX-License-Identifier: GPL-2.0-only OR BSD-2-Clause
%YAML 1.2
---
$id: http://devicetree.org/schemas/display/panel/ebbg,ft8719.yaml#
$schema: http://devicetree.org/meta-schemas/core.yaml#

title: EBBG FT8719 MIPI-DSI LCD panel

maintainers:
  - Joel Selvaraj <jo@jsfamily.in>

description: |
  The FT8719 panel from EBBG is a FHD+ LCD display panel with a resolution
  of 1080x2246. It is a video mode DSI panel. The backlight is managed
  through the QCOM WLED driver.

allOf:
  - $ref: panel-common.yaml#

properties:
  compatible:
    const: ebbg,ft8719

  reg:
    maxItems: 1
    description: DSI virtual channel of the peripheral

  vddio-supply:
    description: power IC supply regulator

  vddpos-supply:
    description: positive boost supply regulator

  vddneg-supply:
    description: negative boost supply regulator

required:
  - compatible
  - reg
  - vddio-supply
  - vddpos-supply
  - vddneg-supply
  - reset-gpios
  - port

unevaluatedProperties: false

examples:
  - |
    #include <dt-bindings/gpio/gpio.h>

    dsi {
      #address-cells = <1>;
      #size-cells = <0>;

      panel@0 {
        compatible = "ebbg,ft8719";
        reg = <0>;

        vddio-supply = <&vreg_l14a_1p88>;
        vddpos-supply = <&lab>;
        vddneg-supply = <&ibb>;

        reset-gpios = <&tlmm 6 GPIO_ACTIVE_LOW>;

        backlight = <&pmi8998_wled>;

        port {
          ebbg_ft8719_in_0: endpoint {
            remote-endpoint = <&dsi0_out>;
          };
        };
      };
    };
```
