## Documentation/devicetree/bindings/display/panel/boe,bf060y8m-aj0.yaml
```yaml
# SPDX-License-Identifier: (GPL-2.0-only OR BSD-2-Clause)
%YAML 1.2
---
$id: http://devicetree.org/schemas/display/panel/boe,bf060y8m-aj0.yaml#
$schema: http://devicetree.org/meta-schemas/core.yaml#

title: BOE BF060Y8M-AJ0 5.99" 1080x2160 AMOLED Panel

maintainers:
  - AngeloGioacchino Del Regno <angelogioacchino.delregno@somainline.org>

description: |
  This is a 5.99" 1080x2160 16.7M Color active matrix AMOLED
  video mode panel module on MIPI-DSI 4-Lane interface, GGRB
  pixel arrangement, 63 micrometers pitch, with an active
  area of 68.04 x 136.08 millimeters.
  Each pixel is divided into red and green dots, or blue and
  green dots, and two pixels share red or blue dots which are
  arranged in vertical stripe.
  The DriverIC for this panel module is SW43404.

allOf:
  - $ref: panel-common.yaml#

properties:
  compatible:
    const: boe,bf060y8m-aj0

  elvdd-supply:
    description: EL Driving positive (VDD) supply (4.40-4.80V)
  elvss-supply:
    description: EL Driving negative (VSS) supply (-5.00V to -1.40V)
  vcc-supply:
    description: Core (TSP) voltage supply (2.70-3.60V)
  vci-supply:
    description: DriverIC Operation supply (2.60-3.60V)
  vddio-supply:
    description: I/O voltage supply (1.62-1.98V)

  port: true
  reg: true
  reset-gpios: true

required:
  - compatible
  - elvdd-supply
  - elvss-supply
  - vcc-supply
  - vci-supply
  - vddio-supply
  - reg
  - reset-gpios

additionalProperties: false

examples:
  - |
    #include <dt-bindings/gpio/gpio.h>

    dsi {
        #address-cells = <1>;
        #size-cells = <0>;
        panel@0 {
            compatible = "boe,bf060y8m-aj0";
            reg = <0>;

            reset-gpios = <&tlmm 94 GPIO_ACTIVE_HIGH>;

            vcc-supply = <&disp_vcc_vreg>;
            vddio-supply = <&disp_vddio_vreg>;
            vci-supply = <&disp_vci_vreg>;
            elvdd-supply = <&disp_elvdd_vreg>;
            elvss-supply = <&disp_elvss_vreg>;

            port {
                panel_in: endpoint {
                    remote-endpoint = <&dsi0_out>;
                };
            };
        };
    };
```

## Documentation/devicetree/bindings/display/panel/boe,himax8279d.txt
```
Boe Himax8279d 1200x1920 TFT LCD panel

Required properties:
- compatible: should be "boe,himax8279d8p" and one of: "boe,himax8279d10p"
- reg: DSI virtual channel of the peripheral
- enable-gpios: panel enable gpio
- pp33-gpios: a GPIO phandle for the 3.3v pin that provides the supply voltage
- pp18-gpios: a GPIO phandle for the 1.8v pin that provides the supply voltage

Optional properties:
- backlight: phandle of the backlight device attached to the panel

Example:

	&mipi_dsi {
		panel {
			compatible = "boe,himax8279d8p", "boe,himax8279d10p";
			reg = <0>;
			backlight = <&backlight>;
			enable-gpios = <&gpio 45 GPIO_ACTIVE_HIGH>;
			pp33-gpios = <&gpio 35 GPIO_ACTIVE_HIGH>;
			pp18-gpios = <&gpio 36 GPIO_ACTIVE_HIGH>;
		};
	};
```

## Documentation/devicetree/bindings/display/panel/boe,himax8279d.yaml
```yaml
# SPDX-License-Identifier: GPL-2.0
%YAML 1.2
---
$id: http://devicetree.org/schemas/display/panel/boe,himax8279d.yaml#
$schema: http://devicetree.org/meta-schemas/core.yaml#

title: Boe Himax8279d 1200x1920 TFT LCD panel

maintainers:
  - Jerry Han <jerry.han.hq@gmail.com>

allOf:
  - $ref: panel-common.yaml#

properties:
  compatible:
    items:
      - const: boe,himax8279d8p
      - const: boe,himax8279d10p

  backlight: true
  enable-gpios: true
  reg: true

  pp33-gpios:
    maxItems: 1
    description: GPIO for the 3.3v pin that provides the supply voltage

  pp18-gpios:
    maxItems: 1
    description: GPIO for the 1.8v pin that provides the supply voltage

required:
  - compatible
  - reg
  - enable-gpios
  - pp33-gpios
  - pp18-gpios

additionalProperties: false

examples:
  - |
    #include <dt-bindings/gpio/gpio.h>

    dsi {
        #address-cells = <1>;
        #size-cells = <0>;
        panel@0 {
            compatible = "boe,himax8279d8p", "boe,himax8279d10p";
            reg = <0>;
            backlight = <&backlight>;
            enable-gpios = <&gpio 45 GPIO_ACTIVE_HIGH>;
            pp33-gpios = <&gpio 35 GPIO_ACTIVE_HIGH>;
            pp18-gpios = <&gpio 36 GPIO_ACTIVE_HIGH>;
        };
    };

...
```

## Documentation/devicetree/bindings/display/panel/boe,hv070wsa-100.txt
```
BOE HV070WSA-100 7.01" WSVGA TFT LCD panel

Required properties:
- compatible: should be "boe,hv070wsa-100"
- power-supply: regulator to provide the VCC supply voltage (3.3 volts)
- enable-gpios: GPIO pin to enable and disable panel (active high)

This binding is compatible with the simple-panel binding, which is specified
in simple-panel.txt in this directory.

The device node can contain one 'port' child node with one child
'endpoint' node, according to the bindings defined in [1]. This
node should describe panel's video bus.

[1]: Documentation/devicetree/bindings/media/video-interfaces.txt

Example:

	panel: panel {
		compatible = "boe,hv070wsa-100";
		power-supply = <&vcc_3v3_reg>;
		enable-gpios = <&gpd1 3 GPIO_ACTIVE_HIGH>;
		port {
			panel_ep: endpoint {
				remote-endpoint = <&bridge_out_ep>;
			};
		};
	};
```

## Documentation/devicetree/bindings/display/panel/boe,mv238qum-n20.txt
```
Boe Corporation 23.8" UHD TFT LCD panel

It has been designed to apply eDP(HBR2, 5.4Gbps) interface.

Required properties:
- compatible: should be "boe,mv238qum-n20"

This binding is compatible with the simple-panel binding, which is specified
in simple-panel.txt in this directory.
```

## Documentation/devicetree/bindings/display/panel/boe,mv270qum-n10.txt
```
Boe Corporation 27" UHD TFT LCD panel

It has been designed to apply eDP(HBR2, 5.4Gbps) interface.

Required properties:
- compatible: should be "boe,mv270qum-n10"

This binding is compatible with the simple-panel binding, which is specified
in simple-panel.txt in this directory.
```

## Documentation/devicetree/bindings/display/panel/boe,nv101wxmn51.txt
```
BOE OPTOELECTRONICS TECHNOLOGY 10.1" WXGA TFT LCD panel

Required properties:
- compatible: should be "boe,nv101wxmn51"

This binding is compatible with the simple-panel binding, which is specified
in simple-panel.txt in this directory.
```

## Documentation/devicetree/bindings/display/panel/boe,nv125fhm-n73.txt
```
Boe Corporation 12.5" FHD TFT LCD panel

Required properties:
- compatible: should be "boe,nv125fhm-n73"

This binding is compatible with the simple-panel binding, which is specified
in simple-panel.txt in this directory.
```

## Documentation/devicetree/bindings/display/panel/boe,td4320.yaml
```yaml
# SPDX-License-Identifier: (GPL-2.0-only OR BSD-2-Clause)
%YAML 1.2
---
$id: http://devicetree.org/schemas/display/panel/boe,td4320.yaml#
$schema: http://devicetree.org/meta-schemas/core.yaml#

title: BOE TD4320 MIPI-DSI panels

maintainers:
  - Barnabas Czeman <barnabas.czeman@mainlining.org>

description:
  BOE TD4320 6.3" 1080x2340 panel found in Xiaomi Redmi Note 7 smartphone.

allOf:
  - $ref: panel-common.yaml#

properties:
  compatible:
    items:
      - const: boe,td4320

  reg:
    maxItems: 1

  iovcc-supply:
    description: I/O voltage rail

  vsn-supply:
    description: Negative source voltage rail

  vsp-supply:
    description: Positive source voltage rail

required:
  - compatible
  - reg
  - reset-gpios
  - port

unevaluatedProperties: false

examples:
  - |
    #include <dt-bindings/gpio/gpio.h>

    dsi {
        #address-cells = <1>;
        #size-cells = <0>;

        panel@0 {
            compatible = "boe,td4320";
            reg = <0>;
            backlight = <&backlight>;
            reset-gpios = <&tlmm 45 GPIO_ACTIVE_LOW>;

            port {
                panel_in: endpoint {
                    remote-endpoint = <&dsi_out>;
                };
            };
        };
    };

...
```

## Documentation/devicetree/bindings/display/panel/boe,th101mb31ig002-28a.yaml
```yaml
# SPDX-License-Identifier: (GPL-2.0-only OR BSD-2-Clause)
%YAML 1.2
---
$id: http://devicetree.org/schemas/display/panel/boe,th101mb31ig002-28a.yaml#
$schema: http://devicetree.org/meta-schemas/core.yaml#

title: BOE TH101MB31IG002-28A WXGA DSI Display Panel

maintainers:
  - Manuel Traut <manut@mecka.net>

properties:
  compatible:
    enum:
        # BOE TH101MB31IG002-28A 10.1" WXGA TFT LCD panel
      - boe,th101mb31ig002-28a
        # The Starry-er88577 is a 10.1" WXGA TFT-LCD panel
      - starry,er88577

  reg:
    maxItems: 1

  backlight: true
  enable-gpios: true
  reset-gpios: true
  power-supply: true
  port: true
  rotation: true

required:
  - compatible
  - reg
  - enable-gpios
  - power-supply

allOf:
  - $ref: panel-common.yaml#
  - if:
      properties:
        compatible:
          # The Starry-er88577 is a 10.1" WXGA TFT-LCD panel
          const: starry,er88577
    then:
      properties:
        reset-gpios: false
    else:
      required:
        - reset-gpios

additionalProperties: false

examples:
  - |
    #include <dt-bindings/gpio/gpio.h>

    dsi {
        #address-cells = <1>;
        #size-cells = <0>;
        panel@0 {
            compatible = "boe,th101mb31ig002-28a";
            reg = <0>;
            backlight = <&backlight_lcd0>;
            enable-gpios = <&gpio 45 GPIO_ACTIVE_HIGH>;
            reset-gpios = <&gpio 55 GPIO_ACTIVE_LOW>;
            rotation = <90>;
            power-supply = <&vcc_3v3>;
            port {
                panel_in_dsi: endpoint {
                    remote-endpoint = <&dsi_out_con>;
                };
            };
        };
    };

...
```

## Documentation/devicetree/bindings/display/panel/boe,tv080wum-nl0.txt
```
Boe Corporation 8.0" WUXGA TFT LCD panel

Required properties:
- compatible: should be "boe,tv080wum-nl0"

This binding is compatible with the simple-panel binding, which is specified
in simple-panel.txt in this directory.
```

## Documentation/devicetree/bindings/display/panel/boe,tv101wum-ll2.yaml
```yaml
# SPDX-License-Identifier: (GPL-2.0-only OR BSD-2-Clause)
%YAML 1.2
---
$id: http://devicetree.org/schemas/display/panel/boe,tv101wum-ll2.yaml#
$schema: http://devicetree.org/meta-schemas/core.yaml#

title: BOE TV101WUM-LL2 DSI Display Panel

maintainers:
  - Neil Armstrong <neil.armstrong@linaro.org>

allOf:
  - $ref: panel-common.yaml#

properties:
  compatible:
    const: boe,tv101wum-ll2

  reg:
    maxItems: 1
    description: DSI virtual channel

  backlight: true
  reset-gpios: true
  vsp-supply: true
  vsn-supply: true
  port: true
  rotation: true

required:
  - compatible
  - reg
  - reset-gpios
  - vsp-supply
  - vsn-supply
  - port

additionalProperties: false

examples:
  - |
    #include <dt-bindings/gpio/gpio.h>
    dsi {
        #address-cells = <1>;
        #size-cells = <0>;
        panel@0 {
            compatible = "boe,tv101wum-ll2";
            reg = <0>;

            vsn-supply = <&vsn_lcd>;
            vsp-supply = <&vsp_lcd>;

            reset-gpios = <&pio 45 GPIO_ACTIVE_LOW>;

            port {
                panel_in: endpoint {
                    remote-endpoint = <&dsi_out>;
                };
            };
        };
    };

...
```

## Documentation/devicetree/bindings/display/panel/boe,tv101wum-nl6.yaml
```yaml
# SPDX-License-Identifier: (GPL-2.0-only OR BSD-2-Clause)
%YAML 1.2
---
$id: http://devicetree.org/schemas/display/panel/boe,tv101wum-nl6.yaml#
$schema: http://devicetree.org/meta-schemas/core.yaml#

title: BOE TV101WUM-NL6 DSI Display Panel

maintainers:
  - Thierry Reding <thierry.reding@gmail.com>
  - Sam Ravnborg <sam@ravnborg.org>

allOf:
  - $ref: panel-common.yaml#

properties:
  compatible:
    enum:
        # BOE TV101WUM-NL6 10.1" WUXGA TFT LCD panel
      - boe,tv101wum-nl6
        # AUO KD101N80-45NA 10.1" WUXGA TFT LCD panel
      - auo,kd101n80-45na
        # BOE TV101WUM-N53 10.1" WUXGA TFT LCD panel
      - boe,tv101wum-n53
        # AUO B101UAN08.3 10.1" WUXGA TFT LCD panel
      - auo,b101uan08.3

  reg:
    description: the virtual channel number of a DSI peripheral

  enable-gpios:
    description: a GPIO spec for the enable pin

  pp1800-supply:
    description: core voltage supply

  avdd-supply:
    description: phandle of the regulator that provides positive voltage

  avee-supply:
    description: phandle of the regulator that provides negative voltage

  backlight:
    description: phandle of the backlight device attached to the panel

  port: true

required:
 - compatible
 - reg
 - enable-gpios
 - pp1800-supply
 - avdd-supply
 - avee-supply

additionalProperties: false

examples:
  - |
    dsi {
        #address-cells = <1>;
        #size-cells = <0>;
        panel@0 {
            compatible = "boe,tv101wum-nl6";
            reg = <0>;
            enable-gpios = <&pio 45 0>;
            avdd-supply = <&ppvarn_lcd>;
            avee-supply = <&ppvarp_lcd>;
            pp1800-supply = <&pp1800_lcd>;
            backlight = <&backlight_lcd0>;
            status = "okay";
            port {
                panel_in: endpoint {
                    remote-endpoint = <&dsi_out>;
                };
            };
        };
    };

...
```

## Documentation/devicetree/bindings/display/panel/cdtech,s070wv95-ct16.txt
```
CDTech(H.K.) Electronics Limited 7" 800x480 color TFT-LCD panel

Required properties:
- compatible: should be "cdtech,s070wv95-ct16"
- power-supply: as specified in the base binding

Optional properties:
- backlight: as specified in the base binding
- enable-gpios: as specified in the base binding

This binding is compatible with the simple-panel binding, which is specified
in simple-panel.txt in this directory.
```

## Documentation/devicetree/bindings/display/panel/chipone,icna3512.yaml
```yaml
# SPDX-License-Identifier: (GPL-2.0-only OR BSD-2-Clause)
%YAML 1.2
---
$id: http://devicetree.org/schemas/display/panel/chipone,icna3512.yaml#
$schema: http://devicetree.org/meta-schemas/core.yaml#

title: Chipone ICNA3512 and ICNA3520 display drivers

maintainers:
  - Neil Armstrong <neil.armstrong@linaro.org>

description:
  The Chipone ICNA3512 and ICNA3520 are DDICs connected
  using a MIPI-DSI video interface.

allOf:
  - $ref: panel-common.yaml#

properties:
  compatible:
    oneOf:
      - items:
          - enum:
              - ayaneo,pocketds-panel-top
              - ayntec,odin2portal-panel
          - const: chipone,icna3512

      - items:
          - enum:
              - ayntec,odin3-panel
              - ayntec,thor-panel-top
          - const: chipone,icna3520

  reg:
    maxItems: 1
    description: DSI virtual channel

  vdd-supply: true
  vddio-supply: true
  vci-supply: true
  disp-supply: true
  blvdd-supply: true

  port: true
  reset-gpios: true
  rotation: true

required:
  - compatible
  - reg
  - vdd-supply
  - vddio-supply
  - vci-supply
  - disp-supply
  - blvdd-supply
  - reset-gpios

additionalProperties: false

examples:
  - |
    #include <dt-bindings/gpio/gpio.h>

    dsi {
        #address-cells = <1>;
        #size-cells = <0>;
        panel@0 {
            compatible = "ayntec,odin2portal-panel", "chipone,icna3512";
            reg = <0>;
            vdd-supply = <&vreg_l11b_1p2>;
            vddio-supply = <&vreg_l12b_1p8>;
            vci-supply = <&vreg_l13b_3p0>;
            disp-supply = <&vdd_disp_2v8>;
            blvdd-supply = <&vdd_bl_5v0>;
            reset-gpios = <&tlmm 133 GPIO_ACTIVE_LOW>;
        };
    };

...
```
