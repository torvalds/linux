## Documentation/devicetree/bindings/display/panel/lg,lp097qx1-spa1.txt
```
LG 9.7" (2048x1536 pixels) TFT LCD panel

Required properties:
- compatible: should be "lg,lp097qx1-spa1"

This binding is compatible with the simple-panel binding, which is specified
in simple-panel.txt in this directory.
```

## Documentation/devicetree/bindings/display/panel/lg,lp120up1.txt
```
LG 12.0" (1920x1280 pixels) TFT LCD panel

Required properties:
- compatible: should be "lg,lp120up1"

This binding is compatible with the simple-panel binding, which is specified
in simple-panel.txt in this directory.
```

## Documentation/devicetree/bindings/display/panel/lg,sw43408.yaml
```yaml
# SPDX-License-Identifier: (GPL-2.0-only OR BSD-2-Clause)
%YAML 1.2
---
$id: http://devicetree.org/schemas/display/panel/lg,sw43408.yaml#
$schema: http://devicetree.org/meta-schemas/core.yaml#

title: LG SW43408 AMOLED DDIC

maintainers:
  - Casey Connolly <casey.connolly@linaro.org>

description:
  The SW43408 is display driver IC with connected panel.

  LG LH546WF1-ED01 panel is used on the Pixel 3, it is a 60hz OLED panel
  which required DSC (Display Stream Compression) and has rounded corners.

allOf:
  - $ref: panel-common.yaml#

properties:
  compatible:
    items:
      - enum:
            # LG 5.46 inch, 1080x2160 pixels, 18:9 ratio
          - lg,sw43408-lh546wf1-ed01
      - const: lg,sw43408

  reg:
    maxItems: 1

  port: true
  vddi-supply: true
  vpnl-supply: true
  reset-gpios: true

required:
  - compatible
  - vddi-supply
  - vpnl-supply
  - reset-gpios

additionalProperties: false

examples:
  - |
    #include <dt-bindings/gpio/gpio.h>

    dsi {
        #address-cells = <1>;
        #size-cells = <0>;

        panel@0 {
            compatible = "lg,sw43408-lh546wf1-ed01", "lg,sw43408";
            reg = <0>;

            vddi-supply = <&vreg_l14a_1p88>;
            vpnl-supply = <&vreg_l28a_3p0>;

            reset-gpios = <&tlmm 6 GPIO_ACTIVE_LOW>;

            port {
                endpoint {
                    remote-endpoint = <&mdss_dsi0_out>;
                };
            };
        };
    };
...
```

## Documentation/devicetree/bindings/display/panel/lgphilips,lb035q02.txt
```
LG.Philips LB035Q02 Panel
=========================

Required properties:
- compatible: "lgphilips,lb035q02"
- enable-gpios: panel enable gpio

Optional properties:
- label: a symbolic name for the panel

Required nodes:
- Video port for DPI input

Example
-------

lcd-panel: panel@0 {
	compatible = "lgphilips,lb035q02";
	reg = <0>;
	spi-max-frequency = <100000>;
	spi-cpol;
	spi-cpha;

	label = "lcd";

	enable-gpios = <&gpio7 7 0>;

	port {
		lcd_in: endpoint {
			remote-endpoint = <&dpi_out>;
		};
	};
};
```

## Documentation/devicetree/bindings/display/panel/lgphilips,lb035q02.yaml
```yaml
# SPDX-License-Identifier: GPL-2.0
%YAML 1.2
---
$id: http://devicetree.org/schemas/display/panel/lgphilips,lb035q02.yaml#
$schema: http://devicetree.org/meta-schemas/core.yaml#

title: LG.Philips LB035Q02 Panel

maintainers:
  - Tomi Valkeinen <tomi.valkeinen@ti.com>

allOf:
  - $ref: panel-common.yaml#
  - $ref: /schemas/spi/spi-peripheral-props.yaml#

properties:
  compatible:
    const: lgphilips,lb035q02

  label: true
  enable-gpios: true
  port: true

  spi-cpha: true
  spi-cpol: true

required:
  - compatible
  - enable-gpios
  - port

unevaluatedProperties: false

examples:
  - |
    spi {
        #address-cells = <1>;
        #size-cells = <0>;

        panel: panel@0 {
            compatible = "lgphilips,lb035q02";
            reg = <0>;
            spi-max-frequency = <100000>;
            spi-cpol;
            spi-cpha;

            label = "lcd";

            enable-gpios = <&gpio7 7 0>;

            port {
                lcd_in: endpoint {
                    remote-endpoint = <&dpi_out>;
                };
            };
        };
    };

...
```

## Documentation/devicetree/bindings/display/panel/logicpd,type28.yaml
```yaml
# SPDX-License-Identifier: GPL-2.0
%YAML 1.2
---
$id: http://devicetree.org/schemas/display/panel/logicpd,type28.yaml#
$schema: http://devicetree.org/meta-schemas/core.yaml#

title: Logic PD Type 28 4.3" WQVGA TFT LCD panel

maintainers:
  - Adam Ford <aford173@gmail.com>

allOf:
  - $ref: panel-common.yaml#

properties:
  compatible:
    const: logicpd,type28

  power-supply: true
  enable-gpios: true
  backlight: true
  port: true

required:
  - compatible

additionalProperties: false

examples:
  - |
    lcd0: display {
      compatible = "logicpd,type28";
      enable-gpios = <&gpio5 27 0>;
      backlight = <&backlight>;
      port {
        lcd_in: endpoint {
          remote-endpoint = <&dpi_out>;
        };
      };
    };

...
```

## Documentation/devicetree/bindings/display/panel/lvds.yaml
```yaml
# SPDX-License-Identifier: GPL-2.0
%YAML 1.2
---
$id: http://devicetree.org/schemas/display/panel/lvds.yaml#
$schema: http://devicetree.org/meta-schemas/core.yaml#

title: LVDS Display Panel

maintainers:
  - Laurent Pinchart <laurent.pinchart+renesas@ideasonboard.com>
  - Thierry Reding <thierry.reding@gmail.com>

description: |+
  LVDS is a physical layer specification defined in ANSI/TIA/EIA-644-A. Multiple
  incompatible data link layers have been used over time to transmit image data
  to LVDS panels. This bindings supports display panels compatible with the
  following specifications.

  [JEIDA] "Digital Interface Standards for Monitor", JEIDA-59-1999, February
  1999 (Version 1.0), Japan Electronic Industry Development Association (JEIDA)
  [LDI] "Open LVDS Display Interface", May 1999 (Version 0.95), National
  Semiconductor
  [VESA] "VESA Notebook Panel Standard", October 2007 (Version 1.0), Video
  Electronics Standards Association (VESA)

  Device compatible with those specifications have been marketed under the
  FPD-Link and FlatLink brands.

allOf:
  - $ref: panel-common.yaml#

properties:
  compatible:
    contains:
      const: panel-lvds
    description:
      Shall contain "panel-lvds" in addition to a mandatory panel-specific
      compatible string defined in individual panel bindings. The "panel-lvds"
      value shall never be used on its own.

  data-mapping:
    enum:
      - jeida-18
      - jeida-24
      - vesa-24
    description: |
      The color signals mapping order.

      LVDS data mappings are defined as follows.

      - "jeida-18" - 18-bit data mapping compatible with the [JEIDA], [LDI] and
        [VESA] specifications. Data are transferred as follows on 3 LVDS lanes.

      Slot	    0       1       2       3       4       5       6
            ________________                         _________________
      Clock	                \_______________________/
              ______  ______  ______  ______  ______  ______  ______
      DATA0	><__G0__><__R5__><__R4__><__R3__><__R2__><__R1__><__R0__><
      DATA1	><__B1__><__B0__><__G5__><__G4__><__G3__><__G2__><__G1__><
      DATA2	><_CTL2_><_CTL1_><_CTL0_><__B5__><__B4__><__B3__><__B2__><

      - "jeida-24" - 24-bit data mapping compatible with the [DSIM] and [LDI]
        specifications. Data are transferred as follows on 4 LVDS lanes.

      Slot	    0       1       2       3       4       5       6
            ________________                         _________________
      Clock	                \_______________________/
              ______  ______  ______  ______  ______  ______  ______
      DATA0	><__G2__><__R7__><__R6__><__R5__><__R4__><__R3__><__R2__><
      DATA1	><__B3__><__B2__><__G7__><__G6__><__G5__><__G4__><__G3__><
      DATA2	><_CTL2_><_CTL1_><_CTL0_><__B7__><__B6__><__B5__><__B4__><
      DATA3	><_CTL3_><__B1__><__B0__><__G1__><__G0__><__R1__><__R0__><

      - "vesa-24" - 24-bit data mapping compatible with the [VESA] specification.
        Data are transferred as follows on 4 LVDS lanes.

      Slot	    0       1       2       3       4       5       6
            ________________                         _________________
      Clock	                \_______________________/
              ______  ______  ______  ______  ______  ______  ______
      DATA0	><__G0__><__R5__><__R4__><__R3__><__R2__><__R1__><__R0__><
      DATA1	><__B1__><__B0__><__G5__><__G4__><__G3__><__G2__><__G1__><
      DATA2	><_CTL2_><_CTL1_><_CTL0_><__B5__><__B4__><__B3__><__B2__><
      DATA3	><_CTL3_><__B7__><__B6__><__G7__><__G6__><__R7__><__R6__><

      Control signals are mapped as follows.

      CTL0: HSync
      CTL1: VSync
      CTL2: Data Enable
      CTL3: 0

  data-mirror:
    type: boolean
    description:
      If set, reverse the bit order described in the data mappings below on all
      data lanes, transmitting bits for slots 6 to 0 instead of 0 to 6.

required:
  - compatible
  - data-mapping
  - width-mm
  - height-mm
  - panel-timing
  - port

...
```

## Documentation/devicetree/bindings/display/panel/lxd,m9189a.yaml
```yaml
# SPDX-License-Identifier: (GPL-2.0-only OR BSD-2-Clause)
%YAML 1.2
---
$id: http://devicetree.org/schemas/display/panel/lxd,m9189a.yaml#
$schema: http://devicetree.org/meta-schemas/core.yaml#

title: LXD M9189A DSI Display Panel

maintainers:
  - Michael Tretter <m.tretter@pengutronix.de>

allOf:
  - $ref: panel-common.yaml

properties:
  compatible:
    const: lxd,m9189a

  reg:
    maxItems: 1

  standby-gpios:
    description: GPIO used for the standby pin
    maxItems: 1

  reset-gpios: true
  power-supply: true
  backlight: true
  port: true

required:
  - compatible
  - reg
  - standby-gpios
  - reset-gpios
  - power-supply
  - backlight
  - port

additionalProperties: false

examples:
  - |
    #include <dt-bindings/gpio/gpio.h>

    dsi {
      #address-cells = <1>;
      #size-cells = <0>;

      panel@0 {
        compatible = "lxd,m9189a";
        reg = <0>;
        backlight = <&backlight>;
        reset-gpios = <&gpio3 25 GPIO_ACTIVE_LOW>;
        standby-gpios = <&gpio5 22 GPIO_ACTIVE_LOW>;
        power-supply = <&reg_display_3v3>;

        port {
          mipi_panel_in: endpoint {
            remote-endpoint = <&mipi_dsi_out>;
          };
        };
      };
    };
```

## Documentation/devicetree/bindings/display/panel/mantix,mlaf057we51-x.yaml
```yaml
# SPDX-License-Identifier: (GPL-2.0-only or BSD-2-Clause)
%YAML 1.2
---
$id: http://devicetree.org/schemas/display/panel/mantix,mlaf057we51-x.yaml#
$schema: http://devicetree.org/meta-schemas/core.yaml#

title: Mantix MLAF057WE51-X 5.7" 720x1440 TFT LCD panel

maintainers:
  - Guido Günther <agx@sigxcpu.org>

description:
  Mantix MLAF057WE51 X is a 720x1440 TFT LCD panel connected using
  a MIPI-DSI video interface.

allOf:
  - $ref: panel-common.yaml#

properties:
  compatible:
    enum:
      - mantix,mlaf057we51-x

  port: true
  reg:
    maxItems: 1
    description: DSI virtual channel

  avdd-supply:
    description: Positive analog power supply

  avee-supply:
    description: Negative analog power supply

  vddi-supply:
    description: 1.8V I/O voltage supply

  reset-gpios: true

  'mantix,tp-rstn-gpios':
    description: second reset line that triggers DSI config load

  backlight: true

required:
  - compatible
  - reg
  - avdd-supply
  - avee-supply
  - vddi-supply
  - reset-gpios

additionalProperties: false

examples:
  - |
    #include <dt-bindings/gpio/gpio.h>

    dsi {
        #address-cells = <1>;
        #size-cells = <0>;
        panel@0 {
            compatible = "mantix,mlaf057we51-x";
            reg = <0>;
            avdd-supply = <&reg_avdd>;
            avee-supply = <&reg_avee>;
            vddi-supply = <&reg_1v8_p>;
            reset-gpios = <&gpio1 29 GPIO_ACTIVE_LOW>;
            mantix,tp-rstn-gpios = <&gpio1 24 GPIO_ACTIVE_LOW>;
            backlight = <&backlight>;
        };
    };

...
```

## Documentation/devicetree/bindings/display/panel/mitsubishi,aa070mc01.txt
```
Mitsubishi "AA070MC01 7.0" WVGA TFT LCD panel

Required properties:
- compatible: should be "mitsubishi,aa070mc01-ca1"

This binding is compatible with the simple-panel binding, which is specified
in simple-panel.txt in this directory.
```

## Documentation/devicetree/bindings/display/panel/mitsubishi,aa104xd12.txt
```
Mitsubishi AA204XD12 LVDS Display Panel
=======================================

The AA104XD12 is a 10.4" XGA TFT-LCD display panel.

These DT bindings follow the LVDS panel bindings defined in panel-lvds.txt
with the following device-specific properties.


Required properties:

- compatible: Shall contain "mitsubishi,aa121td01" and "panel-lvds", in that
  order.
- vcc-supply: Reference to the regulator powering the panel VCC pins.


Example
-------

panel {
	compatible = "mitsubishi,aa104xd12", "panel-lvds";
	vcc-supply = <&vcc_3v3>;

	width-mm = <210>;
	height-mm = <158>;

	data-mapping = "jeida-24";

	panel-timing {
		/* 1024x768 @65Hz */
		clock-frequency = <65000000>;
		hactive = <1024>;
		vactive = <768>;
		hsync-len = <136>;
		hfront-porch = <20>;
		hback-porch = <160>;
		vfront-porch = <3>;
		vback-porch = <29>;
		vsync-len = <6>;
	};

	port {
		panel_in: endpoint {
			remote-endpoint = <&lvds_encoder>;
		};
	};
};
```

## Documentation/devicetree/bindings/display/panel/mitsubishi,aa104xd12.yaml
```yaml
# SPDX-License-Identifier: GPL-2.0
%YAML 1.2
---
$id: http://devicetree.org/schemas/display/panel/mitsubishi,aa104xd12.yaml#
$schema: http://devicetree.org/meta-schemas/core.yaml#

title: Mitsubishi AA104XD12 10.4" XGA LVDS Display Panel

maintainers:
  - Laurent Pinchart <laurent.pinchart@ideasonboard.com>
  - Thierry Reding <thierry.reding@gmail.com>

allOf:
  - $ref: panel-common.yaml#
  - $ref: /schemas/display/lvds.yaml#

select:
  properties:
    compatible:
      contains:
        const: mitsubishi,aa104xd12

  required:
    - compatible

properties:
  compatible:
    items:
      - const: mitsubishi,aa104xd12
      - const: panel-lvds

  vcc-supply:
    description: Reference to the regulator powering the panel VCC pins.

  data-mapping:
    enum:
      - jeida-18
      - jeida-24

  width-mm:
    const: 210

  height-mm:
    const: 158

  backlight: true
  panel-timing: true
  port: true

additionalProperties: false

required:
  - compatible
  - data-mapping
  - width-mm
  - height-mm
  - panel-timing
  - port

examples:
  - |+

    panel {
      compatible = "mitsubishi,aa104xd12", "panel-lvds";
      vcc-supply = <&vcc_3v3>;

      width-mm = <210>;
      height-mm = <158>;

      data-mapping = "jeida-24";

      panel-timing {
        /* 1024x768 @65Hz */
        clock-frequency = <65000000>;
        hactive = <1024>;
        vactive = <768>;
        hsync-len = <136>;
        hfront-porch = <20>;
        hback-porch = <160>;
        vfront-porch = <3>;
        vback-porch = <29>;
        vsync-len = <6>;
      };

      port {
        panel_in: endpoint {
          remote-endpoint = <&lvds_encoder>;
        };
      };
    };

...
```

## Documentation/devicetree/bindings/display/panel/mitsubishi,aa121td01.txt
```
Mitsubishi AA121TD01 LVDS Display Panel
=======================================

The AA121TD01 is a 12.1" WXGA TFT-LCD display panel.

These DT bindings follow the LVDS panel bindings defined in panel-lvds.txt
with the following device-specific properties.


Required properties:

- compatible: Shall contain "mitsubishi,aa121td01" and "panel-lvds", in that
  order.
- vcc-supply: Reference to the regulator powering the panel VCC pins.


Example
-------

panel {
	compatible = "mitsubishi,aa121td01", "panel-lvds";
	vcc-supply = <&vcc_3v3>;

	width-mm = <261>;
	height-mm = <163>;

	data-mapping = "jeida-24";

	panel-timing {
		/* 1280x800 @60Hz */
		clock-frequency = <71000000>;
		hactive = <1280>;
		vactive = <800>;
		hsync-len = <70>;
		hfront-porch = <20>;
		hback-porch = <70>;
		vsync-len = <5>;
		vfront-porch = <3>;
		vback-porch = <15>;
	};

	port {
		panel_in: endpoint {
			remote-endpoint = <&lvds_encoder>;
		};
	};
};
```
