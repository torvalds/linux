## Documentation/devicetree/bindings/display/panel/mitsubishi,aa121td01.yaml
```yaml
# SPDX-License-Identifier: GPL-2.0
%YAML 1.2
---
$id: http://devicetree.org/schemas/display/panel/mitsubishi,aa121td01.yaml#
$schema: http://devicetree.org/meta-schemas/core.yaml#

title: Mitsubishi AA121TD01 12.1" WXGA LVDS Display Panel

maintainers:
  - Laurent Pinchart <laurent.pinchart@ideasonboard.com>
  - Thierry Reding <thierry.reding@gmail.com>

allOf:
  - $ref: lvds.yaml#

properties:
  compatible:
    items:
      - const: mitsubishi,aa121td01
      - {} # panel-lvds, but not listed here to avoid false select

  vcc-supply:
    description: Reference to the regulator powering the panel VCC pins.

  data-mapping:
    const: jeida-24

  width-mm:
    const: 261

  height-mm:
    const: 163

  panel-timing: true
  port: true

additionalProperties: false

required:
  - compatible
  - vcc-supply

examples:
  - |+
    panel {
      compatible = "mitsubishi,aa121td01", "panel-lvds";
      vcc-supply = <&vcc_3v3>;

      width-mm = <261>;
      height-mm = <163>;

      data-mapping = "jeida-24";

      panel-timing {
        /* 1280x800 @60Hz */
        clock-frequency = <71000000>;
        hactive = <1280>;
        vactive = <800>;
        hsync-len = <70>;
        hfront-porch = <20>;
        hback-porch = <70>;
        vsync-len = <5>;
        vfront-porch = <3>;
        vback-porch = <15>;
      };

      port {
        panel_in: endpoint {
          remote-endpoint = <&lvds_encoder>;
        };
      };
    };

...
```

## Documentation/devicetree/bindings/display/panel/motorola,mot-panel.yaml
```yaml
# SPDX-License-Identifier: (GPL-2.0-only OR BSD-2-Clause)
%YAML 1.2
---
$id: http://devicetree.org/schemas/display/panel/motorola,mot-panel.yaml#
$schema: http://devicetree.org/meta-schemas/core.yaml#

title: Atrix 4G and Droid X2 DSI Display Panel

maintainers:
  - Svyatoslav Ryhel <clamor95@gmail.com>

description:
  Atrix 4G and Droid X2 use the same 540x960 DSI video mode panel. Exact
  panel vendor and model are unknown hence generic compatible based on the
  board name "Mot" is used.

allOf:
  - $ref: panel-common.yaml#

properties:
  compatible:
    items:
      - const: motorola,mot-panel

  reg:
    maxItems: 1

  vdd-supply:
    description: Regulator for main power supply.

  vddio-supply:
    description: Regulator for 1.8V IO power supply.

  backlight: true
  reset-gpios: true
  port: true

required:
  - compatible

additionalProperties: false

examples:
  - |
    #include <dt-bindings/gpio/gpio.h>

    dsi {
        #address-cells = <1>;
        #size-cells = <0>;

        panel@0 {
            compatible = "motorola,mot-panel";
            reg = <0>;

            reset-gpios = <&gpio 35 GPIO_ACTIVE_LOW>;

            vdd-supply = <&vdd_5v0_panel>;
            vddio-supply = <&vdd_1v8_vio>;

            backlight = <&backlight>;

            port {
                panel_in: endpoint {
                    remote-endpoint = <&dsi_out>;
                };
            };
        };
    };
...
```

## Documentation/devicetree/bindings/display/panel/nec,nl12880b20-05.txt
```
NEC LCD Technologies, Ltd. 12.1" WXGA (1280x800) LVDS TFT LCD panel

Required properties:
- compatible: should be "nec,nl12880bc20-05"
- power-supply: as specified in the base binding

This binding is compatible with the simple-panel binding, which is specified
in simple-panel.txt in this directory.
```

## Documentation/devicetree/bindings/display/panel/nec,nl4827hc19-05b.txt
```
NEC LCD Technologies,Ltd. WQVGA TFT LCD panel

Required properties:
- compatible: should be "nec,nl4827hc19-05b"

This binding is compatible with the simple-panel binding, which is specified
in simple-panel.txt in this directory.
```

## Documentation/devicetree/bindings/display/panel/nec,nl8048hl11.yaml
```yaml
# SPDX-License-Identifier: GPL-2.0
%YAML 1.2
---
$id: http://devicetree.org/schemas/display/panel/nec,nl8048hl11.yaml#
$schema: http://devicetree.org/meta-schemas/core.yaml#

title: NEC NL8048HL11 4.1" WVGA TFT LCD panel

description:
  The NEC NL8048HL11 is a 4.1" WVGA TFT LCD panel with a 24-bit RGB parallel
  data interface and an SPI control interface.

maintainers:
  - Laurent Pinchart <laurent.pinchart@ideasonboard.com>

allOf:
  - $ref: panel-common.yaml#
  - $ref: /schemas/spi/spi-peripheral-props.yaml#

properties:
  compatible:
    const: nec,nl8048hl11

  reg:
    maxItems: 1

  label: true
  port: true
  reset-gpios: true

  spi-max-frequency:
    maximum: 10000000

required:
  - compatible
  - reg
  - reset-gpios
  - port

unevaluatedProperties: false

examples:
  - |
    #include <dt-bindings/gpio/gpio.h>

    spi {
      #address-cells = <1>;
      #size-cells = <0>;

      lcd_panel: panel@0 {
        compatible = "nec,nl8048hl11";
        reg = <0>;
        spi-max-frequency = <10000000>;

        reset-gpios = <&gpio7 7 GPIO_ACTIVE_LOW>;

        port {
          lcd_in: endpoint {
            remote-endpoint = <&dpi_out>;
          };
        };
      };
    };

...
```

## Documentation/devicetree/bindings/display/panel/netron-dy,e231732.txt
```
Netron-DY E231732 7.0" WSVGA TFT LCD panel

Required properties:
- compatible: should be "netron-dy,e231732"

This binding is compatible with the simple-panel binding, which is specified
in simple-panel.txt in this directory.
```

## Documentation/devicetree/bindings/display/panel/newhaven,nhd-4.3-480272ef-atxl.txt
```
Newhaven Display International 480 x 272 TFT LCD panel

Required properties:
- compatible: should be "newhaven,nhd-4.3-480272ef-atxl"

This binding is compatible with the simple-panel binding, which is specified
in simple-panel.txt in this directory.
```

## Documentation/devicetree/bindings/display/panel/newvision,nv3051d.yaml
```yaml
# SPDX-License-Identifier: (GPL-2.0-only OR BSD-2-Clause)
%YAML 1.2
---
$id: http://devicetree.org/schemas/display/panel/newvision,nv3051d.yaml#
$schema: http://devicetree.org/meta-schemas/core.yaml#

title: NewVision NV3051D based LCD panel

description: |
  The NewVision NV3051D is a driver chip used to drive DSI panels.

maintainers:
  - Chris Morgan <macromorgan@hotmail.com>

allOf:
  - $ref: panel-common.yaml#

properties:
  compatible:
    items:
      - enum:
          - anbernic,rg351v-panel
          - anbernic,rg353p-panel
          - anbernic,rg353v-panel
      - const: newvision,nv3051d

  reg: true
  backlight: true
  port: true
  reset-gpios:
    description: Active low reset GPIO
  vdd-supply: true

required:
  - compatible
  - reg
  - backlight

additionalProperties: false

examples:
  - |
    #include <dt-bindings/gpio/gpio.h>
    dsi {
        #address-cells = <1>;
        #size-cells = <0>;
        panel@0 {
            compatible = "anbernic,rg353p-panel", "newvision,nv3051d";
            reg = <0>;
            backlight = <&backlight>;
            reset-gpios = <&gpio4 0 GPIO_ACTIVE_LOW>;
            vdd-supply = <&vcc3v3_lcd>;

            port {
                mipi_in_panel: endpoint {
                    remote-endpoint = <&mipi_out_panel>;
                };
            };
        };
    };

...
```

## Documentation/devicetree/bindings/display/panel/nlt,nl192108ac18-02d.txt
```
NLT Technologies, Ltd. 15.6" FHD (1920x1080) LVDS TFT LCD panel

Required properties:
- compatible: should be "nlt,nl192108ac18-02d"
- power-supply: as specified in the base binding

This binding is compatible with the simple-panel binding, which is specified
in simple-panel.txt in this directory.
```

## Documentation/devicetree/bindings/display/panel/novatek,nt35510.yaml
```yaml
# SPDX-License-Identifier: (GPL-2.0-only OR BSD-2-Clause)
%YAML 1.2
---
$id: http://devicetree.org/schemas/display/panel/novatek,nt35510.yaml#
$schema: http://devicetree.org/meta-schemas/core.yaml#

title: Novatek NT35510-based display panels

maintainers:
  - Linus Walleij <linus.walleij@linaro.org>

allOf:
  - $ref: panel-common.yaml#

properties:
  compatible:
    items:
      - const: hydis,hva40wv1
      - const: novatek,nt35510
    description: This indicates the panel manufacturer of the panel
      that is in turn using the NT35510 panel driver. The compatible
      string determines how the NT35510 panel driver shall be configured
      to work with the indicated panel. The novatek,nt35510 compatible shall
      always be provided as a fallback.
  reg: true
  reset-gpios: true
  vdd-supply:
     description: regulator that supplies the vdd voltage
  vddi-supply:
     description: regulator that supplies the vddi voltage
  backlight: true

required:
  - compatible
  - reg

additionalProperties: false

examples:
  - |
    #include <dt-bindings/gpio/gpio.h>

    dsi {
        #address-cells = <1>;
        #size-cells = <0>;
        panel@0 {
            compatible = "hydis,hva40wv1", "novatek,nt35510";
            reg = <0>;
            vdd-supply = <&ab8500_ldo_aux4_reg>;
            vddi-supply = <&ab8500_ldo_aux6_reg>;
            reset-gpios = <&gpio4 11 GPIO_ACTIVE_LOW>;
            backlight = <&gpio_bl>;
        };
    };

...
```

## Documentation/devicetree/bindings/display/panel/novatek,nt35532.yaml
```yaml
# SPDX-License-Identifier: (GPL-2.0-only OR BSD-2-Clause)
%YAML 1.2
---
$id: http://devicetree.org/schemas/display/panel/novatek,nt35532.yaml#
$schema: http://devicetree.org/meta-schemas/core.yaml#

title: Novatek NT35532-based DSI display panels

maintainers:
  - Cristian Cozzolino <cristian_ci@protonmail.com>

allOf:
  - $ref: panel-common.yaml#

properties:
  compatible:
    items:
      - enum:
          - flipkart,rimob-panel-nt35532-cs
      - const: novatek,nt35532

  reg:
    maxItems: 1

  backlight: true
  reset-gpios: true

  avdd-supply:
    description: positive boost supply regulator

  avee-supply:
    description: negative boost supply regulator

  vci-supply:
    description: regulator that supplies the analog voltage

  vddam-supply:
    description: power supply for MIPI interface

  vddi-supply:
    description: regulator that supplies the I/O voltage

  port: true

required:
  - compatible
  - reg
  - reset-gpios
  - vddi-supply
  - port

additionalProperties: false

examples:
  - |
    #include <dt-bindings/gpio/gpio.h>

    dsi {
        #address-cells = <1>;
        #size-cells = <0>;

        panel@0 {
            compatible = "flipkart,rimob-panel-nt35532-cs", "novatek,nt35532";
            reg = <0>;

            backlight = <&pmi8950_wled>;
            reset-gpios = <&tlmm 61 GPIO_ACTIVE_LOW>;
            avdd-supply = <&lab>;
            avee-supply = <&ibb>;
            vci-supply = <&pm8953_l17>;
            vddi-supply = <&pm8953_l6>;

            port {
                panel_in: endpoint {
                    remote-endpoint = <&dsi0_out>;
                };
            };
        };
    };
...
```

## Documentation/devicetree/bindings/display/panel/novatek,nt35950.yaml
```yaml
# SPDX-License-Identifier: (GPL-2.0-only OR BSD-2-Clause)
%YAML 1.2
---
$id: http://devicetree.org/schemas/display/panel/novatek,nt35950.yaml#
$schema: http://devicetree.org/meta-schemas/core.yaml#

title: Novatek NT35950-based display panels

maintainers:
  - AngeloGioacchino Del Regno <angelogioacchino.delregno@somainline.org>

description: |
  The nt35950 IC from Novatek is a Driver IC used to drive MIPI-DSI panels,
  with Static RAM for content retention in command mode and also supports
  video mode with VESA Frame Buffer Compression or Display Stream Compression
  on single, or dual dsi port(s).
  This DDIC is also capable of upscaling an input image to the panel's native
  resolution, for example it can upscale a 1920x1080 input to 3840x2160 with
  either bilinear interpolation or pixel duplication.

allOf:
  - $ref: panel-common.yaml#

properties:
  compatible:
    items:
      - enum:
          - sharp,ls055d1sx04
      - const: novatek,nt35950
    description: This indicates the panel manufacturer of the panel
      that is in turn using the NT35950 panel driver. The compatible
      string determines how the NT35950 panel driver shall be configured
      to work with the indicated panel. The novatek,nt35950 compatible shall
      always be provided as a fallback.

  reset-gpios:
    maxItems: 1
    description: phandle of gpio for reset line - This should be 8mA, gpio
      can be configured using mux, pinctrl, pinctrl-names (active high)

  avdd-supply:
    description: positive boost supply regulator
  avee-supply:
    description: negative boost supply regulator
  dvdd-supply:
    description: regulator that supplies the digital voltage
  vddio-supply:
    description: regulator that supplies the I/O voltage

  backlight: true
  ports: true
  reg: true

required:
  - compatible
  - reg
  - reset-gpios
  - avdd-supply
  - avee-supply
  - dvdd-supply
  - vddio-supply

additionalProperties: false

examples:
  - |
    #include <dt-bindings/gpio/gpio.h>

    dsi0 {
        #address-cells = <1>;
        #size-cells = <0>;

        panel@0 {
            compatible = "sharp,ls055d1sx04", "novatek,nt35950";
            reg = <0>;

            backlight = <&pmi8998_wled>;
            reset-gpios = <&tlmm 94 GPIO_ACTIVE_HIGH>;

            avdd-supply = <&lab>;
            avee-supply = <&ibb>;
            dvdd-supply = <&disp_dvdd_vreg>;
            vddio-supply = <&vreg_l14a_1p85>;

            ports {
                #address-cells = <1>;
                #size-cells = <0>;

                port@0 {
                    reg = <0>;
                    panel_in0: endpoint {
                        remote-endpoint = <&dsi0_out>;
                    };
                };

                port@1 {
                    reg = <1>;
                    panel_in1: endpoint {
                        remote-endpoint = <&dsi1_out>;
                    };
                };
            };
        };
    };

...
```
