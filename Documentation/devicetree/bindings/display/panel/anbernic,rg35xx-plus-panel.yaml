## Documentation/devicetree/bindings/display/panel/anbernic,rg35xx-plus-panel.yaml
```yaml
# SPDX-License-Identifier: (GPL-2.0-only OR BSD-2-Clause)
%YAML 1.2
---
$id: http://devicetree.org/schemas/display/panel/anbernic,rg35xx-plus-panel.yaml#
$schema: http://devicetree.org/meta-schemas/core.yaml#

title: Anbernic RG35XX series (WL-355608-A8) 3.5" 640x480 24-bit IPS LCD panel

maintainers:
  - Ryan Walklin <ryan@testtoast.com>

allOf:
  - $ref: panel-common.yaml#
  - $ref: /schemas/spi/spi-peripheral-props.yaml#

properties:
  compatible:
    oneOf:
      - const: anbernic,rg35xx-plus-panel
      - items:
          - enum:
              - anbernic,rg35xx-2024-panel
              - anbernic,rg35xx-h-panel
              - anbernic,rg35xx-sp-panel
          - const: anbernic,rg35xx-plus-panel

  reg:
    maxItems: 1

  spi-3wire: true

required:
  - compatible
  - reg
  - port
  - power-supply
  - reset-gpios

unevaluatedProperties: false

examples:
  - |
    #include <dt-bindings/gpio/gpio.h>

    spi {
        #address-cells = <1>;
        #size-cells = <0>;

        panel@0 {
            compatible = "anbernic,rg35xx-plus-panel";
            reg = <0>;

            spi-3wire;
            spi-max-frequency = <3125000>;

            reset-gpios = <&pio 8 14 GPIO_ACTIVE_LOW>; // PI14

            backlight = <&backlight>;
            power-supply = <&reg_lcd>;

            port {
                endpoint {
                    remote-endpoint = <&tcon_lcd0_out_lcd>;
                };
            };
        };
    };
```

## Documentation/devicetree/bindings/display/panel/anbernic,td4310.yaml
```yaml
# SPDX-License-Identifier: (GPL-2.0-only OR BSD-2-Clause)
%YAML 1.2
---
$id: http://devicetree.org/schemas/display/panel/anbernic,td4310.yaml#
$schema: http://devicetree.org/meta-schemas/core.yaml#

title: Anbernic TD4310 Based Panels

maintainers:
  - Chris Morgan <macromorgan@hotmail.com>

description:
  Anbernic TD4310 Based Panels, such as the RG-Vita-Pro panel
  (a 1080x1920 5.5 inch panel).

allOf:
  - $ref: panel-common.yaml#

properties:
  compatible:
    items:
      - enum:
          - anbernic,panel-vita-pro
      - const: anbernic,td4310

  reg:
    maxItems: 1

  vdd-supply:
    description: Panel power supply

required:
  - compatible
  - port
  - reg
  - reset-gpios
  - vdd-supply

unevaluatedProperties: false

examples:
  - |
    #include <dt-bindings/gpio/gpio.h>

    dsi {
        #address-cells = <1>;
        #size-cells = <0>;

        panel@0 {
            compatible = "anbernic,panel-vita-pro", "anbernic,td4310";
            reg = <0>;
            backlight = <&backlight>;
            enable-gpios = <&gpio0 9 GPIO_ACTIVE_HIGH>;
            reset-gpios = <&gpio0 13 GPIO_ACTIVE_LOW>;
            rotation = <270>;
            vdd-supply = <&vdd_lcd>;

            port {
                endpoint {
                    remote-endpoint = <&dsi_out>;
                };
            };
        };
    };

...
```

## Documentation/devicetree/bindings/display/panel/apple,summit.yaml
```yaml
# SPDX-License-Identifier: (GPL-2.0-only OR BSD-2-Clause)
%YAML 1.2
---
$id: http://devicetree.org/schemas/display/panel/apple,summit.yaml#
$schema: http://devicetree.org/meta-schemas/core.yaml#

title: Apple "Summit" display panel

maintainers:
  - Sasha Finkelstein <fnkl.kernel@gmail.com>

description:
  An OLED panel used as a touchbar on certain Apple laptops.
  Contains a backlight device, which controls brightness of the panel itself.
  The backlight common properties are included for this reason

allOf:
  - $ref: panel-common.yaml#
  - $ref: /schemas/leds/backlight/common.yaml#

properties:
  compatible:
    items:
      - enum:
          - apple,j293-summit
          - apple,j493-summit
      - const: apple,summit

  reg:
    maxItems: 1

required:
  - compatible
  - reg
  - max-brightness
  - port

unevaluatedProperties: false

examples:
  - |
    dsi {
        #address-cells = <1>;
        #size-cells = <0>;

        panel@0 {
            compatible = "apple,j293-summit", "apple,summit";
            reg = <0>;
            max-brightness = <255>;

            port {
                endpoint {
                    remote-endpoint = <&dfr_bridge_out>;
                };
            };
        };
    };
...
```

## Documentation/devicetree/bindings/display/panel/arm,rtsm-display.yaml
```yaml
# SPDX-License-Identifier: GPL-2.0-only OR BSD-2-Clause
%YAML 1.2
---
$id: http://devicetree.org/schemas/display/panel/arm,rtsm-display.yaml#
$schema: http://devicetree.org/meta-schemas/core.yaml#

title: Arm RTSM Virtual Platforms Display

maintainers:
  - Linus Walleij <linus.walleij@linaro.org>

allOf:
  - $ref: panel-common.yaml#

properties:
  compatible:
    const: arm,rtsm-display

  port: true

required:
  - compatible
  - port

additionalProperties: false

...
```

## Documentation/devicetree/bindings/display/panel/arm,versatile-tft-panel.txt
```
ARM Versatile TFT Panels

These panels are connected to the daughterboards found on the
ARM Versatile reference designs.

This device node must appear as a child to a "syscon"-compatible
node.

Required properties:
- compatible: should be "arm,versatile-tft-panel"

Required subnodes:
- port: see display/panel/panel-common.txt, graph.txt


Example:

sysreg@0 {
	compatible = "arm,versatile-sysreg", "syscon", "simple-mfd";
	reg = <0x00000 0x1000>;

	panel: display@0 {
		compatible = "arm,versatile-tft-panel";

		port {
			panel_in: endpoint {
				remote-endpoint = <&foo>;
			};
		};
	};
};
```

## Documentation/devicetree/bindings/display/panel/arm,versatile-tft-panel.yaml
```yaml
# SPDX-License-Identifier: GPL-2.0
%YAML 1.2
---
$id: http://devicetree.org/schemas/display/panel/arm,versatile-tft-panel.yaml#
$schema: http://devicetree.org/meta-schemas/core.yaml#

title: ARM Versatile TFT Panels

maintainers:
  - Linus Walleij <linus.walleij@linaro.org>

description: |
  These panels are connected to the daughterboards found on the
  ARM Versatile reference designs.

  This device node must appear as a child to a "syscon"-compatible
  node.

allOf:
  - $ref: panel-common.yaml#

properties:
  compatible:
    const: arm,versatile-tft-panel

  port: true

required:
  - compatible
  - port

additionalProperties: false

examples:
  - |
    sysreg@0 {
        compatible = "arm,versatile-sysreg", "syscon", "simple-mfd";
        reg = <0x00000 0x1000>;

        #address-cells = <1>;
        #size-cells = <0>;

        panel {
            compatible = "arm,versatile-tft-panel";

            port {
                panel_in: endpoint {
                    remote-endpoint = <&foo>;
                };
            };
        };
    };

...
```

## Documentation/devicetree/bindings/display/panel/armadeus,st0700-adapt.txt
```
Armadeus ST0700 Adapt. A Santek ST0700I5Y-RBSLW 7.0" WVGA (800x480) TFT with
an adapter board.

Required properties:
- compatible: "armadeus,st0700-adapt"
- power-supply: see panel-common.txt

Optional properties:
- backlight: see panel-common.txt
```

## Documentation/devicetree/bindings/display/panel/armadeus,st0700-adapt.yaml
```yaml
# SPDX-License-Identifier: GPL-2.0
%YAML 1.2
---
$id: http://devicetree.org/schemas/display/panel/armadeus,st0700-adapt.yaml#
$schema: http://devicetree.org/meta-schemas/core.yaml#

title: Armadeus ST0700 Adapter

description:
  A Santek ST0700I5Y-RBSLW 7.0" WVGA (800x480) TFT with an adapter board.

maintainers:
  - '"Sébastien Szymanski" <sebastien.szymanski@armadeus.com>'
  - Thierry Reding <thierry.reding@gmail.com>

allOf:
  - $ref: panel-common.yaml#

properties:
  compatible:
    const: armadeus,st0700-adapt

  power-supply: true
  backlight: true
  port: true

additionalProperties: false

required:
  - compatible
  - power-supply

...
```

## Documentation/devicetree/bindings/display/panel/asus,z00t-tm5p5-nt35596.yaml
```yaml
# SPDX-License-Identifier: (GPL-2.0-only OR BSD-2-Clause)
%YAML 1.2
---
$id: http://devicetree.org/schemas/display/panel/asus,z00t-tm5p5-nt35596.yaml#
$schema: http://devicetree.org/meta-schemas/core.yaml#

title: ASUS Z00T TM5P5 NT35596 5.5" 1080×1920 LCD Panel

maintainers:
  - Konrad Dybcio <konradybcio@gmail.com>

description: |+
  This panel seems to only be found in the Asus Z00T
  smartphone and we have no straightforward way of
  actually getting the correct model number,
  as no schematics are released publicly.

allOf:
  - $ref: panel-common.yaml#

properties:
  compatible:
    const: asus,z00t-tm5p5-n35596
  reg: true
  reset-gpios: true
  vdd-supply:
    description: core voltage supply
  vddio-supply:
    description: vddio supply

required:
  - compatible
  - reg
  - vdd-supply
  - vddio-supply
  - reset-gpios

additionalProperties: false

examples:
  - |
    #include <dt-bindings/gpio/gpio.h>

    dsi {
            #address-cells = <1>;
            #size-cells = <0>;
            panel@0 {
                    reg = <0>;

                    compatible = "asus,z00t-tm5p5-n35596";

                    vdd-supply = <&pm8916_l8>;
                    vddio-supply = <&pm8916_l6>;
                    reset-gpios = <&msmgpio 25 GPIO_ACTIVE_HIGH>;
            };
    };
```

## Documentation/devicetree/bindings/display/panel/auo,a030jtn01.yaml
```yaml
# SPDX-License-Identifier: (GPL-2.0 OR BSD-2-Clause)
%YAML 1.2
---
$id: http://devicetree.org/schemas/display/panel/auo,a030jtn01.yaml#
$schema: http://devicetree.org/meta-schemas/core.yaml#

title: AUO A030JTN01 3.0" (320x480 pixels) 24-bit TFT LCD panel

description: |
  Delta RGB 8-bit panel found in some Retrogame handhelds

maintainers:
  - Paul Cercueil <paul@crapouillou.net>
  - Christophe Branchereau <cbranchereau@gmail.com>

allOf:
  - $ref: panel-common.yaml#
  - $ref: /schemas/spi/spi-peripheral-props.yaml#

properties:
  compatible:
    const: auo,a030jtn01

  reg:
    maxItems: 1

required:
  - compatible
  - reg
  - power-supply
  - reset-gpios

unevaluatedProperties: false

examples:
  - |
    #include <dt-bindings/gpio/gpio.h>

    spi {
        #address-cells = <1>;
        #size-cells = <0>;

        panel@0 {
            compatible = "auo,a030jtn01";
            reg = <0>;

            spi-max-frequency = <10000000>;

            reset-gpios = <&gpe 4 GPIO_ACTIVE_LOW>;
            power-supply = <&lcd_power>;

            backlight = <&backlight>;

            port {
                panel_input: endpoint {
                    remote-endpoint = <&panel_output>;
                };
            };
        };
    };
```

## Documentation/devicetree/bindings/display/panel/auo,b080uan01.txt
```
AU Optronics Corporation 8.0" WUXGA TFT LCD panel

Required properties:
- compatible: should be "auo,b101ean01"

This binding is compatible with the simple-panel binding, which is specified
in simple-panel.txt in this directory.
```

## Documentation/devicetree/bindings/display/panel/auo,b101ew05.txt
```
AU Optronics Corporation 10.1" WSVGA TFT LCD panel

Required properties:
- compatible: should be "auo,b101ew05"

This binding is compatible with the simple-panel binding, which is specified
in simple-panel.txt in this directory.
```

## Documentation/devicetree/bindings/display/panel/auo,b125han03.txt
```
AU Optronics Corporation 12.5" FHD TFT LCD panel

Required properties:
- compatible: should be "auo,b125han03"

This binding is compatible with the simple-panel binding, which is specified
in simple-panel.txt in this directory.
```

## Documentation/devicetree/bindings/display/panel/auo,b133htn01.txt
```
AU Optronics Corporation 13.3" FHD (1920x1080) color TFT-LCD panel

Required properties:
- compatible: should be "auo,b133htn01"

This binding is compatible with the simple-panel binding, which is specified
in simple-panel.txt in this directory.
```

## Documentation/devicetree/bindings/display/panel/auo,b133xtn01.txt
```
AU Optronics Corporation 13.3" WXGA (1366x768) TFT LCD panel

Required properties:
- compatible: should be "auo,b133xtn01"

This binding is compatible with the simple-panel binding, which is specified
in simple-panel.txt in this directory.
```

## Documentation/devicetree/bindings/display/panel/auo,g070vvn01.txt
```
AU Optronics Corporation 7.0" FHD (800 x 480) TFT LCD panel

Required properties:
- compatible: should be "auo,g070vvn01"
- backlight: phandle of the backlight device attached to the panel
- power-supply: single regulator to provide the supply voltage

Required nodes:
- port: Parallel port mapping to connect this display

This panel needs single power supply voltage. Its backlight is conntrolled
via PWM signal.

Example:
--------

Example device-tree definition when connected to iMX6Q based board

	lcd_panel: lcd-panel {
		compatible = "auo,g070vvn01";
		backlight = <&backlight_lcd>;
		power-supply = <&reg_display>;

		port {
			lcd_panel_in: endpoint {
				remote-endpoint = <&lcd_display_out>;
			};
		};
	};
```

## Documentation/devicetree/bindings/display/panel/auo,g101evn010.txt
```
AU Optronics Corporation 10.1" (1280x800) color TFT LCD panel

Required properties:
- compatible: should be "auo,g101evn010"
- power-supply: as specified in the base binding

Optional properties:
- backlight: as specified in the base binding
- enable-gpios: as specified in the base binding

This binding is compatible with the simple-panel binding, which is specified
in simple-panel.txt in this directory.
```

## Documentation/devicetree/bindings/display/panel/auo,g104sn02.txt
```
AU Optronics Corporation 10.4" (800x600) color TFT LCD panel

Required properties:
- compatible: should be "auo,g104sn02"
- power-supply: as specified in the base binding

Optional properties:
- backlight: as specified in the base binding
- enable-gpios: as specified in the base binding

This binding is compatible with the simple-panel binding, which is specified
in simple-panel.txt in this directory.
```

## Documentation/devicetree/bindings/display/panel/auo,g133han01.txt
```
AU Optronics Corporation 13.3" FHD (1920x1080) TFT LCD panel

Required properties:
- compatible: should be "auo,g133han01"

This binding is compatible with the simple-panel binding, which is specified
in simple-panel.txt in this directory.
```

## Documentation/devicetree/bindings/display/panel/auo,g185han01.txt
```
AU Optronics Corporation 18.5" FHD (1920x1080) TFT LCD panel

Required properties:
- compatible: should be "auo,g185han01"

This binding is compatible with the simple-panel binding, which is specified
in simple-panel.txt in this directory.
```

## Documentation/devicetree/bindings/display/panel/auo,p320hvn03.txt
```
AU Optronics Corporation 31.5" FHD (1920x1080) TFT LCD panel

Required properties:
- compatible: should be "auo,p320hvn03"
- power-supply: as specified in the base binding

This binding is compatible with the simple-panel binding, which is specified
in simple-panel.txt in this directory.
```

## Documentation/devicetree/bindings/display/panel/auo,t215hvn01.txt
```
AU Optronics Corporation 21.5" FHD (1920x1080) color TFT LCD panel

Required properties:
- compatible: should be "auo,t215hvn01"

This binding is compatible with the simple-panel binding, which is specified
in simple-panel.txt in this directory.
```

## Documentation/devicetree/bindings/display/panel/avic,tm070ddh03.txt
```
Shanghai AVIC Optoelectronics 7" 1024x600 color TFT-LCD panel

Required properties:
- compatible: should be "avic,tm070ddh03"

This binding is compatible with the simple-panel binding, which is specified
in simple-panel.txt in this directory.
```

## Documentation/devicetree/bindings/display/panel/bananapi,s070wv20-ct16.txt
```
Banana Pi 7" (S070WV20-CT16) TFT LCD Panel

Required properties:
- compatible: should be "bananapi,s070wv20-ct16"
- power-supply: see ./panel-common.txt

Optional properties:
- enable-gpios: see ./simple-panel.txt
- backlight: see ./simple-panel.txt

This binding is compatible with the simple-panel binding, which is specified
in ./simple-panel.txt.
```
