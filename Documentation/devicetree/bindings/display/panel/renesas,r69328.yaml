## Documentation/devicetree/bindings/display/panel/samsung,ld9040.txt
```
Samsung LD9040 AMOLED LCD parallel RGB panel with SPI control bus

Required properties:
  - compatible: "samsung,ld9040"
  - reg: address of the panel on SPI bus
  - vdd3-supply: core voltage supply
  - vci-supply: voltage supply for analog circuits
  - reset-gpios: a GPIO spec for the reset pin
  - display-timings: timings for the connected panel according to [1]

The panel must obey rules for SPI slave device specified in document [2].

Optional properties:
  - power-on-delay: delay after turning regulators on [ms]
  - reset-delay: delay after reset sequence [ms]
  - panel-width-mm: physical panel width [mm]
  - panel-height-mm: physical panel height [mm]

The device node can contain one 'port' child node with one child
'endpoint' node, according to the bindings defined in [3]. This
node should describe panel's video bus.

[1]: Documentation/devicetree/bindings/display/display-timing.txt
[2]: Documentation/devicetree/bindings/spi/spi-bus.txt
[3]: Documentation/devicetree/bindings/media/video-interfaces.txt

Example:

	lcd@0 {
		compatible = "samsung,ld9040";
		reg = <0>;
		vdd3-supply = <&ldo7_reg>;
		vci-supply = <&ldo17_reg>;
		reset-gpios = <&gpy4 5 0>;
		spi-max-frequency = <1200000>;
		spi-cpol;
		spi-cpha;
		power-on-delay = <10>;
		reset-delay = <10>;
		panel-width-mm = <90>;
		panel-height-mm = <154>;

		display-timings {
			timing {
				clock-frequency = <23492370>;
				hactive = <480>;
				vactive = <800>;
				hback-porch = <16>;
				hfront-porch = <16>;
				vback-porch = <2>;
				vfront-porch = <28>;
				hsync-len = <2>;
				vsync-len = <1>;
				hsync-active = <0>;
				vsync-active = <0>;
				de-active = <0>;
				pixelclk-active = <0>;
			};
		};

		port {
			lcd_ep: endpoint {
				remote-endpoint = <&fimd_dpi_ep>;
			};
		};
	};
```

## Documentation/devicetree/bindings/display/panel/samsung,ld9040.yaml
```yaml
# SPDX-License-Identifier: GPL-2.0
%YAML 1.2
---
$id: http://devicetree.org/schemas/display/panel/samsung,ld9040.yaml#
$schema: http://devicetree.org/meta-schemas/core.yaml#

title: Samsung LD9040 AMOLED LCD parallel RGB panel with SPI control bus

description: |
  The panel must obey the rules for a SPI slave device as specified in
  spi/spi-controller.yaml

maintainers:
  - Andrzej Hajda <a.hajda@samsung.com>

allOf:
  - $ref: panel-common.yaml#

properties:
  compatible:
    const: samsung,ld9040

  display-timings: true
  port: true
  reg: true
  reset-gpios: true

  vdd3-supply:
    description: core voltage supply

  vci-supply:
    description: voltage supply for analog circuits

  power-on-delay:
    $ref: /schemas/types.yaml#/definitions/uint32
    description: delay after turning regulators on [ms]

  reset-delay:
    $ref: /schemas/types.yaml#/definitions/uint32
    description: delay after reset sequence [ms]

  panel-width-mm:
    description: physical panel width [mm]

  panel-height-mm:
    description: physical panel height [mm]

required:
  - compatible
  - reg
  - vdd3-supply
  - vci-supply
  - reset-gpios
  - display-timings

unevaluatedProperties: false

examples:
  - |
    spi {
        #address-cells = <1>;
        #size-cells = <0>;

        lcd@0 {
            compatible = "samsung,ld9040";
            #address-cells = <1>;
            #size-cells = <0>;

            reg = <0>;
            vdd3-supply = <&ldo7_reg>;
            vci-supply = <&ldo17_reg>;
            reset-gpios = <&gpy4 5 0>;
            spi-max-frequency = <1200000>;
            spi-cpol;
            spi-cpha;
            power-on-delay = <10>;
            reset-delay = <10>;
            panel-width-mm = <90>;
            panel-height-mm = <154>;

            display-timings {
                timing {
                    clock-frequency = <23492370>;
                    hactive = <480>;
                    vactive = <800>;
                    hback-porch = <16>;
                    hfront-porch = <16>;
                    vback-porch = <2>;
                    vfront-porch = <28>;
                    hsync-len = <2>;
                    vsync-len = <1>;
                    hsync-active = <0>;
                    vsync-active = <0>;
                    de-active = <0>;
                    pixelclk-active = <0>;
                };
            };

            port {
                lcd_ep: endpoint {
                    remote-endpoint = <&fimd_dpi_ep>;
                };
            };
        };
    };

...
```

## Documentation/devicetree/bindings/display/panel/samsung,lms380kf01.yaml
```yaml
# SPDX-License-Identifier: (GPL-2.0-only OR BSD-2-Clause)
%YAML 1.2
---
$id: http://devicetree.org/schemas/display/panel/samsung,lms380kf01.yaml#
$schema: http://devicetree.org/meta-schemas/core.yaml#

title: Samsung LMS380KF01 display panel

description: The LMS380KF01 is a 480x800 DPI display panel from Samsung Mobile
  Displays (SMD) utilizing the WideChips WS2401 display controller. It can be
  used with internal or external backlight control.
  The panel must obey the rules for a SPI slave device as specified in
  spi/spi-controller.yaml

maintainers:
  - Linus Walleij <linus.walleij@linaro.org>

allOf:
  - $ref: panel-common.yaml#

properties:
  compatible:
    const: samsung,lms380kf01

  reg: true

  interrupts:
    description: provides an optional ESD (electrostatic discharge)
      interrupt that signals abnormalities in the display hardware.
      This can also be raised for other reasons like erroneous
      configuration.
    maxItems: 1

  reset-gpios: true

  vci-supply:
    description: regulator that supplies the VCI analog voltage
      usually around 3.0 V

  vccio-supply:
    description: regulator that supplies the VCCIO voltage usually
      around 1.8 V

  backlight: true

  spi-cpha: true

  spi-cpol: true

  spi-max-frequency:
    maximum: 1200000

  port: true

required:
  - compatible
  - reg
  - spi-cpha
  - spi-cpol
  - port

additionalProperties: false

examples:
  - |
    #include <dt-bindings/gpio/gpio.h>
    #include <dt-bindings/interrupt-controller/irq.h>

    spi {
        compatible = "spi-gpio";
        sck-gpios = <&gpio 0 GPIO_ACTIVE_HIGH>;
        miso-gpios = <&gpio 1 GPIO_ACTIVE_HIGH>;
        mosi-gpios = <&gpio 2 GPIO_ACTIVE_HIGH>;
        cs-gpios = <&gpio 3 GPIO_ACTIVE_HIGH>;
        num-chipselects = <1>;
        #address-cells = <1>;
        #size-cells = <0>;

        panel@0 {
            compatible = "samsung,lms380kf01";
            spi-max-frequency = <1200000>;
            spi-cpha;
            spi-cpol;
            reg = <0>;
            vci-supply = <&lcd_3v0_reg>;
            vccio-supply = <&lcd_1v8_reg>;
            reset-gpios = <&gpio 4 GPIO_ACTIVE_LOW>;
            interrupt-parent = <&gpio>;
            interrupts = <5 IRQ_TYPE_EDGE_RISING>;

            port {
                panel_in: endpoint {
                    remote-endpoint = <&display_out>;
                };
            };
        };
    };

...
```

## Documentation/devicetree/bindings/display/panel/samsung,lms397kf04.yaml
```yaml
# SPDX-License-Identifier: (GPL-2.0-only OR BSD-2-Clause)
%YAML 1.2
---
$id: http://devicetree.org/schemas/display/panel/samsung,lms397kf04.yaml#
$schema: http://devicetree.org/meta-schemas/core.yaml#

title: Samsung LMS397KF04 display panel

description: The datasheet claims this is based around a display controller
  named DB7430 with a separate backlight controller.

maintainers:
  - Linus Walleij <linus.walleij@linaro.org>

allOf:
  - $ref: panel-common.yaml#

properties:
  compatible:
    const: samsung,lms397kf04

  reg: true

  reset-gpios: true

  vci-supply:
    description: regulator that supplies the VCI analog voltage
      usually around 3.0 V

  vccio-supply:
    description: regulator that supplies the VCCIO voltage usually
      around 1.8 V

  backlight: true

  spi-cpha: true

  spi-cpol: true

  spi-max-frequency:
    description: inherited as a SPI client node, the datasheet specifies
      maximum 300 ns minimum cycle which gives around 3 MHz max frequency
    maximum: 3000000

  port: true

required:
  - compatible
  - reg
  - spi-cpha
  - spi-cpol
  - port

additionalProperties: false

examples:
  - |
    #include <dt-bindings/gpio/gpio.h>

    spi {
      compatible = "spi-gpio";
      sck-gpios = <&gpio 0 GPIO_ACTIVE_HIGH>;
      miso-gpios = <&gpio 1 GPIO_ACTIVE_HIGH>;
      mosi-gpios = <&gpio 2 GPIO_ACTIVE_HIGH>;
      cs-gpios = <&gpio 3 GPIO_ACTIVE_HIGH>;
      num-chipselects = <1>;
      #address-cells = <1>;
      #size-cells = <0>;
      panel@0 {
        compatible = "samsung,lms397kf04";
        spi-max-frequency = <3000000>;
        spi-cpha;
        spi-cpol;
        reg = <0>;
        vci-supply = <&lcd_3v0_reg>;
        vccio-supply = <&lcd_1v8_reg>;
        reset-gpios = <&gpio 4 GPIO_ACTIVE_LOW>;
        backlight = <&ktd259>;

        port {
          panel_in: endpoint {
            remote-endpoint = <&display_out>;
          };
        };
      };
    };

...
```

## Documentation/devicetree/bindings/display/panel/samsung,lsn122dl01-c01.txt
```
Samsung 12.2" (2560x1600 pixels) TFT LCD panel

Required properties:
- compatible: should be "samsung,lsn122dl01-c01"

This binding is compatible with the simple-panel binding, which is specified
in simple-panel.txt in this directory.
```

## Documentation/devicetree/bindings/display/panel/samsung,ltn101nt05.txt
```
Samsung Electronics 10.1" WSVGA TFT LCD panel

Required properties:
- compatible: should be "samsung,ltn101nt05"

This binding is compatible with the simple-panel binding, which is specified
in simple-panel.txt in this directory.
```

## Documentation/devicetree/bindings/display/panel/samsung,ltn140at29-301.txt
```
Samsung Electronics 14" WXGA (1366x768) TFT LCD panel

Required properties:
- compatible: should be "samsung,ltn140at29-301"

This binding is compatible with the simple-panel binding, which is specified
in simple-panel.txt in this directory.
```

## Documentation/devicetree/bindings/display/panel/samsung,s6d16d0.txt
```
Samsung S6D16D0 4" 864x480 AMOLED panel

Required properties:
  - compatible: should be:
    "samsung,s6d16d0",
  - reg: the virtual channel number of a DSI peripheral
  - vdd1-supply: I/O voltage supply
  - reset-gpios: a GPIO spec for the reset pin (active low)

The device yesde can contain one 'port' child yesde with one child
'endpoint' yesde, according to the bindings defined in
media/video-interfaces.txt. This yesde should describe panel's video bus.

Example:
&dsi {
	...

	panel@0 {
		compatible = "samsung,s6d16d0";
		reg = <0>;
		vdd1-supply = <&foo>;
		reset-gpios = <&foo_gpio 0 GPIO_ACTIVE_LOW>;

		port {
			panel_in: endpoint {
				remote-endpoint = <&dsi_out>;
			};
		};
	};
};
```

## Documentation/devicetree/bindings/display/panel/samsung,s6d16d0.yaml
```yaml
# SPDX-License-Identifier: GPL-2.0
%YAML 1.2
---
$id: http://devicetree.org/schemas/display/panel/samsung,s6d16d0.yaml#
$schema: http://devicetree.org/meta-schemas/core.yaml#

title: Samsung S6D16D0 4" 864x480 AMOLED panel

maintainers:
  - Linus Walleij <linus.walleij@linaro.org>

allOf:
  - $ref: panel-common.yaml#

properties:
  compatible:
    const: samsung,s6d16d0

  port: true
  reg: true
  reset-gpios: true

  vdd1-supply:
    description: I/O voltage supply

required:
  - compatible
  - reg
  - vdd1-supply
  - reset-gpios

additionalProperties: false

examples:
  - |
    #include <dt-bindings/gpio/gpio.h>

    dsi {
        #address-cells = <1>;
        #size-cells = <0>;

        panel@0 {
            compatible = "samsung,s6d16d0";
            reg = <0>;
            vdd1-supply = <&foo>;
            reset-gpios = <&foo_gpio 0 GPIO_ACTIVE_LOW>;

            port {
                panel_in: endpoint {
                    remote-endpoint = <&dsi_out>;
                };
            };
        };
    };

...
```

## Documentation/devicetree/bindings/display/panel/samsung,s6d7aa0.yaml
```yaml
# SPDX-License-Identifier: (GPL-2.0-only OR BSD-2-Clause)
%YAML 1.2
---
$id: http://devicetree.org/schemas/display/panel/samsung,s6d7aa0.yaml#
$schema: http://devicetree.org/meta-schemas/core.yaml#

title: Samsung S6D7AA0 MIPI-DSI LCD panel controller

maintainers:
  - Artur Weber <aweber.kernel@gmail.com>

allOf:
  - $ref: panel-common.yaml#

properties:
  compatible:
    items:
      - enum:
          # 1280x800 LSL080AL02 panel
          - samsung,lsl080al02
          # 1024x768 LSL080AL03 panel
          - samsung,lsl080al03
          # 1024x768 LTL101AT01 panel
          - samsung,ltl101at01
      - const: samsung,s6d7aa0

  reg: true

  backlight:
    description:
      Backlight to use for the panel. If this property is set on panels
      that have DSI-based backlight control (LSL080AL03 and LTL101AT01),
      it overrides the DSI-based backlight.

  reset-gpios:
    description: Reset GPIO pin, usually GPIO_ACTIVE_LOW.

  power-supply:
    description:
      Main power supply for the panel; the exact voltage differs between
      panels, and is usually somewhere around 3.3-5v.

  vmipi-supply:
    description: VMIPI supply, usually 1.8v.

required:
  - compatible
  - reg
  - reset-gpios

additionalProperties: false

examples:
  - |
    #include <dt-bindings/gpio/gpio.h>

    dsi {
        #address-cells = <1>;
        #size-cells = <0>;

        panel@0 {
            compatible = "samsung,lsl080al02", "samsung,s6d7aa0";
            reg = <0>;
            power-supply = <&display_3v3_supply>;
            reset-gpios = <&gpf0 4 GPIO_ACTIVE_LOW>;
            backlight = <&backlight>;
        };
    };

...
```

## Documentation/devicetree/bindings/display/panel/samsung,s6e3fc2x01.yaml
```yaml
# SPDX-License-Identifier: GPL-2.0-only OR BSD-2-Clause
%YAML 1.2
---
$id: http://devicetree.org/schemas/display/panel/samsung,s6e3fc2x01.yaml#
$schema: http://devicetree.org/meta-schemas/core.yaml#

title: Samsung S6E3FC2X01 AMOLED DDIC

description: The S6E3FC2X01 is display driver IC with connected panel.

maintainers:
  - David Heidelberg <david@ixit.cz>

allOf:
  - $ref: panel-common.yaml#

properties:
  compatible:
    items:
      - enum:
            # Samsung 6.41 inch, 1080x2340 pixels, 19.5:9 ratio
          - samsung,s6e3fc2x01-ams641rw
      - const: samsung,s6e3fc2x01

  reg:
    maxItems: 1

  reset-gpios: true

  port: true

  vddio-supply:
    description: VDD regulator

  vci-supply:
    description: VCI regulator

  poc-supply:
    description: POC regulator

required:
  - compatible
  - reset-gpios
  - vddio-supply
  - vci-supply
  - poc-supply

unevaluatedProperties: false

examples:
  - |
    #include <dt-bindings/gpio/gpio.h>

    dsi {
        #address-cells = <1>;
        #size-cells = <0>;

        panel@0 {
            compatible = "samsung,s6e3fc2x01-ams641rw", "samsung,s6e3fc2x01";
            reg = <0>;

            vddio-supply = <&vreg_l14a_1p88>;
            vci-supply = <&s2dos05_buck1>;
            poc-supply = <&s2dos05_ldo1>;

            te-gpios = <&tlmm 10 GPIO_ACTIVE_HIGH>;
            reset-gpios = <&tlmm 6 GPIO_ACTIVE_HIGH>;

            pinctrl-0 = <&sde_dsi_active &sde_te_active_sleep>;
            pinctrl-1 = <&sde_dsi_suspend &sde_te_active_sleep>;
            pinctrl-names = "default", "sleep";

            port {
                panel_in: endpoint {
                    remote-endpoint = <&mdss_dsi0_out>;
                };
            };
        };
    };

...
```
