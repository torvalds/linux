## Documentation/devicetree/bindings/display/panel/samsung,s6e3ha2.txt
```
Samsung S6E3HA2 5.7" 1440x2560 AMOLED panel

Required properties:
  - compatible: "samsung,s6e3ha2"
  - reg: the virtual channel number of a DSI peripheral
  - vdd3-supply: I/O voltage supply
  - vci-supply: voltage supply for analog circuits
  - reset-gpios: a GPIO spec for the reset pin (active low)
  - enable-gpios: a GPIO spec for the panel enable pin (active high)

Optional properties:
  - te-gpios: a GPIO spec for the tearing effect synchronization signal
    gpio pin (active high)

Example:
&dsi {
	...

	panel@0 {
		compatible = "samsung,s6e3ha2";
		reg = <0>;
		vdd3-supply = <&ldo27_reg>;
		vci-supply = <&ldo28_reg>;
		reset-gpios = <&gpg0 0 GPIO_ACTIVE_LOW>;
		enable-gpios = <&gpf1 5 GPIO_ACTIVE_HIGH>;
		te-gpios = <&gpf1 3 GPIO_ACTIVE_HIGH>;
	};
};
```

## Documentation/devicetree/bindings/display/panel/samsung,s6e3ha8.yaml
```yaml
# SPDX-License-Identifier: GPL-2.0-only OR BSD-2-Clause
%YAML 1.2
---
$id: http://devicetree.org/schemas/display/panel/samsung,s6e3ha8.yaml#
$schema: http://devicetree.org/meta-schemas/core.yaml#

title: Samsung s6e3ha8 AMOLED DSI panel

description: The s6e3ha8 is a 1440x2960 DPI display panel from Samsung Mobile
  Displays (SMD).

maintainers:
  - Dzmitry Sankouski <dsankouski@gmail.com>

allOf:
  - $ref: panel-common.yaml#

properties:
  compatible:
    const: samsung,s6e3ha8

  reg:
    maxItems: 1

  reset-gpios: true

  port: true

  vdd3-supply:
    description: VDD regulator

  vci-supply:
    description: VCI regulator

  vddr-supply:
    description: VDDR regulator

required:
  - compatible
  - reset-gpios
  - vdd3-supply
  - vci-supply
  - vddr-supply

unevaluatedProperties: false

examples:
  - |
    #include <dt-bindings/gpio/gpio.h>

    dsi {
        #address-cells = <1>;
        #size-cells = <0>;

        panel@0 {
            compatible = "samsung,s6e3ha8";
            reg = <0>;
            vci-supply = <&s2dos05_ldo4>;
            vddr-supply = <&s2dos05_buck1>;
            vdd3-supply = <&s2dos05_ldo1>;
            te-gpios = <&tlmm 10 GPIO_ACTIVE_HIGH>;
            reset-gpios = <&tlmm 6 GPIO_ACTIVE_HIGH>;
            pinctrl-0 = <&sde_dsi_active &sde_te_active_sleep>;
            pinctrl-1 = <&sde_dsi_suspend &sde_te_active_sleep>;
            pinctrl-names = "default", "sleep";

            port {
                panel_in: endpoint {
                    remote-endpoint = <&mdss_dsi0_out>;
                };
            };
        };
    };

...
```

## Documentation/devicetree/bindings/display/panel/samsung,s6e63j0x03.txt
```
Samsung S6E63J0X03 1.63" 320x320 AMOLED panel (interface: MIPI-DSI command mode)

Required properties:
  - compatible: "samsung,s6e63j0x03"
  - reg: the virtual channel number of a DSI peripheral
  - vdd3-supply: I/O voltage supply
  - vci-supply: voltage supply for analog circuits
  - reset-gpios: a GPIO spec for the reset pin (active low)
  - te-gpios: a GPIO spec for the tearing effect synchronization signal
    gpio pin (active high)

Example:
&dsi {
	...

	panel@0 {
		compatible = "samsung,s6e63j0x03";
		reg = <0>;
		vdd3-supply = <&ldo16_reg>;
		vci-supply = <&ldo20_reg>;
		reset-gpios = <&gpe0 1 GPIO_ACTIVE_LOW>;
		te-gpios = <&gpx0 6 GPIO_ACTIVE_HIGH>;
	};
};
```

## Documentation/devicetree/bindings/display/panel/samsung,s6e63m0.txt
```
Samsung s6e63m0 AMOLED LCD panel

Required properties:
  - compatible: "samsung,s6e63m0"
  - reset-gpios: GPIO spec for reset pin
  - vdd3-supply: VDD regulator
  - vci-supply: VCI regulator

The panel must obey rules for SPI slave device specified in document [1].

The device node can contain one 'port' child node with one child
'endpoint' node, according to the bindings defined in [2]. This
node should describe panel's video bus.

[1]: Documentation/devicetree/bindings/spi/spi-bus.txt
[2]: Documentation/devicetree/bindings/media/video-interfaces.txt

Example:

		s6e63m0: display@0 {
			compatible = "samsung,s6e63m0";
			reg = <0>;
			reset-gpio = <&mp05 5 1>;
			vdd3-supply = <&ldo12_reg>;
			vci-supply = <&ldo11_reg>;
			spi-max-frequency = <1200000>;

			port {
				lcd_ep: endpoint {
					remote-endpoint = <&fimd_ep>;
				};
			};
		};
```
