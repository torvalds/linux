## Documentation/devicetree/bindings/display/panel/renesas,r69328.yaml
```yaml
# SPDX-License-Identifier: (GPL-2.0-only OR BSD-2-Clause)
%YAML 1.2
---
$id: http://devicetree.org/schemas/display/panel/renesas,r69328.yaml#
$schema: http://devicetree.org/meta-schemas/core.yaml#

title: Renesas R69328 based DSI Display Panel

maintainers:
  - Svyatoslav Ryhel <clamor95@gmail.com>

description:
  The Renesas R69328 is a generic DSI Panel IC used to control LCD panels.

allOf:
  - $ref: panel-common.yaml#

properties:
  compatible:
    items:
      - enum:
            # JDI DX12D100VM0EAA 4.7" WXGA TFT LCD panel
          - jdi,dx12d100vm0eaa
      - const: renesas,r69328

  reg:
    maxItems: 1

  vdd-supply:
    description: Regulator for main power supply.

  vddio-supply:
    description: Regulator for 1.8V IO power supply.

  backlight: true

  reset-gpios: true
  port: true

required:
  - compatible
  - port
  - backlight

additionalProperties: false

examples:
  - |
    #include <dt-bindings/gpio/gpio.h>

    dsi {
        #address-cells = <1>;
        #size-cells = <0>;

        panel@1 {
            compatible = "jdi,dx12d100vm0eaa", "renesas,r69328";
            reg = <1>;

            reset-gpios = <&gpio 176 GPIO_ACTIVE_LOW>;

            vdd-supply = <&vdd_3v0_lcd>;
            vddio-supply = <&vdd_1v8_io>;

            backlight = <&backlight>;

            port {
                panel_in: endpoint {
                    remote-endpoint = <&dsi_out>;
                };
            };
        };
    };
...
```

## Documentation/devicetree/bindings/display/panel/rocktech,jh057n00900.txt
```
Rocktech jh057n00900 5.5" 720x1440 TFT LCD panel

Required properties:
- compatible: should be "rocktech,jh057n00900"
- reg: DSI virtual channel of the peripheral
- reset-gpios: panel reset gpio
- backlight: phandle of the backlight device attached to the panel
- vcc-supply: phandle of the regulator that provides the vcc supply voltage.
- iovcc-supply: phandle of the regulator that provides the iovcc supply
  voltage.

Example:

	&mipi_dsi {
		panel@0 {
			compatible = "rocktech,jh057n00900";
			reg = <0>;
			backlight = <&backlight>;
			reset-gpios = <&gpio3 13 GPIO_ACTIVE_LOW>;
			vcc-supply = <&reg_2v8_p>;
			iovcc-supply = <&reg_1v8_p>;
		};
	};
```

## Documentation/devicetree/bindings/display/panel/rocktech,jh057n00900.yaml
```yaml
# SPDX-License-Identifier: (GPL-2.0-only OR BSD-2-Clause)
%YAML 1.2
---
$id: http://devicetree.org/schemas/display/panel/rocktech,jh057n00900.yaml#
$schema: http://devicetree.org/meta-schemas/core.yaml#

title: Rocktech JH057N00900 5.5" 720x1440 TFT LCD panel

maintainers:
  - Ondrej Jirman <megi@xff.cz>
  - Guido Gŭnther <agx@sigxcpu.org>

description:
  Rocktech JH057N00900 is a 720x1440 TFT LCD panel
  connected using a MIPI-DSI video interface.

allOf:
  - $ref: panel-common.yaml#

properties:
  compatible:
    enum:
      # Anberic RG353V-V2 5.0" 640x480 TFT LCD panel
      - anbernic,rg353v-panel-v2
      # Powkiddy RGB10MAX3 5.0" 720x1280 TFT LCD panel
      - powkiddy,rgb10max3-panel
      # Powkiddy RGB30 3.0" 720x720 TFT LCD panel
      - powkiddy,rgb30-panel
      # Rocktech JH057N00900 5.5" 720x1440 TFT LCD panel
      - rocktech,jh057n00900
      # Xingbangda XBD599 5.99" 720x1440 TFT LCD panel
      - xingbangda,xbd599

  port: true
  reg:
    maxItems: 1
    description: DSI virtual channel

  vcc-supply:
    description: Panel power supply

  iovcc-supply:
    description: I/O voltage supply

  reset-gpios: true

  backlight: true
  rotation: true

required:
  - compatible
  - reg
  - vcc-supply
  - iovcc-supply
  - reset-gpios

additionalProperties: false

examples:
  - |
    #include <dt-bindings/gpio/gpio.h>

    dsi {
        #address-cells = <1>;
        #size-cells = <0>;
        panel@0 {
            compatible = "rocktech,jh057n00900";
            reg = <0>;
            vcc-supply = <&reg_2v8_p>;
            iovcc-supply = <&reg_1v8_p>;
            reset-gpios = <&gpio3 13 GPIO_ACTIVE_LOW>;
            backlight = <&backlight>;
        };
    };

...
```

## Documentation/devicetree/bindings/display/panel/rocktech,rk070er9427.txt
```
Rocktech Display Ltd. RK070ER9427 800(RGB)x480 TFT LCD panel

This binding is compatible with the simple-panel binding, which is specified
in simple-panel.txt in this directory.

Required properties:
- compatible: should be "rocktech,rk070er9427"

Optional properties:
- backlight: phandle of the backlight device attached to the panel

Optional nodes:
- Video port for LCD panel input.

Example:
	panel {
		compatible = "rocktech,rk070er9427";
		backlight = <&backlight_lcd>;

		port {
			lcd_panel_in: endpoint {
				remote-endpoint = <&lcd_display_out>;
			};
		};
	};
```

## Documentation/devicetree/bindings/display/panel/ronbo,rb070d30.yaml
```yaml
# SPDX-License-Identifier: (GPL-2.0+ OR X11)
%YAML 1.2
---
$id: http://devicetree.org/schemas/display/panel/ronbo,rb070d30.yaml#
$schema: http://devicetree.org/meta-schemas/core.yaml#

title: Ronbo RB070D30 DSI Display Panel

maintainers:
  - Maxime Ripard <mripard@kernel.org>

properties:
  compatible:
    const: ronbo,rb070d30

  reg:
    description: MIPI-DSI virtual channel

  power-gpios:
    description: GPIO used for the power pin
    maxItems: 1

  reset-gpios:
    description: GPIO used for the reset pin
    maxItems: 1

  shlr-gpios:
    description: GPIO used for the shlr pin (horizontal flip)
    maxItems: 1

  updn-gpios:
    description: GPIO used for the updn pin (vertical flip)
    maxItems: 1

  vcc-lcd-supply:
    description: Power regulator

  backlight:
    description: Backlight used by the panel
    $ref: "/schemas/types.yaml#/definitions/phandle"

required:
  - compatible
  - power-gpios
  - reg
  - reset-gpios
  - shlr-gpios
  - updn-gpios
  - vcc-lcd-supply

additionalProperties: false
```

## Documentation/devicetree/bindings/display/panel/samsung,amoled-mipi-dsi.yaml
```yaml
# SPDX-License-Identifier: GPL-2.0
%YAML 1.2
---
$id: http://devicetree.org/schemas/display/panel/samsung,amoled-mipi-dsi.yaml#
$schema: http://devicetree.org/meta-schemas/core.yaml#

title: Samsung AMOLED MIPI-DSI panels

maintainers:
  - Hoegeun Kwon <hoegeun.kwon@samsung.com>

allOf:
  - $ref: panel-common.yaml#

  - if:
      properties:
        compatible:
          contains:
            enum:
              - samsung,s6e3ha2
              - samsung,s6e3hf2
    then:
      required:
        - enable-gpios

properties:
  compatible:
    enum:
        # Samsung S6E63J0X03 1.63" 320x320 AMOLED panel
      - samsung,s6e63j0x03
        # Samsung S6E3HA2 5.7" 1440x2560 AMOLED panel
      - samsung,s6e3ha2
        # Samsung S6E3HF2 5.65" 1600x2560 AMOLED panel
      - samsung,s6e3hf2

  reg: true
  reset-gpios: true
  enable-gpios: true
  te-gpios: true

  vdd3-supply:
    description: I/O voltage supply

  vci-supply:
    description: voltage supply for analog circuits

required:
  - compatible
  - reg
  - vdd3-supply
  - vci-supply
  - reset-gpios

additionalProperties: false

examples:
  - |
    #include <dt-bindings/gpio/gpio.h>

    dsi {
        #address-cells = <1>;
        #size-cells = <0>;

        panel@0 {
            compatible = "samsung,s6e3ha2";
            reg = <0>;
            vdd3-supply = <&ldo27_reg>;
            vci-supply = <&ldo28_reg>;
            reset-gpios = <&gpg0 0 GPIO_ACTIVE_LOW>;
            enable-gpios = <&gpf1 5 GPIO_ACTIVE_HIGH>;
            te-gpios = <&gpf1 3 GPIO_ACTIVE_HIGH>;
        };
    };

...
```

## Documentation/devicetree/bindings/display/panel/samsung,ams495qa01.yaml
```yaml
# SPDX-License-Identifier: (GPL-2.0-only OR BSD-2-Clause)
%YAML 1.2
---
$id: http://devicetree.org/schemas/display/panel/samsung,ams495qa01.yaml#
$schema: http://devicetree.org/meta-schemas/core.yaml#

title: Samsung AMS495QA01 panel with Magnachip D53E6EA8966 controller

maintainers:
  - Chris Morgan <macromorgan@hotmail.com>

allOf:
  - $ref: panel-common.yaml#
  - $ref: /schemas/spi/spi-peripheral-props.yaml#

properties:
  compatible:
    const: samsung,ams495qa01

  reg:
    maxItems: 1

  reset-gpios:
    description: reset gpio, must be GPIO_ACTIVE_LOW
  elvdd-supply:
    description: regulator that supplies voltage to the panel display
  enable-gpios: true
  port: true
  vdd-supply:
    description: regulator that supplies voltage to panel logic

required:
  - compatible
  - reg
  - reset-gpios
  - vdd-supply

additionalProperties: false

examples:
  - |
    #include <dt-bindings/gpio/gpio.h>
    spi {
        #address-cells = <1>;
        #size-cells = <0>;
        panel@0 {
            compatible = "samsung,ams495qa01";
            reg = <0>;
            reset-gpios = <&gpio4 0 GPIO_ACTIVE_LOW>;
            vdd-supply = <&vcc_3v3>;

            port {
                mipi_in_panel: endpoint {
                  remote-endpoint = <&mipi_out_panel>;
                };
            };
        };
    };

...
```

## Documentation/devicetree/bindings/display/panel/samsung,ams581vf01.yaml
```yaml
# SPDX-License-Identifier: GPL-2.0-only OR BSD-2-Clause
%YAML 1.2
---
$id: http://devicetree.org/schemas/display/panel/samsung,ams581vf01.yaml#
$schema: http://devicetree.org/meta-schemas/core.yaml#

title: Samsung AMS581VF01 SOFEF01-based 5.81" 1080x2340 MIPI-DSI Panel

maintainers:
  - Danila Tikhonov <danila@jiaxyga.com>

description:
  The Samsung AMS581VF01 is a 5.81 inch 1080x2340 MIPI-DSI CMD mode OLED panel.

allOf:
  - $ref: panel-common.yaml#

properties:
  compatible:
    const: samsung,ams581vf01

  reg:
    maxItems: 1

  vdd3p3-supply:
    description: 3.3V source voltage rail

  vddio-supply:
    description: I/O source voltage rail

  vsn-supply:
    description: Negative source voltage rail

  vsp-supply:
    description: Positive source voltage rail

  reset-gpios: true
  port: true

required:
  - compatible
  - reg
  - vdd3p3-supply
  - vddio-supply
  - vsn-supply
  - vsp-supply
  - reset-gpios
  - port

additionalProperties: false

examples:
  - |
    #include <dt-bindings/gpio/gpio.h>

    dsi {
        #address-cells = <1>;
        #size-cells = <0>;

        panel@0 {
            compatible = "samsung,ams581vf01";
            reg = <0>;

            vdd3p3-supply = <&vreg_l7c_3p0>;
            vddio-supply = <&vreg_l13a_1p8>;
            vsn-supply = <&vreg_ibb>;
            vsp-supply = <&vreg_lab>;

            reset-gpios = <&pm6150l_gpios 9 GPIO_ACTIVE_LOW>;

            port {
                panel_in: endpoint {
                    remote-endpoint = <&mdss_dsi0_out>;
                };
            };
        };
    };

...
```

## Documentation/devicetree/bindings/display/panel/samsung,ams639rq08.yaml
```yaml
# SPDX-License-Identifier: GPL-2.0-only OR BSD-2-Clause
%YAML 1.2
---
$id: http://devicetree.org/schemas/display/panel/samsung,ams639rq08.yaml#
$schema: http://devicetree.org/meta-schemas/core.yaml#

title: Samsung AMS639RQ08 EA8076-based 6.39" 1080x2340 MIPI-DSI Panel

maintainers:
  - Danila Tikhonov <danila@jiaxyga.com>
  - Jens Reidel <adrian@travitia.xyz>

description:
  The Samsung AMS639RQ08 is a 6.39 inch 1080x2340 MIPI-DSI CMD mode AMOLED panel.

allOf:
  - $ref: panel-common.yaml#

properties:
  compatible:
    const: samsung,ams639rq08

  reg:
    maxItems: 1

  vdd3p3-supply:
    description: 3.3V source voltage rail

  vddio-supply:
    description: I/O source voltage rail

  vsn-supply:
    description: Negative source voltage rail

  vsp-supply:
    description: Positive source voltage rail

  reset-gpios: true
  port: true

required:
  - compatible
  - reg
  - vdd3p3-supply
  - vddio-supply
  - vsn-supply
  - vsp-supply
  - reset-gpios
  - port

additionalProperties: false

examples:
  - |
    #include <dt-bindings/gpio/gpio.h>

    dsi {
        #address-cells = <1>;
        #size-cells = <0>;

        panel@0 {
            compatible = "samsung,ams639rq08";
            reg = <0>;

            vdd3p3-supply = <&vreg_l18a_2p8>;
            vddio-supply = <&vreg_l13a_1p8>;
            vsn-supply = <&vreg_ibb>;
            vsp-supply = <&vreg_lab>;

            reset-gpios = <&pm6150l_gpios 9 GPIO_ACTIVE_LOW>;

            port {
                panel_in: endpoint {
                    remote-endpoint = <&mdss_dsi0_out>;
                };
            };
        };
    };

...
```

## Documentation/devicetree/bindings/display/panel/samsung,atna33xc20.yaml
```yaml
# SPDX-License-Identifier: (GPL-2.0-only OR BSD-2-Clause)
%YAML 1.2
---
$id: http://devicetree.org/schemas/display/panel/samsung,atna33xc20.yaml#
$schema: http://devicetree.org/meta-schemas/core.yaml#

title: Samsung 13.3" FHD (1920x1080 pixels) eDP AMOLED panel

maintainers:
  - Douglas Anderson <dianders@chromium.org>

allOf:
  - $ref: panel-common.yaml#

properties:
  compatible:
    oneOf:
      # Samsung 13.3" FHD (1920x1080 pixels) eDP AMOLED panel
      - const: samsung,atna33xc20
      - items:
          - enum:
              # Samsung 13" 3K (2880×1920 pixels) eDP AMOLED panel
              - samsung,atna30dw01
              # Samsung 14" FHD+ (1920x1200 pixels) eDP AMOLED panel
              - samsung,atna40ct06
              # Samsung 14" WQXGA+ (2880x1800 pixels) eDP AMOLED panel
              - samsung,atna40cu11
              # Samsung 14" WQXGA+ (2880×1800 pixels) eDP AMOLED panel
              - samsung,atna40yk20
              # Samsung 14.5" WQXGA+ (2880x1800 pixels) eDP AMOLED panel
              - samsung,atna45af01
              # Samsung 14.5" 3K (2944x1840 pixels) eDP AMOLED panel
              - samsung,atna45dc02
              # Samsung 15.6" 3K (2880x1620 pixels) eDP AMOLED panel
              - samsung,atna56ac03
          - const: samsung,atna33xc20

  enable-gpios: true
  port: true
  power-supply: true
  no-hpd: true
  hpd-gpios: true

additionalProperties: false

required:
  - compatible
  - enable-gpios
  - power-supply

examples:
  - |
    #include <dt-bindings/clock/qcom,rpmh.h>
    #include <dt-bindings/gpio/gpio.h>
    #include <dt-bindings/interrupt-controller/irq.h>

    i2c {
      #address-cells = <1>;
      #size-cells = <0>;

      bridge@2d {
        compatible = "ti,sn65dsi86";
        reg = <0x2d>;

        interrupt-parent = <&tlmm>;
        interrupts = <10 IRQ_TYPE_LEVEL_HIGH>;

        enable-gpios = <&tlmm 102 GPIO_ACTIVE_HIGH>;

        vpll-supply = <&src_pp1800_s4a>;
        vccio-supply = <&src_pp1800_s4a>;
        vcca-supply = <&src_pp1200_l2a>;
        vcc-supply = <&src_pp1200_l2a>;

        clocks = <&rpmhcc RPMH_LN_BB_CLK2>;
        clock-names = "refclk";

        no-hpd;

        ports {
          #address-cells = <1>;
          #size-cells = <0>;

          port@0 {
            reg = <0>;
            endpoint {
              remote-endpoint = <&dsi0_out>;
            };
          };

          port@1 {
            reg = <1>;
            sn65dsi86_out: endpoint {
              remote-endpoint = <&panel_in_edp>;
            };
          };
        };

        aux-bus {
          panel {
            compatible = "samsung,atna33xc20";
            enable-gpios = <&tlmm 12 GPIO_ACTIVE_HIGH>;
            power-supply = <&pp3300_dx_edp>;
            hpd-gpios = <&sn65dsi86_bridge 2 GPIO_ACTIVE_HIGH>;

            port {
              panel_in_edp: endpoint {
                remote-endpoint = <&sn65dsi86_out>;
              };
            };
          };
        };
      };
    };
```
