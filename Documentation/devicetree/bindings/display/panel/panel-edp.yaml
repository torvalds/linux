## Documentation/devicetree/bindings/display/panel/raydium,rm67200.yaml
```yaml
# SPDX-License-Identifier: GPL-2.0-only OR BSD-2-Clause
%YAML 1.2
---
$id: http://devicetree.org/schemas/display/panel/raydium,rm67200.yaml#
$schema: http://devicetree.org/meta-schemas/core.yaml#

title: Raydium RM67200 based MIPI-DSI panels

maintainers:
  - Sebastian Reichel <sebastian.reichel@collabora.com>

allOf:
  - $ref: panel-common.yaml#

properties:
  compatible:
    items:
      - enum:
          - wanchanglong,w552793baa
      - const: raydium,rm67200

  reg:
    maxItems: 1

  vdd-supply:
    description: 2.8V Logic voltage

  iovcc-supply:
    description: 1.8V IO voltage

  vsp-supply:
    description: positive 5.5V voltage

  vsn-supply:
    description: negative 5.5V voltage

  backlight: true
  port: true
  reset-gpios: true

required:
  - compatible
  - port
  - reg

additionalProperties: false

examples:
  - |
    #include <dt-bindings/gpio/gpio.h>
    dsi {
        #address-cells = <1>;
        #size-cells = <0>;
        panel@0 {
            compatible = "wanchanglong,w552793baa", "raydium,rm67200";
            reg = <0>;

            vdd-supply = <&regulator1>;
            iovcc-supply = <&regulator2>;
            vsp-supply = <&regulator3>;
            vsn-supply = <&regulator4>;
            reset-gpios = <&gpiobank 42 GPIO_ACTIVE_LOW>;

            port {
                panel0_in: endpoint {
                    remote-endpoint = <&dsi0_out>;
                };
            };
        };
    };
...
```

## Documentation/devicetree/bindings/display/panel/raydium,rm68200.txt
```
Raydium Semiconductor Corporation RM68200 5.5" 720p MIPI-DSI TFT LCD panel

The Raydium Semiconductor Corporation RM68200 is a 5.5" 720x1280 TFT LCD
panel connected using a MIPI-DSI video interface.

Required properties:
  - compatible: "raydium,rm68200"
  - reg: the virtual channel number of a DSI peripheral

Optional properties:
  - reset-gpios: a GPIO spec for the reset pin (active low).
  - power-supply: phandle of the regulator that provides the supply voltage.
  - backlight: phandle of the backlight device attached to the panel.

Example:
&dsi {
	...
	panel@0 {
		compatible = "raydium,rm68200";
		reg = <0>;
		reset-gpios = <&gpiof 15 GPIO_ACTIVE_LOW>;
		power-supply = <&v1v8>;
		backlight = <&pwm_backlight>;
	};
};
```

## Documentation/devicetree/bindings/display/panel/raydium,rm68200.yaml
```yaml
# SPDX-License-Identifier: (GPL-2.0-only or BSD-2-Clause)
%YAML 1.2
---
$id: http://devicetree.org/schemas/display/panel/raydium,rm68200.yaml#
$schema: http://devicetree.org/meta-schemas/core.yaml#

title: Raydium Semiconductor Corporation RM68200 5.5" 720p MIPI-DSI TFT LCD panel

maintainers:
  - Philippe CORNU <philippe.cornu@st.com>

description: |
             The Raydium Semiconductor Corporation RM68200 is a 5.5" 720x1280 TFT LCD
             panel connected using a MIPI-DSI video interface.

allOf:
  - $ref: panel-common.yaml#

properties:

  compatible:
    const: raydium,rm68200

  reg:
    maxItems: 1
    description: DSI virtual channel

  backlight: true
  enable-gpios: true
  port: true
  power-supply: true

  reset-gpios:
    maxItems: 1

additionalProperties: false

required:
  - compatible
  - power-supply
  - reg

examples:
  - |
    dsi@0 {
      #address-cells = <1>;
      #size-cells = <0>;
      panel@0 {
        compatible = "raydium,rm68200";
        reg = <0>;
        reset-gpios = <&gpiof 15 0>;
        power-supply = <&v1v8>;
        backlight = <&pwm_backlight>;
      };
    };
...
```

## Documentation/devicetree/bindings/display/panel/raydium,rm692e5.yaml
```yaml
# SPDX-License-Identifier: GPL-2.0-only OR BSD-2-Clause
%YAML 1.2
---
$id: http://devicetree.org/schemas/display/panel/raydium,rm692e5.yaml#
$schema: http://devicetree.org/meta-schemas/core.yaml#

title: Raydium RM692E5 based DSI display panels

maintainers:
  - Konrad Dybcio <konradybcio@kernel.org>

description:
  The Raydium RM692E5 is a generic DSI Panel IC used to control
  AMOLED panels.

allOf:
  - $ref: panel-common.yaml#

properties:
  compatible:
    items:
      - const: fairphone,fp5-rm692e5-boe
      - const: raydium,rm692e5

  dvdd-supply:
    description: Digital voltage rail

  vci-supply:
    description: Analog voltage rail

  vddio-supply:
    description: I/O voltage rail

  reg: true
  port: true

required:
  - compatible
  - reg
  - reset-gpios
  - dvdd-supply
  - vci-supply
  - vddio-supply
  - port

unevaluatedProperties: false

examples:
  - |
    #include <dt-bindings/gpio/gpio.h>

    dsi {
        #address-cells = <1>;
        #size-cells = <0>;

        panel@0 {
            compatible = "fairphone,fp5-rm692e5-boe", "raydium,rm692e5";
            reg = <0>;

            reset-gpios = <&tlmm 44 GPIO_ACTIVE_LOW>;
            dvdd-supply = <&vreg_oled_vci>;
            vci-supply = <&vreg_l12c>;
            vddio-supply = <&vreg_oled_dvdd>;

            port {
                panel_in_0: endpoint {
                    remote-endpoint = <&dsi0_out>;
                };
            };
        };
    };

...
```

## Documentation/devicetree/bindings/display/panel/raydium,rm69380.yaml
```yaml
# SPDX-License-Identifier: GPL-2.0-only OR BSD-2-Clause
%YAML 1.2
---
$id: http://devicetree.org/schemas/display/panel/raydium,rm69380.yaml#
$schema: http://devicetree.org/meta-schemas/core.yaml#

title: Raydium RM69380-based DSI display panels

maintainers:
  - David Wronek <david@mainlining.org>

description:
  The Raydium RM69380 is a generic DSI panel IC used to control
  OLED panels.

allOf:
  - $ref: panel-common-dual.yaml#

properties:
  compatible:
    items:
      - enum:
          - lenovo,j716f-edo-rm69380
      - const: raydium,rm69380
    description: This indicates the panel manufacturer of the panel
      that is in turn using the RM69380 panel driver. The compatible
      string determines how the RM69380 panel driver shall be configured
      to work with the indicated panel. The raydium,rm69380 compatible shall
      always be provided as a fallback.

  reg:
    maxItems: 1

  avdd-supply:
    description: Analog voltage rail

  vddio-supply:
    description: I/O voltage rail

  reset-gpios:
    maxItems: 1
    description: phandle of gpio for reset line - This should be active low

required:
  - compatible
  - reg
  - avdd-supply
  - vddio-supply
  - reset-gpios

unevaluatedProperties: false

examples:
  - |
    #include <dt-bindings/gpio/gpio.h>

    dsi {
        #address-cells = <1>;
        #size-cells = <0>;

        panel@0 {
            compatible = "lenovo,j716f-edo-rm69380", "raydium,rm69380";
            reg = <0>;

            avdd-supply = <&panel_avdd_regulator>;
            vddio-supply = <&vreg_l14a>;
            reset-gpios = <&tlmm 75 GPIO_ACTIVE_LOW>;

            ports {
                #address-cells = <1>;
                #size-cells = <0>;

                port@0 {
                    reg = <0>;
                    panel_in_0: endpoint {
                        remote-endpoint = <&mdss_dsi0_out>;
                    };
                };

                port@1 {
                    reg = <1>;
                    panel_in_1: endpoint {
                        remote-endpoint = <&mdss_dsi1_out>;
                    };
                };
            };
        };
    };

...
```

## Documentation/devicetree/bindings/display/panel/renesas,r61307.yaml
```yaml
# SPDX-License-Identifier: (GPL-2.0-only OR BSD-2-Clause)
%YAML 1.2
---
$id: http://devicetree.org/schemas/display/panel/renesas,r61307.yaml#
$schema: http://devicetree.org/meta-schemas/core.yaml#

title: Renesas R61307 based DSI Display Panel

maintainers:
  - Svyatoslav Ryhel <clamor95@gmail.com>

description:
  The Renesas R61307 is a generic DSI Panel IC used to control LCD panels.

allOf:
  - $ref: panel-common.yaml#

properties:
  compatible:
    items:
      - enum:
            # KOE/HITACHI TX13D100VM0EAA 5.0" XGA TFT LCD panel
          - hit,tx13d100vm0eaa
          - koe,tx13d100vm0eaa
      - const: renesas,r61307

  reg:
    maxItems: 1

  vcc-supply:
    description: Regulator for main power supply.

  iovcc-supply:
    description: Regulator for 1.8V IO power supply.

  backlight: true

  renesas,gamma:
    $ref: /schemas/types.yaml#/definitions/uint32
    description:
      0 - disabled
      1-3 - gamma setting A presets
    enum: [0, 1, 2, 3]

  renesas,column-inversion:
    type: boolean
    description: switch between line and column inversion. The line
      inversion is set by default.

  renesas,contrast:
    type: boolean
    description: digital contrast adjustment

  reset-gpios: true
  port: true

required:
  - compatible
  - port
  - backlight

additionalProperties: false

examples:
  - |
    #include <dt-bindings/gpio/gpio.h>

    dsi {
        #address-cells = <1>;
        #size-cells = <0>;

        panel@1 {
            compatible = "koe,tx13d100vm0eaa", "renesas,r61307";
            reg = <1>;

            reset-gpios = <&gpio 176 GPIO_ACTIVE_LOW>;

            renesas,gamma = <3>;
            renesas,column-inversion;
            renesas,contrast;

            vcc-supply = <&vcc_3v0_lcd>;
            iovcc-supply = <&iovcc_1v8_lcd>;

            backlight = <&backlight>;

            port {
                panel_in: endpoint {
                    remote-endpoint = <&dsi_out>;
                };
            };
        };
    };
...
```

## Documentation/devicetree/bindings/display/panel/renesas,r63419.yaml
```yaml
# SPDX-License-Identifier: (GPL-2.0-only OR BSD-2-Clause)
%YAML 1.2
---
$id: http://devicetree.org/schemas/display/panel/renesas,r63419.yaml#
$schema: http://devicetree.org/meta-schemas/core.yaml#

title: Renesas R63419 based dual-DSI video mode Display Panel

maintainers:
  - Neil Armstrong <neil.armstrong@linaro.org>

description:
  The Renesas R63419 is a generic DDIC used to control dual-DSI LCD panels.

allOf:
  - $ref: panel-common-dual.yaml#

properties:
  compatible:
    items:
      - enum:
          - ayaneo,wt0600-2k
          - ayaneo,wt0630-2k
      - const: renesas,r63419

  reg:
    maxItems: 1

  vdd-supply: true
  vddio-supply: true
  vsp-supply: true
  vsn-supply: true
  vci-supply: true

  backlight: true
  reset-gpios: true
  rotation: true
  ports: true

required:
  - compatible
  - reg
  - vdd-supply
  - vddio-supply
  - vsp-supply
  - vsn-supply
  - vci-supply
  - backlight
  - reset-gpios
  - ports

additionalProperties: false

examples:
  - |
    #include <dt-bindings/gpio/gpio.h>

    dsi {
        #address-cells = <1>;
        #size-cells = <0>;

        panel@0 {
            compatible = "ayaneo,wt0600-2k", "renesas,r63419";
            reg = <0>;

            reset-gpios = <&gpio 176 GPIO_ACTIVE_LOW>;

            vdd-supply = <&vdd_3v0_lcd>;
            vddio-supply = <&vdd_1v8_io>;
            vsn-supply = <&vdd_5v0_neg>;
            vsp-supply = <&vdd_5v0_pos>;
            vci-supply = <&vdd_3v0_vci>;

            backlight = <&backlight>;

            rotation = <90>;

            ports {
                #address-cells = <1>;
                #size-cells = <0>;

                port@0 {
                    reg = <0>;
                    panel_in0: endpoint {
                        remote-endpoint = <&dsi0_out>;
                    };
                };

                port@1 {
                    reg = <1>;
                    panel_in1: endpoint {
                        remote-endpoint = <&dsi1_out>;
                    };
                };
            };
        };
    };
...
```
