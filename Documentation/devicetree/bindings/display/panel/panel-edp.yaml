## Documentation/devicetree/bindings/display/panel/panel-timing.yaml
```yaml
# SPDX-License-Identifier: (GPL-2.0-only OR BSD-2-Clause)
%YAML 1.2
---
$id: http://devicetree.org/schemas/display/panel/panel-timing.yaml#
$schema: http://devicetree.org/meta-schemas/core.yaml#

title: panel timing bindings

maintainers:
  - Thierry Reding <thierry.reding@gmail.com>
  - Sam Ravnborg <sam@ravnborg.org>

description: |
  There are different ways of describing the timing data of a panel. The
  devicetree representation corresponds to the one commonly found in datasheets
  for panels.

  The parameters are defined as seen in the following illustration.

  +----------+-------------------------------------+----------+-------+
  |          |        ^                            |          |       |
  |          |        |vback_porch                 |          |       |
  |          |        v                            |          |       |
  +----------#######################################----------+-------+
  |          #        ^                            #          |       |
  |          #        |                            #          |       |
  |  hback   #        |                            #  hfront  | hsync |
  |   porch  #        |       hactive              #  porch   |  len  |
  |<-------->#<-------+--------------------------->#<-------->|<----->|
  |          #        |                            #          |       |
  |          #        |vactive                     #          |       |
  |          #        |                            #          |       |
  |          #        v                            #          |       |
  +----------#######################################----------+-------+
  |          |        ^                            |          |       |
  |          |        |vfront_porch                |          |       |
  |          |        v                            |          |       |
  +----------+-------------------------------------+----------+-------+
  |          |        ^                            |          |       |
  |          |        |vsync_len                   |          |       |
  |          |        v                            |          |       |
  +----------+-------------------------------------+----------+-------+


  The following is the panel timings shown with time on the x-axis.
  This matches the timing diagrams often found in data sheets.

              Active                 Front           Sync           Back
              Region                 Porch                          Porch
  <-----------------------><----------------><-------------><-------------->
    //////////////////////|
   ////////////////////// |
  //////////////////////  |..................               ................
                                             _______________

  Timing can be specified either as a typical value or as a tuple
  of min, typ, max values.

properties:

  clock-frequency:
   description: Panel clock in Hz

  hactive:
    $ref: /schemas/types.yaml#/definitions/uint32
    description: Horizontal panel resolution in pixels

  vactive:
    $ref: /schemas/types.yaml#/definitions/uint32
    description: Vertical panel resolution in pixels

  hfront-porch:
    description: Horizontal front porch panel timing
    oneOf:
      - $ref: /schemas/types.yaml#/definitions/uint32
        maxItems: 1
        items:
          description: typical number of pixels
      - $ref: /schemas/types.yaml#/definitions/uint32-array
        minItems: 3
        maxItems: 3
        items:
          description: min, typ, max number of pixels

  hback-porch:
    description: Horizontal back porch timing
    oneOf:
      - $ref: /schemas/types.yaml#/definitions/uint32
        maxItems: 1
        items:
          description: typical number of pixels
      - $ref: /schemas/types.yaml#/definitions/uint32-array
        minItems: 3
        maxItems: 3
        items:
          description: min, typ, max number of pixels

  hsync-len:
    description: Horizontal sync length panel timing
    oneOf:
      - $ref: /schemas/types.yaml#/definitions/uint32
        maxItems: 1
        items:
          description: typical number of pixels
      - $ref: /schemas/types.yaml#/definitions/uint32-array
        minItems: 3
        maxItems: 3
        items:
          description: min, typ, max number of pixels

  vfront-porch:
    description: Vertical front porch panel timing
    oneOf:
      - $ref: /schemas/types.yaml#/definitions/uint32
        maxItems: 1
        items:
          description: typical number of lines
      - $ref: /schemas/types.yaml#/definitions/uint32-array
        minItems: 3
        maxItems: 3
        items:
          description: min, typ, max number of lines

  vback-porch:
    description: Vertical back porch panel timing
    oneOf:
      - $ref: /schemas/types.yaml#/definitions/uint32
        maxItems: 1
        items:
          description: typical number of lines
      - $ref: /schemas/types.yaml#/definitions/uint32-array
        minItems: 3
        maxItems: 3
        items:
          description: min, typ, max number of lines

  vsync-len:
    description: Vertical sync length panel timing
    oneOf:
      - $ref: /schemas/types.yaml#/definitions/uint32
        maxItems: 1
        items:
          description: typical number of lines
      - $ref: /schemas/types.yaml#/definitions/uint32-array
        minItems: 3
        maxItems: 3
        items:
          description: min, typ, max number of lines

  hsync-active:
    description: |
      Horizontal sync pulse.
      0 selects active low, 1 selects active high.
      If omitted then it is not used by the hardware
    enum: [0, 1]

  vsync-active:
    description: |
      Vertical sync pulse.
      0 selects active low, 1 selects active high.
      If omitted then it is not used by the hardware
    enum: [0, 1]

  de-active:
    description: |
      Data enable.
      0 selects active low, 1 selects active high.
      If omitted then it is not used by the hardware
    enum: [0, 1]

  pixelclk-active:
    description: |
      Data driving on rising or falling edge.
      Use 0 to drive pixel data on falling edge and
      sample data on rising edge.
      Use 1 to drive pixel data on rising edge and
      sample data on falling edge
    enum: [0, 1]

  syncclk-active:
    description: |
      Drive sync on rising or sample sync on falling edge.
      If not specified then the setup is as specified by pixelclk-active.
      Use 0 to drive sync on falling edge and
      sample sync on rising edge of pixel clock.
      Use 1 to drive sync on rising edge and
      sample sync on falling edge of pixel clock
    enum: [0, 1]

  interlaced:
    type: boolean
    description: Enable interlaced mode

  doublescan:
    type: boolean
    description: Enable double scan mode

  doubleclk:
    type: boolean
    description: Enable double clock mode

required:
 - clock-frequency
 - hactive
 - vactive
 - hfront-porch
 - hback-porch
 - hsync-len
 - vfront-porch
 - vback-porch
 - vsync-len

additionalProperties: false

...
```

## Documentation/devicetree/bindings/display/panel/panel.txt
```
Common display properties
-------------------------

- rotation:	Display rotation in degrees counter clockwise (0,90,180,270)
```

## Documentation/devicetree/bindings/display/panel/pda,91-00156-a0.txt
```
PDA 91-00156-A0 5.0" WVGA TFT LCD panel

Required properties:
- compatible: should be "pda,91-00156-a0"
- power-supply: this panel requires a single power supply. A phandle to a
regulator needs to be specified here. Compatible with panel-common binding which
is specified in the panel-common.txt in this directory.
- backlight: this panel's backlight is controlled by an external backlight
controller. A phandle to this controller needs to be specified here.
Compatible with panel-common binding which is specified in the panel-common.txt
in this directory.

This binding is compatible with the simple-panel binding, which is specified
in simple-panel.txt in this directory.
```

## Documentation/devicetree/bindings/display/panel/pda,91-00156-a0.yaml
```yaml
# SPDX-License-Identifier: GPL-2.0
%YAML 1.2
---
$id: http://devicetree.org/schemas/display/panel/pda,91-00156-a0.yaml#
$schema: http://devicetree.org/meta-schemas/core.yaml#

title: PDA 91-00156-A0 5.0" WVGA TFT LCD panel

maintainers:
  - Cristian Birsan <cristian.birsan@microchip.com>
  - Thierry Reding <thierry.reding@gmail.com>

allOf:
  - $ref: panel-common.yaml#

properties:
  compatible:
    const: pda,91-00156-a0

  power-supply: true
  backlight: true
  port: true

additionalProperties: false

required:
  - compatible
  - power-supply
  - backlight

...
```

## Documentation/devicetree/bindings/display/panel/powertip,st7272.yaml
```yaml
# SPDX-License-Identifier: GPL-2.0-only OR BSD-2-Clause
%YAML 1.2
---
$id: http://devicetree.org/schemas/display/panel/powertip,st7272.yaml#
$schema: http://devicetree.org/meta-schemas/core.yaml#

title: Powertip Electronic Technology Co. 320 x 240 LCD panel

maintainers:
  - Lukasz Majewski <lukma@denx.de>

allOf:
  - $ref: panel-dpi.yaml#

properties:
  compatible:
    items:
      - const: powertip,st7272
      - {} # panel-dpi, but not listed here to avoid false select

  height-mm: true
  panel-timing: true
  port: true
  power-supply: true
  width-mm: true

additionalProperties: false

...
```

## Documentation/devicetree/bindings/display/panel/qiaodian,qd43003c0-40.txt
```
QiaoDian XianShi Corporation 4"3 TFT LCD panel

Required properties:
- compatible: should be "qiaodian,qd43003c0-40"

This binding is compatible with the simple-panel binding, which is specified
in simple-panel.txt in this directory.
```

## Documentation/devicetree/bindings/display/panel/raspberrypi,7inch-touchscreen.txt
```
This binding covers the official 7" (800x480) Raspberry Pi touchscreen
panel.

This DSI panel contains:

- TC358762 DSI->DPI bridge
- Atmel microcontroller on I2C for power sequencing the DSI bridge and
  controlling backlight
- Touchscreen controller on I2C for touch input

and this binding covers the DSI display parts but not its touch input.

Required properties:
- compatible:	Must be "raspberrypi,7inch-touchscreen-panel"
- reg:		Must be "45"
- port:		See panel-common.txt

Example:

dsi1: dsi@7e700000 {
	#address-cells = <1>;
	#size-cells = <0>;
	<...>

	port {
		dsi_out_port: endpoint {
			remote-endpoint = <&panel_dsi_port>;
		};
	};
};

i2c_dsi: i2c {
	compatible = "i2c-gpio";
	#address-cells = <1>;
	#size-cells = <0>;
	gpios = <&gpio 28 0
		 &gpio 29 0>;

	lcd@45 {
		compatible = "raspberrypi,7inch-touchscreen-panel";
		reg = <0x45>;

		port {
			panel_dsi_port: endpoint {
				remote-endpoint = <&dsi_out_port>;
			};
		};
	};
};
```

## Documentation/devicetree/bindings/display/panel/raspberrypi,7inch-touchscreen.yaml
```yaml
# SPDX-License-Identifier: GPL-2.0
%YAML 1.2
---
$id: http://devicetree.org/schemas/display/panel/raspberrypi,7inch-touchscreen.yaml#
$schema: http://devicetree.org/meta-schemas/core.yaml#

title: The official 7" (800x480) Raspberry Pi touchscreen

maintainers:
  - Eric Anholt <eric@anholt.net>
  - Thierry Reding <thierry.reding@gmail.com>

description: |+
  This DSI panel contains:

  - TC358762 DSI->DPI bridge
  - Atmel microcontroller on I2C for power sequencing the DSI bridge and
    controlling backlight
  - Touchscreen controller on I2C for touch input

  and this binding covers the DSI display parts but not its touch input.

properties:
  compatible:
    const: raspberrypi,7inch-touchscreen-panel

  reg:
    const: 0x45

  port: true

required:
  - compatible
  - reg
  - port

additionalProperties: false

examples:
  - |+
    dsi1: dsi {
      #address-cells = <1>;
      #size-cells = <0>;

      port {
        dsi_out_port: endpoint {
          remote-endpoint = <&panel_dsi_port>;
        };
      };
    };

    i2c_dsi: i2c {
      compatible = "i2c-gpio";
      #address-cells = <1>;
      #size-cells = <0>;
      scl-gpios = <&gpio 28 0>;
      sda-gpios = <&gpio 29 0>;

      lcd@45 {
        compatible = "raspberrypi,7inch-touchscreen-panel";
        reg = <0x45>;

        port {
          panel_dsi_port: endpoint {
            remote-endpoint = <&dsi_out_port>;
          };
        };
      };
    };

...
```

## Documentation/devicetree/bindings/display/panel/raydium,rm67191.txt
```
Raydium RM67171 OLED LCD panel with MIPI-DSI protocol

Required properties:
- compatible: 		"raydium,rm67191"
- reg:			virtual channel for MIPI-DSI protocol
			must be <0>
- dsi-lanes:		number of DSI lanes to be used
			must be <3> or <4>
- port: 		input port node with endpoint definition as
			defined in Documentation/devicetree/bindings/graph.txt;
			the input port should be connected to a MIPI-DSI device
			driver

Optional properties:
- reset-gpios:		a GPIO spec for the RST_B GPIO pin
- v3p3-supply:		phandle to 3.3V regulator that powers the VDD_3V3 pin
- v1p8-supply:		phandle to 1.8V regulator that powers the VDD_1V8 pin
- width-mm:		see panel-common.txt
- height-mm:		see panel-common.txt
- video-mode:		0 - burst-mode
			1 - non-burst with sync event
			2 - non-burst with sync pulse

Example:

	panel@0 {
		compatible = "raydium,rm67191";
		reg = <0>;
		pinctrl-0 = <&pinctrl_mipi_dsi_0_1_en>;
		pinctrl-names = "default";
		reset-gpios = <&gpio1 7 GPIO_ACTIVE_LOW>;
		dsi-lanes = <4>;
		width-mm = <68>;
		height-mm = <121>;

		port {
			panel_in: endpoint {
				remote-endpoint = <&mipi_out>;
			};
		};
	};
```

## Documentation/devicetree/bindings/display/panel/raydium,rm67191.yaml
```yaml
# SPDX-License-Identifier: GPL-2.0
%YAML 1.2
---
$id: http://devicetree.org/schemas/display/panel/raydium,rm67191.yaml#
$schema: http://devicetree.org/meta-schemas/core.yaml#

title: Raydium RM67171 OLED LCD panel with MIPI-DSI protocol

maintainers:
  - Robert Chiras <robert.chiras@nxp.com>

allOf:
  - $ref: panel-common.yaml#

properties:
  compatible:
    const: raydium,rm67191

  reg: true
  port: true
  reset-gpios: true
  width-mm: true
  height-mm: true

  dsi-lanes:
    description: Number of DSI lanes to be used must be <3> or <4>
    enum: [3, 4]

  v3p3-supply:
    description: phandle to 3.3V regulator that powers the VDD_3V3 pin

  v1p8-supply:
    description: phandle to 1.8V regulator that powers the VDD_1V8 pin

  video-mode:
    description: |
      0 - burst-mode
      1 - non-burst with sync event
      2 - non-burst with sync pulse
    enum: [0, 1, 2]

required:
  - compatible
  - reg
  - dsi-lanes
  - port

additionalProperties: false

examples:
  - |
    #include <dt-bindings/gpio/gpio.h>

    dsi {
        #address-cells = <1>;
        #size-cells = <0>;

        panel@0 {
            compatible = "raydium,rm67191";
            reg = <0>;
            reset-gpios = <&gpio1 7 GPIO_ACTIVE_LOW>;
            dsi-lanes = <4>;
            width-mm = <68>;
            height-mm = <121>;
            video-mode = <1>;

            port {
                panel_in: endpoint {
                    remote-endpoint = <&mipi_out>;
                };
            };
        };
    };

...
```
