## Documentation/devicetree/bindings/display/panel/sony,td4353-jdi.yaml
```yaml
# SPDX-License-Identifier: (GPL-2.0-only OR BSD-2-Clause)
%YAML 1.2
---
$id: http://devicetree.org/schemas/display/panel/sony,td4353-jdi.yaml#
$schema: http://devicetree.org/meta-schemas/core.yaml#

title: Sony TD4353 JDI 5 / 5.7" 2160x1080 MIPI-DSI Panel

maintainers:
  - Konrad Dybcio <konrad.dybcio@somainline.org>

description: |
  The Sony TD4353 JDI is a 5 (XZ2c) / 5.7 (XZ2) inch 2160x1080
  MIPI-DSI panel, used in Xperia XZ2 and XZ2 Compact smartphones.

allOf:
  - $ref: panel-common.yaml#

properties:
  compatible:
    const: sony,td4353-jdi-tama

  reg:
    maxItems: 1

  backlight: true
  width-mm: true
  height-mm: true

  vddio-supply:
    description: VDDIO 1.8V supply

  vsp-supply:
    description: Positive 5.5V supply

  vsn-supply:
    description: Negative 5.5V supply

  panel-reset-gpios:
    description: Display panel reset pin

  touch-reset-gpios:
    description: Touch panel reset pin

  port: true

required:
  - compatible
  - reg
  - vddio-supply
  - vsp-supply
  - vsn-supply
  - panel-reset-gpios
  - touch-reset-gpios
  - port

additionalProperties: false

examples:
  - |
    #include <dt-bindings/gpio/gpio.h>

    dsi {
        #address-cells = <1>;
        #size-cells = <0>;

        panel: panel@0 {
            compatible = "sony,td4353-jdi-tama";
            reg = <0>;

            backlight = <&pmi8998_wled>;
            vddio-supply = <&vreg_l14a_1p8>;
            vsp-supply = <&lab>;
            vsn-supply = <&ibb>;
            panel-reset-gpios = <&tlmm 6 GPIO_ACTIVE_HIGH>;
            touch-reset-gpios = <&tlmm 99 GPIO_ACTIVE_HIGH>;

            port {
                panel_in: endpoint {
                    remote-endpoint = <&dsi0_out>;
                };
            };
        };
    };
...
```

## Documentation/devicetree/bindings/display/panel/sony,tulip-truly-nt35521.yaml
```yaml
# SPDX-License-Identifier: (GPL-2.0-only OR BSD-2-Clause)
%YAML 1.2
---
$id: http://devicetree.org/schemas/display/panel/sony,tulip-truly-nt35521.yaml#
$schema: http://devicetree.org/meta-schemas/core.yaml#

title: Sony Tulip Truly NT35521 5.24" 1280x720 MIPI-DSI Panel

maintainers:
  - Shawn Guo <shawn.guo@linaro.org>

description: |
  The Sony Tulip Truly NT35521 is a 5.24" 1280x720 MIPI-DSI panel, which
  can be found no Sony Xperia M4 phone.  The panel backlight is managed
  through DSI link.

allOf:
  - $ref: panel-common.yaml#

properties:
  compatible:
    const: sony,tulip-truly-nt35521

  reg:
    maxItems: 1

  positive5-supply:
    description: Positive 5V supply

  negative5-supply:
    description: Negative 5V supply

  reset-gpios: true

  enable-gpios: true

  port: true

required:
  - compatible
  - reg
  - positive5-supply
  - negative5-supply
  - reset-gpios
  - enable-gpios
  - port

additionalProperties: false

examples:
  - |
    #include <dt-bindings/gpio/gpio.h>

    dsi {
        #address-cells = <1>;
        #size-cells = <0>;

        panel@0 {
            compatible = "sony,tulip-truly-nt35521";
            reg = <0>;
            positive5-supply = <&positive5_reg>;
            negative5-supply = <&negative5_reg>;
            reset-gpios = <&msmgpio 25 GPIO_ACTIVE_LOW>;
            enable-gpios = <&msmgpio 10 GPIO_ACTIVE_HIGH>;

            port {
                panel_in: endpoint {
                    remote-endpoint = <&dsi0_out>;
                };
            };
        };
    };
...
```

## Documentation/devicetree/bindings/display/panel/starry,kr122ea0sra.txt
```
Starry 12.2" (1920x1200 pixels) TFT LCD panel

Required properties:
- compatible: should be "starry,kr122ea0sra"

This binding is compatible with the simple-panel binding, which is specified
in simple-panel.txt in this directory.
```

## Documentation/devicetree/bindings/display/panel/startek,kd070fhfid015.yaml
```yaml
# SPDX-License-Identifier: GPL-2.0-only OR BSD-2-Clause
%YAML 1.2
---
$id: http://devicetree.org/schemas/display/panel/startek,kd070fhfid015.yaml#
$schema: http://devicetree.org/meta-schemas/core.yaml#

title: Startek Electronic Technology Co. kd070fhfid015 7 inch TFT LCD panel

maintainers:
  - Alexandre Mergnat <amergnat@baylibre.com>

allOf:
  - $ref: panel-common.yaml#

properties:
  compatible:
    const: startek,kd070fhfid015

  enable-gpios: true

  iovcc-supply:
    description: Reference to the regulator powering the panel IO pins.

  reg:
    maxItems: 1
    description: DSI virtual channel

  reset-gpios: true

  port: true

  power-supply: true

additionalProperties: false

required:
  - compatible
  - enable-gpios
  - iovcc-supply
  - reg
  - reset-gpios
  - port
  - power-supply

examples:
  - |
    #include <dt-bindings/gpio/gpio.h>

    dsi0 {
        #address-cells = <1>;
        #size-cells = <0>;

        panel@0 {
            compatible = "startek,kd070fhfid015";
            reg = <0>;
            enable-gpios = <&pio 67 GPIO_ACTIVE_HIGH>;
            reset-gpios = <&pio 20 GPIO_ACTIVE_HIGH>;
            iovcc-supply = <&mt6357_vsim1_reg>;
            power-supply = <&vsys_lcm_reg>;

            port {
                panel_in: endpoint {
                    remote-endpoint = <&dsi_out>;
                };
            };
        };
    };

...
```

## Documentation/devicetree/bindings/display/panel/startek,startek-kd050c.txt
```
Startek Electronic Technology Co. KD050C 5.0" WVGA TFT LCD panel

Required properties:
- compatible: should be "startek,startek-kd050c"
```

## Documentation/devicetree/bindings/display/panel/startek,startek-kd050c.yaml
```yaml
# SPDX-License-Identifier: GPL-2.0
%YAML 1.2
---
$id: http://devicetree.org/schemas/display/panel/startek,startek-kd050c.yaml#
$schema: http://devicetree.org/meta-schemas/core.yaml#

title: Startek Electronic Technology Co. KD050C 5.0" WVGA TFT LCD panel

maintainers:
  - Nikita Kiryanov <nikita@compulab.co.il>

allOf:
  - $ref: panel-dpi.yaml#

properties:
  compatible:
    items:
      - const: startek,startek-kd050c
      - {} # panel-dpi, but not listed here to avoid false select

  backlight: true
  enable-gpios: true
  height-mm: true
  label: true
  panel-timing: true
  port: true
  power-supply: true
  reset-gpios: true
  width-mm: true

additionalProperties: false

...
```

## Documentation/devicetree/bindings/display/panel/synaptics,r63353.yaml
```yaml
# SPDX-License-Identifier: (GPL-2.0-only OR BSD-2-Clause)
%YAML 1.2
---
$id: http://devicetree.org/schemas/display/panel/synaptics,r63353.yaml#
$schema: http://devicetree.org/meta-schemas/core.yaml#

title: Synaptics R63353 based MIPI-DSI panels

maintainers:
  - Michael Trimarchi <michael@amarulasolutions.com>

allOf:
  - $ref: panel-common.yaml#

properties:
  compatible:
    items:
      - enum:
          - sharp,ls068b3sx02
      - const: syna,r63353

  avdd-supply: true
  dvdd-supply: true
  reg: true

required:
  - compatible
  - avdd-supply
  - dvdd-supply
  - reg
  - reset-gpios
  - port
  - backlight

unevaluatedProperties: false

examples:
  - |
    #include <dt-bindings/gpio/gpio.h>

    dsi {
        #address-cells = <1>;
        #size-cells = <0>;

        panel@0 {
            compatible = "sharp,ls068b3sx02", "syna,r63353";
            reg = <0>;
            avdd-supply = <&avdd_display>;
            dvdd-supply = <&dvdd_display>;
            reset-gpios = <&r_pio 0 5 GPIO_ACTIVE_LOW>; /* PL05 */
            backlight = <&backlight>;

            port {
                panel_in: endpoint {
                    remote-endpoint = <&mipi_dsi_out>;
                };
            };
        };
    };

...
```

## Documentation/devicetree/bindings/display/panel/synaptics,td4300-panel.yaml
```yaml
# SPDX-License-Identifier: (GPL-2.0-only OR BSD-2-Clause)
%YAML 1.2
---
$id: http://devicetree.org/schemas/display/panel/synaptics,td4300-panel.yaml#
$schema: http://devicetree.org/meta-schemas/core.yaml#

title: Synaptics TDDI Display Panel Controller

maintainers:
  - Kaustabh Chakraborty <kauschluss@disroot.org>

allOf:
  - $ref: panel-common.yaml#

properties:
  compatible:
    enum:
      - syna,td4101-panel
      - syna,td4300-panel

  reg:
    maxItems: 1

  vio-supply:
    description: core I/O voltage supply

  vsn-supply:
    description: negative voltage supply for analog circuits

  vsp-supply:
    description: positive voltage supply for analog circuits

  backlight-gpios:
    maxItems: 1
    description: backlight enable GPIO

  reset-gpios: true
  width-mm: true
  height-mm: true
  panel-timing: true

required:
  - compatible
  - reg
  - width-mm
  - height-mm
  - panel-timing

additionalProperties: false

examples:
  - |
    #include <dt-bindings/gpio/gpio.h>

    dsi {
        #address-cells = <1>;
        #size-cells = <0>;

        panel@0 {
            compatible = "syna,td4300-panel";
            reg = <0>;

            vio-supply = <&panel_vio_reg>;
            vsn-supply = <&panel_vsn_reg>;
            vsp-supply = <&panel_vsp_reg>;

            backlight-gpios = <&gpd3 5 GPIO_ACTIVE_LOW>;
            reset-gpios = <&gpd3 4 GPIO_ACTIVE_LOW>;

            width-mm = <68>;
            height-mm = <121>;

            panel-timing {
                clock-frequency = <144389520>;

                hactive = <1080>;
                hsync-len = <4>;
                hfront-porch = <120>;
                hback-porch = <32>;

                vactive = <1920>;
                vsync-len = <2>;
                vfront-porch = <21>;
                vback-porch = <4>;
            };
        };
    };

...
```

## Documentation/devicetree/bindings/display/panel/tfc,s9700rtwv43tr-01b.txt
```
TFC S9700RTWV43TR-01B 7" Three Five Corp 800x480 LCD panel with
resistive touch

The panel is found on TI AM335x-evm.

Required properties:
- compatible: should be "tfc,s9700rtwv43tr-01b"
- power-supply: See panel-common.txt

Optional properties:
- enable-gpios: GPIO pin to enable or disable the panel, if there is one
- backlight: phandle of the backlight device attached to the panel

This binding is compatible with the simple-panel binding, which is specified
in simple-panel.txt in this directory.
```

## Documentation/devicetree/bindings/display/panel/tfc,s9700rtwv43tr-01b.yaml
```yaml
# SPDX-License-Identifier: GPL-2.0
%YAML 1.2
---
$id: http://devicetree.org/schemas/display/panel/tfc,s9700rtwv43tr-01b.yaml#
$schema: http://devicetree.org/meta-schemas/core.yaml#

title: TFC S9700RTWV43TR-01B 7" Three Five Corp 800x480 LCD panel with resistive touch

maintainers:
  - Jyri Sarha <jsarha@ti.com>
  - Thierry Reding <thierry.reding@gmail.com>

description: |+
  The panel is found on TI AM335x-evm.

allOf:
  - $ref: panel-common.yaml#

properties:
  compatible:
    const: tfc,s9700rtwv43tr-01b

  enable-gpios: true
  backlight: true
  port: true

additionalProperties: false

required:
  - compatible
  - power-supply

...
```

## Documentation/devicetree/bindings/display/panel/ti,nspire.yaml
```yaml
# SPDX-License-Identifier: (GPL-2.0-only OR BSD-2-Clause)
%YAML 1.2
---
$id: http://devicetree.org/schemas/display/panel/ti,nspire.yaml#
$schema: http://devicetree.org/meta-schemas/core.yaml#

title: Texas Instruments NSPIRE Display Panels

maintainers:
  - Linus Walleij <linus.walleij@linaro.org>

allOf:
  - $ref: panel-common.yaml#

properties:
  compatible:
    enum:
      - ti,nspire-cx-lcd-panel
      - ti,nspire-classic-lcd-panel
  port: true

required:
  - compatible

additionalProperties: false

examples:
  - |
    panel {
        compatible = "ti,nspire-cx-lcd-panel";
        port {
            panel_in: endpoint {
                remote-endpoint = <&pads>;
            };
        };
    };
```

## Documentation/devicetree/bindings/display/panel/tianma,tm070jdhg30.txt
```
Tianma Micro-electronics TM070JDHG30 7.0" WXGA TFT LCD panel

Required properties:
- compatible: should be "tianma,tm070jdhg30"

This binding is compatible with the simple-panel binding, which is specified
in simple-panel.txt in this directory.
```
