## Documentation/devicetree/bindings/display/panel/sharp,ls037v7dw01.yaml
```yaml
# SPDX-License-Identifier: GPL-2.0
%YAML 1.2
---
$id: http://devicetree.org/schemas/display/panel/sharp,ls037v7dw01.yaml#
$schema: http://devicetree.org/meta-schemas/core.yaml#

title: SHARP LS037V7DW01 TFT-LCD panel

description: |
  This panel can have zero to five GPIOs to configure to change configuration
  between QVGA and VGA mode and the scan direction. As these pins can be also
  configured with external pulls, all the GPIOs are considered optional with holes
  in the array.

maintainers:
  - Tony Lindgren <tony@atomide.com>

allOf:
  - $ref: panel-common.yaml#

properties:
  compatible:
    const: sharp,ls037v7dw01

  label: true
  enable-gpios: true
  reset-gpios: true
  port: true
  power-supply: true

  mode-gpios:
    minItems: 1
    maxItems: 3
    description: |
      GPIO ordered MO, LR, and UD as specified in LS037V7DW01.pdf
      This panel can have zero to three GPIOs to configure to
      change configuration between QVGA and VGA mode and the
      scan direction. As these pins can be also configured
      with external pulls, all the GPIOs are considered
      optional with holes in the array.

required:
  - compatible
  - port

additionalProperties: false

examples:
  - |
    #include <dt-bindings/gpio/gpio.h>

    lcd0: display {
        compatible = "sharp,ls037v7dw01";
        power-supply = <&lcd_3v3>;
        enable-gpios = <&gpio5 24 GPIO_ACTIVE_HIGH>;    /* gpio152, lcd INI */
        reset-gpios = <&gpio5 27 GPIO_ACTIVE_HIGH>;     /* gpio155, lcd RESB */
        mode-gpios = <&gpio5 26 GPIO_ACTIVE_HIGH        /* gpio154, lcd MO */
                      &gpio1 2 GPIO_ACTIVE_HIGH         /* gpio2, lcd LR */
                      &gpio1 3 GPIO_ACTIVE_HIGH>;       /* gpio3, lcd UD */

        port {
            lcd_in: endpoint {
                remote-endpoint = <&dpi_out>;
            };
        };
    };

...
```

## Documentation/devicetree/bindings/display/panel/sharp,ls043t1le01.txt
```
Sharp Microelectronics 4.3" qHD TFT LCD panel

Required properties:
- compatible: should be "sharp,ls043t1le01-qhd"
- reg: DSI virtual channel of the peripheral
- power-supply: phandle of the regulator that provides the supply voltage

Optional properties:
- backlight: phandle of the backlight device attached to the panel
- reset-gpios: a GPIO spec for the reset pin

Example:

	mdss_dsi@fd922800 {
		panel@0 {
			compatible = "sharp,ls043t1le01-qhd";
			reg = <0>;
			avdd-supply = <&pm8941_l22>;
			backlight = <&pm8941_wled>;
			reset-gpios = <&pm8941_gpios 19 GPIO_ACTIVE_HIGH>;
		};
	};
```

## Documentation/devicetree/bindings/display/panel/sharp,ls043t1le01.yaml
```yaml
# SPDX-License-Identifier: GPL-2.0
%YAML 1.2
---
$id: http://devicetree.org/schemas/display/panel/sharp,ls043t1le01.yaml#
$schema: http://devicetree.org/meta-schemas/core.yaml#

title: Sharp Microelectronics 4.3" qHD TFT LCD panel

maintainers:
  - Werner Johansson <werner.johansson@sonymobile.com>

allOf:
  - $ref: panel-common.yaml#

properties:
  compatible:
    const: sharp,ls043t1le01-qhd

  reg: true
  backlight: true
  reset-gpios: true
  port: true

  avdd-supply:
    description: handle of the regulator that provides the supply voltage

required:
  - compatible
  - reg
  - avdd-supply

additionalProperties: false

examples:
  - |
    #include <dt-bindings/gpio/gpio.h>

    dsi {
        #address-cells = <1>;
        #size-cells = <0>;

        panel@0 {
            compatible = "sharp,ls043t1le01-qhd";
            reg = <0>;
            avdd-supply = <&pm8941_l22>;
            backlight = <&pm8941_wled>;
            reset-gpios = <&pm8941_gpios 19 GPIO_ACTIVE_HIGH>;
        };
    };

...
```

## Documentation/devicetree/bindings/display/panel/sharp,ls060t1sx01.yaml
```yaml
# SPDX-License-Identifier: (GPL-2.0-only OR BSD-2-Clause)
%YAML 1.2
---
$id: http://devicetree.org/schemas/display/panel/sharp,ls060t1sx01.yaml#
$schema: http://devicetree.org/meta-schemas/core.yaml#

title: Sharp Microelectronics 6.0" FullHD TFT LCD panel

maintainers:
  - Dmitry Baryskov <dmitry.baryshkov@linaro.org>

allOf:
  - $ref: panel-common.yaml#

properties:
  compatible:
    const: sharp,ls060t1sx01

  reg: true
  backlight: true
  reset-gpios: true
  port: true

  avdd-supply:
    description: handle of the regulator that provides the positive supply voltage
  avee-supply:
    description: handle of the regulator that provides the negative supply voltage
  vddi-supply:
    description: handle of the regulator that provides the I/O supply voltage
  vddh-supply:
    description: handle of the regulator that provides the analog supply voltage

required:
  - compatible
  - reg

additionalProperties: false

examples:
  - |
    #include <dt-bindings/gpio/gpio.h>

    dsi {
        #address-cells = <1>;
        #size-cells = <0>;

        panel@0 {
            compatible = "sharp,ls060t1sx01";
            reg = <0>;
            avdd-supply = <&pm8941_l22>;
            backlight = <&backlight>;
            reset-gpios = <&pm8916_gpios 25 GPIO_ACTIVE_LOW>;
        };
    };

...
```

## Documentation/devicetree/bindings/display/panel/shelly,sca07010-bfn-lnn.txt
```
Shelly SCA07010-BFN-LNN 7.0" WVGA TFT LCD panel

Required properties:
- compatible: should be "shelly,sca07010-bfn-lnn"

This binding is compatible with the simple-panel binding, which is specified
in simple-panel.txt in this directory.
```

## Documentation/devicetree/bindings/display/panel/sitronix,st7701.txt
```
Sitronix ST7701 based LCD panels

ST7701 designed for small and medium sizes of TFT LCD display, is
capable of supporting up to 480RGBX864 in resolution. It provides
several system interfaces like MIPI/RGB/SPI.

Techstar TS8550B is 480x854, 2-lane MIPI DSI LCD panel which has
inbuilt ST7701 chip.

Required properties:
- compatible: must be "sitronix,st7701" and one of
  * "techstar,ts8550b"
- reset-gpios: a GPIO phandle for the reset pin

Required properties for techstar,ts8550b:
- reg: DSI virtual channel used by that screen
- VCC-supply: analog regulator for MIPI circuit
- IOVCC-supply: I/O system regulator

Optional properties:
- backlight: phandle for the backlight control.

panel@0 {
	compatible = "techstar,ts8550b", "sitronix,st7701";
	reg = <0>;
	VCC-supply = <&reg_dldo2>;
	IOVCC-supply = <&reg_dldo2>;
	reset-gpios = <&pio 3 24 GPIO_ACTIVE_HIGH>; /* LCD-RST: PD24 */
	backlight = <&backlight>;
};
```

## Documentation/devicetree/bindings/display/panel/sitronix,st7701.yaml
```yaml
# SPDX-License-Identifier: (GPL-2.0-only OR BSD-2-Clause)
%YAML 1.2
---
$id: http://devicetree.org/schemas/display/panel/sitronix,st7701.yaml#
$schema: http://devicetree.org/meta-schemas/core.yaml#

title: Sitronix ST7701 based LCD panels

maintainers:
  - Jagan Teki <jagan@amarulasolutions.com>

description: |
  ST7701 designed for small and medium sizes of TFT LCD display, is
  capable of supporting up to 480RGBX864 in resolution. It provides
  several system interfaces like MIPI/RGB/SPI.

  Techstar TS8550B is 480x854, 2-lane MIPI DSI LCD panel which has
  inbuilt ST7701 chip.

  Densitron DMT028VGHMCMI-1A is 480x640, 2-lane MIPI DSI LCD panel
  which has built-in ST7701 chip.

properties:
  compatible:
    items:
      - enum:
          - anbernic,rg-arc-panel
          - anbernic,rg28xx-panel
          - densitron,dmt028vghmcmi-1a
          - elida,kd50t048a
          - techstar,ts8550b
          - winstar,wf40eswaa6mnn0
      - const: sitronix,st7701

  reg:
    description: DSI / SPI channel used by that screen
    maxItems: 1

  VCC-supply:
    description: analog regulator for MIPI circuit

  IOVCC-supply:
    description: I/O system regulator

  dc-gpios:
    maxItems: 1
    description:
      Controller data/command selection (D/CX) in 4-line SPI mode.
      If not set, the controller is in 3-line SPI mode.
      Disallowed for DSI.

  port: true
  reset-gpios: true
  rotation: true

  backlight: true

required:
  - compatible
  - reg
  - VCC-supply
  - IOVCC-supply
  - port
  - reset-gpios

allOf:
  - $ref: panel-common.yaml#
  - if:
      properties:
        compatible:
          contains:
            # SPI connected panels
            enum:
              - anbernic,rg28xx-panel
    then:
      $ref: /schemas/spi/spi-peripheral-props.yaml#

  - if:
      properties:
        compatible:
          not:
            contains:
              # DSI or SPI without D/CX pin
              enum:
                - anbernic,rg-arc-panel
                - anbernic,rg28xx-panel
                - densitron,dmt028vghmcmi-1a
                - elida,kd50t048a
                - techstar,ts8550b
    then:
      required:
        - dc-gpios
    else:
      properties:
        dc-gpios: false

unevaluatedProperties: false

examples:
  - |
    #include <dt-bindings/gpio/gpio.h>

    dsi {
        #address-cells = <1>;
        #size-cells = <0>;

        panel@0 {
            compatible = "techstar,ts8550b", "sitronix,st7701";
            reg = <0>;
            VCC-supply = <&reg_dldo2>;
            IOVCC-supply = <&reg_dldo2>;
            reset-gpios = <&pio 3 24 GPIO_ACTIVE_HIGH>; /* LCD-RST: PD24 */
            backlight = <&backlight>;

            port {
                mipi_in_panel: endpoint {
                    remote-endpoint = <&mipi_out_panel>;
                };
            };
        };
    };
  - |
    #include <dt-bindings/gpio/gpio.h>

    spi {
        #address-cells = <1>;
        #size-cells = <0>;

        panel@0 {
            compatible = "anbernic,rg28xx-panel", "sitronix,st7701";
            reg = <0>;
            spi-max-frequency = <3125000>;
            VCC-supply = <&reg_lcd>;
            IOVCC-supply = <&reg_lcd>;
            reset-gpios = <&pio 8 14 GPIO_ACTIVE_HIGH>; /* LCD-RST: PI14 */
            backlight = <&backlight>;

            port {
                panel_in_rgb: endpoint {
                    remote-endpoint = <&tcon_lcd0_out_lcd>;
                };
            };
        };
    };
```

## Documentation/devicetree/bindings/display/panel/sitronix,st7789v.txt
```
Sitronix ST7789V RGB panel with SPI control bus

Required properties:
  - compatible: "sitronix,st7789v"
  - reg: Chip select of the panel on the SPI bus
  - reset-gpios: a GPIO phandle for the reset pin
  - power-supply: phandle of the regulator that provides the supply voltage

Optional properties:
  - backlight: phandle to the backlight used

The generic bindings for the SPI slaves documented in [1] also applies

The device node can contain one 'port' child node with one child
'endpoint' node, according to the bindings defined in [2]. This
node should describe panel's video bus.

[1]: Documentation/devicetree/bindings/spi/spi-bus.txt
[2]: Documentation/devicetree/bindings/graph.txt

Example:

panel@0 {
	compatible = "sitronix,st7789v";
	reg = <0>;
	reset-gpios = <&pio 6 11 GPIO_ACTIVE_LOW>;
	backlight = <&pwm_bl>;
	spi-max-frequency = <100000>;
	spi-cpol;
	spi-cpha;

	port {
		panel_input: endpoint {
			remote-endpoint = <&tcon0_out_panel>;
		};
	};
};
```

## Documentation/devicetree/bindings/display/panel/sitronix,st7789v.yaml
```yaml
# SPDX-License-Identifier: GPL-2.0
%YAML 1.2
---
$id: http://devicetree.org/schemas/display/panel/sitronix,st7789v.yaml#
$schema: http://devicetree.org/meta-schemas/core.yaml#

title: Sitronix ST7789V RGB panel with SPI control bus

maintainers:
  - Maxime Ripard <mripard@kernel.org>

allOf:
  - $ref: panel-common.yaml#
  - $ref: /schemas/spi/spi-peripheral-props.yaml#

properties:
  compatible:
    const: sitronix,st7789v

  reg: true
  reset-gpios: true
  power-supply: true
  backlight: true
  port: true

required:
  - compatible
  - reg
  - reset-gpios
  - power-supply

unevaluatedProperties: false

examples:
  - |
    #include <dt-bindings/gpio/gpio.h>

    spi {
        #address-cells = <1>;
        #size-cells = <0>;

        panel@0 {
            compatible = "sitronix,st7789v";
            reg = <0>;
            reset-gpios = <&pio 6 11 GPIO_ACTIVE_LOW>;
            backlight = <&pwm_bl>;
            power-supply = <&power>;
            spi-max-frequency = <100000>;
            spi-cpol;
            spi-cpha;

            port {
                panel_input: endpoint {
                    remote-endpoint = <&tcon0_out_panel>;
                };
            };
        };
    };

...
```

## Documentation/devicetree/bindings/display/panel/sony,acx424akp.yaml
```yaml
# SPDX-License-Identifier: (GPL-2.0-only OR BSD-2-Clause)
%YAML 1.2
---
$id: http://devicetree.org/schemas/display/panel/sony,acx424akp.yaml#
$schema: http://devicetree.org/meta-schemas/core.yaml#

title: Sony ACX424AKP/ACX424AKM 4" 480x864/480x854 AMOLED panel

description: The Sony ACX424AKP and ACX424AKM are panels built around
  the Novatek NT35560 display controller. The only difference is that
  the AKM is configured to use 10 pixels less in the Y axis than the
  AKP.

maintainers:
  - Linus Walleij <linus.walleij@linaro.org>

allOf:
  - $ref: panel-common.yaml#

properties:
  compatible:
    enum:
      - sony,acx424akp
      - sony,acx424akm

  reg:
    maxItems: 1

  reset-gpios: true
  vddi-supply:
    description: regulator that supplies the vddi voltage
  enforce-video-mode: true

required:
  - compatible
  - reg
  - reset-gpios

additionalProperties: false

examples:
  - |
    #include <dt-bindings/gpio/gpio.h>

    dsi-controller@a0351000 {
        compatible = "ste,mcde-dsi";
        reg = <0xa0351000 0x1000>;
        #address-cells = <1>;
        #size-cells = <0>;

        panel@0 {
            compatible = "sony,acx424akp";
            reg = <0>;
            vddi-supply = <&foo>;
            reset-gpios = <&foo_gpio 0 GPIO_ACTIVE_LOW>;
        };
    };

...
```

## Documentation/devicetree/bindings/display/panel/sony,acx565akm.txt
```
Sony ACX565AKM SDI Panel
========================

Required properties:
- compatible: "sony,acx565akm"

Optional properties:
- label: a symbolic name for the panel
- reset-gpios: panel reset gpio

Required nodes:
- Video port for SDI input

Example
-------

acx565akm@2 {
	compatible = "sony,acx565akm";
	spi-max-frequency = <6000000>;
	reg = <2>;

	label = "lcd";
	reset-gpios = <&gpio3 26 GPIO_ACTIVE_HIGH>; /* 90 */

	port {
		lcd_in: endpoint {
			remote-endpoint = <&sdi_out>;
		};
	};
};
```

## Documentation/devicetree/bindings/display/panel/sony,acx565akm.yaml
```yaml
# SPDX-License-Identifier: GPL-2.0
%YAML 1.2
---
$id: http://devicetree.org/schemas/display/panel/sony,acx565akm.yaml#
$schema: http://devicetree.org/meta-schemas/core.yaml#

title: Sony ACX565AKM SDI Panel

description: |
  The panel must obey the rules for a SPI slave device as specified in
  spi/spi-controller.yaml

maintainers:
  - Tomi Valkeinen <tomi.valkeinen@ti.com>

allOf:
  - $ref: panel-common.yaml#

properties:
  compatible:
    const: sony,acx565akm

  label: true
  reset-gpios: true
  port: true

required:
  - compatible
  - port

unevaluatedProperties: false

examples:
  - |
    #include <dt-bindings/gpio/gpio.h>

    spi {
        #address-cells = <1>;
        #size-cells = <0>;

        panel@2 {
            compatible = "sony,acx565akm";
            spi-max-frequency = <6000000>;
            reg = <2>;

            label = "lcd";
            reset-gpios = <&gpio3 26 GPIO_ACTIVE_HIGH>; /* 90 */

            port {
                lcd_in: endpoint {
                    remote-endpoint = <&sdi_out>;
                };
            };
        };
    };

...
```
