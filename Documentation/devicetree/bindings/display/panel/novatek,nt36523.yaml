## Documentation/devicetree/bindings/display/panel/novatek,nt36523.yaml
```yaml
# SPDX-License-Identifier: GPL-2.0-only OR BSD-2-Clause
%YAML 1.2
---
$id: http://devicetree.org/schemas/display/panel/novatek,nt36523.yaml#
$schema: http://devicetree.org/meta-schemas/core.yaml#

title: Novatek NT36523 based DSI display Panels

maintainers:
  - Jianhua Lu <lujianhua000@gmail.com>

description: |
  The Novatek NT36523 is a generic DSI Panel IC used to drive dsi
  panels. Support video mode panels from China Star Optoelectronics
  Technology (CSOT) and BOE Technology.

allOf:
  - $ref: panel-common.yaml#

properties:
  compatible:
    oneOf:
      - items:
          - enum:
              - xiaomi,elish-boe-nt36523
              - xiaomi,elish-csot-nt36523
          - const: novatek,nt36523
      - items:
          - enum:
              - lenovo,j606f-boe-nt36523w
          - const: novatek,nt36523w

  reset-gpios:
    maxItems: 1
    description: phandle of gpio for reset line - This should be 8mA

  vddio-supply:
    description: regulator that supplies the I/O voltage

  reg: true
  ports: true
  rotation: true
  backlight: true

required:
  - compatible
  - reg
  - vddio-supply
  - reset-gpios
  - ports

unevaluatedProperties: false

examples:
  - |
    #include <dt-bindings/gpio/gpio.h>

    dsi {
        #address-cells = <1>;
        #size-cells = <0>;

        panel@0 {
            compatible = "xiaomi,elish-csot-nt36523", "novatek,nt36523";
            reg = <0>;

            vddio-supply = <&vreg_l14a_1p88>;
            reset-gpios = <&tlmm 75 GPIO_ACTIVE_LOW>;
            backlight = <&backlight>;

            ports {
                #address-cells = <1>;
                #size-cells = <0>;

                port@0 {
                    reg = <0>;
                    panel_in_0: endpoint {
                        remote-endpoint = <&dsi0_out>;
                    };
                };

                port@1{
                    reg = <1>;
                    panel_in_1: endpoint {
                        remote-endpoint = <&dsi1_out>;
                    };
                };
            };
        };
    };

...
```

## Documentation/devicetree/bindings/display/panel/novatek,nt36672a.yaml
```yaml
# SPDX-License-Identifier: GPL-2.0-only OR BSD-2-Clause
%YAML 1.2
---
$id: http://devicetree.org/schemas/display/panel/novatek,nt36672a.yaml#
$schema: http://devicetree.org/meta-schemas/core.yaml#

title: Novatek NT36672A based DSI display Panels

maintainers:
  - Sumit Semwal <sumit.semwal@linaro.org>

description: |
  The nt36672a IC from Novatek is a generic DSI Panel IC used to drive dsi
  panels.
  Right now, support is added only for a Tianma FHD+ LCD display panel with a
  resolution of 1080x2246. It is a video mode DSI panel.

allOf:
  - $ref: panel-common.yaml#

properties:
  compatible:
    items:
      - enum:
          - tianma,fhd-video
      - const: novatek,nt36672a
    description: This indicates the panel manufacturer of the panel that is
      in turn using the NT36672A panel driver. This compatible string
      determines how the NT36672A panel driver is configured for the indicated
      panel. The novatek,nt36672a compatible shall always be provided as a fallback.

  reg:
    maxItems: 1

  reset-gpios:
    maxItems: 1
    description: phandle of gpio for reset line - This should be 8mA, gpio
      can be configured using mux, pinctrl, pinctrl-names (active high)

  vddio-supply:
    description: phandle of the regulator that provides the supply voltage
      Power IC supply

  vddpos-supply:
    description: phandle of the positive boost supply regulator

  vddneg-supply:
    description: phandle of the negative boost supply regulator

  port: true
  backlight: true

required:
  - compatible
  - reg
  - vddio-supply
  - vddpos-supply
  - vddneg-supply
  - reset-gpios
  - port

unevaluatedProperties: false

examples:
  - |+
    #include <dt-bindings/gpio/gpio.h>

    dsi0 {
        #address-cells = <1>;
        #size-cells = <0>;

        panel@0 {
            compatible = "tianma,fhd-video", "novatek,nt36672a";
            reg = <0>;
            vddio-supply = <&vreg_l14a_1p88>;
            vddpos-supply = <&lab>;
            vddneg-supply = <&ibb>;

            backlight = <&pmi8998_wled>;
            reset-gpios = <&tlmm 6 GPIO_ACTIVE_HIGH>;

            port {
                tianma_nt36672a_in_0: endpoint {
                    remote-endpoint = <&dsi0_out>;
                };
            };
        };
    };

...
```

## Documentation/devicetree/bindings/display/panel/novatek,nt36672e.yaml
```yaml
# SPDX-License-Identifier: GPL-2.0-only OR BSD-2-Clause
%YAML 1.2
---
$id: http://devicetree.org/schemas/display/panel/novatek,nt36672e.yaml#
$schema: http://devicetree.org/meta-schemas/core.yaml#

title: Novatek NT36672E LCD DSI Panel

maintainers:
  - Ritesh Kumar <quic_riteshk@quicinc.com>

allOf:
  - $ref: panel-common.yaml#

properties:
  compatible:
    const: novatek,nt36672e

  reg:
    maxItems: 1
    description: DSI virtual channel

  vddi-supply: true
  avdd-supply: true
  avee-supply: true
  port: true
  reset-gpios: true
  backlight: true

required:
  - compatible
  - reg
  - vddi-supply
  - avdd-supply
  - avee-supply
  - reset-gpios
  - port

additionalProperties: false

examples:
  - |
    #include <dt-bindings/gpio/gpio.h>
    dsi {
        #address-cells = <1>;
        #size-cells = <0>;
        panel@0 {
            compatible = "novatek,nt36672e";
            reg = <0>;

            reset-gpios = <&tlmm 44 GPIO_ACTIVE_HIGH>;

            vddi-supply = <&vreg_l8c_1p8>;
            avdd-supply = <&disp_avdd>;
            avee-supply = <&disp_avee>;

            backlight = <&pwm_backlight>;

            port {
                panel0_in: endpoint {
                    remote-endpoint = <&dsi0_out>;
                };
            };
        };
    };
...
```

## Documentation/devicetree/bindings/display/panel/novatek,nt37801.yaml
```yaml
# SPDX-License-Identifier: GPL-2.0-only OR BSD-2-Clause
%YAML 1.2
---
$id: http://devicetree.org/schemas/display/panel/novatek,nt37801.yaml#
$schema: http://devicetree.org/meta-schemas/core.yaml#

title: Novatek NT37801 AMOLED DSI Panel

maintainers:
  - Krzysztof Kozlowski <krzk@kernel.org>

description:
  Naming is inconclusive and different sources claim this is either Novatek
  NT37801 or NT37810 AMOLED DSI Panel.

allOf:
  - $ref: panel-common.yaml#

properties:
  compatible:
    const: novatek,nt37801

  reg:
    maxItems: 1
    description: DSI virtual channel

  vci-supply: true
  vdd-supply: true
  vddio-supply: true
  port: true
  reset-gpios: true

required:
  - compatible
  - reg
  - vci-supply
  - vdd-supply
  - vddio-supply
  - port
  - reset-gpios

additionalProperties: false

examples:
  - |
    #include <dt-bindings/gpio/gpio.h>

    dsi {
        #address-cells = <1>;
        #size-cells = <0>;

        panel@0 {
            compatible = "novatek,nt37801";
            reg = <0>;

            vci-supply = <&vreg_l13b_3p0>;
            vdd-supply = <&vreg_l11b_1p2>;
            vddio-supply = <&vreg_l12b_1p8>;

            reset-gpios = <&tlmm 98 GPIO_ACTIVE_LOW>;

            port {
                endpoint {
                    remote-endpoint = <&dsi0_out>;
                };
            };
        };
    };
...
```

## Documentation/devicetree/bindings/display/panel/nvd,9128.txt
```
New Vision Display 7.0" 800 RGB x 480 TFT LCD panel

Required properties:
- compatible: should be "nvd,9128"

This binding is compatible with the simple-panel binding, which is specified
in simple-panel.txt in this directory.
```

## Documentation/devicetree/bindings/display/panel/okaya,rs800480t-7x0gp.txt
```
OKAYA Electric America, Inc. RS800480T-7X0GP 7" WVGA LCD panel

Required properties:
- compatible: should be "okaya,rs800480t-7x0gp"

This binding is compatible with the simple-panel binding, which is specified
in simple-panel.txt in this directory.
```

## Documentation/devicetree/bindings/display/panel/olimex,lcd-olinuxino-43-ts.txt
```
Olimex 4.3" TFT LCD panel

Required properties:
- compatible: should be "olimex,lcd-olinuxino-43-ts"

This binding is compatible with the simple-panel binding, which is specified
in simple-panel.txt in this directory.
```

## Documentation/devicetree/bindings/display/panel/olimex,lcd-olinuxino.txt
```
Binding for Olimex Ltd. LCD-OLinuXiyes bridge panel.

This device can be used as bridge between a host controller and LCD panels.
Currently supported LCDs are:
  - LCD-OLinuXiyes-4.3TS
  - LCD-OLinuXiyes-5
  - LCD-OLinuXiyes-7
  - LCD-OLinuXiyes-10

The panel itself contains:
  - AT24C16C EEPROM holding panel identification and timing requirements
  - AR1021 resistive touch screen controller (optional)
  - FT5x6 capacitive touch screnn controller (optional)
  - GT911/GT928 capacitive touch screen controller (optional)

The above chips share same I2C bus. The EEPROM is factory preprogrammed with
device information (id, serial, etc.) and timing requirements.

Touchscreen bingings can be found in these files:
  - input/touchscreen/goodix.txt
  - input/touchscreen/edt-ft5x06.txt
  - input/touchscreen/ar1021.txt

Required properties:
  - compatible: should be "olimex,lcd-olinuxiyes"
  - reg: address of the configuration EEPROM, should be <0x50>
  - power-supply: phandle of the regulator that provides the supply voltage

Optional properties:
  - enable-gpios: GPIO pin to enable or disable the panel
  - backlight: phandle of the backlight device attacked to the panel

Example:
&i2c2 {
	panel@50 {
		compatible = "olimex,lcd-olinuxiyes";
		reg = <0x50>;
		power-supply = <&reg_vcc5v0>;
		enable-gpios = <&pio 7 8 GPIO_ACTIVE_HIGH>;
		backlight = <&backlight>;
	};
};
```

## Documentation/devicetree/bindings/display/panel/olimex,lcd-olinuxino.yaml
```yaml
# SPDX-License-Identifier: GPL-2.0
%YAML 1.2
---
$id: http://devicetree.org/schemas/display/panel/olimex,lcd-olinuxino.yaml#
$schema: http://devicetree.org/meta-schemas/core.yaml#

title: Olimex Ltd. LCD-OLinuXino bridge panel.

maintainers:
  - Stefan Mavrodiev <stefan@olimex.com>

description: |
  This device can be used as bridge between a host controller and LCD panels.
  Currently supported LCDs are:
    - LCD-OLinuXino-4.3TS
    - LCD-OLinuXino-5
    - LCD-OLinuXino-7
    - LCD-OLinuXino-10

  The panel itself contains:
    - AT24C16C EEPROM holding panel identification and timing requirements
    - AR1021 resistive touch screen controller (optional)
    - FT5x6 capacitive touch screen controller (optional)
    - GT911/GT928 capacitive touch screen controller (optional)

  The above chips share same I2C bus. The EEPROM is factory preprogrammed with
  device information (id, serial, etc.) and timing requirements.

  Touchscreen bingings can be found in these files:
    - input/touchscreen/goodix.yaml
    - input/touchscreen/edt-ft5x06.txt
    - input/touchscreen/ar1021.txt

allOf:
  - $ref: panel-common.yaml#

properties:
  compatible:
    const: olimex,lcd-olinuxino

  backlight: true
  enable-gpios: true
  power-supply: true
  reg: true

required:
  - compatible
  - reg
  - power-supply

additionalProperties: false

examples:
  - |
    #include <dt-bindings/gpio/gpio.h>

    i2c {
        #address-cells = <1>;
        #size-cells = <0>;

        panel@50 {
            compatible = "olimex,lcd-olinuxino";
            reg = <0x50>;
            power-supply = <&reg_vcc5v0>;
            enable-gpios = <&pio 7 8 GPIO_ACTIVE_HIGH>;
            backlight = <&backlight>;
        };
    };

...
```

## Documentation/devicetree/bindings/display/panel/ontat,yx700wv03.txt
```
On Tat Industrial Company 7" DPI TFT panel.

Required properties:
- compatible: should be "ontat,yx700wv03"

This binding is compatible with the simple-panel binding, which is specified
in simple-panel.txt in this directory.
```

## Documentation/devicetree/bindings/display/panel/orisetech,otm8009a.txt
```
Orise Tech OTM8009A 3.97" 480x800 TFT LCD panel (MIPI-DSI video mode)

The Orise Tech OTM8009A is a 3.97" 480x800 TFT LCD panel connected using
a MIPI-DSI video interface. Its backlight is managed through the DSI link.

Required properties:
  - compatible: "orisetech,otm8009a"
  - reg: the virtual channel number of a DSI peripheral

Optional properties:
  - reset-gpios: a GPIO spec for the reset pin (active low).

Example:
&dsi {
	...
	panel@0 {
		compatible = "orisetech,otm8009a";
		reg = <0>;
		reset-gpios = <&gpioh 7 GPIO_ACTIVE_LOW>;
	};
};
```

## Documentation/devicetree/bindings/display/panel/orisetech,otm8009a.yaml
```yaml
# SPDX-License-Identifier: (GPL-2.0-only or BSD-2-Clause)
%YAML 1.2
---
$id: http://devicetree.org/schemas/display/panel/orisetech,otm8009a.yaml#
$schema: http://devicetree.org/meta-schemas/core.yaml#

title: Orise Tech OTM8009A 3.97" 480x800 TFT LCD panel (MIPI-DSI video mode)

maintainers:
  - Philippe CORNU <philippe.cornu@foss.st.com>

description: |
             The Orise Tech OTM8009A is a 3.97" 480x800 TFT LCD panel connected using
             a MIPI-DSI video interface. Its backlight is managed through the DSI link.
allOf:
  - $ref: panel-common.yaml#

properties:

  compatible:
    const: orisetech,otm8009a

  reg:
    maxItems: 1
    description: DSI virtual channel

  enable-gpios: true
  port: true
  power-supply: true

  reset-gpios:
    maxItems: 1

additionalProperties: false

required:
  - compatible
  - reg

examples:
  - |
    dsi {
      #address-cells = <1>;
      #size-cells = <0>;
      panel@0 {
        compatible = "orisetech,otm8009a";
        reg = <0>;
        reset-gpios = <&gpiof 15 0>;
        power-supply = <&v1v8>;
      };
    };
...
```

## Documentation/devicetree/bindings/display/panel/ortustech,com37h3m05dtc.txt
```
OrtusTech COM37H3M05DTC Blanview 3.7" VGA portrait TFT-LCD panel

Required properties:
- compatible: should be "ortustech,com37h3m05dtc"

Optional properties:
- enable-gpios: GPIO pin to enable or disable the panel
- backlight: phandle of the backlight device attached to the panel
- power-supply: phandle of the regulator that provides the supply voltage

This binding is compatible with the simple-panel binding, which is specified
in simple-panel.txt in this directory.
```

## Documentation/devicetree/bindings/display/panel/ortustech,com43h4m85ulc.txt
```
OrtusTech COM43H4M85ULC Blanview 3.7" TFT-LCD panel

Required properties:
- compatible: should be "ortustech,com43h4m85ulc"

This binding is compatible with the simple-panel binding, which is specified
in simple-panel.txt in this directory.
```

## Documentation/devicetree/bindings/display/panel/osddisplays,osd070t1718-19ts.txt
```
OSD Displays OSD070T1718-19TS 7" WVGA TFT LCD panel

Required properties:
- compatible: shall be "osddisplays,osd070t1718-19ts"
- power-supply: see simple-panel.txt

Optional properties:
- backlight: see simple-panel.txt

This binding is compatible with the simple-panel binding, which is specified
in simple-panel.txt in this directory. No other simple-panel properties than
the ones specified herein are valid.
```

## Documentation/devicetree/bindings/display/panel/osddisplays,osd101t2045-53ts.txt
```
One Stop Displays OSD101T2045-53TS 10.1" 1920x1200 panel

Required properties:
- compatible: should be "osddisplays,osd101t2045-53ts"
- power-supply: as specified in the base binding

Optional properties:
- backlight: as specified in the base binding

This binding is compatible with the simple-panel binding, which is specified
in simple-panel.txt in this directory.
```
