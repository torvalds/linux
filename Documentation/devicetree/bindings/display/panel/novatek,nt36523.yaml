## Documentation/devicetree/bindings/display/panel/panel-dsi-cm.yaml
```yaml
# SPDX-License-Identifier: (GPL-2.0-only OR BSD-2-Clause)
%YAML 1.2
---
$id: http://devicetree.org/schemas/display/panel/panel-dsi-cm.yaml#
$schema: http://devicetree.org/meta-schemas/core.yaml#

title: DSI command mode panels

maintainers:
  - Tomi Valkeinen <tomi.valkeinen@ti.com>
  - Sebastian Reichel <sre@kernel.org>

description: |
  This binding file is a collection of the DSI panels that
  are usually driven in command mode. If no backlight is
  referenced via the optional backlight property, the DSI
  panel is assumed to have native backlight support.
  The panel may use an OF graph binding for the association
  to the display, or it may be a direct child node of the
  display.

allOf:
  - $ref: panel-common.yaml#

properties:

  compatible:
    items:
      - enum:
          - motorola,droid4-panel        # Panel from Motorola Droid4 phone
          - nokia,himalaya               # Panel from Nokia N950 phone
          - tpo,taal                     # Panel from OMAP4 SDP board
      - const: panel-dsi-cm              # Generic DSI command mode panel compatible fallback

  reg:
    maxItems: 1
    description: DSI virtual channel

  vddi-supply:
    description:
      Display panels require power to be supplied. While several panels need
      more than one power supply with panel-specific constraints governing the
      order and timings of the power supplies, in many cases a single power
      supply is sufficient, either because the panel has a single power rail, or
      because all its power rails can be driven by the same supply. In that case
      the vddi-supply property specifies the supply powering the panel as a
      phandle to a regulator.

  vpnl-supply:
    description:
      When the display panel needs a second power supply, this property can be
      used in addition to vddi-supply. Both supplies will be enabled at the
      same time before the panel is being accessed.

  width-mm: true
  height-mm: true
  label: true
  rotation: true
  panel-timing: true
  port: true
  reset-gpios: true
  te-gpios: true
  backlight: true

additionalProperties: false

required:
  - compatible
  - reg

examples:
  - |
    #include <dt-bindings/gpio/gpio.h>

    dsi-controller {
        #address-cells = <1>;
        #size-cells = <0>;

        panel@0 {
            compatible = "tpo,taal", "panel-dsi-cm";
            reg = <0>;
            reset-gpios = <&gpio4 6 GPIO_ACTIVE_HIGH>;
        };
    };

...
```

## Documentation/devicetree/bindings/display/panel/panel-edp-legacy.yaml
```yaml
# SPDX-License-Identifier: (GPL-2.0-only OR BSD-2-Clause)
%YAML 1.2
---
$id: http://devicetree.org/schemas/display/panel/panel-edp-legacy.yaml#
$schema: http://devicetree.org/meta-schemas/core.yaml#

title: Legacy eDP panels from before the "edp-panel" compatible

maintainers:
  - Douglas Anderson <dianders@chromium.org>

description: |
  This binding file is a collection of eDP panels from before the generic
  "edp-panel" compatible was introduced. It is kept around to support old
  dts files. The only reason one might add a new panel here instead of using
  the generic "edp-panel" is if it needed to be used on an eDP controller
  that doesn't support the generic "edp-panel" compatible, but it should be
  a strong preference to add the generic "edp-panel" compatible instead.

allOf:
  - $ref: panel-common.yaml#

properties:
  compatible:
    enum:
    # compatible must be listed in alphabetical order, ordered by compatible.
    # The description in the comment is mandatory for each compatible.

        # AU Optronics Corporation 10.1" WSVGA TFT LCD panel
      - auo,b101ean01
        # AUO B116XAK01 eDP TFT LCD panel
      - auo,b116xa01
        # AU Optronics Corporation 13.3" FHD (1920x1080) color TFT-LCD panel
      - auo,b133htn01
        # AU Optronics Corporation 13.3" WXGA (1366x768) TFT LCD panel
      - auo,b133xtn01
        # BOE OPTOELECTRONICS TECHNOLOGY 10.1" WXGA TFT LCD panel
      - boe,nv101wxmn51
        # BOE NV133FHM-N61 13.3" FHD (1920x1080) TFT LCD Panel
      - boe,nv110wtm-n61
        # BOE NV110WTM-N61 11.0" 2160x1440 TFT LCD Panel
      - boe,nv133fhm-n61
        # BOE NV133FHM-N62 13.3" FHD (1920x1080) TFT LCD Panel
      - boe,nv133fhm-n62
        # BOE NV140FHM-N49 14.0" FHD a-Si FT panel
      - boe,nv140fhmn49
        # Innolux Corporation 11.6" WXGA (1366x768) TFT LCD panel
      - innolux,n116bca-ea1
        # Innolux Corporation 11.6" WXGA (1366x768) TFT LCD panel
      - innolux,n116bge
        # InnoLux 13.3" FHD (1920x1080) eDP TFT LCD panel
      - innolux,n125hce-gn1
        # Innolux P120ZDG-BF1 12.02 inch eDP 2K display panel
      - innolux,p120zdg-bf1
        # King & Display KD116N21-30NV-A010 eDP TFT LCD panel
      - kingdisplay,kd116n21-30nv-a010
        # LG LP079QX1-SP0V 7.9" (1536x2048 pixels) TFT LCD panel
      - lg,lp079qx1-sp0v
        # LG 9.7" (2048x1536 pixels) TFT LCD panel
      - lg,lp097qx1-spa1
        # LG 12.0" (1920x1280 pixels) TFT LCD panel
      - lg,lp120up1
        # LG 12.9" (2560x1700 pixels) TFT LCD panel
      - lg,lp129qe
        # NewEast Optoelectronics CO., LTD WJFH116008A eDP TFT LCD panel
      - neweast,wjfh116008a
        # Samsung 12.2" (2560x1600 pixels) TFT LCD panel
      - samsung,lsn122dl01-c01
        # Samsung Electronics 14" WXGA (1366x768) TFT LCD panel
      - samsung,ltn140at29-301
        # Sharp LD-D5116Z01B 12.3" WUXGA+ eDP panel
      - sharp,ld-d5116z01b
        # Sharp 12.3" (2400x1600 pixels) TFT LCD panel
      - sharp,lq123p1jx31

  backlight: true
  ddc-i2c-bus: true
  enable-gpios: true
  panel-timing: true
  port: true
  power-supply: true
  no-hpd: true
  hpd-gpios: true

additionalProperties: false

required:
  - compatible
  - power-supply

examples:
  - |
    panel: panel {
      compatible = "innolux,n116bge";
      power-supply = <&panel_regulator>;
      backlight = <&backlight>;

      panel-timing {
        clock-frequency = <74250000>;
        hactive = <1366>;
        hfront-porch = <136>;
        hback-porch = <60>;
        hsync-len = <30>;
        hsync-active = <0>;
        vactive = <768>;
        vfront-porch = <8>;
        vback-porch = <12>;
        vsync-len = <12>;
        vsync-active = <0>;
      };

      port {
        panel_in_edp: endpoint {
          remote-endpoint = <&edp_out_panel>;
        };
      };
    };
```
