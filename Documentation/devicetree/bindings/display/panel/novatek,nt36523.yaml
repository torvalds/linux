## Documentation/devicetree/bindings/display/panel/osddisplays,osd101t2587-53ts.txt
```
One Stop Displays OSD101T2587-53TS 10.1" 1920x1200 panel

The panel is similar to OSD101T2045-53TS, but it needs additional
MIPI_DSI_TURN_ON_PERIPHERAL message from the host.

Required properties:
- compatible: should be "osddisplays,osd101t2587-53ts"
- power-supply: as specified in the base binding

Optional properties:
- backlight: as specified in the base binding

This binding is compatible with the simple-panel binding, which is specified
in simple-panel.txt in this directory.
```

## Documentation/devicetree/bindings/display/panel/panasonic,vvx10f034n00.txt
```
Panasonic 10" WUXGA TFT LCD panel

Required properties:
- compatible: should be "panasonic,vvx10f034n00"
- reg: DSI virtual channel of the peripheral
- power-supply: phandle of the regulator that provides the supply voltage

Optional properties:
- backlight: phandle of the backlight device attached to the panel

Example:

	mdss_dsi@fd922800 {
		panel@0 {
			compatible = "panasonic,vvx10f034n00";
			reg = <0>;
			power-supply = <&vreg_vsp>;
			backlight = <&lp8566_wled>;
		};
	};
```

## Documentation/devicetree/bindings/display/panel/panel-common-dual.yaml
```yaml
# SPDX-License-Identifier: GPL-2.0-only OR BSD-2-Clause
%YAML 1.2
---
$id: http://devicetree.org/schemas/display/panel/panel-common-dual.yaml#
$schema: http://devicetree.org/meta-schemas/core.yaml#

title: Common Properties for Dual-Link Display Panels

maintainers:
  - Thierry Reding <thierry.reding@gmail.com>
  - Laurent Pinchart <laurent.pinchart+renesas@ideasonboard.com>

description:
  Properties common for Panel IC supporting dual link panels.  Devices might
  support also single link.

allOf:
  - $ref: panel-common.yaml#

properties:
  ports:
    $ref: /schemas/graph.yaml#/properties/ports
    additionalProperties: false

    properties:
      port@0:
        $ref: /schemas/graph.yaml#/properties/port
        description: First link

      port@1:
        $ref: /schemas/graph.yaml#/properties/port
        description: Second link

      "#address-cells": true
      "#size-cells": true

    required:
      - port@0

# Single-panel setups are still allowed.
oneOf:
  - required:
      - ports
  - required:
      - port

additionalProperties: true
```

## Documentation/devicetree/bindings/display/panel/panel-common.txt
```
Common Properties for Display Panel
===================================

This document defines device tree properties common to several classes of
display panels. It doesn't constitue a device tree binding specification by
itself but is meant to be referenced by device tree bindings.

When referenced from panel device tree bindings the properties defined in this
document are defined as follows. The panel device tree bindings are
responsible for defining whether each property is required or optional.


Descriptive Properties
----------------------

- width-mm,
- height-mm: The width-mm and height-mm specify the width and height of the
  physical area where images are displayed. These properties are expressed in
  millimeters and rounded to the closest unit.

- label: The label property specifies a symbolic name for the panel as a
  string suitable for use by humans. It typically contains a name inscribed on
  the system (e.g. as an affixed label) or specified in the system's
  documentation (e.g. in the user's manual).

  If no such name exists, and unless the property is mandatory according to
  device tree bindings, it shall rather be omitted than constructed of
  non-descriptive information. For instance an LCD panel in a system that
  contains a single panel shall not be labelled "LCD" if that name is not
  inscribed on the system or used in a descriptive fashion in system
  documentation.


Display Timings
---------------

- panel-timing: Most display panels are restricted to a single resolution and
  require specific display timings. The panel-timing subnode expresses those
  timings as specified in the timing subnode section of the display timing
  bindings defined in
  Documentation/devicetree/bindings/display/display-timing.txt.


Connectivity
------------

- ports: Panels receive video data through one or multiple connections. While
  the nature of those connections is specific to the panel type, the
  connectivity is expressed in a standard fashion using ports as specified in
  the device graph bindings defined in
  Documentation/devicetree/bindings/graph.txt.

- ddc-i2c-bus: Some panels expose EDID information through an I2C-compatible
  bus such as DDC2 or E-DDC. For such panels the ddc-i2c-bus contains a
  phandle to the system I2C controller connected to that bus.


Control I/Os
------------

Many display panels can be controlled through pins driven by GPIOs. The nature
and timing of those control signals are device-specific and left for panel
device tree bindings to specify. The following GPIO specifiers can however be
used for panels that implement compatible control signals.

- enable-gpios: Specifier for a GPIO connected to the panel enable control
  signal. The enable signal is active high and enables operation of the panel.
  This property can also be used for panels implementing an active low power
  down signal, which is a negated version of the enable signal. Active low
  enable signals (or active high power down signals) can be supported by
  inverting the GPIO specifier polarity flag.

  Note that the enable signal control panel operation only and must not be
  confused with a backlight enable signal.

- reset-gpios: Specifier for a GPIO coonnected to the panel reset control
  signal. The reset signal is active low and resets the panel internal logic
  while active. Active high reset signals can be supported by inverting the
  GPIO specifier polarity flag.

Power
-----

- power-supply: display panels require power to be supplied. While several
  panels need more than one power supply with panel-specific constraints
  governing the order and timings of the power supplies, in many cases a single
  power supply is sufficient, either because the panel has a single power rail,
  or because all its power rails can be driven by the same supply. In that case
  the power-supply property specifies the supply powering the panel as a phandle
  to a regulator.

Backlight
---------

Most display panels include a backlight. Some of them also include a backlight
controller exposed through a control bus such as I2C or DSI. Others expose
backlight control through GPIO, PWM or other signals connected to an external
backlight controller.

- backlight: For panels whose backlight is controlled by an external backlight
  controller, this property contains a phandle that references the controller.
```

## Documentation/devicetree/bindings/display/panel/panel-common.yaml
```yaml
# SPDX-License-Identifier: GPL-2.0
%YAML 1.2
---
$id: http://devicetree.org/schemas/display/panel/panel-common.yaml#
$schema: http://devicetree.org/meta-schemas/core.yaml#

title: Common Properties for Display Panels

maintainers:
  - Thierry Reding <thierry.reding@gmail.com>
  - Laurent Pinchart <laurent.pinchart+renesas@ideasonboard.com>

description: |
  This document defines device tree properties common to several classes of
  display panels. It doesn't constitue a device tree binding specification by
  itself but is meant to be referenced by device tree bindings.

  When referenced from panel device tree bindings the properties defined in this
  document are defined as follows. The panel device tree bindings are
  responsible for defining whether each property is required or optional.

properties:
  # Descriptive Properties
  width-mm:
    description:
      Specifies the width of the physical area where images are displayed. This
      property is expressed in millimeters and rounded to the closest unit.

  height-mm:
    description:
      Specifies the height of the physical area where images are displayed. This
      property is expressed in millimeters and rounded to the closest unit.

  label:
    description: |
      The label property specifies a symbolic name for the panel as a
      string suitable for use by humans. It typically contains a name inscribed
      on the system (e.g. as an affixed label) or specified in the system's
      documentation (e.g. in the user's manual).

      If no such name exists, and unless the property is mandatory according to
      device tree bindings, it shall rather be omitted than constructed of
      non-descriptive information. For instance an LCD panel in a system that
      contains a single panel shall not be labelled "LCD" if that name is not
      inscribed on the system or used in a descriptive fashion in system
      documentation.

  rotation:
    description:
      Display rotation in degrees counter clockwise (0,90,180,270)
    $ref: /schemas/types.yaml#/definitions/uint32
    enum: [0, 90, 180, 270]

  # Display Timings
  panel-timing:
    description:
      Most display panels are restricted to a single resolution and
      require specific display timings. The panel-timing subnode expresses those
      timings.
    $ref: panel-timing.yaml#

  display-timings:
    description:
      Some display panels support several resolutions with different timings.
      The display-timings bindings supports specifying several timings and
      optionally specifying which is the native mode.
    $ref: display-timings.yaml#

  # Connectivity
  port:
    $ref: /schemas/graph.yaml#/properties/port

  ddc-i2c-bus:
    $ref: /schemas/types.yaml#/definitions/phandle
    description:
      Some panels expose EDID information through an I2C-compatible
      bus such as DDC2 or E-DDC. For such panels the ddc-i2c-bus contains a
      phandle to the system I2C controller connected to that bus.

  no-hpd:
    type: boolean
    description:
      This panel is supposed to communicate that it's ready via HPD
      (hot plug detect) signal, but the signal isn't hooked up so we should
      hardcode the max delay from the panel spec when powering up the panel.

  hpd-gpios:
    maxItems: 1
    description:
      If Hot Plug Detect (HPD) is connected to a GPIO in the system rather
      than a dedicated HPD pin the pin can be specified here.

  # Control I/Os

  # Many display panels can be controlled through pins driven by GPIOs. The nature
  # and timing of those control signals are device-specific and left for panel
  # device tree bindings to specify. The following GPIO specifiers can however be
  # used for panels that implement compatible control signals.

  enable-gpios:
    maxItems: 1
    description: |
      Specifier for a GPIO connected to the panel enable control signal. The
      enable signal is active high and enables operation of the panel. This
      property can also be used for panels implementing an active low power down
      signal, which is a negated version of the enable signal. Active low enable
      signals (or active high power down signals) can be supported by inverting
      the GPIO specifier polarity flag.

      Note that the enable signal control panel operation only and must not be
      confused with a backlight enable signal.

  reset-gpios:
    maxItems: 1
    description:
      Specifier for a GPIO connected to the panel reset control signal.
      The reset signal is active low and resets the panel internal logic
      while active. Active high reset signals can be supported by inverting the
      GPIO specifier polarity flag.

  te-gpios:
    maxItems: 1
    description:
      GPIO spec for the tearing effect synchronization signal.
      The tearing effect signal is active high. Active low signals can be
      supported by inverting the GPIO specifier polarity flag.

  # Power
  power-supply:
    description:
      Display panels require power to be supplied. While several panels need
      more than one power supply with panel-specific constraints governing the
      order and timings of the power supplies, in many cases a single power
      supply is sufficient, either because the panel has a single power rail, or
      because all its power rails can be driven by the same supply. In that case
      the power-supply property specifies the supply powering the panel as a
      phandle to a regulator.

  # Backlight

  # Most display panels include a backlight. Some of them also include a backlight
  # controller exposed through a control bus such as I2C or DSI. Others expose
  # backlight control through GPIO, PWM or other signals connected to an external
  # backlight controller.

  backlight:
    $ref: /schemas/types.yaml#/definitions/phandle
    description:
      For panels whose backlight is controlled by an external backlight
      controller, this property contains a phandle that references the
      controller.

dependencies:
  width-mm: [ height-mm ]
  height-mm: [ width-mm ]

additionalProperties: true

...
```

## Documentation/devicetree/bindings/display/panel/panel-dpi.txt
```
Generic MIPI DPI Panel
======================

Required properties:
- compatible: "panel-dpi"

Optional properties:
- label: a symbolic name for the panel
- enable-gpios: panel enable gpio
- reset-gpios: GPIO to control the RESET pin
- vcc-supply: phandle of regulator that will be used to enable power to the display
- backlight: phandle of the backlight device

Required nodes:
- "panel-timing" containing video timings
  (Documentation/devicetree/bindings/display/panel/display-timing.txt)
- Video port for DPI input

Example
-------

lcd0: display@0 {
        compatible = "samsung,lte430wq-f0c", "panel-dpi";
        label = "lcd";

        backlight = <&backlight>;

        port {
            lcd_in: endpoint {
                    remote-endpoint = <&dpi_out>;
            };
        };

        panel-timing {
                clock-frequency = <9200000>;
                hactive = <480>;
                vactive = <272>;
                hfront-porch = <8>;
                hback-porch = <4>;
                hsync-len = <41>;
                vback-porch = <2>;
                vfront-porch = <4>;
                vsync-len = <10>;

                hsync-active = <0>;
                vsync-active = <0>;
                de-active = <1>;
                pixelclk-active = <1>;
        };
};
```

## Documentation/devicetree/bindings/display/panel/panel-dpi.yaml
```yaml
# SPDX-License-Identifier: (GPL-2.0-only OR BSD-2-Clause)
%YAML 1.2
---
$id: http://devicetree.org/schemas/display/panel/panel-dpi.yaml#
$schema: http://devicetree.org/meta-schemas/core.yaml#

title: Generic MIPI DPI Panel

maintainers:
  - Sam Ravnborg <sam@ravnborg.org>

allOf:
  - $ref: panel-common.yaml#

properties:
  compatible:
    description:
      Shall contain a panel specific compatible and "panel-dpi"
      in that order.
    items:
      - {}
      - const: panel-dpi

  backlight: true
  enable-gpios: true
  height-mm: true
  label: true
  panel-timing: true
  port: true
  power-supply: true
  reset-gpios: true
  width-mm: true

required:
  - panel-timing
  - power-supply

additionalProperties: false

examples:
  - |
    panel {
        compatible = "osddisplays,osd057T0559-34ts", "panel-dpi";
        label = "osddisplay";
        power-supply = <&vcc_supply>;
        backlight = <&backlight>;

        port {
            lcd_in: endpoint {
                remote-endpoint = <&dpi_out>;
            };
        };
        panel-timing {
            clock-frequency = <9200000>;
            hactive = <800>;
            vactive = <480>;
            hfront-porch = <8>;
            hback-porch = <4>;
            hsync-len = <41>;
            vback-porch = <2>;
            vfront-porch = <4>;
            vsync-len = <10>;

            hsync-active = <0>;
            vsync-active = <0>;
            de-active = <1>;
            pixelclk-active = <1>;
        };
    };

...
```
