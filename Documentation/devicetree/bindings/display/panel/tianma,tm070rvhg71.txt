## Documentation/devicetree/bindings/display/panel/tianma,tm070rvhg71.txt
```
Tianma Micro-electronics TM070RVHG71 7.0" WXGA TFT LCD panel

Required properties:
- compatible: should be "tianma,tm070rvhg71"
- power-supply: single regulator to provide the supply voltage
- backlight: phandle of the backlight device attached to the panel

Required nodes:
- port: LVDS port mapping to connect this display

This panel needs single power supply voltage. Its backlight is conntrolled
via PWM signal.

Example:
--------

Example device-tree definition when connected to iMX6Q based board

	panel: panel-lvds0 {
		compatible = "tianma,tm070rvhg71";
		backlight = <&backlight_lvds>;
		power-supply = <&reg_lvds>;

		port {
			panel_in_lvds0: endpoint {
				remote-endpoint = <&lvds0_out>;
			};
		};
	};
```

## Documentation/devicetree/bindings/display/panel/toppoly,td028ttec1.txt
```
Toppoly TD028TTEC1 Panel
========================

Required properties:
- compatible: "toppoly,td028ttec1"

Optional properties:
- label: a symbolic name for the panel

Required nodes:
- Video port for DPI input

Example
-------

lcd-panel: td028ttec1@0 {
	compatible = "toppoly,td028ttec1";
	reg = <0>;
	spi-max-frequency = <100000>;
	spi-cpol;
	spi-cpha;

	label = "lcd";
	port {
		lcd_in: endpoint {
			remote-endpoint = <&dpi_out>;
		};
	};
};
```

## Documentation/devicetree/bindings/display/panel/toshiba,lt089ac29000.txt
```
Toshiba 8.9" WXGA (1280x768) TFT LCD panel

Required properties:
- compatible: should be "toshiba,lt089ac29000"
- power-supply: as specified in the base binding

This binding is compatible with the simple-panel binding, which is specified
in simple-panel.txt in this directory.
```

## Documentation/devicetree/bindings/display/panel/tpk,f07a-0102.txt
```
TPK U.S.A. LLC Fusion 7" integrated projected capacitive touch display with,
800 x 480 (WVGA) LCD panel.

Required properties:
- compatible: should be "tpk,f07a-0102"

This binding is compatible with the simple-panel binding, which is specified
in simple-panel.txt in this directory.
```

## Documentation/devicetree/bindings/display/panel/tpk,f10a-0102.txt
```
TPK U.S.A. LLC Fusion 10.1" integrated projected capacitive touch display with,
1024 x 600 (WSVGA) LCD panel.

Required properties:
- compatible: should be "tpk,f10a-0102"

This binding is compatible with the simple-panel binding, which is specified
in simple-panel.txt in this directory.
```

## Documentation/devicetree/bindings/display/panel/tpo,td.yaml
```yaml
# SPDX-License-Identifier: GPL-2.0
%YAML 1.2
---
$id: http://devicetree.org/schemas/display/panel/tpo,td.yaml#
$schema: http://devicetree.org/meta-schemas/core.yaml#

title: Toppoly TD Panels

description: |
  The panel must obey the rules for a SPI slave device as specified in
  spi/spi-controller.yaml

maintainers:
  - Marek Belisko <marek@goldelico.com>
  - H. Nikolaus Schaller <hns@goldelico.com>

allOf:
  - $ref: panel-common.yaml#

properties:
  compatible:
    enum:
        # Toppoly TD028TTEC1 Panel
      - tpo,td028ttec1
        # Toppoly TD043MTEA1 Panel
      - tpo,td043mtea1

  reg: true
  label: true
  reset-gpios: true
  backlight: true
  port: true

required:
  - compatible
  - port

unevaluatedProperties: false

examples:
  - |
    spi {
        #address-cells = <1>;
        #size-cells = <0>;

        panel: panel@0 {
            compatible = "tpo,td043mtea1";
            reg = <0>;
            spi-max-frequency = <100000>;
            spi-cpol;
            spi-cpha;

            label = "lcd";

            reset-gpios = <&gpio7 7 0>;

            port {
                lcd_in: endpoint {
                    remote-endpoint = <&dpi_out>;
                };
            };
        };
    };

...
```

## Documentation/devicetree/bindings/display/panel/tpo,td028ttec1.txt
```
Toppoly TD028TTEC1 Panel
========================

Required properties:
- compatible: "tpo,td028ttec1"

Optional properties:
- label: a symbolic name for the panel
- backlight: phandle of the backlight device

Required nodes:
- Video port for DPI input

Example
-------

lcd-panel: td028ttec1@0 {
	compatible = "tpo,td028ttec1";
	reg = <0>;
	spi-max-frequency = <100000>;
	spi-cpol;
	spi-cpha;

	label = "lcd";
	backlight = <&backlight>;
	port {
		lcd_in: endpoint {
			remote-endpoint = <&dpi_out>;
		};
	};
};
```

## Documentation/devicetree/bindings/display/panel/tpo,tpg110.txt
```
TPO TPG110 Panel
================

This panel driver is a component that acts as an intermediary
between an RGB output and a variety of panels. The panel
driver is strapped up in electronics to the desired resolution
and other properties, and has a control interface over 3WIRE
SPI. By talking to the TPG110 over SPI, the strapped properties
can be discovered and the hardware is therefore mostly
self-describing.

       +--------+
SPI -> |  TPO   | -> physical display
RGB -> | TPG110 |
       +--------+

If some electrical strap or alternate resolution is desired,
this can be set up by taking software control of the display
over the SPI interface. The interface can also adjust
for properties of the display such as gamma correction and
certain electrical driving levels.

The TPG110 does not know the physical dimensions of the panel
connected, so this needs to be specified in the device tree.

It requires a GPIO line for control of its reset line.

The serial protocol has line names that resemble I2C but the
protocol is not I2C but 3WIRE SPI.

Required properties:
- compatible : one of:
  "ste,nomadik-nhk15-display", "tpo,tpg110"
  "tpo,tpg110"
- grestb-gpios : panel reset GPIO
- width-mm : see display/panel/panel-common.txt
- height-mm : see display/panel/panel-common.txt

The device needs to be a child of an SPI bus, see
spi/spi-bus.txt. The SPI child must set the following
properties:
- spi-3wire
- spi-max-frequency = <3000000>;
as these are characteristics of this device.

The device node can contain one 'port' child node with one child
'endpoint' node, according to the bindings defined in
media/video-interfaces.txt. This node should describe panel's video bus.

Example
-------

panel: display@0 {
	compatible = "tpo,tpg110";
	reg = <0>;
	spi-3wire;
	/* 320 ns min period ~= 3 MHz */
	spi-max-frequency = <3000000>;
	/* Width and height from data sheet */
	width-mm = <116>;
	height-mm = <87>;
	grestb-gpios = <&foo_gpio 5 GPIO_ACTIVE_LOW>;
	backlight = <&bl>;

	port {
		nomadik_clcd_panel: endpoint {
			remote-endpoint = <&foo>;
		};
	};
};
```

## Documentation/devicetree/bindings/display/panel/tpo,tpg110.yaml
```yaml
# SPDX-License-Identifier: GPL-2.0
%YAML 1.2
---
$id: http://devicetree.org/schemas/display/panel/tpo,tpg110.yaml#
$schema: http://devicetree.org/meta-schemas/core.yaml#

title: TPO TPG110 Panel

maintainers:
  - Linus Walleij <linus.walleij@linaro.org>
  - Thierry Reding <thierry.reding@gmail.com>

description: |+
  This panel driver is a component that acts as an intermediary
  between an RGB output and a variety of panels. The panel
  driver is strapped up in electronics to the desired resolution
  and other properties, and has a control interface over 3WIRE
  SPI. By talking to the TPG110 over SPI, the strapped properties
  can be discovered and the hardware is therefore mostly
  self-describing.

         +--------+
  SPI -> |  TPO   | -> physical display
  RGB -> | TPG110 |
         +--------+

  If some electrical strap or alternate resolution is desired,
  this can be set up by taking software control of the display
  over the SPI interface. The interface can also adjust
  for properties of the display such as gamma correction and
  certain electrical driving levels.

  The TPG110 does not know the physical dimensions of the panel
  connected, so this needs to be specified in the device tree.

  It requires a GPIO line for control of its reset line.

  The serial protocol has line names that resemble I2C but the
  protocol is not I2C but 3WIRE SPI.


allOf:
  - $ref: panel-common.yaml#
  - $ref: /schemas/spi/spi-peripheral-props.yaml#

properties:
  compatible:
    oneOf:
      - items:
          - enum:
              - ste,nomadik-nhk15-display
          - const: tpo,tpg110
      - const: tpo,tpg110

  reg: true

  grestb-gpios:
    maxItems: 1
    description: panel reset GPIO

  spi-3wire: true

  spi-max-frequency:
    const: 3000000

required:
  - compatible
  - reg
  - grestb-gpios
  - width-mm
  - height-mm
  - spi-3wire
  - spi-max-frequency
  - port

unevaluatedProperties: false

examples:
  - |+
    spi {
      #address-cells = <1>;
      #size-cells = <0>;

      panel: display@0 {
        compatible = "tpo,tpg110";
        reg = <0>;
        spi-3wire;
        /* 320 ns min period ~= 3 MHz */
        spi-max-frequency = <3000000>;
        /* Width and height from data sheet */
        width-mm = <116>;
        height-mm = <87>;
        grestb-gpios = <&foo_gpio 5 1>;
        backlight = <&bl>;

        port {
          nomadik_clcd_panel: endpoint {
            remote-endpoint = <&foo>;
          };
        };
      };
    };

...
```

## Documentation/devicetree/bindings/display/panel/truly,nt35597-2K-display.yaml
```yaml
# SPDX-License-Identifier: (GPL-2.0-only OR BSD-2-Clause)
%YAML 1.2
---
$id: http://devicetree.org/schemas/display/panel/truly,nt35597-2K-display.yaml#
$schema: http://devicetree.org/meta-schemas/core.yaml#

title: Truly NT35597 DSI 2K display

maintainers:
  - Neil Armstrong <neil.armstrong@linaro.org>

description: |
  Truly NT35597 DSI 2K display is used on the Qualcomm SDM845 MTP board.

allOf:
  - $ref: panel-common-dual.yaml#

properties:
  compatible:
    const: truly,nt35597-2K-display

  reg:
    maxItems: 1

  vdda-supply:
    description: regulator that provides the supply voltage Power IC supply

  vdispp-supply:
    description: regulator that provides the supply voltage for positive LCD bias

  vdispn-supply:
    description: regulator that provides the supply voltage for negative LCD bias

  reset-gpios: true

  mode-gpios:
    description:
      Gpio for choosing the mode of the display for single DSI or Dual DSI.
      This should be low for dual DSI and high for single DSI mode.

  ports:
    required:
      - port@0
      - port@1

required:
  - compatible
  - reg
  - vdda-supply
  - reset-gpios
  - mode-gpios
  - ports

additionalProperties: false

examples:
  - |
    #include <dt-bindings/gpio/gpio.h>

    dsi {
        #address-cells = <1>;
        #size-cells = <0>;

        panel@0 {
            compatible = "truly,nt35597-2K-display";
            reg = <0>;

            vdda-supply = <&pm8998_l14>;
            vdispp-supply = <&lab_regulator>;
            vdispn-supply = <&ibb_regulator>;

            reset-gpios = <&tlmm 6 GPIO_ACTIVE_LOW>;
            mode-gpios = <&tlmm 52 GPIO_ACTIVE_HIGH>;

            ports {
                #address-cells = <1>;
                #size-cells = <0>;

                port@0 {
                    reg = <0>;

                    panel0_in: endpoint {
                        remote-endpoint = <&dsi0_out>;
                    };
                };

                port@1 {
                    reg = <1>;

                    panel1_in: endpoint {
                        remote-endpoint = <&dsi1_out>;
                    };
                };
            };
        };
    };
...
```

## Documentation/devicetree/bindings/display/panel/urt,umsh-8596md.txt
```
United Radiant Technology UMSH-8596MD-xT 7.0" WVGA TFT LCD panel

Supported are LVDS versions (-11T, -19T) and parallel ones
(-T, -1T, -7T, -20T).

Required properties:
- compatible: should be one of:
  "urt,umsh-8596md-t",
  "urt,umsh-8596md-1t",
  "urt,umsh-8596md-7t",
  "urt,umsh-8596md-11t",
  "urt,umsh-8596md-19t",
  "urt,umsh-8596md-20t".

This binding is compatible with the simple-panel binding, which is specified
in simple-panel.txt in this directory.
```

## Documentation/devicetree/bindings/display/panel/visionox,r66451.yaml
```yaml
# SPDX-License-Identifier: GPL-2.0-only OR BSD-2-Clause
%YAML 1.2
---
$id: http://devicetree.org/schemas/display/panel/visionox,r66451.yaml#
$schema: http://devicetree.org/meta-schemas/core.yaml#

title: Visionox R66451 AMOLED DSI Panel

maintainers:
  - Jessica Zhang <quic_jesszhan@quicinc.com>

allOf:
  - $ref: panel-common.yaml#

properties:
  compatible:
    const: visionox,r66451

  reg:
    maxItems: 1
    description: DSI virtual channel

  vddio-supply: true
  vdd-supply: true
  port: true
  reset-gpios: true

additionalProperties: false

required:
  - compatible
  - reg
  - vddio-supply
  - vdd-supply
  - reset-gpios
  - port

examples:
  - |
    #include <dt-bindings/gpio/gpio.h>
    dsi {
        #address-cells = <1>;
        #size-cells = <0>;
        panel@0 {
            compatible = "visionox,r66451";
            reg = <0>;
            vddio-supply = <&vreg_l12c_1p8>;
            vdd-supply = <&vreg_l13c_3p0>;

            reset-gpios = <&tlmm 24 GPIO_ACTIVE_LOW>;

            port {
                panel0_in: endpoint {
                    remote-endpoint = <&dsi0_out>;
                };
            };
        };
    };
...
```

## Documentation/devicetree/bindings/display/panel/visionox,rm69299.yaml
```yaml
# SPDX-License-Identifier: GPL-2.0-only OR BSD-2-Clause
%YAML 1.2
---
$id: http://devicetree.org/schemas/display/panel/visionox,rm69299.yaml#
$schema: http://devicetree.org/meta-schemas/core.yaml#

title: Visionox model RM69299 Panels

maintainers:
  - Abhinav Kumar <quic_abhinavk@quicinc.com>
  - Jessica Zhang <quic_jesszhan@quicinc.com>

description: |
  This binding is for display panels using a Visionox RM692999 panel.

allOf:
  - $ref: panel-common.yaml#

properties:
  compatible:
    enum:
      - visionox,rm69299-1080p-display
      - visionox,rm69299-shift

  reg:
    maxItems: 1

  vdda-supply:
    description: |
      Phandle of the regulator that provides the vdda supply voltage.

  vdd3p3-supply:
    description: |
      Phandle of the regulator that provides the vdd3p3 supply voltage.

  port: true
  reset-gpios: true

additionalProperties: false

required:
  - compatible
  - reg
  - vdda-supply
  - vdd3p3-supply
  - reset-gpios
  - port

examples:
  - |
    dsi {
        #address-cells = <1>;
        #size-cells = <0>;

        panel@0 {
            compatible = "visionox,rm69299-1080p-display";
            reg = <0>;

            vdda-supply = <&src_pp1800_l8c>;
            vdd3p3-supply = <&src_pp2800_l18a>;

            reset-gpios = <&pm6150l_gpio 3 0>;
            port {
                panel0_in: endpoint {
                    remote-endpoint = <&dsi0_out>;
                };
            };
        };
    };
...
```
