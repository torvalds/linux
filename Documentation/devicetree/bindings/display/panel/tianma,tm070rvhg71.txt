## Documentation/devicetree/bindings/display/panel/visionox,rm692e5.yaml
```yaml
# SPDX-License-Identifier: GPL-2.0-only OR BSD-2-Clause
%YAML 1.2
---
$id: http://devicetree.org/schemas/display/panel/visionox,rm692e5.yaml#
$schema: http://devicetree.org/meta-schemas/core.yaml#

title: Visionox RM692E5 6.55" 2400x1080 120Hz MIPI-DSI Panel

maintainers:
  - Danila Tikhonov <danila@jiaxyga.com>

description:
  The Visionox RM692E5 is a generic DSI Panel IC used to control
  AMOLED panels.

allOf:
  - $ref: panel-common.yaml#

properties:
  compatible:
    oneOf:
      - enum:
          - visionox,rm692e5
      - items:
          - enum:
              - nothing,rm692e5-spacewar
          - const: visionox,rm692e5

  reg:
    maxItems: 1

  vdd-supply:
    description: 3.3V source voltage rail

  vddio-supply:
    description: 1.8V I/O source voltage rail

  reset-gpios: true
  port: true

required:
  - compatible
  - reg
  - reset-gpios
  - vdd-supply
  - vddio-supply
  - port

additionalProperties: false

examples:
  - |
    #include <dt-bindings/gpio/gpio.h>

    dsi {
        #address-cells = <1>;
        #size-cells = <0>;

        panel@0 {
            compatible = "nothing,rm692e5-spacewar",
                         "visionox,rm692e5";
            reg = <0>;

            reset-gpios = <&tlmm 44 GPIO_ACTIVE_LOW>;

            vdd-supply = <&vdd_oled>;
            vddio-supply = <&vdd_io_oled>;

            port {
                panel_in: endpoint {
                    remote-endpoint = <&mdss_dsi0_out>;
                };
            };
        };
    };

...
```

## Documentation/devicetree/bindings/display/panel/visionox,vtdr6130.yaml
```yaml
# SPDX-License-Identifier: GPL-2.0-only or BSD-2-Clause
%YAML 1.2
---
$id: http://devicetree.org/schemas/display/panel/visionox,vtdr6130.yaml#
$schema: http://devicetree.org/meta-schemas/core.yaml#

title: Visionox VTDR6130 AMOLED DSI Panel

maintainers:
  - Neil Armstrong <neil.armstrong@linaro.org>

allOf:
  - $ref: panel-common.yaml#

properties:
  compatible:
    const: visionox,vtdr6130

  reg:
    maxItems: 1
    description: DSI virtual channel

  vddio-supply: true
  vci-supply: true
  vdd-supply: true
  port: true
  reset-gpios: true

additionalProperties: false

required:
  - compatible
  - reg
  - vddio-supply
  - vci-supply
  - vdd-supply
  - reset-gpios
  - port

examples:
  - |
    #include <dt-bindings/gpio/gpio.h>
    dsi {
        #address-cells = <1>;
        #size-cells = <0>;
        panel@0 {
            compatible = "visionox,vtdr6130";
            reg = <0>;

            vddio-supply = <&vreg_l12b_1p8>;
            vci-supply = <&vreg_l13b_3p0>;
            vdd-supply = <&vreg_l11b_1p2>;

            reset-gpios = <&tlmm 133 GPIO_ACTIVE_LOW>;

            port {
                panel0_in: endpoint {
                    remote-endpoint = <&dsi0_out>;
                };
            };
        };
    };
...
```

## Documentation/devicetree/bindings/display/panel/winstar,wf35ltiacd.txt
```
Winstar Display Corporation 3.5" QVGA (320x240) TFT LCD panel

Required properties:
- compatible: should be "winstar,wf35ltiacd"
- power-supply: regulator to provide the VCC supply voltage (3.3 volts)

This binding is compatible with the simple-panel binding, which is specified
in simple-panel.txt in this directory.

Example:
	backlight: backlight {
		compatible = "pwm-backlight";
		pwms = <&hlcdc_pwm 0 50000 PWM_POLARITY_INVERTED>;
		brightness-levels = <0 31 63 95 127 159 191 223 255>;
		default-brightness-level = <191>;
		power-supply = <&bl_reg>;
	};

	bl_reg: backlight_regulator {
		compatible = "regulator-fixed";
		regulator-name = "backlight-power-supply";
		regulator-min-microvolt = <5000000>;
		regulator-max-microvolt = <5000000>;
	};

	panel: panel {
		compatible = "winstar,wf35ltiacd", "simple-panel";
		backlight = <&backlight>;
		power-supply = <&panel_reg>;
		#address-cells = <1>;
		#size-cells = <0>;

		port {
			#address-cells = <1>;
			#size-cells = <0>;

			panel_input: endpoint {
				remote-endpoint = <&hlcdc_panel_output>;
			};
		};
	};

	panel_reg: panel_regulator {
		compatible = "regulator-fixed";
		regulator-name = "panel-power-supply";
		regulator-min-microvolt = <3300000>;
		regulator-max-microvolt = <3300000>;
	};
```

## Documentation/devicetree/bindings/display/panel/wl-355608-a8.yaml
```yaml
# SPDX-License-Identifier: (GPL-2.0-only OR BSD-2-Clause)
%YAML 1.2
---
$id: http://devicetree.org/schemas/display/panel/wl-355608-a8.yaml#
$schema: http://devicetree.org/meta-schemas/core.yaml#

title: WL-355608-A8 3.5" (640x480 pixels) 24-bit IPS LCD panel

maintainers:
  - Ryan Walklin <ryan@testtoast.com>

allOf:
  - $ref: panel-common.yaml#
  - $ref: /schemas/spi/spi-peripheral-props.yaml#

properties:
  compatible:
    const: wl-355608-a8

  reg:
    maxItems: 1

  spi-3wire: true

required:
  - compatible
  - reg
  - port
  - power-supply
  - reset-gpios

unevaluatedProperties: false

examples:
  - |
    #include <dt-bindings/gpio/gpio.h>

    spi {
        #address-cells = <1>;
        #size-cells = <0>;

        panel@0 {
            compatible = "wl-355608-a8";
            reg = <0>;

            spi-3wire;
            spi-max-frequency = <3125000>;

            reset-gpios = <&pio 8 14 GPIO_ACTIVE_LOW>; // PI14

            backlight = <&backlight>;
            power-supply = <&reg_lcd>;

            port {
                endpoint {
                    remote-endpoint = <&tcon_lcd0_out_lcd>;
                };
            };
        };
    };
```

## Documentation/devicetree/bindings/display/panel/xinpeng,xpp055c272.yaml
```yaml
# SPDX-License-Identifier: (GPL-2.0-only OR BSD-2-Clause)
%YAML 1.2
---
$id: http://devicetree.org/schemas/display/panel/xinpeng,xpp055c272.yaml#
$schema: http://devicetree.org/meta-schemas/core.yaml#

title: Xinpeng XPP055C272 5.5in 720x1280 DSI panel

maintainers:
  - Heiko Stuebner <heiko.stuebner@theobroma-systems.com>

allOf:
  - $ref: panel-common.yaml#

properties:
  compatible:
    const: xinpeng,xpp055c272
  reg: true
  backlight: true
  reset-gpios: true
  iovcc-supply:
     description: regulator that supplies the iovcc voltage
  vci-supply:
     description: regulator that supplies the vci voltage

required:
  - compatible
  - reg
  - backlight
  - iovcc-supply
  - vci-supply

additionalProperties: false

examples:
  - |
    dsi {
        #address-cells = <1>;
        #size-cells = <0>;

        panel@0 {
            compatible = "xinpeng,xpp055c272";
            reg = <0>;
            backlight = <&backlight>;
            iovcc-supply = <&vcc_1v8>;
            vci-supply = <&vcc3v3_lcd>;
        };
    };

...
```

## Documentation/devicetree/bindings/display/renesas,cmm.yaml
```yaml
# SPDX-License-Identifier: GPL-2.0-only
%YAML 1.2
---
$id: http://devicetree.org/schemas/display/renesas,cmm.yaml#
$schema: http://devicetree.org/meta-schemas/core.yaml#

title: Renesas R-Car Color Management Module (CMM)

maintainers:
  - Laurent Pinchart <laurent.pinchart@ideasonboard.com>
  - Kieran Bingham <kieran.bingham+renesas@ideasonboard.com>
  - Jacopo Mondi <jacopo+renesas@jmondi.org>

description: |+
  Renesas R-Car color management module connected to R-Car DU video channels.
  It provides image enhancement functions such as 1-D look-up tables (LUT),
  3-D look-up tables (CLU), 1D-histogram generation (HGO), and color
  space conversion (CSC).

properties:
  compatible:
    oneOf:
      - items:
          - enum:
              - renesas,r8a7795-cmm
              - renesas,r8a7796-cmm
              - renesas,r8a77965-cmm
              - renesas,r8a77990-cmm
              - renesas,r8a77995-cmm
          - const: renesas,rcar-gen3-cmm
      - items:
          - const: renesas,rcar-gen2-cmm

  reg:
    maxItems: 1

  clocks:
    maxItems: 1

  resets:
    maxItems: 1

  power-domains:
    maxItems: 1

required:
  - compatible
  - reg
  - clocks
  - resets
  - power-domains

additionalProperties: false

examples:
  - |
    #include <dt-bindings/clock/r8a7796-cpg-mssr.h>
    #include <dt-bindings/power/r8a7796-sysc.h>

    cmm0: cmm@fea40000 {
         compatible = "renesas,r8a7796-cmm",
                      "renesas,rcar-gen3-cmm";
         reg = <0xfea40000 0x1000>;
         power-domains = <&sysc R8A7796_PD_ALWAYS_ON>;
         clocks = <&cpg CPG_MOD 711>;
         resets = <&cpg 711>;
    };
```

## Documentation/devicetree/bindings/display/renesas,du.txt
```
* Renesas R-Car Display Unit (DU)

Required Properties:

  - compatible: must be one of the following.
    - "renesas,du-r8a7743" for R8A7743 (RZ/G1M) compatible DU
    - "renesas,du-r8a7744" for R8A7744 (RZ/G1N) compatible DU
    - "renesas,du-r8a7745" for R8A7745 (RZ/G1E) compatible DU
    - "renesas,du-r8a77470" for R8A77470 (RZ/G1C) compatible DU
    - "renesas,du-r8a774a1" for R8A774A1 (RZ/G2M) compatible DU
    - "renesas,du-r8a774c0" for R8A774C0 (RZ/G2E) compatible DU
    - "renesas,du-r8a7779" for R8A7779 (R-Car H1) compatible DU
    - "renesas,du-r8a7790" for R8A7790 (R-Car H2) compatible DU
    - "renesas,du-r8a7791" for R8A7791 (R-Car M2-W) compatible DU
    - "renesas,du-r8a7792" for R8A7792 (R-Car V2H) compatible DU
    - "renesas,du-r8a7793" for R8A7793 (R-Car M2-N) compatible DU
    - "renesas,du-r8a7794" for R8A7794 (R-Car E2) compatible DU
    - "renesas,du-r8a7795" for R8A7795 (R-Car H3) compatible DU
    - "renesas,du-r8a7796" for R8A7796 (R-Car M3-W) compatible DU
    - "renesas,du-r8a77965" for R8A77965 (R-Car M3-N) compatible DU
    - "renesas,du-r8a77970" for R8A77970 (R-Car V3M) compatible DU
    - "renesas,du-r8a77980" for R8A77980 (R-Car V3H) compatible DU
    - "renesas,du-r8a77990" for R8A77990 (R-Car E3) compatible DU
    - "renesas,du-r8a77995" for R8A77995 (R-Car D3) compatible DU

  - reg: the memory-mapped I/O registers base address and length

  - interrupts: Interrupt specifiers for the DU interrupts.

  - clocks: A list of phandles + clock-specifier pairs, one for each entry in
    the clock-names property.
  - clock-names: Name of the clocks. This property is model-dependent.
    - R8A7779 uses a single functional clock. The clock doesn't need to be
      named.
    - All other DU instances use one functional clock per channel The
      functional clocks must be named "du.x" with "x" being the channel
      numerical index.
    - In addition to the functional clocks, all DU versions also support
      externally supplied pixel clocks. Those clocks are optional. When
      supplied they must be named "dclkin.x" with "x" being the input clock
      numerical index.

  - vsps: A list of phandle and channel index tuples to the VSPs that handle
    the memory interfaces for the DU channels. The phandle identifies the VSP
    instance that serves the DU channel, and the channel index identifies the
    LIF instance in that VSP.

Required nodes:

The connections to the DU output video ports are modeled using the OF graph
bindings specified in Documentation/devicetree/bindings/graph.txt.

The following table lists for each supported model the port number
corresponding to each DU output.

                        Port0          Port1          Port2          Port3
-----------------------------------------------------------------------------
 R8A7743 (RZ/G1M)       DPAD 0         LVDS 0         -              -
 R8A7744 (RZ/G1N)       DPAD 0         LVDS 0         -              -
 R8A7745 (RZ/G1E)       DPAD 0         DPAD 1         -              -
 R8A77470 (RZ/G1C)      DPAD 0         DPAD 1         LVDS 0         -
 R8A774A1 (RZ/G2M)      DPAD 0         HDMI 0         LVDS 0         -
 R8A774C0 (RZ/G2E)      DPAD 0         LVDS 0         LVDS 1         -
 R8A7779 (R-Car H1)     DPAD 0         DPAD 1         -              -
 R8A7790 (R-Car H2)     DPAD 0         LVDS 0         LVDS 1         -
 R8A7791 (R-Car M2-W)   DPAD 0         LVDS 0         -              -
 R8A7792 (R-Car V2H)    DPAD 0         DPAD 1         -              -
 R8A7793 (R-Car M2-N)   DPAD 0         LVDS 0         -              -
 R8A7794 (R-Car E2)     DPAD 0         DPAD 1         -              -
 R8A7795 (R-Car H3)     DPAD 0         HDMI 0         HDMI 1         LVDS 0
 R8A7796 (R-Car M3-W)   DPAD 0         HDMI 0         LVDS 0         -
 R8A77965 (R-Car M3-N)  DPAD 0         HDMI 0         LVDS 0         -
 R8A77970 (R-Car V3M)   DPAD 0         LVDS 0         -              -
 R8A77980 (R-Car V3H)   DPAD 0         LVDS 0         -              -
 R8A77990 (R-Car E3)    DPAD 0         LVDS 0         LVDS 1         -
 R8A77995 (R-Car D3)    DPAD 0         LVDS 0         LVDS 1         -


Example: R8A7795 (R-Car H3) ES2.0 DU

	du: display@feb00000 {
		compatible = "renesas,du-r8a7795";
		reg = <0 0xfeb00000 0 0x80000>;
		interrupts = <GIC_SPI 256 IRQ_TYPE_LEVEL_HIGH>,
			     <GIC_SPI 268 IRQ_TYPE_LEVEL_HIGH>,
			     <GIC_SPI 269 IRQ_TYPE_LEVEL_HIGH>,
			     <GIC_SPI 270 IRQ_TYPE_LEVEL_HIGH>;
		clocks = <&cpg CPG_MOD 724>,
			 <&cpg CPG_MOD 723>,
			 <&cpg CPG_MOD 722>,
			 <&cpg CPG_MOD 721>;
		clock-names = "du.0", "du.1", "du.2", "du.3";
		vsps = <&vspd0 0>, <&vspd1 0>, <&vspd2 0>, <&vspd0 1>;

		ports {
			#address-cells = <1>;
			#size-cells = <0>;

			port@0 {
				reg = <0>;
				du_out_rgb: endpoint {
				};
			};
			port@1 {
				reg = <1>;
				du_out_hdmi0: endpoint {
					remote-endpoint = <&dw_hdmi0_in>;
				};
			};
			port@2 {
				reg = <2>;
				du_out_hdmi1: endpoint {
					remote-endpoint = <&dw_hdmi1_in>;
				};
			};
			port@3 {
				reg = <3>;
				du_out_lvds0: endpoint {
				};
			};
		};
	};
```
