## Documentation/devicetree/bindings/display/renesas,rzg2l-du.yaml
```yaml
# SPDX-License-Identifier: (GPL-2.0-only OR BSD-2-Clause)
%YAML 1.2
---
$id: http://devicetree.org/schemas/display/renesas,rzg2l-du.yaml#
$schema: http://devicetree.org/meta-schemas/core.yaml#

title: Renesas RZ/G2L Display Unit (DU)

maintainers:
  - Biju Das <biju.das.jz@bp.renesas.com>
  - Laurent Pinchart <laurent.pinchart+renesas@ideasonboard.com>

description: |
  These DT bindings describe the Display Unit embedded in the Renesas RZ/G2L
  and RZ/V2L SoCs.

properties:
  compatible:
    oneOf:
      - enum:
          - renesas,r9a07g044-du # RZ/G2{L,LC}
      - items:
          - enum:
              - renesas,r9a07g054-du    # RZ/V2L
          - const: renesas,r9a07g044-du # RZ/G2L fallback

  reg:
    maxItems: 1

  interrupts:
    maxItems: 1

  clocks:
    items:
      - description: Main clock
      - description: Register access clock
      - description: Video clock

  clock-names:
    items:
      - const: aclk
      - const: pclk
      - const: vclk

  resets:
    maxItems: 1

  power-domains:
    maxItems: 1

  ports:
    $ref: /schemas/graph.yaml#/properties/ports
    description: |
      The connections to the DU output video ports are modeled using the OF
      graph bindings. The number of ports and their assignment are
      model-dependent. Each port shall have a single endpoint.

    patternProperties:
      "^port@[0-1]$":
        $ref: /schemas/graph.yaml#/properties/port
        unevaluatedProperties: false

    required:
      - port@0

    unevaluatedProperties: false

  renesas,vsps:
    $ref: /schemas/types.yaml#/definitions/phandle-array
    items:
      items:
        - description: phandle to VSP instance that serves the DU channel
        - description: Channel index identifying the LIF instance in that VSP
    description:
      A list of phandle and channel index tuples to the VSPs that handle the
      memory interfaces for the DU channels.

required:
  - compatible
  - reg
  - interrupts
  - clocks
  - clock-names
  - resets
  - power-domains
  - ports
  - renesas,vsps

additionalProperties: false

examples:
  # RZ/G2L DU
  - |
    #include <dt-bindings/clock/r9a07g044-cpg.h>
    #include <dt-bindings/interrupt-controller/arm-gic.h>

    display@10890000 {
        compatible = "renesas,r9a07g044-du";
        reg = <0x10890000 0x10000>;
        interrupts = <GIC_SPI 152 IRQ_TYPE_LEVEL_HIGH>;
        clocks = <&cpg CPG_MOD R9A07G044_LCDC_CLK_A>,
                 <&cpg CPG_MOD R9A07G044_LCDC_CLK_P>,
                 <&cpg CPG_MOD R9A07G044_LCDC_CLK_D>;
        clock-names = "aclk", "pclk", "vclk";
        resets = <&cpg R9A07G044_LCDC_RESET_N>;
        power-domains = <&cpg>;

        renesas,vsps = <&vspd0 0>;

        ports {
            #address-cells = <1>;
            #size-cells = <0>;

            port@0 {
                reg = <0>;
                endpoint {
                    remote-endpoint = <&dsi0_in>;
                };
            };
            port@1 {
                reg = <1>;
            };
        };
    };

...
```

## Documentation/devicetree/bindings/display/renesas,shmobile-lcdc.yaml
```yaml
# SPDX-License-Identifier: (GPL-2.0-only OR BSD-2-Clause)
%YAML 1.2
---
$id: http://devicetree.org/schemas/display/renesas,shmobile-lcdc.yaml#
$schema: http://devicetree.org/meta-schemas/core.yaml#

title: Renesas SH-Mobile LCD Controller (LCDC)

maintainers:
  - Laurent Pinchart <laurent.pinchart+renesas@ideasonboard.com>
  - Geert Uytterhoeven <geert+renesas@glider.be>

properties:
  compatible:
    enum:
      - renesas,r8a7740-lcdc # R-Mobile A1
      - renesas,sh73a0-lcdc  # SH-Mobile AG5

  reg:
    maxItems: 1

  interrupts:
    maxItems: 1

  clocks:
    minItems: 1
    maxItems: 5
    description:
      Only the functional clock is mandatory.
      Some of the optional clocks are model-dependent (e.g. "video" (a.k.a.
      "vou" or "dv_clk") is available on R-Mobile A1 only).

  clock-names:
    minItems: 1
    items:
      - const: fck
      - enum: [ media, lclk, hdmi, video ]
      - enum: [ media, lclk, hdmi, video ]
      - enum: [ media, lclk, hdmi, video ]
      - enum: [ media, lclk, hdmi, video ]

  power-domains:
    maxItems: 1

  ports:
    $ref: /schemas/graph.yaml#/properties/ports

    properties:
      port@0:
        $ref: /schemas/graph.yaml#/properties/port
        description: LCD port (R-Mobile A1 and SH-Mobile AG5)
        unevaluatedProperties: false

      port@1:
        $ref: /schemas/graph.yaml#/properties/port
        description: HDMI port (R-Mobile A1 LCDC1 and SH-Mobile AG5)
        unevaluatedProperties: false

      port@2:
        $ref: /schemas/graph.yaml#/properties/port
        description: MIPI-DSI port (SH-Mobile AG5)
        unevaluatedProperties: false

    required:
      - port@0

    unevaluatedProperties: false

required:
  - compatible
  - reg
  - interrupts
  - clocks
  - clock-names
  - power-domains
  - ports

additionalProperties: false

allOf:
  - if:
      properties:
        compatible:
          contains:
            const: renesas,r8a7740-lcdc
    then:
      properties:
        ports:
          properties:
            port@2: false

  - if:
      properties:
        compatible:
          contains:
            const: renesas,sh73a0-lcdc
    then:
      properties:
        ports:
          required:
            - port@1
            - port@2

examples:
  - |
    #include <dt-bindings/clock/r8a7740-clock.h>
    #include <dt-bindings/interrupt-controller/arm-gic.h>

    lcd-controller@fe940000 {
        compatible = "renesas,r8a7740-lcdc";
        reg = <0xfe940000 0x4000>;
        interrupts = <GIC_SPI 177 IRQ_TYPE_LEVEL_HIGH>;
        clocks = <&mstp1_clks R8A7740_CLK_LCDC0>,
                 <&cpg_clocks R8A7740_CLK_M3>, <&lcdlclk0_clk>,
                 <&vou_clk>;
        clock-names = "fck", "media", "lclk", "video";
        power-domains = <&pd_a4lc>;

        ports {
            #address-cells = <1>;
            #size-cells = <0>;

            port@0 {
                reg = <0>;

                lcdc0_rgb: endpoint {
                };
            };
        };
    };
```

## Documentation/devicetree/bindings/display/repaper.txt
```
Pervasive Displays RePaper branded e-ink displays

Required properties:
- compatible:		"pervasive,e1144cs021" for 1.44" display
			"pervasive,e1190cs021" for 1.9" display
			"pervasive,e2200cs021" for 2.0" display
			"pervasive,e2271cs021" for 2.7" display

- panel-on-gpios:	Timing controller power control
- discharge-gpios:	Discharge control
- reset-gpios:		RESET pin
- busy-gpios:		BUSY pin

Required property for e2271cs021:
- border-gpios:		Border control

The node for this driver must be a child node of a SPI controller, hence
all mandatory properties described in ../spi/spi-bus.txt must be specified.

Optional property:
- pervasive,thermal-zone:	name of thermometer's thermal zone

Example:

	display_temp: lm75@48 {
		compatible = "lm75b";
		reg = <0x48>;
		#thermal-sensor-cells = <0>;
	};

	thermal-zones {
		display {
			polling-delay-passive = <0>;
			polling-delay = <0>;
			thermal-sensors = <&display_temp>;
		};
	};

	papirus27@0{
		compatible = "pervasive,e2271cs021";
		reg = <0>;

		spi-max-frequency = <8000000>;

		panel-on-gpios = <&gpio 23 0>;
		border-gpios = <&gpio 14 0>;
		discharge-gpios = <&gpio 15 0>;
		reset-gpios = <&gpio 24 0>;
		busy-gpios = <&gpio 25 0>;

		pervasive,thermal-zone = "display";
	};
```

## Documentation/devicetree/bindings/display/rockchip/analogix_dp-rockchip.txt
```
Rockchip RK3288 specific extensions to the Analogix Display Port
================================

Required properties:
- compatible: "rockchip,rk3288-dp",
	      "rockchip,rk3399-edp";

- reg: physical base address of the controller and length

- clocks: from common clock binding: handle to dp clock.
	  of memory mapped region.

- clock-names: from common clock binding:
	       Required elements: "dp" "pclk"

- resets: Must contain an entry for each entry in reset-names.
	  See ../reset/reset.txt for details.

- pinctrl-names: Names corresponding to the chip hotplug pinctrl states.
- pinctrl-0: pin-control mode. should be <&edp_hpd>

- reset-names: Must include the name "dp"

- rockchip,grf: this soc should set GRF regs, so need get grf here.

- ports: there are 2 port nodes with endpoint definitions as defined in
  Documentation/devicetree/bindings/media/video-interfaces.txt.
    Port 0: contained 2 endpoints, connecting to the output of vop.
    Port 1: contained 1 endpoint, connecting to the input of panel.

Optional property for different chips:
- clocks: from common clock binding: handle to grf_vio clock.

- clock-names: from common clock binding:
	       Required elements: "grf"

For the below properties, please refer to Analogix DP binding document:
 * Documentation/devicetree/bindings/display/bridge/analogix_dp.txt
- phys (required)
- phy-names (required)
- hpd-gpios (optional)
- force-hpd (optional)
-------------------------------------------------------------------------------

Example:
	dp-controller: dp@ff970000 {
		compatible = "rockchip,rk3288-dp";
		reg = <0xff970000 0x4000>;
		interrupts = <GIC_SPI 98 IRQ_TYPE_LEVEL_HIGH>;
		clocks = <&cru SCLK_EDP>, <&cru PCLK_EDP_CTRL>;
		clock-names = "dp", "pclk";
		phys = <&dp_phy>;
		phy-names = "dp";

		rockchip,grf = <&grf>;
		resets = <&cru 111>;
		reset-names = "dp";

		pinctrl-names = "default";
		pinctrl-0 = <&edp_hpd>;

		status = "disabled";

		ports {
			#address-cells = <1>;
			#size-cells = <0>;
			edp_in: port@0 {
				reg = <0>;
				#address-cells = <1>;
				#size-cells = <0>;
				edp_in_vopb: endpoint@0 {
					reg = <0>;
					remote-endpoint = <&vopb_out_edp>;
				};
				edp_in_vopl: endpoint@1 {
					reg = <1>;
					remote-endpoint = <&vopl_out_edp>;
				};
			};

			edp_out: port@1 {
				reg = <1>;
				#address-cells = <1>;
				#size-cells = <0>;
				edp_out_panel: endpoint {
					reg = <0>;
					remote-endpoint = <&panel_in_edp>
				};
			};
		};
	};

	pinctrl {
		edp {
			edp_hpd: edp-hpd {
				rockchip,pins = <7 11 RK_FUNC_2 &pcfg_pull_none>;
			};
		};
	};
```
