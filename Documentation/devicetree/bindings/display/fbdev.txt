## Documentation/devicetree/bindings/display/ht16k33.txt
```
Holtek ht16k33 RAM mapping 16*8 LED controller driver with keyscan
-------------------------------------------------------------------------------

Required properties:
- compatible:		"holtek,ht16k33"
- reg:			I2C slave address of the chip.
- interrupts:		Interrupt specification for the key pressed interrupt.
- refresh-rate-hz:	Display update interval in HZ.
- debounce-delay-ms:	Debouncing interval time in milliseconds.
- linux,keymap: 	The keymap for keys as described in the binding
			document (devicetree/bindings/input/matrix-keymap.txt).

Optional properties:
- linux,no-autorepeat:	Disable keyrepeat.
- default-brightness-level: Initial brightness level [0-15] (default: 15).

Example:

&i2c1 {
	ht16k33: ht16k33@70 {
		compatible = "holtek,ht16k33";
		reg = <0x70>;
		refresh-rate-hz = <20>;
		debounce-delay-ms = <50>;
		interrupt-parent = <&gpio4>;
		interrupts = <5 (IRQ_TYPE_LEVEL_HIGH | IRQ_TYPE_EDGE_RISING)>;
		linux,keymap = <
			MATRIX_KEY(2, 0, KEY_F6)
			MATRIX_KEY(3, 0, KEY_F8)
			MATRIX_KEY(4, 0, KEY_F10)
			MATRIX_KEY(5, 0, KEY_F4)
			MATRIX_KEY(6, 0, KEY_F2)
			MATRIX_KEY(2, 1, KEY_F5)
			MATRIX_KEY(3, 1, KEY_F7)
			MATRIX_KEY(4, 1, KEY_F9)
			MATRIX_KEY(5, 1, KEY_F3)
			MATRIX_KEY(6, 1, KEY_F1)
		>;
	};
};
```

## Documentation/devicetree/bindings/display/ilitek,ili9225.txt
```
Ilitek ILI9225 display panels

This binding is for display panels using an Ilitek ILI9225 controller in SPI
mode.

Required properties:
- compatible:	"ilitek,ili9225-2.2in-176x220"
- rs-gpios:	Register select signal
- reset-gpios:	Reset pin

The node for this driver must be a child node of a SPI controller, hence
all mandatory properties described in ../spi/spi-bus.txt must be specified.

Optional properties:
- rotation:	panel rotation in degrees counter clockwise (0,90,180,270)

Example:
	display@0{
		compatible = "ilitek,ili9225-2.2in-176x220";
		reg = <0>;
		spi-max-frequency = <12000000>;
		rs-gpios = <&gpio0 9 GPIO_ACTIVE_HIGH>;
		reset-gpios = <&gpio0 8 GPIO_ACTIVE_HIGH>;
		rotation = <270>;
	};
```

## Documentation/devicetree/bindings/display/ilitek,ili9341.txt
```
Ilitek ILI9341 display panels

This binding is for display panels using an Ilitek ILI9341 controller in SPI
mode.

Required properties:
- compatible:	"adafruit,yx240qv29", "ilitek,ili9341"
- dc-gpios:	D/C pin
- reset-gpios:	Reset pin

The node for this driver must be a child node of a SPI controller, hence
all mandatory properties described in ../spi/spi-bus.txt must be specified.

Optional properties:
- rotation:	panel rotation in degrees counter clockwise (0,90,180,270)
- backlight:	phandle of the backlight device attached to the panel

Example:
	display@0{
		compatible = "adafruit,yx240qv29", "ilitek,ili9341";
		reg = <0>;
		spi-max-frequency = <32000000>;
		dc-gpios = <&gpio0 9 GPIO_ACTIVE_HIGH>;
		reset-gpios = <&gpio0 8 GPIO_ACTIVE_HIGH>;
		rotation = <270>;
		backlight = <&backlight>;
	};
```

## Documentation/devicetree/bindings/display/ilitek,ili9486.yaml
```yaml
# SPDX-License-Identifier: GPL-2.0-only
%YAML 1.2
---
$id: http://devicetree.org/schemas/display/ilitek,ili9486.yaml#
$schema: http://devicetree.org/meta-schemas/core.yaml#

title: Ilitek ILI9486 display panels

maintainers:
  - Kamlesh Gurudasani <kamlesh.gurudasani@gmail.com>

description:
  This binding is for display panels using an Ilitek ILI9486 controller in SPI
  mode.

allOf:
  - $ref: panel/panel-common.yaml#

properties:
  compatible:
    items:
      - enum:
          # Waveshare 3.5" 320x480 Color TFT LCD
          - waveshare,rpi-lcd-35
          # Ozzmaker 3.5" 320x480 Color TFT LCD
          - ozzmaker,piscreen
      - const: ilitek,ili9486

  spi-max-frequency:
    maximum: 32000000

  dc-gpios:
    maxItems: 1
    description: Display data/command selection (D/CX)

  backlight: true
  reg: true
  reset-gpios: true
  rotation: true

required:
  - compatible
  - reg
  - dc-gpios
  - reset-gpios

additionalProperties: false

examples:
  - |
    #include <dt-bindings/gpio/gpio.h>

    backlight: backlight {
            compatible = "gpio-backlight";
            gpios = <&gpio 22 GPIO_ACTIVE_HIGH>;
    };
    spi {
            #address-cells = <1>;
            #size-cells = <0>;


            display@0{
                    compatible = "waveshare,rpi-lcd-35", "ilitek,ili9486";
                    reg = <0>;
                    spi-max-frequency = <32000000>;
                    dc-gpios = <&gpio0 24 GPIO_ACTIVE_HIGH>;
                    reset-gpios = <&gpio0 25 GPIO_ACTIVE_HIGH>;
                    rotation = <180>;
                    backlight = <&backlight>;
            };
    };

...
```

## Documentation/devicetree/bindings/display/imx/fsl,imx-display-subsystem.yaml
```yaml
# SPDX-License-Identifier: (GPL-2.0-only OR BSD-2-Clause)
%YAML 1.2
---
$id: http://devicetree.org/schemas/display/imx/fsl,imx-display-subsystem.yaml#
$schema: http://devicetree.org/meta-schemas/core.yaml#

title: Freescale i.MX DRM master device

maintainers:
  - Frank Li <Frank.Li@nxp.com>

description:
  The freescale i.MX DRM master device is a virtual device needed to list all
  IPU or other display interface nodes that comprise the graphics subsystem.

properties:
  compatible:
    const: fsl,imx-display-subsystem

  ports:
    $ref: /schemas/types.yaml#/definitions/phandle-array
    description:
      Should contain a list of phandles pointing to camera
      sensor interface ports of IPU devices.

required:
  - compatible

additionalProperties: false

examples:
  - |
    display-subsystem {
        compatible = "fsl,imx-display-subsystem";
        ports = <&ipu_di0>;
    };
```

## Documentation/devicetree/bindings/display/imx/fsl,imx-fb.txt
```
Freescale imx21 Framebuffer

This framebuffer driver supports devices imx1, imx21, imx25, and imx27.

Required properties:
- compatible : "fsl,<chip>-fb", chip should be imx1 or imx21
- reg : Should contain 1 register ranges(address and length)
- interrupts : One interrupt of the fb dev

Required nodes:
- display: Phandle to a display node as described in
	Documentation/devicetree/bindings/display/panel/display-timing.txt
	Additional, the display node has to define properties:
	- bits-per-pixel: Bits per pixel
	- fsl,pcr: LCDC PCR value
	A display node may optionally define
	- fsl,aus-mode: boolean to enable AUS mode (only for imx21)

Optional properties:
- lcd-supply: Regulator for LCD supply voltage.
- fsl,dmacr: DMA Control Register value. This is optional. By default, the
	register is not modified as recommended by the datasheet.
- fsl,lpccr: Contrast Control Register value. This property provides the
	default value for the contrast control register.
	If that property is omitted, the register is zeroed.
- fsl,lscr1: LCDC Sharp Configuration Register value.

Example:

	imxfb: fb@10021000 {
		compatible = "fsl,imx21-fb";
		interrupts = <61>;
		reg = <0x10021000 0x1000>;
		display = <&display0>;
	};

	...

	display0: display0 {
		model = "Primeview-PD050VL1";
		native-mode = <&timing_disp0>;
		bits-per-pixel = <16>;
		fsl,pcr = <0xf0c88080>;	/* non-standard but required */
		display-timings {
			timing_disp0: 640x480 {
				hactive = <640>;
				vactive = <480>;
				hback-porch = <112>;
				hfront-porch = <36>;
				hsync-len = <32>;
				vback-porch = <33>;
				vfront-porch = <33>;
				vsync-len = <2>;
				clock-frequency = <25000000>;
			};
		};
	};
```

## Documentation/devicetree/bindings/display/imx/fsl,imx-lcdc.yaml
```yaml
# SPDX-License-Identifier: (GPL-2.0-only OR BSD-2-Clause)
%YAML 1.2
---
$id: http://devicetree.org/schemas/display/imx/fsl,imx-lcdc.yaml#
$schema: http://devicetree.org/meta-schemas/core.yaml#

title: Freescale i.MX LCD Controller, found on i.MX1, i.MX21, i.MX25 and i.MX27

maintainers:
  - Sascha Hauer <s.hauer@pengutronix.de>
  - Pengutronix Kernel Team <kernel@pengutronix.de>

properties:
  compatible:
    oneOf:
      - enum:
          - fsl,imx1-fb
          - fsl,imx21-fb
      - items:
          - enum:
              - fsl,imx25-fb
              - fsl,imx27-fb
          - const: fsl,imx21-fb
      - items:
          - const: fsl,imx25-lcdc
          - const: fsl,imx21-lcdc

  clocks:
    maxItems: 3

  clock-names:
    items:
      - const: ipg
      - const: ahb
      - const: per

  port:
    $ref: /schemas/graph.yaml#/properties/port

  display:
    $ref: /schemas/types.yaml#/definitions/phandle

  interrupts:
    maxItems: 1

  reg:
    maxItems: 1

  lcd-supply:
    description:
      Regulator for LCD supply voltage.

  fsl,dmacr:
    $ref: /schemas/types.yaml#/definitions/uint32
    description:
      Override value for DMA Control Register

  fsl,lpccr:
    $ref: /schemas/types.yaml#/definitions/uint32
    description:
      Contrast Control Register value.

  fsl,lscr1:
    $ref: /schemas/types.yaml#/definitions/uint32
    description:
      LCDC Sharp Configuration Register value.

allOf:
  - if:
      properties:
        compatible:
          contains:
            enum:
              - fsl,imx1-lcdc
              - fsl,imx21-lcdc
    then:
      properties:
        display: false
        fsl,dmacr: false
        fsl,lpccr: false
        fsl,lscr1: false

      required:
        - port

    else:
      properties:
        port: false

      required:
        - display

required:
  - compatible
  - clocks
  - clock-names
  - interrupts
  - reg

additionalProperties: false

examples:
  - |
    lcdc@53fbc000 {
        compatible = "fsl,imx25-lcdc", "fsl,imx21-lcdc";
        reg = <0x53fbc000 0x4000>;
        interrupts = <39>;
        clocks = <&clks 103>, <&clks 66>, <&clks 49>;
        clock-names = "ipg", "ahb", "per";

        port {
            parallel_out: endpoint {
              remote-endpoint = <&panel_in>;
            };
        };
    };
  - |
    imxfb: fb@10021000 {
        compatible = "fsl,imx21-fb";
        interrupts = <61>;
        reg = <0x10021000 0x1000>;
        display = <&display0>;
        clocks = <&clks 103>, <&clks 49>, <&clks 66>;
        clock-names = "ipg", "ahb", "per";
    };

    display0: display0 {
        model = "Primeview-PD050VL1";
        bits-per-pixel = <16>;
        fsl,pcr = <0xf0c88080>; /* non-standard but required */

        display-timings {
            native-mode = <&timing_disp0>;
            timing_disp0: timing0 {
                hactive = <640>;
                vactive = <480>;
                hback-porch = <112>;
                hfront-porch = <36>;
                hsync-len = <32>;
                vback-porch = <33>;
                vfront-porch = <33>;
                vsync-len = <2>;
                clock-frequency = <25000000>;
            };
        };
    };
```

## Documentation/devicetree/bindings/display/imx/fsl,imx-parallel-display.yaml
```yaml
# SPDX-License-Identifier: (GPL-2.0-only OR BSD-2-Clause)
%YAML 1.2
---
$id: http://devicetree.org/schemas/display/imx/fsl,imx-parallel-display.yaml#
$schema: http://devicetree.org/meta-schemas/core.yaml#

title: Parallel display support

maintainers:
  - Frank Li <Frank.Li@nxp.com>

properties:
  compatible:
    const: fsl,imx-parallel-display

  interface-pix-fmt:
    $ref: /schemas/types.yaml#/definitions/string
    enum:
      - rgb24
      - rgb565
      - bgr666
      - lvds666

  ddc:
    $ref: /schemas/types.yaml#/definitions/phandle
    description:
      phandle describing the i2c bus handling the display data channel

  '#address-cells':
    const: 1

  '#size-cells':
    const: 0

  port@0:
    $ref: /schemas/graph.yaml#/$defs/port-base
    unevaluatedProperties: false
    description: input port connected to the IPU display interface

  port@1:
    $ref: /schemas/graph.yaml#/$defs/port-base
    unevaluatedProperties: false
    description: output port connected to a panel

required:
  - compatible

additionalProperties: false

examples:
  - |
    display {
        compatible = "fsl,imx-parallel-display";
        #address-cells = <1>;
        #size-cells = <0>;
        interface-pix-fmt = "rgb24";

        port@0 {
            reg = <0>;

            endpoint {
                remote-endpoint = <&ipu_di0_disp0>;
            };
        };

        port@1 {
            reg = <1>;

            endpoint {
                remote-endpoint = <&panel_in>;
            };
        };
    };
```

## Documentation/devicetree/bindings/display/imx/fsl,imx53-tve.yaml
```yaml
# SPDX-License-Identifier: (GPL-2.0-only OR BSD-2-Clause)
%YAML 1.2
---
$id: http://devicetree.org/schemas/display/imx/fsl,imx53-tve.yaml#
$schema: http://devicetree.org/meta-schemas/core.yaml#

title: Freescale i.MX53 Television Encoder (TVE)

maintainers:
  - Frank Li <Frank.Li@nxp.com>

description:
  The Television Encoder (TVE) is a hardware block in the i.MX53 SoC that
  converts digital video data into analog TV signals (NTSC/PAL).

properties:
  compatible:
    const: fsl,imx53-tve

  reg:
    maxItems: 1

  interrupts:
    maxItems: 1

  clocks:
    items:
      - description: TVE gate clock
      - description: Display interface selector clock

  clock-names:
    items:
      - const: tve
      - const: di_sel

  ddc-i2c-bus:
    $ref: /schemas/types.yaml#/definitions/phandle
    description:
      Phandle to the I2C bus used for DDC (Display Data Channel) communication
      to read EDID information from the connected display.

  dac-supply:
    description:
      Regulator supply for the TVE DAC (Digital-to-Analog Converter).

  fsl,tve-mode:
    $ref: /schemas/types.yaml#/definitions/string
    description:
      TVE output mode selection.
    enum:
      - ntsc
      - pal
      - vga

  fsl,hsync-pin:
    $ref: /schemas/types.yaml#/definitions/uint32
    description:
      Pin number for horizontal sync signal in VGA mode.
    minimum: 0
    maximum: 8

  fsl,vsync-pin:
    $ref: /schemas/types.yaml#/definitions/uint32
    description:
      Pin number for vertical sync signal in VGA mode.
    minimum: 0
    maximum: 8

  port:
    $ref: /schemas/graph.yaml#/properties/port
    description:
      Port node with one endpoint connected to the IPU display interface.

required:
  - compatible
  - reg
  - interrupts
  - clocks
  - clock-names
  - fsl,tve-mode

additionalProperties: false

examples:
  - |
    #include <dt-bindings/clock/imx5-clock.h>
    #include <dt-bindings/interrupt-controller/irq.h>

    tve@63ff0000 {
        compatible = "fsl,imx53-tve";
        reg = <0x63ff0000 0x1000>;
        interrupts = <92>;
        clocks = <&clks IMX5_CLK_TVE_GATE>,
                 <&clks IMX5_CLK_IPU_DI1_SEL>;
        clock-names = "tve", "di_sel";
        fsl,tve-mode = "vga";

        port {
            endpoint {
                remote-endpoint = <&ipu_di1_tve>;
            };
        };
    };
```
