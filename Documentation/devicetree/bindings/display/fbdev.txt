## Documentation/devicetree/bindings/display/imx/fsl,imx6-hdmi.yaml
```yaml
# SPDX-License-Identifier: (GPL-2.0-only OR BSD-2-Clause)
%YAML 1.2
---
$id: http://devicetree.org/schemas/display/imx/fsl,imx6-hdmi.yaml#
$schema: http://devicetree.org/meta-schemas/core.yaml#

title: Freescale i.MX6 DWC HDMI TX Encoder

maintainers:
  - Philipp Zabel <p.zabel@pengutronix.de>

description: |
  The HDMI transmitter is a Synopsys DesignWare HDMI 1.4 TX controller IP
  with a companion PHY IP.

allOf:
  - $ref: ../bridge/synopsys,dw-hdmi.yaml#

properties:
  compatible:
    enum:
      - fsl,imx6dl-hdmi
      - fsl,imx6q-hdmi

  reg-io-width:
    const: 1

  clocks:
    maxItems: 2

  clock-names:
    maxItems: 2

  ddc-i2c-bus:
    $ref: /schemas/types.yaml#/definitions/phandle
    description:
      The HDMI DDC bus can be connected to either a system I2C master or the
      functionally-reduced I2C master contained in the DWC HDMI. When connected
      to a system I2C master this property contains a phandle to that I2C
      master controller.

  gpr:
    $ref: /schemas/types.yaml#/definitions/phandle
    description:
      phandle to the iomuxc-gpr region containing the HDMI multiplexer control
      register.

  ports:
    $ref: /schemas/graph.yaml#/properties/ports
    description: |
      This device has four video ports, corresponding to the four inputs of the
      HDMI multiplexer. Each port shall have a single endpoint.

    properties:
      port@0:
        $ref: /schemas/graph.yaml#/properties/port
        description: First input of the HDMI multiplexer

      port@1:
        $ref: /schemas/graph.yaml#/properties/port
        description: Second input of the HDMI multiplexer

      port@2:
        $ref: /schemas/graph.yaml#/properties/port
        description: Third input of the HDMI multiplexer

      port@3:
        $ref: /schemas/graph.yaml#/properties/port
        description: Fourth input of the HDMI multiplexer

    anyOf:
      - required:
          - port@0
      - required:
          - port@1
      - required:
          - port@2
      - required:
          - port@3

required:
  - compatible
  - reg
  - clocks
  - clock-names
  - gpr
  - interrupts
  - ports

unevaluatedProperties: false

examples:
  - |
    #include <dt-bindings/clock/imx6qdl-clock.h>

    hdmi: hdmi@120000 {
        reg = <0x00120000 0x9000>;
        interrupts = <0 115 0x04>;
        gpr = <&gpr>;
        clocks = <&clks IMX6QDL_CLK_HDMI_IAHB>,
                 <&clks IMX6QDL_CLK_HDMI_ISFR>;
        clock-names = "iahb", "isfr";

        ports {
            #address-cells = <1>;
            #size-cells = <0>;

            port@0 {
                reg = <0>;

                hdmi_mux_0: endpoint {
                    remote-endpoint = <&ipu1_di0_hdmi>;
                };
            };

            port@1 {
                reg = <1>;

                hdmi_mux_1: endpoint {
                    remote-endpoint = <&ipu1_di1_hdmi>;
                };
            };
        };
    };

...
```

## Documentation/devicetree/bindings/display/imx/fsl,imx6q-ipu.yaml
```yaml
# SPDX-License-Identifier: (GPL-2.0-only OR BSD-2-Clause)
%YAML 1.2
---
$id: http://devicetree.org/schemas/display/imx/fsl,imx6q-ipu.yaml#
$schema: http://devicetree.org/meta-schemas/core.yaml#

title: Freescale i.MX IPUv3

maintainers:
  - Frank Li <Frank.Li@nxp.com>

properties:
  compatible:
    oneOf:
      - enum:
          - fsl,imx51-ipu
          - fsl,imx53-ipu
          - fsl,imx6q-ipu
      - items:
          - const: fsl,imx6qp-ipu
          - const: fsl,imx6q-ipu

  reg:
    maxItems: 1

  interrupts:
    minItems: 1
    maxItems: 2

  clocks:
    maxItems: 3

  clock-names:
    items:
      - const: bus
      - const: di0
      - const: di1

  resets:
    maxItems: 1

  '#address-cells':
    const: 1

  '#size-cells':
    const: 0

  fsl,prg:
    $ref: /schemas/types.yaml#/definitions/phandle
    description: phandle to prg node associated with this IPU instance

  port@0:
    $ref: /schemas/graph.yaml#/$defs/port-base
    unevaluatedProperties: false
    description: CSI0

  port@1:
    $ref: /schemas/graph.yaml#/$defs/port-base
    unevaluatedProperties: false
    description: CSI1

  port@2:
    $ref: /schemas/graph.yaml#/$defs/port-base
    unevaluatedProperties: false
    description: DI0

  port@3:
    $ref: /schemas/graph.yaml#/$defs/port-base
    unevaluatedProperties: false
    description: DI1

required:
  - compatible
  - reg
  - interrupts
  - resets

additionalProperties: false

examples:
  - |
    display-controller@18000000 {
        compatible = "fsl,imx53-ipu";
        reg = <0x18000000 0x080000000>;
        #address-cells = <1>;
        #size-cells = <0>;
        interrupts = <11 10>;
        resets = <&src 2>;

        port@2 {
            reg = <2>;

            endpoint {
                remote-endpoint = <&display_in>;
            };
        };
    };
```

## Documentation/devicetree/bindings/display/imx/fsl,imx6q-ldb.yaml
```yaml
# SPDX-License-Identifier: (GPL-2.0-only OR BSD-2-Clause)
%YAML 1.2
---
$id: http://devicetree.org/schemas/display/imx/fsl,imx6q-ldb.yaml#
$schema: http://devicetree.org/meta-schemas/core.yaml#

title: Freescale LVDS Display Bridge (ldb)

description:
  The LVDS Display Bridge device tree node contains up to two lvds-channel
  nodes describing each of the two LVDS encoder channels of the bridge.

maintainers:
  - Frank Li <Frank.Li@nxp.com>

properties:
  compatible:
    oneOf:
      - enum:
          - fsl,imx53-ldb
      - items:
          - enum:
              - fsl,imx6q-ldb
          - const: fsl,imx53-ldb

  reg:
    maxItems: 1

  '#address-cells':
    const: 1

  '#size-cells':
    const: 0

  gpr:
    $ref: /schemas/types.yaml#/definitions/phandle
    description:
      The phandle points to the iomuxc-gpr region containing the LVDS
      control register.

  clocks:
    minItems: 6
    maxItems: 8

  clock-names:
    oneOf:
      - items:
          - const: di0_pll
          - const: di1_pll
          - const: di0_sel
          - const: di1_sel
          - const: di0
          - const: di1
      - items:
          - const: di0_pll
          - const: di1_pll
          - const: di0_sel
          - const: di1_sel
          - const: di2_sel
          - const: di3_sel
          - const: di0
          - const: di1

  fsl,dual-channel:
    $ref: /schemas/types.yaml#/definitions/flag
    description:
      if it exists, only LVDS channel 0 should
      be configured - one input will be distributed on both outputs in dual
      channel mode

patternProperties:
  '^lvds-channel@[0-1]$':
    type: object
    description:
      Each LVDS Channel has to contain either an of graph link to a panel device node
      or a display-timings node that describes the video timings for the connected
      LVDS display as well as the fsl,data-mapping and fsl,data-width properties.

    properties:
      reg:
        maxItems: 1

      '#address-cells':
        const: 1

      '#size-cells':
        const: 0

      display-timings:
        $ref: /schemas/display/panel/display-timings.yaml#

      fsl,data-mapping:
        enum:
          - spwg
          - jeida

      fsl,data-width:
        $ref: /schemas/types.yaml#/definitions/uint32
        description: should be <18> or <24>
        enum:
          - 18
          - 24

      fsl,panel:
        $ref: /schemas/types.yaml#/definitions/phandle
        description: phandle to lcd panel

    patternProperties:
      '^port@[0-4]$':
        $ref: /schemas/graph.yaml#/properties/port
        description:
          On i.MX5, the internal two-input-multiplexer is used. Due to hardware
          limitations, only one input port (port@[0,1]) can be used for each channel
          (lvds-channel@[0,1], respectively).
          On i.MX6, there should be four input ports (port@[0-3]) that correspond
          to the four LVDS multiplexer inputs.
          A single output port (port@2 on i.MX5, port@4 on i.MX6) must be connected
          to a panel input port. Optionally, the output port can be left out if
          display-timings are used instead.

    additionalProperties: false

required:
  - compatible
  - gpr
  - clocks
  - clock-names

additionalProperties: false

examples:
  - |
    #include <dt-bindings/clock/imx5-clock.h>

    ldb@53fa8008 {
        compatible = "fsl,imx53-ldb";
        reg = <0x53fa8008 0x4>;
        #address-cells = <1>;
        #size-cells = <0>;
        gpr = <&gpr>;
        clocks = <&clks IMX5_CLK_LDB_DI0_SEL>,
                 <&clks IMX5_CLK_LDB_DI1_SEL>,
                 <&clks IMX5_CLK_IPU_DI0_SEL>,
                 <&clks IMX5_CLK_IPU_DI1_SEL>,
                 <&clks IMX5_CLK_LDB_DI0_GATE>,
                 <&clks IMX5_CLK_LDB_DI1_GATE>;
        clock-names = "di0_pll", "di1_pll",
                      "di0_sel", "di1_sel",
                      "di0", "di1";

        /* Using an of-graph endpoint link to connect the panel */
        lvds-channel@0 {
                reg = <0>;
                #address-cells = <1>;
                #size-cells = <0>;

                port@0 {
                    reg = <0>;

                    endpoint {
                        remote-endpoint = <&ipu_di0_lvds0>;
                    };
                };

                port@2 {
                    reg = <2>;

                    endpoint {
                        remote-endpoint = <&panel_in>;
                    };
               };
        };

        /* Using display-timings and fsl,data-mapping/width instead */
        lvds-channel@1 {
                reg = <1>;
                #address-cells = <1>;
                #size-cells = <0>;
                fsl,data-mapping = "spwg";
                fsl,data-width = <24>;

                display-timings {/* ... */
                };

                port@1 {
                     reg = <1>;

                     endpoint {
                         remote-endpoint = <&ipu_di1_lvds1>;
                     };
                };
        };
    };
```

## Documentation/devicetree/bindings/display/imx/fsl,imx6qp-pre.yaml
```yaml
# SPDX-License-Identifier: (GPL-2.0-only OR BSD-2-Clause)
%YAML 1.2
---
$id: http://devicetree.org/schemas/display/imx/fsl,imx6qp-pre.yaml#
$schema: http://devicetree.org/meta-schemas/core.yaml#

title: Freescale i.MX PRE (Prefetch Resolve Engine)

maintainers:
  - Frank Li <Frank.Li@nxp.com>

properties:
  compatible:
    const: fsl,imx6qp-pre

  reg:
    maxItems: 1

  interrupts:
    maxItems: 1

  clocks:
    maxItems: 1

  clock-names:
    items:
      - const: axi
  fsl,iram:
    $ref: /schemas/types.yaml#/definitions/phandle
    description:
      phandle pointing to the mmio-sram device node, that should be
      used for the PRE SRAM double buffer.

required:
  - compatible
  - reg
  - interrupts
  - clocks
  - clock-names

additionalProperties: false

examples:
  - |
    #include <dt-bindings/clock/imx6qdl-clock.h>
    #include <dt-bindings/interrupt-controller/arm-gic.h>

    pre@21c8000 {
        compatible = "fsl,imx6qp-pre";
        reg = <0x021c8000 0x1000>;
        interrupts = <GIC_SPI 90 IRQ_TYPE_EDGE_RISING>;
        clocks = <&clks IMX6QDL_CLK_PRE0>;
        clock-names = "axi";
        fsl,iram = <&ocram2>;
    };
```
