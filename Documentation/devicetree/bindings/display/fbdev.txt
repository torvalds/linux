## Documentation/devicetree/bindings/display/fbdev.txt
```
General framebuffer properties:

Optional properties for framebuffers:
 - clear-on-probe	: clear the framebuffer during probe (bool)
 - rotate		: rotate a framebuffer over 0, 1, 2 and 3 (or 0, 90,
			  180 and 270) degree's (integer)
```

## Documentation/devicetree/bindings/display/fsl,dcu.txt
```
Device Tree bindings for Freescale DCU DRM Driver

Required properties:
- compatible:		Should be one of
	* "fsl,ls1021a-dcu".
	* "fsl,vf610-dcu".

- reg:			Address and length of the register set for dcu.
- clocks:		Handle to "dcu" and "pix" clock (in the order below)
			This can be the same clock (e.g. LS1021a)
			See ../clocks/clock-bindings.txt for details.
- clock-names:		Should be "dcu" and "pix"
			See ../clocks/clock-bindings.txt for details.
- big-endian		Boolean property, LS1021A DCU registers are big-endian.
- port			Video port for the panel output

Optional properties:
- fsl,tcon:		The phandle to the timing controller node.

Examples:
dcu: dcu@2ce0000 {
	compatible = "fsl,ls1021a-dcu";
	reg = <0x0 0x2ce0000 0x0 0x10000>;
	clocks = <&platform_clk 0>, <&platform_clk 0>;
	clock-names = "dcu", "pix";
	big-endian;
	fsl,tcon = <&tcon>;

	port {
		dcu_out: endpoint {
			remote-endpoint = <&panel_out>;
	     };
	};
};
```

## Documentation/devicetree/bindings/display/fsl,lcdif.yaml
```yaml
# SPDX-License-Identifier: (GPL-2.0-only OR BSD-2-Clause)
%YAML 1.2
---
$id: http://devicetree.org/schemas/display/fsl,lcdif.yaml#
$schema: http://devicetree.org/meta-schemas/core.yaml#

title: Freescale/NXP i.MX LCD Interface (LCDIF)

maintainers:
  - Marek Vasut <marex@denx.de>
  - Stefan Agner <stefan@agner.ch>

description: |
  (e)LCDIF display controller found in the Freescale/NXP i.MX SoCs.

properties:
  compatible:
    oneOf:
      - enum:
          - fsl,imx23-lcdif
          - fsl,imx28-lcdif
          - fsl,imx6sx-lcdif
          - fsl,imx8mp-lcdif
          - fsl,imx93-lcdif
      - items:
          - enum:
              - fsl,imx6sl-lcdif
              - fsl,imx6sll-lcdif
              - fsl,imx6ul-lcdif
              - fsl,imx7d-lcdif
              - fsl,imx8mm-lcdif
              - fsl,imx8mn-lcdif
              - fsl,imx8mq-lcdif
          - const: fsl,imx6sx-lcdif

  reg:
    maxItems: 1

  clocks:
    items:
      - description: Pixel clock
      - description: Bus clock
      - description: Display AXI clock
    minItems: 1

  clock-names:
    items:
      - const: pix
      - const: axi
      - const: disp_axi
    minItems: 1

  interrupts:
    items:
      - description: LCDIF DMA interrupt
      - description: LCDIF Error interrupt
    minItems: 1

  power-domains:
    maxItems: 1

  port:
    $ref: /schemas/graph.yaml#/properties/port
    description: The LCDIF output port

required:
  - compatible
  - reg
  - clocks
  - interrupts
  - port

additionalProperties: false

allOf:
  - if:
      properties:
        compatible:
          contains:
            const: fsl,imx6sx-lcdif
    then:
      properties:
        clocks:
          minItems: 2
          maxItems: 3
        clock-names:
          minItems: 2
          maxItems: 3
      required:
        - clock-names
  - if:
      properties:
        compatible:
          contains:
            enum:
              - fsl,imx8mp-lcdif
              - fsl,imx93-lcdif
    then:
      properties:
        clocks:
          minItems: 3
          maxItems: 3
        clock-names:
          minItems: 3
          maxItems: 3
      required:
        - clock-names
  - if:
      not:
        properties:
          compatible:
            contains:
              enum:
                - fsl,imx6sx-lcdif
                - fsl,imx8mp-lcdif
                - fsl,imx93-lcdif
    then:
      properties:
        clocks:
          maxItems: 1
        clock-names:
          maxItems: 1
  - if:
      properties:
        compatible:
          const: fsl,imx6sx-lcdif
    then:
      required:
        - power-domains
  - if:
      properties:
        compatible:
          contains:
            enum:
              - fsl,imx6sl-lcdif
              - fsl,imx8mm-lcdif
              - fsl,imx8mn-lcdif
              - fsl,imx8mp-lcdif
              - fsl,imx93-lcdif
    then:
      required:
        - power-domains
  - if:
      properties:
        compatible:
          contains:
            enum:
              - fsl,imx23-lcdif
    then:
      properties:
        interrupts:
          minItems: 2
          maxItems: 2
    else:
      properties:
        interrupts:
          maxItems: 1

examples:
  - |
    #include <dt-bindings/clock/imx6sx-clock.h>
    #include <dt-bindings/interrupt-controller/arm-gic.h>

    display-controller@2220000 {
        compatible = "fsl,imx6sx-lcdif";
        reg = <0x02220000 0x4000>;
        interrupts = <GIC_SPI 5 IRQ_TYPE_LEVEL_HIGH>;
        clocks = <&clks IMX6SX_CLK_LCDIF1_PIX>,
                 <&clks IMX6SX_CLK_LCDIF_APB>,
                 <&clks IMX6SX_CLK_DISPLAY_AXI>;
        clock-names = "pix", "axi", "disp_axi";
        power-domains = <&pd_disp>;

        port {
            endpoint {
                remote-endpoint = <&panel_in>;
            };
        };
    };

...
```

## Documentation/devicetree/bindings/display/fsl,ls1021a-dcu.yaml
```yaml
# SPDX-License-Identifier: (GPL-2.0-only OR BSD-2-Clause)
%YAML 1.2
---
$id: http://devicetree.org/schemas/display/fsl,ls1021a-dcu.yaml#
$schema: http://devicetree.org/meta-schemas/core.yaml#

title: Freescale DCU DRM Driver

maintainers:
  - Frank Li <Frank.Li@nxp.com>

properties:
  compatible:
    enum:
      - fsl,ls1021a-dcu
      - fsl,vf610-dcu

  reg:
    maxItems: 1

  interrupts:
    maxItems: 1

  clocks:
    maxItems: 2

  clock-names:
    items:
      - const: dcu
      - const: pix

  big-endian: true

  port:
    $ref: /schemas/graph.yaml#/$defs/port-base
    unevaluatedProperties: false
    description: Video port for the panel output

    properties:
      endpoint:
        $ref: /schemas/media/video-interfaces.yaml#
        unevaluatedProperties: false

  fsl,tcon:
    $ref: /schemas/types.yaml#/definitions/phandle
    description: The phandle to the timing controller node.

required:
  - compatible
  - reg
  - clocks
  - clock-names

additionalProperties: false

examples:
  - |
    display-controller@2ce0000 {
        compatible = "fsl,ls1021a-dcu";
        reg = <0x2ce0000 0x10000>;
        clocks = <&platform_clk 0>, <&platform_clk 0>;
        clock-names = "dcu", "pix";
        big-endian;
        fsl,tcon = <&tcon>;

        port {
            endpoint {
                remote-endpoint = <&panel_out>;
            };
        };
    };
```

## Documentation/devicetree/bindings/display/fsl,tcon.txt
```
Device Tree bindings for Freescale TCON Driver

Required properties:
- compatible:		Should be one of
	* "fsl,vf610-tcon".

- reg:			Address and length of the register set for tcon.
- clocks:		From common clock binding: handle to tcon ipg clock.
- clock-names:		From common clock binding: Shall be "ipg".

Examples:
timing-controller@4003d000 {
	compatible = "fsl,vf610-tcon";
	reg = <0x4003d000 0x1000>;
	clocks = <&clks VF610_CLK_TCON0>;
	clock-names = "ipg";
};
```

## Documentation/devicetree/bindings/display/fsl,vf610-tcon.yaml
```yaml
# SPDX-License-Identifier: (GPL-2.0-only OR BSD-2-Clause)
%YAML 1.2
---
$id: http://devicetree.org/schemas/display/fsl,vf610-tcon.yaml#
$schema: http://devicetree.org/meta-schemas/core.yaml#

title: Freescale TCON

maintainers:
  - Frank Li <Frank.Li@nxp.com>

properties:
  compatible:
    const: fsl,vf610-tcon

  reg:
    maxItems: 1

  clocks:
    maxItems: 1

  clock-names:
    items:
      - const: ipg

required:
  - compatible
  - reg
  - clocks
  - clock-names

additionalProperties: false

examples:
  - |
    #include <dt-bindings/clock/vf610-clock.h>

    timing-controller@4003d000 {
        compatible = "fsl,vf610-tcon";
        reg = <0x4003d000 0x1000>;
        clocks = <&clks VF610_CLK_TCON0>;
        clock-names = "ipg";
    };
```

## Documentation/devicetree/bindings/display/google,goldfish-fb.txt
```
Android Goldfish framebuffer

Android Goldfish framebuffer device used by Android emulator.

Required properties:

- compatible : should contain "google,goldfish-fb"
- reg        : <registers mapping>
- interrupts : <interrupt mapping>

Example:

	display-controller@1f008000 {
		compatible = "google,goldfish-fb";
		interrupts = <0x10>;
		reg = <0x1f008000 0x100>;
	};
```

## Documentation/devicetree/bindings/display/google,goldfish-fb.yaml
```yaml
# SPDX-License-Identifier: (GPL-2.0-only OR BSD-2-Clause)
%YAML 1.2
---
$id: http://devicetree.org/schemas/display/google,goldfish-fb.yaml#
$schema: http://devicetree.org/meta-schemas/core.yaml#

title: Android Goldfish Framebuffer

maintainers:
  - Kuan-Wei Chiu <visitorckw@gmail.com>

description:
  Android Goldfish framebuffer device used by Android emulator.

properties:
  compatible:
    const: google,goldfish-fb

  reg:
    maxItems: 1

  interrupts:
    maxItems: 1

required:
  - compatible
  - reg
  - interrupts

additionalProperties: false

examples:
  - |
    display@1f008000 {
        compatible = "google,goldfish-fb";
        reg = <0x1f008000 0x100>;
        interrupts = <16>;
    };
```

## Documentation/devicetree/bindings/display/himax,hx8357.yaml
```yaml
# SPDX-License-Identifier: (GPL-2.0-only OR BSD-2-Clause)
%YAML 1.2
---
$id: http://devicetree.org/schemas/display/himax,hx8357.yaml#
$schema: http://devicetree.org/meta-schemas/core.yaml#

title: Himax HX8357D display panel

description:
  Display panels using a Himax HX8357D controller in SPI
  mode, such as the Adafruit 3.5" TFT for Raspberry Pi.

maintainers:
  - Frank Li <Frank.Li@nxp.com>

properties:
  compatible:
    oneOf:
      - items:
          - enum:
              - adafruit,yx350hv15
              - himax,hx8357b
          - const: himax,hx8357
      - items:
          - enum:
              - himax,hx8369a
          - const: himax,hx8369

  reg:
    maxItems: 1

  dc-gpios:
    maxItems: 1
    description: D/C pin

  rotation:
    enum: [0, 90, 180, 270]

  backlight:
    description:
      phandle of the backlight device attached to the panel

  im-gpios:
    maxItems: 3

  reset-gpios:
    maxItems: 1

  spi-cpha: true

  spi-cpol: true

required:
  - compatible
  - reg

allOf:
  - $ref: /schemas/spi/spi-peripheral-props.yaml#

unevaluatedProperties: false

examples:
  - |
    #include <dt-bindings/gpio/gpio.h>

    spi {
        #address-cells = <1>;
        #size-cells = <0>;

        display@0 {
            compatible = "adafruit,yx350hv15", "himax,hx8357";
            reg = <0>;
            spi-max-frequency = <32000000>;
            dc-gpios = <&gpio0 25 GPIO_ACTIVE_HIGH>;
            rotation = <90>;
            backlight = <&backlight>;
       };
    };
```

## Documentation/devicetree/bindings/display/himax,hx8357d.txt
```
Himax HX8357D display panels

This binding is for display panels using a Himax HX8357D controller in SPI
mode, such as the Adafruit 3.5" TFT for Raspberry Pi.

Required properties:
- compatible:	"adafruit,yx350hv15", "himax,hx8357d"
- dc-gpios:	D/C pin
- reg:		address of the panel on the SPI bus

The node for this driver must be a child node of a SPI controller, hence
all mandatory properties described in ../spi/spi-bus.txt must be specified.

Optional properties:
- rotation:	panel rotation in degrees counter clockwise (0,90,180,270)
- backlight:	phandle of the backlight device attached to the panel

Example:
	display@0{
		compatible = "adafruit,yx350hv15", "himax,hx8357d";
		reg = <0>;
		spi-max-frequency = <32000000>;
		dc-gpios = <&gpio0 25 GPIO_ACTIVE_HIGH>;
		rotation = <90>;
		backlight = <&backlight>;
	};
```

## Documentation/devicetree/bindings/display/hisilicon/dw-dsi.txt
```
Device-Tree bindings for DesignWare DSI Host Controller v1.20a driver

A DSI Host Controller resides in the middle of display controller and external
HDMI converter or panel.

Required properties:
- compatible: value should be "hisilicon,hi6220-dsi".
- reg: physical base address and length of dsi controller's registers.
- clocks: contains APB clock phandle + clock-specifier pair.
- clock-names: should be "pclk".
- ports: contains DSI controller input and output sub port.
  The input port connects to ADE output port with the reg value "0".
  The output port with the reg value "1", it could connect to panel or
  any other bridge endpoints.
  See Documentation/devicetree/bindings/graph.txt for more device graph info.

A example of HiKey board hi6220 SoC and board specific DT entry:
Example:

SoC specific:
	dsi: dsi@f4107800 {
		compatible = "hisilicon,hi6220-dsi";
		reg = <0x0 0xf4107800 0x0 0x100>;
		clocks = <&media_ctrl  HI6220_DSI_PCLK>;
		clock-names = "pclk";
		status = "disabled";

		ports {
			#address-cells = <1>;
			#size-cells = <0>;

			/* 0 for input port */
			port@0 {
				reg = <0>;
				dsi_in: endpoint {
					remote-endpoint = <&ade_out>;
				};
			};
		};
	};


Board specific:
	&dsi {
		status = "ok";

		ports {
			/* 1 for output port */
			port@1 {
				reg = <1>;

				dsi_out0: endpoint@0 {
					remote-endpoint = <&adv7533_in>;
				};
			};
		};
	};

	&i2c2 {
		...

		adv7533: adv7533@39 {
			...

			port {
				adv7533_in: endpoint {
					remote-endpoint = <&dsi_out0>;
				};
			};
		};
	};
```

## Documentation/devicetree/bindings/display/hisilicon/hisi-ade.txt
```
Device-Tree bindings for hisilicon ADE display controller driver

ADE (Advanced Display Engine) is the display controller which grab image
data from memory, do composition, do post image processing, generate RGB
timing stream and transfer to DSI.

Required properties:
- compatible: value should be "hisilicon,hi6220-ade".
- reg: physical base address and length of the ADE controller's registers.
- hisilicon,noc-syscon: ADE NOC QoS syscon.
- resets: The ADE reset controller node.
- interrupt: the ldi vblank interrupt number used.
- clocks: a list of phandle + clock-specifier pairs, one for each entry
  in clock-names.
- clock-names: should contain:
  "clk_ade_core" for the ADE core clock.
  "clk_codec_jpeg" for the media NOC QoS clock, which use the same clock with
  jpeg codec.
  "clk_ade_pix" for the ADE pixel clock.
- assigned-clocks: Should contain "clk_ade_core" and "clk_codec_jpeg" clocks'
  phandle + clock-specifier pairs.
- assigned-clock-rates: clock rates, one for each entry in assigned-clocks.
  The rate of "clk_ade_core" could be "360000000" or "180000000";
  The rate of "clk_codec_jpeg" could be or less than "1440000000".
  These rate values could be configured according to performance and power
  consumption.
- port: the output port. This contains one endpoint subnode, with its
  remote-endpoint set to the phandle of the connected DSI input endpoint.
  See Documentation/devicetree/bindings/graph.txt for more device graph info.

Optional properties:
- dma-coherent: Present if dma operations are coherent.


A example of HiKey board hi6220 SoC specific DT entry:
Example:

	ade: ade@f4100000 {
		compatible = "hisilicon,hi6220-ade";
		reg = <0x0 0xf4100000 0x0 0x7800>;
		reg-names = "ade_base";
		hisilicon,noc-syscon = <&medianoc_ade>;
		resets = <&media_ctrl MEDIA_ADE>;
		interrupts = <0 115 4>; /* ldi interrupt */

		clocks = <&media_ctrl HI6220_ADE_CORE>,
			 <&media_ctrl HI6220_CODEC_JPEG>,
			 <&media_ctrl HI6220_ADE_PIX_SRC>;
		/*clock name*/
		clock-names  = "clk_ade_core",
			       "clk_codec_jpeg",
			       "clk_ade_pix";

		assigned-clocks = <&media_ctrl HI6220_ADE_CORE>,
			<&media_ctrl HI6220_CODEC_JPEG>;
		assigned-clock-rates = <360000000>, <288000000>;
		dma-coherent;

		port {
			ade_out: endpoint {
				remote-endpoint = <&dsi_in>;
			};
		};
	};
```
