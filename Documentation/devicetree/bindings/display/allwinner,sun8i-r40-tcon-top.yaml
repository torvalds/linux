## Documentation/devicetree/bindings/display/amlogic,simple-framebuffer.txt
```
Meson specific Simple Framebuffer bindings

This binding documents meson specific extensions to the simple-framebuffer
bindings. The meson simplefb u-boot code relies on the devicetree containing
pre-populated simplefb nodes.

These extensions are intended so that u-boot can select the right node based
on which pipeline is being used. As such they are solely intended for
firmware / bootloader use, and the OS should ignore them.

Required properties:
- compatible: "amlogic,simple-framebuffer", "simple-framebuffer"
- amlogic,pipeline, one of:
  "vpu-cvbs"
  "vpu-hdmi"

Example:

chosen {
	#address-cells = <2>;
	#size-cells = <2>;
	ranges;

	simplefb_hdmi: framebuffer-hdmi {
		compatible = "amlogic,simple-framebuffer",
			     "simple-framebuffer";
		amlogic,pipeline = "vpu-hdmi";
		clocks = <&clkc CLKID_HDMI_PCLK>,
			 <&clkc CLKID_CLK81>,
			 <&clkc CLKID_GCLK_VENCI_INT0>;
		power-domains = <&pwrc_vpu>;
	};
};
```

## Documentation/devicetree/bindings/display/apple,h7-display-pipe-mipi.yaml
```yaml
# SPDX-License-Identifier: (GPL-2.0 OR BSD-2-Clause)
%YAML 1.2
---
$id: http://devicetree.org/schemas/display/apple,h7-display-pipe-mipi.yaml#
$schema: http://devicetree.org/meta-schemas/core.yaml#

title: Apple pre-DCP display controller MIPI interface

maintainers:
  - Sasha Finkelstein <fnkl.kernel@gmail.com>

description:
  The MIPI controller part of the pre-DCP Apple display controller

allOf:
  - $ref: dsi-controller.yaml#

properties:
  compatible:
    items:
      - enum:
          - apple,t8112-display-pipe-mipi
          - apple,t8103-display-pipe-mipi
      - const: apple,h7-display-pipe-mipi

  reg:
    maxItems: 1

  power-domains:
    maxItems: 1

  ports:
    $ref: /schemas/graph.yaml#/properties/ports

    properties:
      port@0:
        $ref: /schemas/graph.yaml#/properties/port
        description: Input port. Always connected to the primary controller

      port@1:
        $ref: /schemas/graph.yaml#/properties/port
        description: Output MIPI DSI port to the panel

    required:
      - port@0
      - port@1

required:
  - compatible
  - reg
  - ports

unevaluatedProperties: false

examples:
  - |
    dsi@28200000 {
        compatible = "apple,t8103-display-pipe-mipi", "apple,h7-display-pipe-mipi";
        reg = <0x28200000 0xc000>;
        power-domains = <&ps_dispdfr_mipi>;

        ports {
            #address-cells = <1>;
            #size-cells = <0>;

            port@0 {
                reg = <0>;

                dfr_adp_out_mipi: endpoint {
                    remote-endpoint = <&dfr_adp_out_mipi>;
                };
            };

            port@1 {
                reg = <1>;

                dfr_panel_in: endpoint {
                    remote-endpoint = <&dfr_mipi_out_panel>;
                };
            };
        };
    };
...
```

## Documentation/devicetree/bindings/display/apple,h7-display-pipe.yaml
```yaml
# SPDX-License-Identifier: (GPL-2.0 OR BSD-2-Clause)
%YAML 1.2
---
$id: http://devicetree.org/schemas/display/apple,h7-display-pipe.yaml#
$schema: http://devicetree.org/meta-schemas/core.yaml#

title: Apple pre-DCP display controller

maintainers:
  - Sasha Finkelstein <fnkl.kernel@gmail.com>

description:
  A secondary display controller used to drive the "touchbar" on
  certain Apple laptops.

properties:
  compatible:
    items:
      - enum:
          - apple,t8112-display-pipe
          - apple,t8103-display-pipe
      - const: apple,h7-display-pipe

  reg:
    items:
      - description: Primary register block, controls planes and blending
      - description:
          Contains other configuration registers like interrupt
          and FIFO control

  reg-names:
    items:
      - const: be
      - const: fe

  power-domains:
    description:
      Phandles to pmgr entries that are needed for this controller to turn on.
      Aside from that, their specific functions are unknown
    maxItems: 2

  interrupts:
    items:
      - description: Unknown function
      - description: Primary interrupt. Vsync events are reported via it

  interrupt-names:
    items:
      - const: be
      - const: fe

  iommus:
    maxItems: 1

  port:
    $ref: /schemas/graph.yaml#/properties/port
    description: Output port. Always connected to apple,h7-display-pipe-mipi

required:
  - compatible
  - reg
  - interrupts
  - port

additionalProperties: false

examples:
  - |
    #include <dt-bindings/interrupt-controller/apple-aic.h>
    display-pipe@28200000 {
        compatible = "apple,t8103-display-pipe", "apple,h7-display-pipe";
        reg = <0x28200000 0xc000>,
              <0x28400000 0x4000>;
        reg-names = "be", "fe";
        power-domains = <&ps_dispdfr_fe>, <&ps_dispdfr_be>;
        interrupt-parent = <&aic>;
        interrupts = <AIC_IRQ 502 IRQ_TYPE_LEVEL_HIGH>,
                     <AIC_IRQ 506 IRQ_TYPE_LEVEL_HIGH>;
        interrupt-names = "be", "fe";
        iommus = <&displaydfr_dart 0>;

        port {
            dfr_adp_out_mipi: endpoint {
                remote-endpoint = <&dfr_mipi_in_adp>;
            };
        };
    };
...
```

## Documentation/devicetree/bindings/display/arm,hdlcd.txt
```
ARM HDLCD

This is a display controller found on several development platforms produced
by ARM Ltd and in more modern of its' Fast Models. The HDLCD is an RGB
streamer that reads the data from a framebuffer and sends it to a single
digital encoder (DVI or HDMI).

Required properties:
  - compatible: "arm,hdlcd"
  - reg: Physical base address and length of the controller's registers.
  - interrupts: One interrupt used by the display controller to notify the
    interrupt controller when any of the interrupt sources programmed in
    the interrupt mask register have activated.
  - clocks: A list of phandle + clock-specifier pairs, one for each
    entry in 'clock-names'.
  - clock-names: A list of clock names. For HDLCD it should contain:
      - "pxlclk" for the clock feeding the output PLL of the controller.

Required sub-nodes:
  - port: The HDLCD connection to an encoder chip. The connection is modeled
    using the OF graph bindings specified in
    Documentation/devicetree/bindings/graph.txt.

Optional properties:
  - memory-region: phandle to a node describing memory (see
    Documentation/devicetree/bindings/reserved-memory/reserved-memory.txt) to be
    used for the framebuffer; if not present, the framebuffer may be located
    anywhere in memory.


Example:

/ {
	...

	hdlcd@2b000000 {
		compatible = "arm,hdlcd";
		reg = <0 0x2b000000 0 0x1000>;
		interrupts = <GIC_SPI 85 IRQ_TYPE_LEVEL_HIGH>;
		clocks = <&oscclk5>;
		clock-names = "pxlclk";
		port {
			hdlcd_output: endpoint@0 {
				remote-endpoint = <&hdmi_enc_input>;
			};
		};
	};

	/* HDMI encoder on I2C bus */
	i2c@7ffa0000 {
		....
		hdmi-transmitter@70 {
			compatible = ".....";
			reg = <0x70>;
			port@0 {
				hdmi_enc_input: endpoint {
					remote-endpoint = <&hdlcd_output>;
				};

				hdmi_enc_output: endpoint {
					remote-endpoint = <&hdmi_1_port>;
				};
			};
		};

	};

	hdmi1: connector@1 {
		compatible = "hdmi-connector";
		type = "a";
		port {
			hdmi_1_port: endpoint {
				remote-endpoint = <&hdmi_enc_output>;
			};
		};
	};

	...
};
```

## Documentation/devicetree/bindings/display/arm,hdlcd.yaml
```yaml
# SPDX-License-Identifier: (GPL-2.0-only OR BSD-2-Clause)
%YAML 1.2
---
$id: http://devicetree.org/schemas/display/arm,hdlcd.yaml#
$schema: http://devicetree.org/meta-schemas/core.yaml#

title: Arm HDLCD display controller

maintainers:
  - Liviu Dudau <Liviu.Dudau@arm.com>
  - Andre Przywara <andre.przywara@arm.com>

description:
  The Arm HDLCD is a display controller found on several development platforms
  produced by ARM Ltd and in more modern of its Fast Models. The HDLCD is an
  RGB streamer that reads the data from a framebuffer and sends it to a single
  digital encoder (DVI or HDMI).

properties:
  compatible:
    const: arm,hdlcd

  reg:
    maxItems: 1

  interrupts:
    maxItems: 1

  clock-names:
    const: pxlclk

  clocks:
    maxItems: 1
    description: The input reference for the pixel clock.

  memory-region:
    maxItems: 1
    description:
      Phandle to a node describing memory to be used for the framebuffer.
      If not present, the framebuffer may be located anywhere in memory.

  iommus:
    maxItems: 1

  port:
    $ref: /schemas/graph.yaml#/properties/port
    unevaluatedProperties: false
    description:
      Output endpoint of the controller, connecting the LCD panel signals.

additionalProperties: false

required:
  - compatible
  - reg
  - interrupts
  - clocks
  - port

examples:
  - |
    hdlcd@2b000000 {
        compatible = "arm,hdlcd";
        reg = <0x2b000000 0x1000>;
        interrupts = <0 85 4>;
        clocks = <&oscclk5>;
        clock-names = "pxlclk";
        port {
            hdlcd_output: endpoint {
                remote-endpoint = <&hdmi_enc_input>;
            };
        };
    };

    /* HDMI encoder on I2C bus */
    i2c {
        #address-cells = <1>;
        #size-cells = <0>;
        hdmi-transmitter@70 {
            compatible = "nxp,tda998x";
            reg = <0x70>;
            port {
                hdmi_enc_input: endpoint {
                    remote-endpoint = <&hdlcd_output>;
                };
            };
        };
    };
...
```

## Documentation/devicetree/bindings/display/arm,komeda.txt
```
Device Tree bindings for Arm Komeda display driver

Required properties:
- compatible: Should be "arm,mali-d71"
- reg: Physical base address and length of the registers in the system
- interrupts: the interrupt line number of the device in the system
- clocks: A list of phandle + clock-specifier pairs, one for each entry
    in 'clock-names'
- clock-names: A list of clock names. It should contain:
      - "mclk": for the main processor clock
      - "pclk": for the APB interface clock
- #address-cells: Must be 1
- #size-cells: Must be 0

Required properties for sub-node: pipeline@nq
Each device contains one or two pipeline sub-nodes (at least one), each
pipeline node should provide properties:
- reg: Zero-indexed identifier for the pipeline
- clocks: A list of phandle + clock-specifier pairs, one for each entry
    in 'clock-names'
- clock-names: should contain:
      - "pxclk": pixel clock
      - "aclk": AXI interface clock

- port: each pipeline connect to an encoder input port. The connection is
    modeled using the OF graph bindings specified in
    Documentation/devicetree/bindings/graph.txt

Optional properties:
  - memory-region: phandle to a node describing memory (see
    Documentation/devicetree/bindings/reserved-memory/reserved-memory.txt)
    to be used for the framebuffer; if not present, the framebuffer may
    be located anywhere in memory.

Example:
/ {
	...

	dp0: display@c00000 {
		#address-cells = <1>;
		#size-cells = <0>;
		compatible = "arm,mali-d71";
		reg = <0xc00000 0x20000>;
		interrupts = <0 168 4>;
		clocks = <&dpu_mclk>, <&dpu_aclk>;
		clock-names = "mclk", "pclk";

		dp0_pipe0: pipeline@0 {
			clocks = <&fpgaosc2>, <&dpu_aclk>;
			clock-names = "pxclk", "aclk";
			reg = <0>;

			port {
				dp0_pipe0_out: endpoint {
					remote-endpoint = <&db_dvi0_in>;
				};
			};
		};

		dp0_pipe1: pipeline@1 {
			clocks = <&fpgaosc2>, <&dpu_aclk>;
			clock-names = "pxclk", "aclk";
			reg = <1>;

			port {
				dp0_pipe1_out: endpoint {
					remote-endpoint = <&db_dvi1_in>;
				};
			};
		};
	};
	...
};
```

## Documentation/devicetree/bindings/display/arm,komeda.yaml
```yaml
# SPDX-License-Identifier: (GPL-2.0-only OR BSD-2-Clause)
%YAML 1.2
---
$id: http://devicetree.org/schemas/display/arm,komeda.yaml#
$schema: http://devicetree.org/meta-schemas/core.yaml#

title: Arm Komeda display processor

maintainers:
  - Liviu Dudau <Liviu.Dudau@arm.com>
  - Andre Przywara <andre.przywara@arm.com>

description:
  The Arm Mali D71 display processor supports up to two displays with up
  to a 4K resolution each. Each pipeline can be composed of up to four
  layers. It is typically connected to a digital display connector like HDMI.

properties:
  compatible:
    oneOf:
      - items:
          - const: arm,mali-d32
          - const: arm,mali-d71
      - const: arm,mali-d71

  reg:
    maxItems: 1

  interrupts:
    maxItems: 1

  clock-names:
    const: aclk

  clocks:
    maxItems: 1
    description: The main DPU processor clock

  "#address-cells":
    const: 1

  "#size-cells":
    const: 0

  memory-region:
    maxItems: 1
    description:
      Phandle to a node describing memory to be used for the framebuffer.
      If not present, the framebuffer may be located anywhere in memory.

  iommus:
    description:
      The stream IDs for each of the used pipelines, each four IDs for the
      four layers, plus one for the write-back stream.
    minItems: 5
    maxItems: 10

patternProperties:
  '^pipeline@[01]$':
    type: object
    description:
      clocks

    properties:
      reg:
        enum: [ 0, 1 ]

      clock-names:
        const: pxclk

      clocks:
        maxItems: 1
        description: The input reference for the pixel clock.

      port:
        $ref: /schemas/graph.yaml#/$defs/port-base
        unevaluatedProperties: false

additionalProperties: false

required:
  - "#address-cells"
  - "#size-cells"
  - compatible
  - reg
  - interrupts
  - clock-names
  - clocks
  - pipeline@0

examples:
  - |
    display@c00000 {
        #address-cells = <1>;
        #size-cells = <0>;
        compatible = "arm,mali-d71";
        reg = <0xc00000 0x20000>;
        interrupts = <168>;
        clocks = <&dpu_aclk>;
        clock-names = "aclk";
        iommus = <&smmu 0>, <&smmu 1>, <&smmu 2>, <&smmu 3>,
                 <&smmu 8>,
                 <&smmu 4>, <&smmu 5>, <&smmu 6>, <&smmu 7>,
                 <&smmu 9>;

        dp0_pipe0: pipeline@0 {
            clocks = <&fpgaosc2>;
            clock-names = "pxclk";
            reg = <0>;

            port {
                dp0_pipe0_out: endpoint {
                    remote-endpoint = <&db_dvi0_in>;
                };
            };
        };

        dp0_pipe1: pipeline@1 {
            clocks = <&fpgaosc2>;
            clock-names = "pxclk";
            reg = <1>;

            port {
                dp0_pipe1_out: endpoint {
                    remote-endpoint = <&db_dvi1_in>;
                };
            };
        };
    };
...
```
