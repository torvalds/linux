## Documentation/devicetree/bindings/display/arm,malidp.txt
```
ARM Mali-DP

The following bindings apply to a family of Display Processors sold as
licensable IP by ARM Ltd. The bindings describe the Mali DP500, DP550 and
DP650 processors that offer multiple composition layers, support for
rotation and scaling output.

Required properties:
  - compatible: should be one of
	"arm,mali-dp500"
	"arm,mali-dp550"
	"arm,mali-dp650"
    depending on the particular implementation present in the hardware
  - reg: Physical base address and size of the block of registers used by
    the processor.
  - interrupts: Interrupt list, as defined in ../interrupt-controller/interrupts.txt,
    interrupt client nodes.
  - interrupt-names: name of the engine inside the processor that will
    use the corresponding interrupt. Should be one of "DE" or "SE".
  - clocks: A list of phandle + clock-specifier pairs, one for each entry
    in 'clock-names'
  - clock-names: A list of clock names. It should contain:
      - "pclk": for the APB interface clock
      - "aclk": for the AXI interface clock
      - "mclk": for the main processor clock
      - "pxlclk": for the pixel clock feeding the output PLL of the processor.
  - arm,malidp-output-port-lines: Array of u8 values describing the number
    of output lines per channel (R, G and B).

Required sub-nodes:
  - port: The Mali DP connection to an encoder input port. The connection
    is modelled using the OF graph bindings specified in
    Documentation/devicetree/bindings/graph.txt

Optional properties:
  - memory-region: phandle to a node describing memory (see
    Documentation/devicetree/bindings/reserved-memory/reserved-memory.txt)
    to be used for the framebuffer; if not present, the framebuffer may
    be located anywhere in memory.


Example:

/ {
	...

	dp0: malidp@6f200000 {
		compatible = "arm,mali-dp650";
		reg = <0 0x6f200000 0 0x20000>;
		memory-region = <&display_reserved>;
		interrupts = <0 168 IRQ_TYPE_LEVEL_HIGH>,
			     <0 168 IRQ_TYPE_LEVEL_HIGH>;
		interrupt-names = "DE", "SE";
		clocks = <&oscclk2>, <&fpgaosc0>, <&fpgaosc1>, <&fpgaosc1>;
		clock-names = "pxlclk", "mclk", "aclk", "pclk";
		arm,malidp-output-port-lines = /bits/ 8 <8 8 8>;
		port {
			dp0_output: endpoint {
				remote-endpoint = <&tda998x_2_input>;
			};
		};
	};

	...
};
```

## Documentation/devicetree/bindings/display/arm,malidp.yaml
```yaml
# SPDX-License-Identifier: (GPL-2.0-only OR BSD-2-Clause)
%YAML 1.2
---
$id: http://devicetree.org/schemas/display/arm,malidp.yaml#
$schema: http://devicetree.org/meta-schemas/core.yaml#

title: Arm Mali Display Processor (Mali-DP)

maintainers:
  - Liviu Dudau <Liviu.Dudau@arm.com>
  - Andre Przywara <andre.przywara@arm.com>

description:
  The following bindings apply to a family of Display Processors sold as
  licensable IP by ARM Ltd. The bindings describe the Mali DP500, DP550 and
  DP650 processors that offer multiple composition layers, support for
  rotation and scaling output.

properties:
  compatible:
    enum:
      - arm,mali-dp500
      - arm,mali-dp550
      - arm,mali-dp650

  reg:
    maxItems: 1

  interrupts:
    items:
      - description:
          The interrupt used by the Display Engine (DE). Can be shared with
          the interrupt for the Scaling Engine (SE), but it will have to be
          listed individually.
      - description:
          The interrupt used by the Scaling Engine (SE). Can be shared with
          the interrupt for the Display Engine (DE), but it will have to be
          listed individually.

  interrupt-names:
    items:
      - const: DE
      - const: SE

  clock-names:
    items:
      - const: pxlclk
      - const: mclk
      - const: aclk
      - const: pclk

  clocks:
    items:
      - description: the pixel clock feeding the output PLL of the processor
      - description: the main processor clock
      - description: the AXI interface clock
      - description: the APB interface clock

  memory-region:
    maxItems: 1
    description:
      Phandle to a node describing memory to be used for the framebuffer.
      If not present, the framebuffer may be located anywhere in memory.

  arm,malidp-output-port-lines:
    $ref: /schemas/types.yaml#/definitions/uint8-array
    description:
      Number of output lines/bits for each colour channel.
    items:
      - description: number of output lines for the red channel (R)
      - description: number of output lines for the green channel (G)
      - description: number of output lines for the blue channel (B)

  arm,malidp-arqos-value:
    $ref: /schemas/types.yaml#/definitions/uint32
    description:
      Quality-of-Service value for the display engine FIFOs, to write
      into the RQOS register of the DP500.
      See the ARM Mali-DP500 TRM for details on the encoding.
      If omitted, the RQOS register will not be changed.

  port:
    $ref: /schemas/graph.yaml#/properties/port
    unevaluatedProperties: false
    description:
      Output endpoint of the controller, connecting the LCD panel signals.

additionalProperties: false

required:
  - compatible
  - reg
  - interrupts
  - interrupt-names
  - clocks
  - clock-names
  - port
  - arm,malidp-output-port-lines

examples:
  - |
    dp0: malidp@6f200000 {
        compatible = "arm,mali-dp650";
        reg = <0x6f200000 0x20000>;
        memory-region = <&display_reserved>;
        interrupts = <168>, <168>;
        interrupt-names = "DE", "SE";
        clocks = <&oscclk2>, <&fpgaosc0>, <&fpgaosc1>, <&fpgaosc1>;
        clock-names = "pxlclk", "mclk", "aclk", "pclk";
        arm,malidp-output-port-lines = /bits/ 8 <8 8 8>;
        arm,malidp-arqos-value = <0xd000d000>;

        port {
            dp0_output: endpoint {
                remote-endpoint = <&tda998x_2_input>;
            };
        };
    };
...
```

## Documentation/devicetree/bindings/display/arm,pl11x.txt
```
* ARM PrimeCell Color LCD Controller PL110/PL111

See also Documentation/devicetree/bindings/arm/primecell.yaml

Required properties:

- compatible: must be one of:
	"arm,pl110", "arm,primecell"
	"arm,pl111", "arm,primecell"

- reg: base address and size of the control registers block

- interrupt-names: either the single entry "combined" representing a
	combined interrupt output (CLCDINTR), or the four entries
	"mbe", "vcomp", "lnbu", "fuf" representing the individual
	CLCDMBEINTR, CLCDVCOMPINTR, CLCDLNBUINTR, CLCDFUFINTR interrupts

- interrupts: contains an interrupt specifier for each entry in
	interrupt-names

- clock-names: should contain "clcdclk" and "apb_pclk"

- clocks: contains phandle and clock specifier pairs for the entries
	in the clock-names property. See
	Documentation/devicetree/bindings/clock/clock-bindings.txt

Optional properties:

- memory-region: phandle to a node describing memory (see
	Documentation/devicetree/bindings/reserved-memory/reserved-memory.txt)
	to be used for the framebuffer; if not present, the framebuffer
	may be located anywhere in the memory

- max-memory-bandwidth: maximum bandwidth in bytes per second that the
	cell's memory interface can handle; if not present, the memory
	interface is fast enough to handle all possible video modes

Required sub-nodes:

- port: describes LCD panel signals, following the common binding
	for video transmitter interfaces; see
	Documentation/devicetree/bindings/media/video-interfaces.txt;
	when it is a TFT panel, the port's endpoint must define the
	following property:

	- arm,pl11x,tft-r0g0b0-pads: an array of three 32-bit values,
		defining the way CLD pads are wired up; first value
		contains index of the "CLD" external pin (pad) used
		as R0 (first bit of the red component), second value
	        index of the pad used as G0, third value index of the
		pad used as B0, see also "LCD panel signal multiplexing
		details" paragraphs in the PL110/PL111 Technical
		Reference Manuals; this implicitly defines available
		color modes, for example:
		- PL111 TFT 4:4:4 panel:
			arm,pl11x,tft-r0g0b0-pads = <4 15 20>;
		- PL110 TFT (1:)5:5:5 panel:
			arm,pl11x,tft-r0g0b0-pads = <1 7 13>;
		- PL111 TFT (1:)5:5:5 panel:
			arm,pl11x,tft-r0g0b0-pads = <3 11 19>;
		- PL111 TFT 5:6:5 panel:
			arm,pl11x,tft-r0g0b0-pads = <3 10 19>;
		- PL110 and PL111 TFT 8:8:8 panel:
			arm,pl11x,tft-r0g0b0-pads = <0 8 16>;
		- PL110 and PL111 TFT 8:8:8 panel, R & B components swapped:
			arm,pl11x,tft-r0g0b0-pads = <16 8 0>;


Example:

	clcd@10020000 {
		compatible = "arm,pl111", "arm,primecell";
		reg = <0x10020000 0x1000>;
		interrupt-names = "combined";
		interrupts = <0 44 4>;
		clocks = <&oscclk1>, <&oscclk2>;
		clock-names = "clcdclk", "apb_pclk";
		max-memory-bandwidth = <94371840>; /* Bps, 1024x768@60 16bpp */

		port {
			clcd_pads: endpoint {
				remote-endpoint = <&clcd_panel>;
				arm,pl11x,tft-r0g0b0-pads = <0 8 16>;
			};
		};

	};

	panel {
		compatible = "panel-dpi";

		port {
			clcd_panel: endpoint {
				remote-endpoint = <&clcd_pads>;
			};
		};

		panel-timing {
			clock-frequency = <25175000>;
			hactive = <640>;
			hback-porch = <40>;
			hfront-porch = <24>;
			hsync-len = <96>;
			vactive = <480>;
			vback-porch = <32>;
			vfront-porch = <11>;
			vsync-len = <2>;
		};
	};
```

## Documentation/devicetree/bindings/display/arm,pl11x.yaml
```yaml
# SPDX-License-Identifier: (GPL-2.0-only OR BSD-2-Clause)
%YAML 1.2
---
$id: http://devicetree.org/schemas/display/arm,pl11x.yaml#
$schema: http://devicetree.org/meta-schemas/core.yaml#

title: Arm PrimeCell Color LCD Controller PL110/PL111

maintainers:
  - Liviu Dudau <Liviu.Dudau@arm.com>
  - Andre Przywara <andre.przywara@arm.com>

description:
  The Arm Primcell PL010/PL111 is an LCD controller IP, than scans out
  a framebuffer region in system memory, and creates timed signals for
  a variety of LCD panels.

# We need a select here so we don't match all nodes with 'arm,primecell'
select:
  properties:
    compatible:
      contains:
        enum:
          - arm,pl110
          - arm,pl111
  required:
    - compatible

properties:
  compatible:
    items:
      - enum:
          - arm,pl110
          - arm,pl111
      - const: arm,primecell

  reg:
    maxItems: 1

  interrupt-names:
    oneOf:
      - const: combined
        description:
          The IP provides four individual interrupt lines, but also one
          combined line. If the integration only connects this line to the
          interrupt controller, this single interrupt is noted here.
      - items:
          - const: mbe        # CLCDMBEINTR
          - const: vcomp      # CLCDVCOMPINTR
          - const: lnbu       # CLCDLNBUINTR
          - const: fuf        # CLCDFUFINTR

  interrupts:
    minItems: 1
    maxItems: 4

  clock-names:
    items:
      - const: clcdclk
      - const: apb_pclk

  clocks:
    items:
      - description: The CLCDCLK reference clock for the controller.
      - description: The HCLK AHB slave clock for the register access.

  memory-region:
    maxItems: 1
    description:
      Phandle to a node describing memory to be used for the framebuffer.
      If not present, the framebuffer may be located anywhere in memory.

  max-memory-bandwidth:
    $ref: /schemas/types.yaml#/definitions/uint32
    description:
      Maximum bandwidth in bytes per second that the cell's memory interface
      can handle.
      If not present, the memory interface is fast enough to handle all
      possible video modes.

  resets:
    maxItems: 1

  port:
    $ref: /schemas/graph.yaml#/$defs/port-base
    additionalProperties: false

    description:
      Output endpoint of the controller, connecting the LCD panel signals.

    properties:
      endpoint:
        $ref: /schemas/graph.yaml#/$defs/endpoint-base
        unevaluatedProperties: false

        properties:
          arm,pl11x,tft-r0g0b0-pads:
            $ref: /schemas/types.yaml#/definitions/uint32-array
            items:
              - description: index of CLD pad used for first red bit (R0)
              - description: index of CLD pad used for first green bit (G0)
              - description: index of CLD pad used for first blue bit (G0)
            deprecated: true
            description: |
              DEPRECATED. An array of three 32-bit values, defining the way
              CLD[23:0] pads are wired up.
              The first value contains the index of the "CLD" external pin (pad)
              used as R0 (first bit of the red component), the second value for
              green, the third value for blue.
              See also "LCD panel signal multiplexing details" paragraphs in the
              PL110/PL111 Technical Reference Manuals.
              This implicitly defines available color modes, for example:
              - PL111 TFT 4:4:4 panel:
                  arm,pl11x,tft-r0g0b0-pads = <4 15 20>;
              - PL110 TFT (1:)5:5:5 panel:
                  arm,pl11x,tft-r0g0b0-pads = <1 7 13>;
              - PL111 TFT (1:)5:5:5 panel:
                  arm,pl11x,tft-r0g0b0-pads = <3 11 19>;
              - PL111 TFT 5:6:5 panel:
                  arm,pl11x,tft-r0g0b0-pads = <3 10 19>;
              - PL110 and PL111 TFT 8:8:8 panel:
                  arm,pl11x,tft-r0g0b0-pads = <0 8 16>;
              - PL110 and PL111 TFT 8:8:8 panel, R & B components swapped:
                  arm,pl11x,tft-r0g0b0-pads = <16 8 0>;

additionalProperties: false

required:
  - compatible
  - reg
  - clock-names
  - clocks
  - port

allOf:
  - if:
      properties:
        interrupts:
          minItems: 2
      required:
        - interrupts
    then:
      required:
        - interrupt-names

examples:
  - |
    clcd@10020000 {
        compatible = "arm,pl111", "arm,primecell";
        reg = <0x10020000 0x1000>;
        interrupt-names = "combined";
        interrupts = <44>;
        clocks = <&oscclk1>, <&oscclk2>;
        clock-names = "clcdclk", "apb_pclk";
        max-memory-bandwidth = <94371840>; /* Bps, 1024x768@60 16bpp */

        port {
            clcd_pads: endpoint {
                remote-endpoint = <&clcd_panel>;
            };
        };
    };

    panel {
        compatible = "arm,rtsm-display";

        port {
            clcd_panel: endpoint {
                remote-endpoint = <&clcd_pads>;
            };
        };
    };
...
```
