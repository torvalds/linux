## Documentation/devicetree/bindings/dma/adi,axi-dmac.yaml
```yaml
# SPDX-License-Identifier: (GPL-2.0-only OR BSD-2-Clause)
%YAML 1.2
---
$id: http://devicetree.org/schemas/dma/adi,axi-dmac.yaml#
$schema: http://devicetree.org/meta-schemas/core.yaml#

title: Analog Devices AXI-DMAC DMA controller

description: |
  FPGA-based DMA controller designed for use with high-speed converter hardware.

  http://analogdevicesinc.github.io/hdl/library/axi_dmac/index.html

maintainers:
  - Nuno Sa <nuno.sa@analog.com>

additionalProperties: false

properties:
  compatible:
    const: adi,axi-dmac-1.00.a

  reg:
    maxItems: 1

  interrupts:
    maxItems: 1

  clocks:
    maxItems: 1

  "#dma-cells":
    const: 1

  adi,channels:
    deprecated: true
    type: object
    description:
      This sub-node must contain a sub-node for each DMA channel. This node is
      only required for IP versions older than 4.3.a and should otherwise be
      omitted.
    additionalProperties: false

    properties:
      "#size-cells":
        const: 0
      "#address-cells":
        const: 1

    patternProperties:
      "^dma-channel@[0-9a-f]+$":
        type: object
        description:
          DMA channel properties based on HDL compile-time configuration.
        additionalProperties: false

        properties:
          reg:
            maxItems: 1

          adi,source-bus-width:
            $ref: /schemas/types.yaml#/definitions/uint32
            description: Width of the source bus in bits.
            enum: [8, 16, 32, 64, 128]

          adi,destination-bus-width:
            $ref: /schemas/types.yaml#/definitions/uint32
            description: Width of the destination bus in bits.
            enum: [8, 16, 32, 64, 128]

          adi,source-bus-type:
            $ref: /schemas/types.yaml#/definitions/uint32
            description: |
              Type of the source bus.

              0: Memory mapped AXI interface
              1: Streaming AXI interface
              2: FIFO interface
            enum: [0, 1, 2]

          adi,destination-bus-type:
            $ref: /schemas/types.yaml#/definitions/uint32
            description: Type of the destination bus (see adi,source-bus-type).
            enum: [0, 1, 2]

          adi,length-width:
            deprecated: true
            $ref: /schemas/types.yaml#/definitions/uint32
            description: Width of the DMA transfer length register.

          adi,cyclic:
            deprecated: true
            type: boolean
            description:
              Must be set if the channel supports hardware cyclic DMA transfers.

          adi,2d:
            deprecated: true
            type: boolean
            description:
              Must be set if the channel supports hardware 2D DMA transfers.

        required:
          - reg
          - adi,source-bus-width
          - adi,destination-bus-width
          - adi,source-bus-type
          - adi,destination-bus-type

    required:
      - "#size-cells"
      - "#address-cells"

required:
  - compatible
  - reg
  - interrupts
  - clocks
  - "#dma-cells"

examples:
  - |
    dma-controller@7c420000 {
        compatible = "adi,axi-dmac-1.00.a";
        reg = <0x7c420000 0x10000>;
        interrupts = <0 57 0>;
        clocks = <&clkc 16>;
        #dma-cells = <1>;
    };
```

## Documentation/devicetree/bindings/dma/allwinner,sun4i-a10-dma.yaml
```yaml
# SPDX-License-Identifier: GPL-2.0
%YAML 1.2
---
$id: http://devicetree.org/schemas/dma/allwinner,sun4i-a10-dma.yaml#
$schema: http://devicetree.org/meta-schemas/core.yaml#

title: Allwinner A10 DMA Controller

maintainers:
  - Chen-Yu Tsai <wens@csie.org>
  - Maxime Ripard <mripard@kernel.org>

allOf:
  - $ref: dma-controller.yaml#

properties:
  "#dma-cells":
    const: 2
    description:
      The first cell is either 0 or 1, the former to use the normal
      DMA, 1 for dedicated DMA. The second cell is the request line
      number.

  compatible:
    enum:
      - allwinner,sun4i-a10-dma
      - allwinner,suniv-f1c100s-dma

  reg:
    maxItems: 1

  interrupts:
    maxItems: 1

  clocks:
    maxItems: 1

required:
  - "#dma-cells"
  - compatible
  - reg
  - interrupts
  - clocks

additionalProperties: false

examples:
  - |
    dma: dma-controller@1c02000 {
        compatible = "allwinner,sun4i-a10-dma";
        reg = <0x01c02000 0x1000>;
        interrupts = <27>;
        clocks = <&ahb_gates 6>;
        #dma-cells = <2>;
    };

...
```

## Documentation/devicetree/bindings/dma/allwinner,sun50i-a64-dma.yaml
```yaml
# SPDX-License-Identifier: GPL-2.0
%YAML 1.2
---
$id: http://devicetree.org/schemas/dma/allwinner,sun50i-a64-dma.yaml#
$schema: http://devicetree.org/meta-schemas/core.yaml#

title: Allwinner A64 DMA Controller Device Tree Bindings

maintainers:
  - Chen-Yu Tsai <wens@csie.org>
  - Maxime Ripard <mripard@kernel.org>

allOf:
  - $ref: "dma-controller.yaml#"

properties:
  "#dma-cells":
    const: 1
    description: The cell is the request line number.

  compatible:
    oneOf:
      - enum:
          - allwinner,sun20i-d1-dma
          - allwinner,sun50i-a64-dma
          - allwinner,sun50i-a100-dma
          - allwinner,sun50i-h6-dma
      - items:
          - const: allwinner,sun8i-r40-dma
          - const: allwinner,sun50i-a64-dma

  reg:
    maxItems: 1

  interrupts:
    maxItems: 1

  clocks:
    minItems: 1
    maxItems: 2

  clock-names:
    items:
      - const: bus
      - const: mbus

  resets:
    maxItems: 1

required:
  - "#dma-cells"
  - compatible
  - reg
  - interrupts
  - clocks
  - resets
  - dma-channels

if:
  properties:
    compatible:
      enum:
        - allwinner,sun20i-d1-dma
        - allwinner,sun50i-a100-dma
        - allwinner,sun50i-h6-dma

then:
  properties:
    clocks:
      minItems: 2

  required:
    - clock-names

else:
  properties:
    clocks:
      maxItems: 1

unevaluatedProperties: false

examples:
  - |
    dma: dma-controller@1c02000 {
        compatible = "allwinner,sun50i-a64-dma";
        reg = <0x01c02000 0x1000>;
        interrupts = <0 50 4>;
        clocks = <&ccu 30>;
        dma-channels = <8>;
        dma-requests = <27>;
        resets = <&ccu 7>;
        #dma-cells = <1>;
    };

...
```

## Documentation/devicetree/bindings/dma/allwinner,sun6i-a31-dma.yaml
```yaml
# SPDX-License-Identifier: GPL-2.0
%YAML 1.2
---
$id: http://devicetree.org/schemas/dma/allwinner,sun6i-a31-dma.yaml#
$schema: http://devicetree.org/meta-schemas/core.yaml#

title: Allwinner A31 DMA Controller

maintainers:
  - Chen-Yu Tsai <wens@csie.org>
  - Maxime Ripard <mripard@kernel.org>

allOf:
  - $ref: dma-controller.yaml#

properties:
  "#dma-cells":
    const: 1
    description: The cell is the request line number.

  compatible:
    enum:
      - allwinner,sun6i-a31-dma
      - allwinner,sun8i-a23-dma
      - allwinner,sun8i-a83t-dma
      - allwinner,sun8i-h3-dma
      - allwinner,sun8i-v3s-dma

  reg:
    maxItems: 1

  interrupts:
    maxItems: 1

  clocks:
    maxItems: 1

  resets:
    maxItems: 1

required:
  - "#dma-cells"
  - compatible
  - reg
  - interrupts
  - clocks
  - resets

additionalProperties: false

examples:
  - |
    dma: dma-controller@1c02000 {
        compatible = "allwinner,sun6i-a31-dma";
        reg = <0x01c02000 0x1000>;
        interrupts = <0 50 4>;
        clocks = <&ahb1_gates 6>;
        resets = <&ahb1_rst 6>;
        #dma-cells = <1>;
    };

...
```

## Documentation/devicetree/bindings/dma/altr,msgdma.yaml
```yaml
# SPDX-License-Identifier: GPL-2.0-only OR BSD-2-Clause
%YAML 1.2
---
$id: http://devicetree.org/schemas/dma/altr,msgdma.yaml#
$schema: http://devicetree.org/meta-schemas/core.yaml#

title: Altera mSGDMA IP core

maintainers:
  - Olivier Dautricourt <olivierdautricourt@gmail.com>

description: |
  Altera / Intel modular Scatter-Gather Direct Memory Access (mSGDMA)
  intellectual property (IP)

allOf:
  - $ref: dma-controller.yaml#

properties:
  compatible:
    const: altr,socfpga-msgdma

  reg:
    items:
      - description: Control and Status Register Slave Port
      - description: Descriptor Slave Port
      - description: Response Slave Port (Optional)
    minItems: 2

  reg-names:
    items:
      - const: csr
      - const: desc
      - const: resp
    minItems: 2

  interrupts:
    maxItems: 1

  "#dma-cells":
    const: 1
    description:
      The cell identifies the channel id (must be 0)

required:
  - compatible
  - reg
  - reg-names
  - interrupts

unevaluatedProperties: false

examples:
  - |
    #include <dt-bindings/interrupt-controller/irq.h>

    msgdma_controller: dma-controller@ff200b00 {
        compatible = "altr,socfpga-msgdma";
        reg = <0xff200b00 0x100>, <0xff200c00 0x100>, <0xff200d00 0x100>;
        reg-names = "csr", "desc", "resp";
        interrupts = <0 67 IRQ_TYPE_LEVEL_HIGH>;
        #dma-cells = <1>;
    };
```

## Documentation/devicetree/bindings/dma/apm,xgene-storm-dma.yaml
```yaml
# SPDX-License-Identifier: (GPL-2.0-only OR BSD-2-Clause)
%YAML 1.2
---
$id: http://devicetree.org/schemas/dma/apm,xgene-storm-dma.yaml#
$schema: http://devicetree.org/meta-schemas/core.yaml#

title: APM X-Gene Storm SoC DMA

maintainers:
  - Khuong Dinh <khuong@os.amperecomputing.com>

properties:
  compatible:
    const: apm,xgene-storm-dma

  reg:
    items:
      - description: DMA control and status registers
      - description: Descriptor ring control and status registers
      - description: Descriptor ring command registers
      - description: SoC efuse registers

  interrupts:
    items:
      - description: DMA error reporting interrupt
      - description: DMA channel 0 completion interrupt
      - description: DMA channel 1 completion interrupt
      - description: DMA channel 2 completion interrupt
      - description: DMA channel 3 completion interrupt

  clocks:
    maxItems: 1

  dma-coherent: true

required:
  - compatible
  - reg
  - interrupts
  - clocks

additionalProperties: false

examples:
  - |
    dma@1f270000 {
        compatible = "apm,xgene-storm-dma";
        reg = <0x1f270000 0x10000>,
              <0x1f200000 0x10000>,
              <0x1b000000 0x400000>,
              <0x1054a000 0x100>;
        interrupts = <0x0 0x82 0x4>,
                    <0x0 0xb8 0x4>,
                    <0x0 0xb9 0x4>,
                    <0x0 0xba 0x4>,
                    <0x0 0xbb 0x4>;
        dma-coherent;
        clocks = <&dmaclk 0>;
    };
```

## Documentation/devicetree/bindings/dma/apm-xgene-dma.txt
```
Applied Micro X-Gene SoC DMA nodes

DMA nodes are defined to describe on-chip DMA interfaces in
APM X-Gene SoC.

Required properties for DMA interfaces:
- compatible: Should be "apm,xgene-dma".
- device_type: set to "dma".
- reg: Address and length of the register set for the device.
  It contains the information of registers in the following order:
  1st - DMA control and status register address space.
  2nd - Descriptor ring control and status register address space.
  3rd - Descriptor ring command register address space.
  4th - Soc efuse register address space.
- interrupts: DMA has 5 interrupts sources. 1st interrupt is
  DMA error reporting interrupt. 2nd, 3rd, 4th and 5th interrupts
  are completion interrupts for each DMA channels.
- clocks: Reference to the clock entry.

Optional properties:
- dma-coherent : Present if dma operations are coherent

Example:
	dmaclk: dmaclk@1f27c000 {
		compatible = "apm,xgene-device-clock";
		#clock-cells = <1>;
		clocks = <&socplldiv2 0>;
		reg = <0x0 0x1f27c000 0x0 0x1000>;
		reg-names = "csr-reg";
		clock-output-names = "dmaclk";
	};

	dma: dma@1f270000 {
			compatible = "apm,xgene-storm-dma";
			device_type = "dma";
			reg = <0x0 0x1f270000 0x0 0x10000>,
			      <0x0 0x1f200000 0x0 0x10000>,
			      <0x0 0x1b008000 0x0 0x2000>,
			      <0x0 0x1054a000 0x0 0x100>;
			interrupts = <0x0 0x82 0x4>,
				     <0x0 0xb8 0x4>,
				     <0x0 0xb9 0x4>,
				     <0x0 0xba 0x4>,
				     <0x0 0xbb 0x4>;
			dma-coherent;
			clocks = <&dmaclk 0>;
	};
```

## Documentation/devicetree/bindings/dma/apple,admac.yaml
```yaml
# SPDX-License-Identifier: GPL-2.0-only OR BSD-2-Clause
%YAML 1.2
---
$id: http://devicetree.org/schemas/dma/apple,admac.yaml#
$schema: http://devicetree.org/meta-schemas/core.yaml#

title: Apple Audio DMA Controller (ADMAC)

description: |
  Apple's Audio DMA Controller (ADMAC) is used to fetch and store audio samples
  on SoCs from the "Apple Silicon" family.

  The controller has been seen with up to 24 channels. Even-numbered channels
  are TX-only, odd-numbered are RX-only. Individual channels are coupled to
  fixed device endpoints.

maintainers:
  - Martin Povišer <povik+lin@cutebit.org>

allOf:
  - $ref: dma-controller.yaml#

properties:
  compatible:
    items:
      - enum:
          - apple,t6000-admac
          - apple,t8103-admac
          - apple,t8112-admac
      - const: apple,admac

  reg:
    maxItems: 1

  '#dma-cells':
    const: 1
    description:
      Clients specify a single cell with channel number.

  dma-channels:
    maximum: 24

  interrupts:
    minItems: 4
    maxItems: 4
    description:
      Interrupts that correspond to the 4 IRQ outputs of the controller. Usually
      only one of the controller outputs will be connected as an usable interrupt
      source. The remaining interrupts will be left without a valid value, e.g.
      in an interrupts-extended list the disconnected positions will contain
      an empty phandle reference <0>.

  iommus:
    minItems: 1
    maxItems: 2

  power-domains:
    maxItems: 1

  resets:
    maxItems: 1

required:
  - compatible
  - reg
  - '#dma-cells'
  - dma-channels
  - interrupts

additionalProperties: false

examples:
  - |
    #include <dt-bindings/interrupt-controller/apple-aic.h>
    #include <dt-bindings/interrupt-controller/irq.h>

    aic: interrupt-controller {
      interrupt-controller;
      #interrupt-cells = <3>;
    };

    admac: dma-controller@238200000 {
      compatible = "apple,t8103-admac", "apple,admac";
      reg = <0x38200000 0x34000>;
      dma-channels = <24>;
      interrupts-extended = <0>,
                            <&aic AIC_IRQ 626 IRQ_TYPE_LEVEL_HIGH>,
                            <0>,
                            <0>;
      #dma-cells = <1>;
    };
```

## Documentation/devicetree/bindings/dma/arm,dma-350.yaml
```yaml
# SPDX-License-Identifier: (GPL-2.0-only OR BSD-2-Clause)
%YAML 1.2
---
$id: http://devicetree.org/schemas/dma/arm,dma-350.yaml#
$schema: http://devicetree.org/meta-schemas/core.yaml#

title: Arm CoreLink DMA-350 Controller

maintainers:
  - Robin Murphy <robin.murphy@arm.com>

allOf:
  - $ref: dma-controller.yaml#

properties:
  compatible:
    const: arm,dma-350

  reg:
    items:
      - description: Base and size of the full register map

  interrupts:
    minItems: 1
    items:
      - description: Channel 0 interrupt
      - description: Channel 1 interrupt
      - description: Channel 2 interrupt
      - description: Channel 3 interrupt
      - description: Channel 4 interrupt
      - description: Channel 5 interrupt
      - description: Channel 6 interrupt
      - description: Channel 7 interrupt

  "#dma-cells":
    const: 1
    description: The cell is the trigger input number

required:
  - compatible
  - reg
  - interrupts

unevaluatedProperties: false
```
