## Documentation/devicetree/bindings/display/xylon,logicvc-display.yaml
```yaml
# SPDX-License-Identifier: (GPL-2.0 OR BSD-2-Clause)
# Copyright 2019 Bootlin
%YAML 1.2
---
$id: http://devicetree.org/schemas/display/xylon,logicvc-display.yaml#
$schema: http://devicetree.org/meta-schemas/core.yaml#

title: Xylon LogiCVC display controller

maintainers:
  - Paul Kocialkowski <paul.kocialkowski@bootlin.com>

description: |
  The Xylon LogiCVC is a display controller that supports multiple layers.
  It is usually implemented as programmable logic and was optimized for use
  with Xilinx Zynq-7000 SoCs and Xilinx FPGAs.

  Because the controller is intended for use in a FPGA, most of the
  configuration of the controller takes place at logic configuration bitstream
  synthesis time. As a result, many of the device-tree bindings are meant to
  reflect the synthesis configuration and must not be configured differently.
  Matching synthesis parameters are provided when applicable.

  Layers are declared in the "layers" sub-node and have dedicated configuration.
  In version 3 of the controller, each layer has fixed memory offset and address
  starting from the video memory base address for its framebuffer. In version 4,
  framebuffers are configured with a direct memory address instead.

properties:
  compatible:
    enum:
      - xylon,logicvc-3.02.a-display
      - xylon,logicvc-4.01.a-display

  reg:
    maxItems: 1

  clocks:
    minItems: 1
    maxItems: 4

  clock-names:
    minItems: 1
    items:
      # vclk is required and must be provided as first item.
      - const: vclk
      # Other clocks are optional and can be provided in any order.
      - enum:
          - vclk2
          - lvdsclk
          - lvdsclkn
      - enum:
          - vclk2
          - lvdsclk
          - lvdsclkn
      - enum:
          - vclk2
          - lvdsclk
          - lvdsclkn

  interrupts:
    maxItems: 1

  memory-region:
    maxItems: 1

  xylon,display-interface:
    enum:
      # Parallel RGB interface (C_DISPLAY_INTERFACE == 0)
      - parallel-rgb
      # ITU-T BR656 interface (C_DISPLAY_INTERFACE == 1)
      - bt656
      # 4-bit LVDS interface (C_DISPLAY_INTERFACE == 2)
      - lvds-4bits
      # 3-bit LVDS interface (C_DISPLAY_INTERFACE == 4)
      - lvds-3bits
      # DVI interface (C_DISPLAY_INTERFACE == 5)
      - dvi
    description: Display output interface (C_DISPLAY_INTERFACE).

  xylon,display-colorspace:
    enum:
      # RGB colorspace (C_DISPLAY_COLOR_SPACE == 0)
      - rgb
      # YUV 4:2:2 colorspace (C_DISPLAY_COLOR_SPACE == 1)
      - yuv422
      # YUV 4:4:4 colorspace (C_DISPLAY_COLOR_SPACE == 2)
      - yuv444
    description: Display output colorspace (C_DISPLAY_COLOR_SPACE).

  xylon,display-depth:
    $ref: /schemas/types.yaml#/definitions/uint32
    description: Display output depth (C_PIXEL_DATA_WIDTH).

  xylon,row-stride:
    $ref: /schemas/types.yaml#/definitions/uint32
    description: Fixed number of pixels in a framebuffer row (C_ROW_STRIDE).

  xylon,dithering:
    $ref: /schemas/types.yaml#/definitions/flag
    description: Dithering module is enabled (C_XCOLOR)

  xylon,background-layer:
    $ref: /schemas/types.yaml#/definitions/flag
    description: |
      The last layer is used to display a black background (C_USE_BACKGROUND).
      The layer must still be registered.

  xylon,layers-configurable:
    $ref: /schemas/types.yaml#/definitions/flag
    description: |
      Configuration of layers' size, position and offset is enabled
      (C_USE_SIZE_POSITION).

  layers:
    type: object

    properties:
      "#address-cells":
        const: 1

      "#size-cells":
        const: 0

    patternProperties:
      "^layer@[0-9]+$":
        type: object

        properties:
          reg:
            maxItems: 1

          xylon,layer-depth:
            $ref: /schemas/types.yaml#/definitions/uint32
            description: Layer depth (C_LAYER_X_DATA_WIDTH).

          xylon,layer-colorspace:
            enum:
              # RGB colorspace (C_LAYER_X_TYPE == 0)
              - rgb
              # YUV packed colorspace (C_LAYER_X_TYPE == 0)
              - yuv
            description: Layer colorspace (C_LAYER_X_TYPE).

          xylon,layer-alpha-mode:
            enum:
              # Alpha is configured layer-wide (C_LAYER_X_ALPHA_MODE == 0)
              - layer
              # Alpha is configured per-pixel (C_LAYER_X_ALPHA_MODE == 1)
              - pixel
            description: Alpha mode for the layer (C_LAYER_X_ALPHA_MODE).

          xylon,layer-base-offset:
            $ref: /schemas/types.yaml#/definitions/uint32
            description: |
              Offset in number of lines (C_LAYER_X_OFFSET) starting from the
              video RAM base (C_VMEM_BASEADDR), only for version 3.

          xylon,layer-buffer-offset:
            $ref: /schemas/types.yaml#/definitions/uint32
            description: |
              Offset in number of lines (C_BUFFER_*_OFFSET) starting from the
              layer base offset for the second buffer used in double-buffering.

          xylon,layer-primary:
            $ref: /schemas/types.yaml#/definitions/flag
            description: |
              Layer should be registered as a primary plane (exactly one is
              required).

        additionalProperties: false

        required:
          - reg
          - xylon,layer-depth
          - xylon,layer-colorspace
          - xylon,layer-alpha-mode

    required:
      - "#address-cells"
      - "#size-cells"
      - layer@0

    additionalProperties: false

    description: |
      The description of the display controller layers, containing layer
      sub-nodes that each describe a registered layer.

  port:
    $ref: /schemas/graph.yaml#/properties/port
    description: |
      Video output port, typically connected to a panel or bridge.

additionalProperties: false

required:
  - compatible
  - reg
  - clocks
  - clock-names
  - interrupts
  - xylon,display-interface
  - xylon,display-colorspace
  - xylon,display-depth
  - xylon,row-stride
  - layers
  - port

examples:
  - |
    #include <dt-bindings/interrupt-controller/irq.h>

    logicvc: logicvc@43c00000 {
      compatible = "xylon,logicvc-3.02.a", "syscon", "simple-mfd";
      reg = <0x43c00000 0x6000>;

      #address-cells = <1>;
      #size-cells = <1>;

      logicvc_display: display@0 {
        compatible = "xylon,logicvc-3.02.a-display";
        reg = <0x0 0x6000>;

        memory-region = <&logicvc_cma>;

        clocks = <&logicvc_vclk 0>, <&logicvc_lvdsclk 0>;
        clock-names = "vclk", "lvdsclk";

        interrupt-parent = <&intc>;
        interrupts = <0 34 IRQ_TYPE_LEVEL_HIGH>;

        xylon,display-interface = "lvds-4bits";
        xylon,display-colorspace = "rgb";
        xylon,display-depth = <16>;
        xylon,row-stride = <1024>;

        xylon,layers-configurable;

        layers {
          #address-cells = <1>;
          #size-cells = <0>;

          layer@0 {
            reg = <0>;
            xylon,layer-depth = <16>;
            xylon,layer-colorspace = "rgb";
            xylon,layer-alpha-mode = "layer";
            xylon,layer-base-offset = <0>;
            xylon,layer-buffer-offset = <480>;
            xylon,layer-primary;
          };

          layer@1 {
            reg = <1>;
            xylon,layer-depth = <16>;
            xylon,layer-colorspace = "rgb";
            xylon,layer-alpha-mode = "layer";
            xylon,layer-base-offset = <2400>;
            xylon,layer-buffer-offset = <480>;
          };

          layer@2 {
            reg = <2>;
            xylon,layer-depth = <16>;
            xylon,layer-colorspace = "rgb";
            xylon,layer-alpha-mode = "layer";
            xylon,layer-base-offset = <960>;
            xylon,layer-buffer-offset = <480>;
          };

          layer@3 {
            reg = <3>;
            xylon,layer-depth = <16>;
            xylon,layer-colorspace = "rgb";
            xylon,layer-alpha-mode = "layer";
            xylon,layer-base-offset = <480>;
            xylon,layer-buffer-offset = <480>;
          };

          layer@4 {
            reg = <4>;
            xylon,layer-depth = <16>;
            xylon,layer-colorspace = "rgb";
            xylon,layer-alpha-mode = "layer";
            xylon,layer-base-offset = <8192>;
            xylon,layer-buffer-offset = <480>;
          };
        };

        port {
          #address-cells = <1>;
          #size-cells = <0>;

          logicvc_output: endpoint@0 {
            reg = <0>;
            remote-endpoint = <&panel_input>;
          };
        };
      };
    };
```

## Documentation/devicetree/bindings/display/zte,vou.txt
```
ZTE VOU Display Controller

This is a display controller found on ZTE ZX296718 SoC.  It includes multiple
Graphic Layer (GL) and Video Layer (VL), two Mixers/Channels, and a few blocks
handling scaling, color space conversion etc.  VOU also integrates the support
for typical output devices, like HDMI, TV Encoder, VGA, and RGB LCD.

* Master VOU node

It must be the parent node of all the sub-device nodes.

Required properties:
 - compatible: should be "zte,zx296718-vou"
 - #address-cells: should be <1>
 - #size-cells: should be <1>
 - ranges: list of address translations between VOU and sub-devices

* VOU DPC device

Required properties:
 - compatible: should be "zte,zx296718-dpc"
 - reg: Physical base address and length of DPC register regions, one for each
   entry in 'reg-names'
 - reg-names: The names of register regions. The following regions are required:
	"osd"
	"timing_ctrl"
	"dtrc"
	"vou_ctrl"
	"otfppu"
 - interrupts: VOU DPC interrupt number to CPU
 - clocks: A list of phandle + clock-specifier pairs, one for each entry
   in 'clock-names'
 - clock-names: A list of clock names.  The following clocks are required:
	"aclk"
	"ppu_wclk"
	"main_wclk"
	"aux_wclk"

* HDMI output device

Required properties:
 - compatible: should be "zte,zx296718-hdmi"
 - reg: Physical base address and length of the HDMI device IO region
 - interrupts : HDMI interrupt number to CPU
 - clocks: A list of phandle + clock-specifier pairs, one for each entry
   in 'clock-names'
 - clock-names: A list of clock names.  The following clocks are required:
	"osc_cec"
	"osc_clk"
	"xclk"

* TV Encoder output device

Required properties:
 - compatible: should be "zte,zx296718-tvenc"
 - reg: Physical base address and length of the TVENC device IO region
 - zte,tvenc-power-control: the phandle to SYSCTRL block followed by two
   integer cells.  The first cell is the offset of SYSCTRL register used
   to control TV Encoder DAC power, and the second cell is the bit mask.

* VGA output device

Required properties:
 - compatible: should be "zte,zx296718-vga"
 - reg: Physical base address and length of the VGA device IO region
 - interrupts : VGA interrupt number to CPU
 - clocks: Phandle with clock-specifier pointing to VGA I2C clock.
 - clock-names: Must be "i2c_wclk".
 - zte,vga-power-control: the phandle to SYSCTRL block followed by two
   integer cells.  The first cell is the offset of SYSCTRL register used
   to control VGA DAC power, and the second cell is the bit mask.

Example:

vou: vou@1440000 {
	compatible = "zte,zx296718-vou";
	#address-cells = <1>;
	#size-cells = <1>;
	ranges = <0 0x1440000 0x10000>;

	dpc: dpc@0 {
		compatible = "zte,zx296718-dpc";
		reg = <0x0000 0x1000>, <0x1000 0x1000>,
		      <0x5000 0x1000>, <0x6000 0x1000>,
		      <0xa000 0x1000>;
		reg-names = "osd", "timing_ctrl",
			    "dtrc", "vou_ctrl",
			    "otfppu";
		interrupts = <GIC_SPI 81 IRQ_TYPE_LEVEL_HIGH>;
		clocks = <&topcrm VOU_ACLK>, <&topcrm VOU_PPU_WCLK>,
			 <&topcrm VOU_MAIN_WCLK>, <&topcrm VOU_AUX_WCLK>;
		clock-names = "aclk", "ppu_wclk",
			      "main_wclk", "aux_wclk";
	};

	vga: vga@8000 {
		compatible = "zte,zx296718-vga";
		reg = <0x8000 0x1000>;
		interrupts = <GIC_SPI 86 IRQ_TYPE_LEVEL_HIGH>;
		clocks = <&topcrm VGA_I2C_WCLK>;
		clock-names = "i2c_wclk";
		zte,vga-power-control = <&sysctrl 0x170 0xe0>;
	};

	hdmi: hdmi@c000 {
		compatible = "zte,zx296718-hdmi";
		reg = <0xc000 0x4000>;
		interrupts = <GIC_SPI 82 IRQ_TYPE_EDGE_RISING>;
		clocks = <&topcrm HDMI_OSC_CEC>,
			 <&topcrm HDMI_OSC_CLK>,
			 <&topcrm HDMI_XCLK>;
		clock-names = "osc_cec", "osc_clk", "xclk";
	};

	tvenc: tvenc@2000 {
		compatible = "zte,zx296718-tvenc";
		reg = <0x2000 0x1000>;
		zte,tvenc-power-control = <&sysctrl 0x170 0x10>;
	};
};
```

## Documentation/devicetree/bindings/dma/8250_mtk_dma.txt
```
* Mediatek UART APDMA Controller

Required properties:
- compatible should contain:
  * "mediatek,mt2712-uart-dma" for MT2712 compatible APDMA
  * "mediatek,mt6577-uart-dma" for MT6577 and all of the above

- reg: The base address of the APDMA register bank.

- interrupts: A single interrupt specifier.

- clocks : Must contain an entry for each entry in clock-names.
  See ../clocks/clock-bindings.txt for details.
- clock-names: The APDMA clock for register accesses

Examples:

	apdma: dma-controller@11000380 {
		compatible = "mediatek,mt2712-uart-dma";
		reg = <0 0x11000380 0 0x400>;
		interrupts = <GIC_SPI 63 IRQ_TYPE_LEVEL_LOW>,
			     <GIC_SPI 64 IRQ_TYPE_LEVEL_LOW>,
			     <GIC_SPI 65 IRQ_TYPE_LEVEL_LOW>,
			     <GIC_SPI 66 IRQ_TYPE_LEVEL_LOW>,
			     <GIC_SPI 67 IRQ_TYPE_LEVEL_LOW>,
			     <GIC_SPI 68 IRQ_TYPE_LEVEL_LOW>,
			     <GIC_SPI 69 IRQ_TYPE_LEVEL_LOW>,
			     <GIC_SPI 70 IRQ_TYPE_LEVEL_LOW>;
		clocks = <&pericfg CLK_PERI_AP_DMA>;
		clock-names = "apdma";
		#dma-cells = <1>;
	};
```

## Documentation/devicetree/bindings/dma/adi,axi-dmac.txt
```
Analog Device AXI-DMAC DMA controller

Required properties:
 - compatible: Must be "adi,axi-dmac-1.00.a".
 - reg: Specification for the controllers memory mapped register map.
 - interrupts: Specification for the controllers interrupt.
 - clocks: Phandle and specifier to the controllers AXI interface clock
 - #dma-cells: Must be 1.

Required sub-nodes:
 - adi,channels: This sub-node must contain a sub-node for each DMA channel. For
   the channel sub-nodes the following bindings apply. They must match the
   configuration options of the peripheral as it was instantiated.

Required properties for adi,channels sub-node:
 - #size-cells: Must be 0
 - #address-cells: Must be 1

Required channel sub-node properties:
 - reg: Which channel this node refers to.
 - adi,length-width: Width of the DMA transfer length register.
 - adi,source-bus-width,
   adi,destination-bus-width: Width of the source or destination bus in bits.
 - adi,source-bus-type,
   adi,destination-bus-type: Type of the source or destination bus. Must be one
   of the following:
	0 (AXI_DMAC_TYPE_AXI_MM): Memory mapped AXI interface
	1 (AXI_DMAC_TYPE_AXI_STREAM): Streaming AXI interface
	2 (AXI_DMAC_TYPE_AXI_FIFO): FIFO interface

Optional channel properties:
 - adi,cyclic: Must be set if the channel supports hardware cyclic DMA
   transfers.
 - adi,2d: Must be set if the channel supports hardware 2D DMA transfers.

DMA clients connected to the AXI-DMAC DMA controller must use the format
described in the dma.txt file using a one-cell specifier. The value of the
specifier refers to the DMA channel index.

Example:

dma: dma@7c420000 {
	compatible = "adi,axi-dmac-1.00.a";
	reg = <0x7c420000 0x10000>;
	interrupts = <0 57 0>;
	clocks = <&clkc 16>;
	#dma-cells = <1>;

	adi,channels {
		#size-cells = <0>;
		#address-cells = <1>;

		dma-channel@0 {
			reg = <0>;
			adi,source-bus-width = <32>;
			adi,source-bus-type = <ADI_AXI_DMAC_TYPE_MM_AXI>;
			adi,destination-bus-width = <64>;
			adi,destination-bus-type = <ADI_AXI_DMAC_TYPE_FIFO>;
		};
	};
};
```
