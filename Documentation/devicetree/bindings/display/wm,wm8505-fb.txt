## Documentation/devicetree/bindings/dma/arm,pl330.yaml
```yaml
# SPDX-License-Identifier: GPL-2.0
%YAML 1.2
---
$id: http://devicetree.org/schemas/dma/arm,pl330.yaml#
$schema: http://devicetree.org/meta-schemas/core.yaml#

title: ARM PrimeCell PL330 DMA Controller

maintainers:
  - Vinod Koul <vkoul@kernel.org>

description:
  The ARM PrimeCell PL330 DMA controller can move blocks of memory contents
  between memory and peripherals or memory to memory.

# We need a select here so we don't match all nodes with 'arm,primecell'
select:
  properties:
    compatible:
      contains:
        const: arm,pl330
  required:
    - compatible

allOf:
  - $ref: dma-controller.yaml#
  - $ref: /schemas/arm/primecell.yaml#

properties:
  compatible:
    items:
      - enum:
          - arm,pl330
      - const: arm,primecell

  reg:
    maxItems: 1

  interrupts:
    minItems: 1
    maxItems: 32
    description: A single combined interrupt or an interrupt per event

  '#dma-cells':
    const: 1
    description: Contains the DMA request number for the consumer

  arm,pl330-broken-no-flushp:
    type: boolean
    description: quirk for avoiding to execute DMAFLUSHP

  arm,pl330-periph-burst:
    type: boolean
    description: quirk for performing burst transfer only

  dma-coherent: true

  power-domains:
    maxItems: 1

  resets:
    minItems: 1
    maxItems: 2

  reset-names:
    minItems: 1
    items:
      - const: dma
      - const: dma-ocp

required:
  - compatible
  - reg
  - interrupts

unevaluatedProperties: false

examples:
  - |
    dma-controller@12680000 {
        compatible = "arm,pl330", "arm,primecell";
        reg = <0x12680000 0x1000>;
        interrupts = <99>;
        #dma-cells = <1>;
    };
...
```

## Documentation/devicetree/bindings/dma/arm-pl08x.txt
```
* ARM PrimeCells PL080 and PL081 and derivatives DMA controller

Required properties:
- compatible: "arm,pl080", "arm,primecell";
	      "arm,pl081", "arm,primecell";
	      "faraday,ftdmac020", "arm,primecell"
- arm,primecell-periphid: on the FTDMAC020 the primecell ID is not hard-coded
  in the hardware and must be specified here as <0x0003b080>. This number
  follows the PrimeCell standard numbering using the JEP106 vendor code 0x38
  for Faraday Technology.
- reg: Address range of the PL08x registers
- interrupt: The PL08x interrupt number
- clocks: The clock running the IP core clock
- clock-names: Must contain "apb_pclk"
- lli-bus-interface-ahb1: if AHB master 1 is eligible for fetching LLIs
- lli-bus-interface-ahb2: if AHB master 2 is eligible for fetching LLIs
- mem-bus-interface-ahb1: if AHB master 1 is eligible for fetching memory contents
- mem-bus-interface-ahb2: if AHB master 2 is eligible for fetching memory contents
- #dma-cells: must be <2>. First cell should contain the DMA request,
              second cell should contain either 1 or 2 depending on
              which AHB master that is used.

Optional properties:
- dma-channels: contains the total number of DMA channels supported by the DMAC
- dma-requests: contains the total number of DMA requests supported by the DMAC
- memcpy-burst-size: the size of the bursts for memcpy: 1, 4, 8, 16, 32
  64, 128 or 256 bytes are legal values
- memcpy-bus-width: the bus width used for memcpy in bits: 8, 16 or 32 are legal
  values, the Faraday FTDMAC020 can also accept 64 bits

Clients
Required properties:
- dmas: List of DMA controller phandle, request channel and AHB master id
- dma-names: Names of the aforementioned requested channels

Example:

dmac0: dma-controller@10130000 {
	compatible = "arm,pl080", "arm,primecell";
	reg = <0x10130000 0x1000>;
	interrupt-parent = <&vica>;
	interrupts = <15>;
	clocks = <&hclkdma0>;
	clock-names = "apb_pclk";
	lli-bus-interface-ahb1;
	lli-bus-interface-ahb2;
	mem-bus-interface-ahb2;
	memcpy-burst-size = <256>;
	memcpy-bus-width = <32>;
	#dma-cells = <2>;
};

device@40008000 {
	...
	dmas = <&dmac0 0 2
		&dmac0 1 2>;
	dma-names = "tx", "rx";
	...
};
```

## Documentation/devicetree/bindings/dma/arm-pl08x.yaml
```yaml
# SPDX-License-Identifier: (GPL-2.0-only OR BSD-2-Clause)
%YAML 1.2
---
$id: http://devicetree.org/schemas/dma/arm-pl08x.yaml#
$schema: http://devicetree.org/meta-schemas/core.yaml#

title: ARM PrimeCells PL080 and PL081 and derivatives DMA controller

maintainers:
  - Vinod Koul <vkoul@kernel.org>

allOf:
  - $ref: /schemas/arm/primecell.yaml#
  - $ref: "dma-controller.yaml#"

# We need a select here so we don't match all nodes with 'arm,primecell'
select:
  properties:
    compatible:
      contains:
        enum:
          - arm,pl080
          - arm,pl081
  required:
    - compatible

properties:
  compatible:
    oneOf:
      - items:
          - enum:
              - arm,pl080
              - arm,pl081
          - const: arm,primecell
      - items:
          - const: faraday,ftdma020
          - const: arm,pl080
          - const: arm,primecell

  reg:
    maxItems: 1
    description: Address range of the PL08x registers

  interrupts:
    minItems: 1
    description: The PL08x interrupt number

  clocks:
    minItems: 1
    description: The clock running the IP core clock

  clock-names:
    maxItems: 1

  lli-bus-interface-ahb1:
    type: boolean
    description: if AHB master 1 is eligible for fetching LLIs

  lli-bus-interface-ahb2:
    type: boolean
    description: if AHB master 2 is eligible for fetching LLIs

  mem-bus-interface-ahb1:
    type: boolean
    description: if AHB master 1 is eligible for fetching memory contents

  mem-bus-interface-ahb2:
    type: boolean
    description: if AHB master 2 is eligible for fetching memory contents

  memcpy-burst-size:
    $ref: /schemas/types.yaml#/definitions/uint32
    enum:
      - 1
      - 4
      - 8
      - 16
      - 32
      - 64
      - 128
      - 256
    description: the size of the bursts for memcpy

  memcpy-bus-width:
    $ref: /schemas/types.yaml#/definitions/uint32
    enum:
      - 8
      - 16
      - 32
      - 64
    description: bus width used for memcpy in bits. FTDMAC020 also accept 64 bits

  resets:
    maxItems: 1

required:
  - reg
  - interrupts
  - clocks
  - clock-names
  - "#dma-cells"

unevaluatedProperties: false

examples:
  - |
    dmac0: dma-controller@10130000 {
      compatible = "arm,pl080", "arm,primecell";
      reg = <0x10130000 0x1000>;
      interrupt-parent = <&vica>;
      interrupts = <15>;
      clocks = <&hclkdma0>;
      clock-names = "apb_pclk";
      lli-bus-interface-ahb1;
      lli-bus-interface-ahb2;
      mem-bus-interface-ahb2;
      memcpy-burst-size = <256>;
      memcpy-bus-width = <32>;
      #dma-cells = <2>;
    };
  - |
    #include <dt-bindings/interrupt-controller/irq.h>
    #include <dt-bindings/reset/cortina,gemini-reset.h>
    #include <dt-bindings/clock/cortina,gemini-clock.h>
    dma-controller@67000000 {
      compatible = "faraday,ftdma020", "arm,pl080", "arm,primecell";
      /* Faraday Technology FTDMAC020 variant */
      arm,primecell-periphid = <0x0003b080>;
      reg = <0x67000000 0x1000>;
      interrupts = <9 IRQ_TYPE_EDGE_RISING>;
      resets = <&syscon GEMINI_RESET_DMAC>;
      clocks = <&syscon GEMINI_CLK_AHB>;
      clock-names = "apb_pclk";
      /* Bus interface AHB1 (AHB0) is totally tilted */
      lli-bus-interface-ahb2;
      mem-bus-interface-ahb2;
      memcpy-burst-size = <256>;
      memcpy-bus-width = <32>;
      #dma-cells = <2>;
    };
```

## Documentation/devicetree/bindings/dma/arm-pl330.txt
```
* ARM PrimeCell PL330 DMA Controller

The ARM PrimeCell PL330 DMA controller can move blocks of memory contents
between memory and peripherals or memory to memory.

Required properties:
  - compatible: should include both "arm,pl330" and "arm,primecell".
  - reg: physical base address of the controller and length of memory mapped
    region.
  - interrupts: interrupt number to the cpu.

Optional properties:
  - dma-coherent      : Present if dma operations are coherent
  - #dma-cells: must be <1>. used to represent the number of integer
    cells in the dmas property of client device.
  - dma-channels: contains the total number of DMA channels supported by the DMAC
  - dma-requests: contains the total number of DMA requests supported by the DMAC
  - arm,pl330-broken-no-flushp: quirk for avoiding to execute DMAFLUSHP
  - resets: contains an entry for each entry in reset-names.
	    See ../reset/reset.txt for details.
  - reset-names: must contain at least "dma", and optional is "dma-ocp".

Example:

	pdma0: pdma@12680000 {
		compatible = "arm,pl330", "arm,primecell";
		reg = <0x12680000 0x1000>;
		interrupts = <99>;
		#dma-cells = <1>;
		#dma-channels = <8>;
		#dma-requests = <32>;
	};

Client drivers (device nodes requiring dma transfers from dev-to-mem or
mem-to-dev) should specify the DMA channel numbers and dma channel names
as shown below.

  [property name]  = <[phandle of the dma controller] [dma request id]>;
  [property name]  = <[dma channel name]>

      where 'dma request id' is the dma request number which is connected
      to the client controller. The 'property name' 'dmas' and 'dma-names'
      as required by the generic dma device tree binding helpers. The dma
      names correspond 1:1 with the dma request ids in the dmas property.

  Example:  dmas = <&pdma0 12
		    &pdma1 11>;
	    dma-names = "tx", "rx";
```

## Documentation/devicetree/bindings/dma/aspeed,ast2600-udma.yaml
```yaml
# SPDX-License-Identifier: (GPL-2.0-only OR BSD-2-Clause)
%YAML 1.2
---
$id: http://devicetree.org/schemas/dma/aspeed,ast2600-udma.yaml#
$schema: http://devicetree.org/meta-schemas/core.yaml#

title: Aspeed AST2600 UART DMA controller

maintainers:
  - Chia-Wei Wang <chiawei_wang@aspeedtech.com>

description: |
  The Aspeed AST2600 UDMA controller provides direct memory access capabilities
  for the NS16550A-compatible UART devices inside AST2600 SoCs. UDMA supports 28
  DMA channels and each UART device has its dedicated pair of TX and RX channels.

allOf:
  - $ref: "dma-controller.yaml#"

properties:
  compatible:
    const: aspeed,ast2600-udma

  reg:
    maxItems: 1

  interrupts:
    maxItems: 1

  "#dma-cells":
    const: 1

  dma-channels:
    maximum: 28

required:
  - compatible
  - reg
  - interrupts
  - "#dma-cells"
  - dma-channels

additionalProperties: false

examples:
  - |
    #include <dt-bindings/interrupt-controller/arm-gic.h>
    udma: dma-controller@1e79e000 {
        compatible = "aspeed,ast2600-udma";
        reg = <0x1e79e000 0x1000>;
        interrupts = <GIC_SPI 56 IRQ_TYPE_LEVEL_HIGH>;
        dma-channels = <28>;
        #dma-cells = <1>;
    };

...
```

## Documentation/devicetree/bindings/dma/atmel,at91sam9g45-dma.yaml
```yaml
# SPDX-License-Identifier: (GPL-2.0-only OR BSD-2-Clause)
%YAML 1.2
---
$id: http://devicetree.org/schemas/dma/atmel,at91sam9g45-dma.yaml#
$schema: http://devicetree.org/meta-schemas/core.yaml#

title: Atmel Direct Memory Access Controller (DMA)

maintainers:
  - Ludovic Desroches <ludovic.desroches@microchip.com>

description:
  The Atmel Direct Memory Access Controller (DMAC) transfers data from a source
  peripheral to a destination peripheral over one or more AMBA buses. One channel
  is required for each source/destination pair. In the most basic configuration,
  the DMAC has one master interface and one channel. The master interface reads
  the data from a source and writes it to a destination. Two AMBA transfers are
  required for each DMAC data transfer. This is also known as a dual-access transfer.
  The DMAC is programmed via the APB interface.

properties:
  compatible:
    enum:
      - atmel,at91sam9g45-dma
      - atmel,at91sam9rl-dma

  reg:
    maxItems: 1

  interrupts:
    maxItems: 1

  "#dma-cells":
    description:
      Must be <2>, used to represent the number of integer cells in the dma
      property of client devices. The two cells in order are
      1. The first cell represents the channel number.
      2. The second cell is 0 for RX and 1 for TX transfers.
    const: 2

  clocks:
    maxItems: 1

  clock-names:
    const: dma_clk

required:
  - compatible
  - reg
  - interrupts
  - "#dma-cells"
  - clocks
  - clock-names

additionalProperties: false

examples:
  - |
    dma-controller@ffffec00 {
        compatible = "atmel,at91sam9g45-dma";
        reg = <0xffffec00 0x200>;
        interrupts = <21>;
        #dma-cells = <2>;
        clocks = <&pmc 2 20>;
        clock-names = "dma_clk";
    };

...
```

## Documentation/devicetree/bindings/dma/atmel,sama5d4-dma.yaml
```yaml
# SPDX-License-Identifier: (GPL-2.0-only OR BSD-2-Clause)
%YAML 1.2
---
$id: http://devicetree.org/schemas/dma/atmel,sama5d4-dma.yaml#
$schema: http://devicetree.org/meta-schemas/core.yaml#

title: Microchip AT91 Extensible Direct Memory Access Controller

maintainers:
  - Nicolas Ferre <nicolas.ferre@microchip.com>
  - Charan Pedumuru <charan.pedumuru@microchip.com>

description:
  The DMA Controller (XDMAC) is a AHB-protocol central direct memory access
  controller. It performs peripheral data transfer and memory move operations
  over one or two bus ports through the unidirectional communication
  channel. Each channel is fully programmable and provides both peripheral
  or memory-to-memory transfers. The channel features are configurable at
  implementation.

allOf:
  - $ref: dma-controller.yaml#

properties:
  compatible:
    oneOf:
      - enum:
          - atmel,sama5d4-dma
          - microchip,sama7g5-dma
      - items:
          - enum:
              - microchip,sam9x60-dma
              - microchip,sam9x7-dma
          - const: atmel,sama5d4-dma

  "#dma-cells":
    description: |
      Represents the number of integer cells in the `dmas` property of client
      devices. The single cell specifies the channel configuration register:
        - bit 13: SIF (Source Interface Identifier) for memory interface.
        - bit 14: DIF (Destination Interface Identifier) for peripheral interface.
        - bit 30-24: PERID (Peripheral Identifier).
    const: 1

  reg:
    maxItems: 1

  interrupts:
    maxItems: 1

  clocks:
    maxItems: 1

  clock-names:
    const: dma_clk

required:
  - compatible
  - reg
  - interrupts
  - clocks
  - clock-names
  - "#dma-cells"

unevaluatedProperties: false

examples:
  - |
    #include <dt-bindings/clock/at91.h>
    #include <dt-bindings/dma/at91.h>
    #include <dt-bindings/interrupt-controller/irq.h>
    dma-controller@f0008000 {
        compatible = "atmel,sama5d4-dma";
        reg = <0xf0008000 0x1000>;
        interrupts = <20 IRQ_TYPE_LEVEL_HIGH 0>;
        #dma-cells = <1>;
        clocks = <&pmc PMC_TYPE_PERIPHERAL 20>;
        clock-names = "dma_clk";
    };
```
