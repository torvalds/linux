## Documentation/devicetree/bindings/display/rockchip/cdn-dp-rockchip.txt
```
Rockchip RK3399 specific extensions to the cdn Display Port
================================

Required properties:
- compatible: must be "rockchip,rk3399-cdn-dp"

- reg: physical base address of the controller and length

- clocks: from common clock binding: handle to dp clock.

- clock-names: from common clock binding:
	       Required elements: "core-clk" "pclk" "spdif" "grf"

- resets : a list of phandle + reset specifier pairs
- reset-names : string of reset names
		Required elements: "apb", "core", "dptx", "spdif"
- power-domains : power-domain property defined with a phandle
		  to respective power domain.
- assigned-clocks: main clock, should be <&cru SCLK_DP_CORE>
- assigned-clock-rates : the DP core clk frequency, shall be: 100000000

- rockchip,grf: this soc should set GRF regs, so need get grf here.

- ports: contain a port nodes with endpoint definitions as defined in
	 Documentation/devicetree/bindings/media/video-interfaces.txt.
	 contained 2 endpoints, connecting to the output of vop.

- phys: from general PHY binding: the phandle for the PHY device.

- extcon: extcon specifier for the Power Delivery

- #sound-dai-cells = it must be 1 if your system is using 2 DAIs: I2S, SPDIF

-------------------------------------------------------------------------------

Example:
	cdn_dp: dp@fec00000 {
		compatible = "rockchip,rk3399-cdn-dp";
		reg = <0x0 0xfec00000 0x0 0x100000>;
		interrupts = <GIC_SPI 9 IRQ_TYPE_LEVEL_HIGH>;
		clocks = <&cru SCLK_DP_CORE>, <&cru PCLK_DP_CTRL>,
			 <&cru SCLK_SPDIF_REC_DPTX>, <&cru PCLK_VIO_GRF>;
		clock-names = "core-clk", "pclk", "spdif", "grf";
		assigned-clocks = <&cru SCLK_DP_CORE>;
		assigned-clock-rates = <100000000>;
		power-domains = <&power RK3399_PD_HDCP>;
		phys = <&tcphy0_dp>, <&tcphy1_dp>;
		resets = <&cru SRST_DPTX_SPDIF_REC>;
		reset-names = "spdif";
		extcon = <&fusb0>, <&fusb1>;
		rockchip,grf = <&grf>;
		#address-cells = <1>;
		#size-cells = <0>;
		#sound-dai-cells = <1>;

		ports {
			#address-cells = <1>;
			#size-cells = <0>;

			dp_in: port {
				#address-cells = <1>;
				#size-cells = <0>;
				dp_in_vopb: endpoint@0 {
					reg = <0>;
					remote-endpoint = <&vopb_out_dp>;
				};

				dp_in_vopl: endpoint@1 {
					reg = <1>;
					remote-endpoint = <&vopl_out_dp>;
				};
			};
		};
	};
```

## Documentation/devicetree/bindings/display/rockchip/dw_hdmi-rockchip.txt
```
Rockchip DWC HDMI TX Encoder
============================

The HDMI transmitter is a Synopsys DesignWare HDMI 1.4 TX controller IP
with a companion PHY IP.

These DT bindings follow the Synopsys DWC HDMI TX bindings defined in
Documentation/devicetree/bindings/display/bridge/dw_hdmi.txt with the
following device-specific properties.


Required properties:

- compatible: should be one of the following:
		"rockchip,rk3288-dw-hdmi"
		"rockchip,rk3328-dw-hdmi"
		"rockchip,rk3399-dw-hdmi"
- reg: See dw_hdmi.txt.
- reg-io-width: See dw_hdmi.txt. Shall be 4.
- interrupts: HDMI interrupt number
- clocks: See dw_hdmi.txt.
- clock-names: Shall contain "iahb" and "isfr" as defined in dw_hdmi.txt.
- ports: See dw_hdmi.txt. The DWC HDMI shall have a single port numbered 0
  corresponding to the video input of the controller. The port shall have two
  endpoints, numbered 0 and 1, connected respectively to the vopb and vopl.
- rockchip,grf: Shall reference the GRF to mux vopl/vopb.

Optional properties

- ddc-i2c-bus: The HDMI DDC bus can be connected to either a system I2C master
  or the functionally-reduced I2C master contained in the DWC HDMI. When
  connected to a system I2C master this property contains a phandle to that
  I2C master controller.
- clock-names: See dw_hdmi.txt. The "cec" clock is optional.
- clock-names: May contain "cec" as defined in dw_hdmi.txt.
- clock-names: May contain "grf", power for grf io.
- clock-names: May contain "vpll", external clock for some hdmi phy.
- phys: from general PHY binding: the phandle for the PHY device.
- phy-names: Should be "hdmi" if phys references an external phy.

Optional pinctrl entry:
- If you have both a "unwedge" and "default" pinctrl entry, dw_hdmi
  will switch to the unwedge pinctrl state for 10ms if it ever gets an
  i2c timeout.  It's intended that this unwedge pinctrl entry will
  cause the SDA line to be driven low to work around a hardware
  errata.

Example:

hdmi: hdmi@ff980000 {
	compatible = "rockchip,rk3288-dw-hdmi";
	reg = <0xff980000 0x20000>;
	reg-io-width = <4>;
	ddc-i2c-bus = <&i2c5>;
	rockchip,grf = <&grf>;
	interrupts = <GIC_SPI 103 IRQ_TYPE_LEVEL_HIGH>;
	clocks = <&cru  PCLK_HDMI_CTRL>, <&cru SCLK_HDMI_HDCP>;
	clock-names = "iahb", "isfr";
	ports {
		hdmi_in: port {
			#address-cells = <1>;
			#size-cells = <0>;
			hdmi_in_vopb: endpoint@0 {
				reg = <0>;
				remote-endpoint = <&vopb_out_hdmi>;
			};
			hdmi_in_vopl: endpoint@1 {
				reg = <1>;
				remote-endpoint = <&vopl_out_hdmi>;
			};
		};
	};
};
```

## Documentation/devicetree/bindings/display/rockchip/dw_mipi_dsi_rockchip.txt
```
Rockchip specific extensions to the Synopsys Designware MIPI DSI
================================

Required properties:
- #address-cells: Should be <1>.
- #size-cells: Should be <0>.
- compatible: one of
	"rockchip,px30-mipi-dsi", "snps,dw-mipi-dsi"
	"rockchip,rk3288-mipi-dsi", "snps,dw-mipi-dsi"
	"rockchip,rk3399-mipi-dsi", "snps,dw-mipi-dsi"
- reg: Represent the physical address range of the controller.
- interrupts: Represent the controller's interrupt to the CPU(s).
- clocks, clock-names: Phandles to the controller's pll reference
  clock(ref) when using an internal dphy and APB clock(pclk).
  For RK3399, a phy config clock (phy_cfg) and a grf clock(grf)
  are required. As described in [1].
- rockchip,grf: this soc should set GRF regs to mux vopl/vopb.
- ports: contain a port node with endpoint definitions as defined in [2].
  For vopb,set the reg = <0> and set the reg = <1> for vopl.
- video port 0 for the VOP input, the remote endpoint maybe vopb or vopl
- video port 1 for either a panel or subsequent encoder

Optional properties:
- phys: from general PHY binding: the phandle for the PHY device.
- phy-names: Should be "dphy" if phys references an external phy.
- #phy-cells: Defined when used as ISP phy, should be 0.
- power-domains: a phandle to mipi dsi power domain node.
- resets: list of phandle + reset specifier pairs, as described in [3].
- reset-names: string reset name, must be "apb".

[1] Documentation/devicetree/bindings/clock/clock-bindings.txt
[2] Documentation/devicetree/bindings/media/video-interfaces.txt
[3] Documentation/devicetree/bindings/reset/reset.txt

Example:
	mipi_dsi: mipi@ff960000 {
		#address-cells = <1>;
		#size-cells = <0>;
		compatible = "rockchip,rk3288-mipi-dsi", "snps,dw-mipi-dsi";
		reg = <0xff960000 0x4000>;
		interrupts = <GIC_SPI 83 IRQ_TYPE_LEVEL_HIGH>;
		clocks = <&cru SCLK_MIPI_24M>, <&cru PCLK_MIPI_DSI0>;
		clock-names = "ref", "pclk";
		resets = <&cru SRST_MIPIDSI0>;
		reset-names = "apb";
		rockchip,grf = <&grf>;

		ports {
			#address-cells = <1>;
			#size-cells = <0>;

			mipi_in: port@0 {
				reg = <0>;
				#address-cells = <1>;
				#size-cells = <0>;

				mipi_in_vopb: endpoint@0 {
					reg = <0>;
					remote-endpoint = <&vopb_out_mipi>;
				};
				mipi_in_vopl: endpoint@1 {
					reg = <1>;
					remote-endpoint = <&vopl_out_mipi>;
				};
			};

			mipi_out: port@1 {
				reg = <1>;
				#address-cells = <1>;
				#size-cells = <0>;

				mipi_out_panel: endpoint {
					remote-endpoint = <&panel_in_mipi>;
				};
			};
		};

		panel {
			compatible ="boe,tv080wum-nl0";
			reg = <0>;

			enable-gpios = <&gpio7 3 GPIO_ACTIVE_HIGH>;
			pinctrl-names = "default";
			pinctrl-0 = <&lcd_en>;
			backlight = <&backlight>;

			port {
				panel_in_mipi: endpoint {
					remote-endpoint = <&mipi_out_panel>;
				};
			};
		};
	};
```

## Documentation/devicetree/bindings/display/rockchip/inno_hdmi-rockchip.txt
```
Rockchip specific extensions to the Innosilicon HDMI
================================

Required properties:
- compatible:
	"rockchip,rk3036-inno-hdmi";
	"rockchip,rk3128-inno-hdmi";
	"rockchip,rk618-inno-hdmi";
- reg:
	Physical base address and length of the controller's registers.
- clocks, clock-names:
	For Rockchip RK3036:
	Phandle to hdmi controller clock, name should be "aclk" and "pclk".
	For Rockchip RK618:
	handle to hdmi controller clock, name should be "hdmi".
- interrupts:
	HDMI interrupt number
- ports:
	Contain one port node with endpoint definitions as defined in
	Documentation/devicetree/bindings/graph.txt.
- pinctrl-0, pinctrl-name:
	Switch the iomux of HPD/CEC pins to HDMI function.

Example:

For Rockchip RK3036:
hdmi: hdmi@20034000 {
	compatible = "rockchip,rk3036-inno-hdmi";
	reg = <0x20034000 0x4000>;
	interrupts = <GIC_SPI 45 IRQ_TYPE_LEVEL_HIGH>;
	clocks = <&cru ACLK_VIO>, <&cru PCLK_HDMI>;
	clock-names = "aclk", "pclk";
	pinctrl-names = "default";
	pinctrl-0 = <&hdmi_ctl>;
	status = "disabled";

	hdmi_in: port {
		#address-cells = <1>;
		#size-cells = <0>;
		hdmi_in_lcdc: endpoint@0 {
			reg = <0>;
			remote-endpoint = <&lcdc_out_hdmi>;
		};
	};
};

&pinctrl {
	hdmi {
		hdmi_ctl: hdmi-ctl {
			rockchip,pins = <1 8  RK_FUNC_1 &pcfg_pull_none>,
					<1 9  RK_FUNC_1 &pcfg_pull_none>,
					<1 10 RK_FUNC_1 &pcfg_pull_none>,
					<1 11 RK_FUNC_1 &pcfg_pull_none>;
		};
	};

};

For Rockchip RK618:

&rk618 {
	HDMI: hdmi {
		compatible = "rockchip,rk618-inno-hdmi";
		clocks = <&CRU HDMI_CLK>;
		clock-names = "hdmi";
		interrupt-parent = <&gpio3>;
		interrupts = <23 IRQ_TYPE_LEVEL_HIGH>;
		status = "okay";

		ports {
			#address-cells = <1>;
			#size-cells = <0>;

			port@0 {
				reg = <0>;

				hdmi_input_vop: endpoint {
					remote-endpoint = <&vop_output_hdmi>;
				};
			};

			port@1 {
				reg = <1>;
				#address-cells = <1>;
				#size-cells = <0>;

				hdmi_output_vif: endpoint@0 {
					reg = <0>;
					remote-endpoint = <&vif_input_hdmi>;
					status = "disabled";
				};

				hdmi_output_lvds: endpoint@1 {
					reg = <1>;
					remote-endpoint = <&lvds_input_hdmi>;
					status = "okay";
				};
			};
		};
	};
};
```

## Documentation/devicetree/bindings/display/rockchip/rockchip,analogix-dp.yaml
```yaml
# SPDX-License-Identifier: GPL-2.0
%YAML 1.2
---
$id: http://devicetree.org/schemas/display/rockchip/rockchip,analogix-dp.yaml#
$schema: http://devicetree.org/meta-schemas/core.yaml#

title: Rockchip specific extensions to the Analogix Display Port

maintainers:
  - Sandy Huang <hjc@rock-chips.com>
  - Heiko Stuebner <heiko@sntech.de>

properties:
  compatible:
    enum:
      - rockchip,rk3288-dp
      - rockchip,rk3399-edp
      - rockchip,rk3588-edp

  clocks:
    minItems: 2
    maxItems: 3

  clock-names:
    minItems: 2
    items:
      - const: dp
      - const: pclk
      - const: grf

  power-domains:
    maxItems: 1

  resets:
    minItems: 1
    maxItems: 2

  reset-names:
    minItems: 1
    items:
      - const: dp
      - const: apb

  rockchip,grf:
    $ref: /schemas/types.yaml#/definitions/phandle
    description:
      This SoC makes use of GRF regs.

  aux-bus:
    $ref: /schemas/display/dp-aux-bus.yaml#

required:
  - compatible
  - clocks
  - clock-names
  - resets
  - reset-names
  - rockchip,grf

allOf:
  - $ref: /schemas/display/bridge/analogix,dp.yaml#

  - if:
      properties:
        compatible:
          contains:
            enum:
              - rockchip,rk3588-edp
    then:
      properties:
        resets:
          minItems: 2
        reset-names:
          minItems: 2

unevaluatedProperties: false

examples:
  - |
    #include <dt-bindings/clock/rk3288-cru.h>
    #include <dt-bindings/interrupt-controller/arm-gic.h>
    #include <dt-bindings/interrupt-controller/irq.h>
    dp@ff970000 {
      compatible = "rockchip,rk3288-dp";
      reg = <0xff970000 0x4000>;
      interrupts = <GIC_SPI 98 IRQ_TYPE_LEVEL_HIGH>;
      clocks = <&cru SCLK_EDP>, <&cru PCLK_EDP_CTRL>;
      clock-names = "dp", "pclk";
      phys = <&dp_phy>;
      phy-names = "dp";
      resets = <&cru 111>;
      reset-names = "dp";
      rockchip,grf = <&grf>;
      pinctrl-0 = <&edp_hpd>;
      pinctrl-names = "default";

      ports {
        #address-cells = <1>;
        #size-cells = <0>;

        edp_in: port@0 {
          reg = <0>;
          #address-cells = <1>;
          #size-cells = <0>;

          edp_in_vopb: endpoint@0 {
            reg = <0>;
            remote-endpoint = <&vopb_out_edp>;
          };
          edp_in_vopl: endpoint@1 {
            reg = <1>;
            remote-endpoint = <&vopl_out_edp>;
          };
        };

        edp_out: port@1 {
          reg = <1>;

          edp_out_panel: endpoint {
            remote-endpoint = <&panel_in_edp>;
          };
        };
      };
    };
```
