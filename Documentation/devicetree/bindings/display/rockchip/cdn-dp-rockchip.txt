## Documentation/devicetree/bindings/display/rockchip/rockchip,rk3588-dw-hdmi-qp.yaml
```yaml
# SPDX-License-Identifier: (GPL-2.0-only OR BSD-2-Clause)
%YAML 1.2
---
$id: http://devicetree.org/schemas/display/rockchip/rockchip,rk3588-dw-hdmi-qp.yaml#
$schema: http://devicetree.org/meta-schemas/core.yaml#

title: Rockchip DW HDMI QP TX Encoder

maintainers:
  - Cristian Ciocaltea <cristian.ciocaltea@collabora.com>

description: |
  Rockchip RK3588 SoC integrates the Synopsys DesignWare HDMI QP TX controller
  IP and a HDMI/eDP TX Combo PHY based on a Samsung IP block, providing the
  following features, among others:

  * Fixed Rate Link (FRL)
  * Display Stream Compression (DSC)
  * 4K@120Hz and 8K@60Hz video modes
  * Variable Refresh Rate (VRR) including Quick Media Switching (QMS)
  * Fast Vactive (FVA)
  * SCDC I2C DDC access
  * Multi-stream audio
  * Enhanced Audio Return Channel (EARC)

allOf:
  - $ref: /schemas/sound/dai-common.yaml#

properties:
  compatible:
    enum:
      - rockchip,rk3576-dw-hdmi-qp
      - rockchip,rk3588-dw-hdmi-qp

  reg:
    maxItems: 1

  clocks:
    items:
      - description: Peripheral/APB bus clock
      - description: EARC RX biphase clock
      - description: Reference clock
      - description: Audio interface clock
      - description: TMDS/FRL link clock
      - description: Video datapath clock

  clock-names:
    items:
      - const: pclk
      - const: earc
      - const: ref
      - const: aud
      - const: hdp
      - const: hclk_vo1

  interrupts:
    items:
      - description: AVP Unit interrupt
      - description: CEC interrupt
      - description: eARC RX interrupt
      - description: Main Unit interrupt
      - description: HPD interrupt

  interrupt-names:
    items:
      - const: avp
      - const: cec
      - const: earc
      - const: main
      - const: hpd

  phys:
    maxItems: 1
    description: The HDMI/eDP PHY

  ports:
    $ref: /schemas/graph.yaml#/properties/ports

    properties:
      port@0:
        $ref: /schemas/graph.yaml#/properties/port
        description: Video port for RGB/YUV input.

      port@1:
        $ref: /schemas/graph.yaml#/properties/port
        description: Video port for HDMI/eDP output.

    required:
      - port@0
      - port@1

  power-domains:
    maxItems: 1

  resets:
    maxItems: 2

  reset-names:
    items:
      - const: ref
      - const: hdp

  "#sound-dai-cells":
    const: 0

  rockchip,grf:
    $ref: /schemas/types.yaml#/definitions/phandle
    description:
      Some HDMI QP related data is accessed through SYS GRF regs.

  rockchip,vo-grf:
    $ref: /schemas/types.yaml#/definitions/phandle
    description:
      Additional HDMI QP related data is accessed through VO GRF regs.

required:
  - compatible
  - reg
  - clocks
  - clock-names
  - interrupts
  - interrupt-names
  - phys
  - ports
  - resets
  - reset-names
  - rockchip,grf
  - rockchip,vo-grf

unevaluatedProperties: false

examples:
  - |
    #include <dt-bindings/clock/rockchip,rk3588-cru.h>
    #include <dt-bindings/interrupt-controller/arm-gic.h>
    #include <dt-bindings/interrupt-controller/irq.h>
    #include <dt-bindings/power/rk3588-power.h>
    #include <dt-bindings/reset/rockchip,rk3588-cru.h>

    soc {
      #address-cells = <2>;
      #size-cells = <2>;

      hdmi@fde80000 {
        compatible = "rockchip,rk3588-dw-hdmi-qp";
        reg = <0x0 0xfde80000 0x0 0x20000>;
        clocks = <&cru PCLK_HDMITX0>,
                 <&cru CLK_HDMITX0_EARC>,
                 <&cru CLK_HDMITX0_REF>,
                 <&cru MCLK_I2S5_8CH_TX>,
                 <&cru CLK_HDMIHDP0>,
                 <&cru HCLK_VO1>;
        clock-names = "pclk", "earc", "ref", "aud", "hdp", "hclk_vo1";
        interrupts = <GIC_SPI 169 IRQ_TYPE_LEVEL_HIGH 0>,
                     <GIC_SPI 170 IRQ_TYPE_LEVEL_HIGH 0>,
                     <GIC_SPI 171 IRQ_TYPE_LEVEL_HIGH 0>,
                     <GIC_SPI 172 IRQ_TYPE_LEVEL_HIGH 0>,
                     <GIC_SPI 360 IRQ_TYPE_LEVEL_HIGH 0>;
        interrupt-names = "avp", "cec", "earc", "main", "hpd";
        phys = <&hdptxphy0>;
        power-domains = <&power RK3588_PD_VO1>;
        resets = <&cru SRST_HDMITX0_REF>, <&cru SRST_HDMIHDP0>;
        reset-names = "ref", "hdp";
        rockchip,grf = <&sys_grf>;
        rockchip,vo-grf = <&vo1_grf>;
        #sound-dai-cells = <0>;

        ports {
          #address-cells = <1>;
          #size-cells = <0>;

          port@0 {
            reg = <0>;

            hdmi0_in_vp0: endpoint {
              remote-endpoint = <&vp0_out_hdmi0>;
            };
          };

          port@1 {
            reg = <1>;

            hdmi0_out_con0: endpoint {
              remote-endpoint = <&hdmi_con0_in>;
            };
          };
        };
      };
    };
```

## Documentation/devicetree/bindings/display/rockchip/rockchip,rk3588-mipi-dsi2.yaml
```yaml
# SPDX-License-Identifier: (GPL-2.0-only OR BSD-2-Clause)
%YAML 1.2
---
$id: http://devicetree.org/schemas/display/rockchip/rockchip,rk3588-mipi-dsi2.yaml#
$schema: http://devicetree.org/meta-schemas/core.yaml#

title: Rockchip specific extensions to the Synopsys Designware MIPI DSI2

maintainers:
  - Heiko Stuebner <heiko@sntech.de>

properties:
  compatible:
    enum:
      - rockchip,rk3576-mipi-dsi2
      - rockchip,rk3588-mipi-dsi2

  reg:
    maxItems: 1

  interrupts:
    maxItems: 1

  clocks:
    maxItems: 2

  clock-names:
    items:
      - const: pclk
      - const: sys

  rockchip,grf:
    $ref: /schemas/types.yaml#/definitions/phandle
    description:
      This SoC uses GRF regs to switch between vopl/vopb.

  phys:
    maxItems: 1

  phy-names:
    const: dcphy

  power-domains:
    maxItems: 1

  resets:
    maxItems: 1

  reset-names:
    const: apb

  ports:
    $ref: /schemas/graph.yaml#/properties/ports

    properties:
      port@0:
        $ref: /schemas/graph.yaml#/properties/port
        description: Input node to receive pixel data.

      port@1:
        $ref: /schemas/graph.yaml#/properties/port
        description: DSI output node to panel.

    required:
      - port@0
      - port@1

required:
  - compatible
  - clocks
  - clock-names
  - rockchip,grf
  - phys
  - phy-names
  - ports
  - reg

allOf:
  - $ref: /schemas/display/dsi-controller.yaml#

unevaluatedProperties: false

examples:
  - |
    #include <dt-bindings/clock/rockchip,rk3588-cru.h>
    #include <dt-bindings/interrupt-controller/arm-gic.h>
    #include <dt-bindings/interrupt-controller/irq.h>
    #include <dt-bindings/phy/phy.h>
    #include <dt-bindings/power/rk3588-power.h>
    #include <dt-bindings/reset/rockchip,rk3588-cru.h>

    soc {
      #address-cells = <2>;
      #size-cells = <2>;

      dsi@fde20000 {
        compatible = "rockchip,rk3588-mipi-dsi2";
        reg = <0x0 0xfde20000 0x0 0x10000>;
        interrupts = <GIC_SPI 167 IRQ_TYPE_LEVEL_HIGH 0>;
        clocks = <&cru PCLK_DSIHOST0>, <&cru CLK_DSIHOST0>;
        clock-names = "pclk", "sys";
        resets = <&cru SRST_P_DSIHOST0>;
        reset-names = "apb";
        power-domains = <&power RK3588_PD_VOP>;
        phys = <&mipidcphy0 PHY_TYPE_DPHY>;
        phy-names = "dcphy";
        rockchip,grf = <&vop_grf>;

        ports {
          #address-cells = <1>;
          #size-cells = <0>;
          dsi0_in: port@0 {
            reg = <0>;
          };

          dsi0_out: port@1 {
            reg = <1>;
          };
        };
      };
    };
```

## Documentation/devicetree/bindings/display/rockchip/rockchip,rk618.txt
```
Rockchip RK618 display bridge bindings
======================================

VIF Module
----------

Required properties:
- compatible: value should be one of the following:
   "rockchip,rk618-vif"
- clocks: must include clock specifiers corresponding to entries in the
	  clock-names property.
	  See ../clocks/clock-bindings.txt for details.
- clock-names: list of clock names sorted in the same order as the clocks
	       property. Must contain "vif", "vif_pre".

Required nodes:

The connections to the video ports are modeled using the OF graph
bindings specified in Documentation/devicetree/bindings/graph.txt.

Example:

&rk618 {
	status = "okay";

	vif {
		compatible = "rockchip,rk618-vif";
		clocks = <&CRU VIF0_CLK>, <&CRU VIF0_PRE_CLK>;
		clock-names = "vif", "vif_pre";
		status = "okay";

		ports {
			#address-cells = <1>;
			#size-cells = <0>;

			port@0 {
				reg = <0>;

				bridge_input_rgb: endpoint {
					remote-endpoint = <&rgb_out_bridge>;
				};
			};

			port@1 {
				reg = <1>;

				vif_output_hdmi: endpoint {
					remote-endpoint = <&hdmi_input_vif>;
				};
			};
		};
	};
};

SCALER Module
----------

Required properties:
- compatible: value should be one of the following:
   "rockchip,rk618-scaler"
- clocks: must include clock specifiers corresponding to entries in the
	  clock-names property.
	  See ../clocks/clock-bindings.txt for details.
- clock-names: list of clock names sorted in the same order as the clocks
	       property. Must contain "scaler", "vif", "dither".

Required nodes:

The connections to the video ports are modeled using the OF graph
bindings specified in Documentation/devicetree/bindings/graph.txt.

Example:

&rk618 {
	status = "okay";

	scaler {
		compatible = "rockchip,rk618-scaler";
		clocks = <&CRU SCALER_CLK>, <&CRU DITHER_CLK>, <&CRU VIF0_CLK>;
		clock-names = "scaler", "dither", "vif";
		status = "okay";

		ports {
			#address-cells = <1>;
			#size-cells = <0>;

			port@0 {
				reg = <0>;

				scaler_input_hdmi: endpoint {
					remote-endpoint = <&hdmi_output_scaler>;
				};
			};

			port@1 {
				reg = <1>;

				scaler_output_lvds: endpoint {
					remote-endpoint = <&lvds_input_scaler>;
				};
			};
		};
	};
};

LVDS Connector
------------

Required properties:
- compatible: value should be one of the following:
   "rockchip,rk618-lvds"
- clocks: must include clock specifiers corresponding to entries in the
	  clock-names property.
	  See ../clocks/clock-bindings.txt for details.
- clock-names: list of clock names sorted in the same order as the clocks
	       property. Must contain "lvds".

Optional properties:
- dual-channel: boolean. if it exists, enable dual channel mode

Required nodes:

The connections to the video ports are modeled using the OF graph
bindings specified in Documentation/devicetree/bindings/graph.txt.

Example:

&rk618 {
	status = "okay";

	lvds {
		compatible = "rockchip,rk618-lvds";
		clocks = <&CRU LVDS_CLK>;
		clock-names = "lvds";
		status = "okay";

		ports {
			#address-cells = <1>;
			#size-cells = <0>;

			port@0 {
				reg = <0>;

				bridge_input_rgb: endpoint {
					remote-endpoint = <&rgb_out_bridge>;
				};
			};

			port@1 {
				reg = <1>;

				lvds_output_panel: endpoint {
					remote-endpoint = <&panel_input_lvds>;
				};
			};
		};
	};
};

RGB Connector
------------

Required properties:
- compatible: value should be one of the following:
   "rockchip,rk618-rgb"
- clocks: must include clock specifiers corresponding to entries in the
	  clock-names property.
	  See ../clocks/clock-bindings.txt for details.
- clock-names: list of clock names sorted in the same order as the clocks
	       property. Must contain "rgb".

Required nodes:

The connections to the video ports are modeled using the OF graph
bindings specified in Documentation/devicetree/bindings/graph.txt.

Example:

&rk618 {
	status = "okay";

	rgb {
		compatible = "rockchip,rk618-rgb";
		clocks = <&CRU RGB_CLK>;
		clock-names = "rgb";
		status = "okay";

		ports {
			#address-cells = <1>;
			#size-cells = <0>;

			port@0 {
				reg = <0>;

				bridge_input_rgb: endpoint {
					remote-endpoint = <&rgb_out_bridge>;
				};
			};

			port@1 {
				reg = <1>;
				#address-cells = <1>;
				#size-cells = <0>;

				rgb_output_panel: endpoint@0 {
					reg = <0>;
					remote-endpoint = <&panel_input_rgb>;
				};
			};
		};
	};
};

HDMI Connector
------------

Required properties:
- compatible: value should be one of the following:
   "rockchip,rk618-hdmi"
- clocks: must include clock specifiers corresponding to entries in the
	  clock-names property.
	  See ../clocks/clock-bindings.txt for details.
- clock-names: list of clock names sorted in the same order as the clocks
	       property. Must contain "hdmi".
- interrupt-parent: phandle for the interrupt gpio controller
- interrupts: GPIO interrupt to which the chip is connected

Required nodes:

The connections to the video ports are modeled using the OF graph
bindings specified in Documentation/devicetree/bindings/graph.txt.

Example:

&rk618 {
	status = "okay";

	hdmi {
		compatible = "rockchip,rk618-hdmi";
		clocks = <&CRU HDMI_CLK>;
		clock-names = "hdmi";
		interrupt-parent = <&gpio3>;
		interrupts = <23 IRQ_TYPE_LEVEL_HIGH>;
		status = "okay";

		ports {
			#address-cells = <1>;
			#size-cells = <0>;

			port@0 {
				reg = <0>;

				bridge_input_rgb: endpoint {
					remote-endpoint = <&rgb_out_bridge>;
				};
			};
		};
	};
};

DSI Connector
------------

Required properties:
- compatible: value should be one of the following:
   "rockchip,rk618-dsi"
- clocks: must include clock specifiers corresponding to entries in the
	  clock-names property.
	  See ../clocks/clock-bindings.txt for details.
- clock-names: list of clock names sorted in the same order as the clocks
	       property. Must contain "dsi".
- #address-cells, #size-cells: should be set respectively to <1> and <0>.

Optional properties:
- rockchip,lane-rate: specifies the lane data rate [Mbps]

Child nodes:
  Should contain DSI peripheral nodes
  (see Documentation/devicetree/bindings/display/mipi-dsi-bus.txt).

Required nodes:

The connections to the video ports are modeled using the OF graph
bindings specified in Documentation/devicetree/bindings/graph.txt.

Example:

&rk618 {
	status = "okay";

	dsi {
		compatible = "rockchip,rk618-dsi";
		clocks = <&CRU MIPI_CLK>;
		clock-names = "dsi";
		#address-cells = <1>;
		#size-cells = <0>;
		status = "okay";

		ports {
			#address-cells = <1>;
			#size-cells = <0>;

			port@0 {
				reg = <0>;

				bridge_input_rgb: endpoint {
					remote-endpoint = <&rgb_out_bridge>;
				};
			};
		};
	};
};
```

## Documentation/devicetree/bindings/display/rockchip/rockchip,virtual-connector.txt
```
Rockchip virtual connector driver
================================

Required properties:
- compatible: should be "rockchip,virtual-connector"

patternProperties:
  "connector-enable": if this connector should be enabled
  "connector-vp-id": which video port this connector attached to.
  The connector here should be hdmi0/1, dp0/1, mipi0/1
  "virtual-connector-count": the number of virtual connector devices.
  "virtualX-disconnected": Set specified virtual connector to disconnected.
  The X here should be less than virtual-connector-count.

Example:
vconn {
	compatible = "rockchip,virtual-connector";
	hdmi0-enable;
	hdmi1-enable;
	hdmi0-vp-id = <0>;
	hdmi1-vp-id = <1>;
	virtual-connector-count = <2>;
	virtual1-disconnected;
	status = "okay";
};
```

## Documentation/devicetree/bindings/display/rockchip/rockchip-backlight.txt
```
Rockchip DRM backlight device
================================

Rockchip display controller(see VOP bindings[0]) support CABC function,
and the CABC function required using VOP self pwm to control backlight,
This backlight device manager the backlight PWM, auto select correct
PWM for backlight.

Required properties:
- compatible: Should be "rockchip,drm-backlight"

Other properties are same to commom PWM backlight bindings[1].

[0]: Documentation/devicetree/bindings/display/rockchip/rockchip-vop.txt
[1]: Documentation/devicetree/bindings/leds/backlight/pwm-backlight.txt

example:

backlight {
	compatible = "rockchip,drm-backlight";
	pwms = <&pwm 0 5000000>;

	brightness-levels = <0 4 8 16 32 64 128 255>;
	default-brightness-level = <6>;

	power-supply = <&vdd_bl_reg>;
	enable-gpios = <&gpio 58 0>;
};
```
