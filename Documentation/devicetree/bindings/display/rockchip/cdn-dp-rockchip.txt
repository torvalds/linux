## Documentation/devicetree/bindings/display/rockchip/rockchip,dw-dp.yaml
```yaml
# SPDX-License-Identifier: (GPL-2.0-only OR BSD-2-Clause)
%YAML 1.2
---
$id: http://devicetree.org/schemas/display/rockchip/rockchip,dw-dp.yaml#
$schema: http://devicetree.org/meta-schemas/core.yaml#

title: Rockchip DW DisplayPort Transmitter

maintainers:
  - Andy Yan <andy.yan@rock-chips.com>

description: |
  The Rockchip RK3588 SoC integrates the Synopsys DesignWare DPTX controller
  which is compliant with the DisplayPort Specification Version 1.4 with the
  following features:

  * DisplayPort 1.4a
  * Main Link: 1/2/4 lanes
  * Main Link Support 1.62Gbps, 2.7Gbps, 5.4Gbps and 8.1Gbps
  * AUX channel 1Mbps
  * Single Stream Transport(SST)
  * Multistream Transport (MST)
  * Type-C support (alternate mode)
  * HDCP 2.2, HDCP 1.3
  * Supports up to 8/10 bits per color component
  * Supports RBG, YCbCr4:4:4, YCbCr4:2:2, YCbCr4:2:0
  * Pixel clock up to 594MHz
  * I2S, SPDIF audio interface

allOf:
  - $ref: /schemas/sound/dai-common.yaml#

properties:
  compatible:
    enum:
      - rockchip,rk3588-dp

  reg:
    maxItems: 1

  interrupts:
    maxItems: 1

  clocks:
    items:
      - description: Peripheral/APB bus clock
      - description: DisplayPort AUX clock
      - description: HDCP clock
      - description: I2S interface clock
      - description: SPDIF interfce clock

  clock-names:
    items:
      - const: apb
      - const: aux
      - const: hdcp
      - const: i2s
      - const: spdif

  phys:
    maxItems: 1

  ports:
    $ref: /schemas/graph.yaml#/properties/ports

    properties:
      port@0:
        $ref: /schemas/graph.yaml#/properties/port
        description: Video port for RGB/YUV input.

      port@1:
        $ref: /schemas/graph.yaml#/properties/port
        description: Video port for DP output.

    required:
      - port@0
      - port@1

  power-domains:
    maxItems: 1

  resets:
    maxItems: 1

  "#sound-dai-cells":
    const: 0

required:
  - compatible
  - reg
  - clocks
  - clock-names
  - interrupts
  - phys
  - ports
  - resets

unevaluatedProperties: false

examples:
  - |
    #include <dt-bindings/clock/rockchip,rk3588-cru.h>
    #include <dt-bindings/phy/phy.h>
    #include <dt-bindings/interrupt-controller/arm-gic.h>
    #include <dt-bindings/interrupt-controller/irq.h>
    #include <dt-bindings/power/rk3588-power.h>
    #include <dt-bindings/reset/rockchip,rk3588-cru.h>

    soc {
      #address-cells = <2>;
      #size-cells = <2>;

      dp@fde50000 {
        compatible = "rockchip,rk3588-dp";
        reg = <0x0 0xfde50000 0x0 0x4000>;
        interrupts = <GIC_SPI 161 IRQ_TYPE_LEVEL_HIGH 0>;
        clocks = <&cru PCLK_DP0>, <&cru CLK_AUX16M_0>,
        <&cru CLK_DP0>, <&cru MCLK_I2S4_8CH_TX>,
        <&cru MCLK_SPDIF2_DP0>;
        clock-names = "apb", "aux", "hdcp", "i2s", "spdif";
        assigned-clocks = <&cru CLK_AUX16M_0>;
        assigned-clock-rates = <16000000>;
        resets = <&cru SRST_DP0>;
        phys = <&usbdp_phy0 PHY_TYPE_DP>;
        power-domains = <&power RK3588_PD_VO0>;
        #sound-dai-cells = <0>;


        ports {
          #address-cells = <1>;
          #size-cells = <0>;

          port@0 {
            reg = <0>;

            dp0_in_vp2: endpoint {
              remote-endpoint = <&vp2_out_dp0>;
            };
          };

          port@1 {
            reg = <1>;

            dp0_out_con0: endpoint {
              remote-endpoint = <&dp_con0_in>;
            };
          };
        };
      };
    };
```

## Documentation/devicetree/bindings/display/rockchip/rockchip,dw-hdmi.yaml
```yaml
# SPDX-License-Identifier: (GPL-2.0-only OR BSD-2-Clause)
%YAML 1.2
---
$id: http://devicetree.org/schemas/display/rockchip/rockchip,dw-hdmi.yaml#
$schema: http://devicetree.org/meta-schemas/core.yaml#

title: Rockchip DWC HDMI TX Encoder

maintainers:
  - Mark Yao <markyao0591@gmail.com>

description: |
  The HDMI transmitter is a Synopsys DesignWare HDMI 1.4 TX controller IP
  with a companion PHY IP.

allOf:
  - $ref: ../bridge/synopsys,dw-hdmi.yaml#
  - $ref: /schemas/sound/dai-common.yaml#

properties:
  compatible:
    enum:
      - rockchip,rk3228-dw-hdmi
      - rockchip,rk3288-dw-hdmi
      - rockchip,rk3328-dw-hdmi
      - rockchip,rk3399-dw-hdmi
      - rockchip,rk3568-dw-hdmi

  reg-io-width:
    const: 4

  avdd-0v9-supply:
    description:
      A 0.9V supply that powers up the SoC internal circuitry. The actual pin name
      varies between the different SoCs and is usually HDMI_TX_AVDD_0V9 or sometimes
      HDMI_AVDD_1V0.

  avdd-1v8-supply:
    description:
      A 1.8V supply that powers up the SoC internal circuitry. The pin name on the
      SoC usually is HDMI_TX_AVDD_1V8.

  clocks:
    minItems: 2
    items:
      - {}
      - {}
      # The next three clocks are all optional, but shall be specified in this
      # order when present.
      - description: The HDMI CEC controller main clock
      - description: Power for GRF IO
      - description: External clock for some HDMI PHY (old clock name, deprecated)
      - description: External clock for some HDMI PHY (new name)

  clock-names:
    minItems: 2
    items:
      - {}
      - {}
      - enum:
          - cec
          - grf
          - vpll
          - ref
      - enum:
          - grf
          - vpll
          - ref
      - enum:
          - vpll
          - ref

  ddc-i2c-bus:
    $ref: /schemas/types.yaml#/definitions/phandle
    description:
      The HDMI DDC bus can be connected to either a system I2C master or the
      functionally-reduced I2C master contained in the DWC HDMI. When connected
      to a system I2C master this property contains a phandle to that I2C
      master controller.

  phys:
    maxItems: 1
    description: The HDMI PHY

  phy-names:
    const: hdmi

  pinctrl-names:
    description:
      The unwedge pinctrl entry shall drive the DDC SDA line low. This is
      intended to work around a hardware errata that can cause the DDC I2C
      bus to be wedged.
    minItems: 1
    items:
      - const: default
      - const: unwedge

  power-domains:
    maxItems: 1

  ports:
    $ref: /schemas/graph.yaml#/properties/ports

    properties:
      port@0:
        $ref: /schemas/graph.yaml#/properties/port
        description: Input of the DWC HDMI TX
        properties:
          endpoint:
            description: Connection to the VOP
          endpoint@0:
            description: Connection to the VOPB
          endpoint@1:
            description: Connection to the VOPL
      port@1:
        $ref: /schemas/graph.yaml#/properties/port
        description: Output of the DWC HDMI TX

    required:
      - port@0
      - port@1

  rockchip,grf:
    $ref: /schemas/types.yaml#/definitions/phandle
    description:
      phandle to the GRF to mux vopl/vopb.

  "#sound-dai-cells":
    const: 0

required:
  - compatible
  - reg
  - reg-io-width
  - clocks
  - clock-names
  - interrupts
  - ports
  - rockchip,grf

unevaluatedProperties: false

examples:
  - |
    #include <dt-bindings/clock/rk3288-cru.h>
    #include <dt-bindings/interrupt-controller/arm-gic.h>
    #include <dt-bindings/interrupt-controller/irq.h>
    #include <dt-bindings/power/rk3288-power.h>

    hdmi: hdmi@ff980000 {
        compatible = "rockchip,rk3288-dw-hdmi";
        reg = <0xff980000 0x20000>;
        reg-io-width = <4>;
        interrupts = <GIC_SPI 103 IRQ_TYPE_LEVEL_HIGH>;
        clocks = <&cru  PCLK_HDMI_CTRL>, <&cru SCLK_HDMI_HDCP>;
        clock-names = "iahb", "isfr";
        ddc-i2c-bus = <&i2c5>;
        power-domains = <&power RK3288_PD_VIO>;
        rockchip,grf = <&grf>;
        #sound-dai-cells = <0>;

        ports {
            #address-cells = <1>;
            #size-cells = <0>;

            port@0 {
                reg = <0>;
                #address-cells = <1>;
                #size-cells = <0>;

                hdmi_in_vopb: endpoint@0 {
                    reg = <0>;
                    remote-endpoint = <&vopb_out_hdmi>;
                };

                hdmi_in_vopl: endpoint@1 {
                    reg = <1>;
                    remote-endpoint = <&vopl_out_hdmi>;
                };
            };

            port@1 {
                reg = <1>;

                hdmi_out_con: endpoint {
                    remote-endpoint = <&hdmi_con_in>;
                };
            };
        };
    };

...
```

## Documentation/devicetree/bindings/display/rockchip/rockchip,dw-mipi-dsi.yaml
```yaml
# SPDX-License-Identifier: GPL-2.0
%YAML 1.2
---
$id: http://devicetree.org/schemas/display/rockchip/rockchip,dw-mipi-dsi.yaml#
$schema: http://devicetree.org/meta-schemas/core.yaml#

title: Rockchip specific extensions to the Synopsys Designware MIPI DSI

maintainers:
  - Sandy Huang <hjc@rock-chips.com>
  - Heiko Stuebner <heiko@sntech.de>

properties:
  compatible:
    items:
      - enum:
          - rockchip,px30-mipi-dsi
          - rockchip,rk3128-mipi-dsi
          - rockchip,rk3288-mipi-dsi
          - rockchip,rk3399-mipi-dsi
          - rockchip,rk3568-mipi-dsi
          - rockchip,rv1126-mipi-dsi
      - const: snps,dw-mipi-dsi

  interrupts:
    maxItems: 1

  clocks:
    minItems: 1
    maxItems: 4

  clock-names:
    oneOf:
      - minItems: 2
        items:
          - const: ref
          - const: pclk
          - const: phy_cfg
          - const: grf
      - const: pclk

  rockchip,grf:
    $ref: /schemas/types.yaml#/definitions/phandle
    description:
      This SoC uses GRF regs to switch between vopl/vopb.

  phys:
    maxItems: 1

  phy-names:
    const: dphy

  "#phy-cells":
    const: 0
    description:
      Defined when in use as ISP phy.

  power-domains:
    maxItems: 1

  "#address-cells":
    const: 1

  "#size-cells":
    const: 0

required:
  - compatible
  - clocks
  - clock-names
  - rockchip,grf

allOf:
  - $ref: /schemas/display/bridge/snps,dw-mipi-dsi.yaml#
  - if:
      properties:
        compatible:
          contains:
            enum:
              - rockchip,px30-mipi-dsi
              - rockchip,rk3128-mipi-dsi
              - rockchip,rk3568-mipi-dsi
              - rockchip,rv1126-mipi-dsi

    then:
      properties:
        clocks:
          maxItems: 1

        clock-names:
          maxItems: 1

      required:
        - phys
        - phy-names

  - if:
      properties:
        compatible:
          contains:
            const: rockchip,rk3288-mipi-dsi

    then:
      properties:
        clocks:
          maxItems: 2

        clock-names:
          maxItems: 2

  - if:
      properties:
        compatible:
          contains:
            const: rockchip,rk3399-mipi-dsi

    then:
      properties:
        clocks:
          minItems: 4

        clock-names:
          minItems: 4

unevaluatedProperties: false

examples:
  - |
    #include <dt-bindings/clock/rk3288-cru.h>
    #include <dt-bindings/interrupt-controller/arm-gic.h>
    #include <dt-bindings/interrupt-controller/irq.h>

    mipi_dsi: dsi@ff960000 {
      compatible = "rockchip,rk3288-mipi-dsi", "snps,dw-mipi-dsi";
      reg = <0xff960000 0x4000>;
      interrupts = <GIC_SPI 83 IRQ_TYPE_LEVEL_HIGH>;
      clocks = <&cru SCLK_MIPIDSI_24M>, <&cru PCLK_MIPI_DSI0>;
      clock-names = "ref", "pclk";
      resets = <&cru SRST_MIPIDSI0>;
      reset-names = "apb";
      rockchip,grf = <&grf>;

      ports {
        #address-cells = <1>;
        #size-cells = <0>;

        mipi_in: port@0 {
          reg = <0>;
          #address-cells = <1>;
          #size-cells = <0>;

          mipi_in_vopb: endpoint@0 {
            reg = <0>;
            remote-endpoint = <&vopb_out_mipi>;
          };
          mipi_in_vopl: endpoint@1 {
            reg = <1>;
            remote-endpoint = <&vopl_out_mipi>;
          };
        };

        mipi_out: port@1 {
          reg = <1>;

          mipi_out_panel: endpoint {
            remote-endpoint = <&panel_in_mipi>;
          };
        };
      };
    };
```

## Documentation/devicetree/bindings/display/rockchip/rockchip,inno-hdmi.yaml
```yaml
# SPDX-License-Identifier: GPL-2.0
%YAML 1.2
---
$id: http://devicetree.org/schemas/display/rockchip/rockchip,inno-hdmi.yaml#
$schema: http://devicetree.org/meta-schemas/core.yaml#

title: Rockchip Innosilicon HDMI controller

maintainers:
  - Sandy Huang <hjc@rock-chips.com>
  - Heiko Stuebner <heiko@sntech.de>

properties:
  compatible:
    enum:
      - rockchip,rk3036-inno-hdmi

  reg:
    maxItems: 1

  interrupts:
    maxItems: 1

  clocks:
    maxItems: 1

  clock-names:
    const: pclk

  ports:
    $ref: /schemas/graph.yaml#/properties/ports

    properties:
      port@0:
        $ref: /schemas/graph.yaml#/properties/port
        description:
          Port node with one endpoint connected to a vop node.

      port@1:
        $ref: /schemas/graph.yaml#/properties/port
        description:
          Port node with one endpoint connected to a hdmi-connector node.

    required:
      - port@0
      - port@1

required:
  - compatible
  - reg
  - interrupts
  - clocks
  - clock-names
  - pinctrl-0
  - pinctrl-names
  - ports

additionalProperties: false

examples:
  - |
    #include <dt-bindings/clock/rk3036-cru.h>
    #include <dt-bindings/interrupt-controller/arm-gic.h>
    #include <dt-bindings/pinctrl/rockchip.h>
    hdmi: hdmi@20034000 {
      compatible = "rockchip,rk3036-inno-hdmi";
      reg = <0x20034000 0x4000>;
      interrupts = <GIC_SPI 45 IRQ_TYPE_LEVEL_HIGH>;
      clocks = <&cru  PCLK_HDMI>;
      clock-names = "pclk";
      pinctrl-names = "default";
      pinctrl-0 = <&hdmi_ctl>;

      ports {
        #address-cells = <1>;
        #size-cells = <0>;

        hdmi_in: port@0 {
          reg = <0>;
          hdmi_in_vop: endpoint {
            remote-endpoint = <&vop_out_hdmi>;
          };
        };

        hdmi_out: port@1 {
          reg = <1>;
          hdmi_out_con: endpoint {
            remote-endpoint = <&hdmi_con_in>;
          };
        };
      };
    };

    pinctrl {
      hdmi {
        hdmi_ctl: hdmi-ctl {
          rockchip,pins = <1 RK_PB0 1 &pcfg_pull_none>,
                          <1 RK_PB1 1 &pcfg_pull_none>,
                          <1 RK_PB2 1 &pcfg_pull_none>,
                          <1 RK_PB3 1 &pcfg_pull_none>;
        };
      };
    };
```
