## Documentation/devicetree/bindings/display/rockchip/rockchip-drm.txt
```
Rockchip DRM master device
================================

The Rockchip DRM master device is a virtual device needed to list all
vop devices or other display interface nodes that comprise the
graphics subsystem.

Required properties:
- compatible: Should be "rockchip,display-subsystem"
- ports: Should contain a list of phandles pointing to display interface port
  of vop devices. vop definitions as defined in
  Documentation/devicetree/bindings/display/rockchip/rockchip-vop.txt

Optional properties
- backlight: spacial backlight required by cabc function.
- secure-memory-region: phandle to a node describing secure memory
- clocks: include clock specifiers corresponding to entries in the
          clock-names property.
- clock-names: optional include
               hdmi-tmds-pll: special pll required by some hdmi-vop design,
                              if there is no hdmi plug, also can reuse for
                              common display pll.
               default-vop-pll: common display pll.

example:

display-subsystem {
	compatible = "rockchip,display-subsystem";
	ports = <&vopl_out>, <&vopb_out>;
	backlight = <&backlight>
	clocks = <&cru PLL_VPLL>, <&cru PLL_CPLL>;
	clock-names = "hdmi-tmds-pll", "default-vop-pll";
};
```

## Documentation/devicetree/bindings/display/rockchip/rockchip-drm.yaml
```yaml
# SPDX-License-Identifier: (GPL-2.0-only)
%YAML 1.2
---
$id: http://devicetree.org/schemas/display/rockchip/rockchip-drm.yaml#
$schema: http://devicetree.org/meta-schemas/core.yaml#

title: Rockchip DRM master device

maintainers:
  - Sandy Huang <hjc@rock-chips.com>
  - Heiko Stuebner <heiko@sntech.de>

description: |
  The Rockchip DRM master device is a virtual device needed to list all
  vop devices or other display interface nodes that comprise the
  graphics subsystem.

properties:
  compatible:
    const: rockchip,display-subsystem

  ports:
    $ref: /schemas/types.yaml#/definitions/phandle-array
    items:
      maxItems: 1
    description: |
      Should contain a list of phandles pointing to display interface port
      of vop devices. vop definitions as defined in
      Documentation/devicetree/bindings/display/rockchip/rockchip-vop.yaml

required:
  - compatible
  - ports

additionalProperties: false

examples:
  - |
    display-subsystem {
        compatible = "rockchip,display-subsystem";
        ports = <&vopl_out>, <&vopb_out>;
    };
```

## Documentation/devicetree/bindings/display/rockchip/rockchip-lvds.txt
```
Rockchip RK3288 LVDS interface
================================

Required properties:
- compatible: matching the soc type, one of
	- "rockchip,rk3288-lvds";
	- "rockchip,px30-lvds";

- reg: physical base address of the controller and length
	of memory mapped region.
- clocks: must include clock specifiers corresponding to entries in the
	clock-names property.
- clock-names: must contain "pclk_lvds"

- avdd1v0-supply: regulator phandle for 1.0V analog power
- avdd1v8-supply: regulator phandle for 1.8V analog power
- avdd3v3-supply: regulator phandle for 3.3V analog power

- rockchip,grf: phandle to the general register files syscon
- rockchip,output: "rgb", "lvds" or "duallvds", This describes the output interface

- phys: LVDS/DSI DPHY (px30 only)
- phy-names: name of the PHY, must be "dphy" (px30 only)

Optional properties:
- pinctrl-names: must contain a "lcdc" entry.
- pinctrl-0: pin control group to be used for this controller.

Required nodes:

The lvds has two video ports as described by
	Documentation/devicetree/bindings/media/video-interfaces.txt
Their connections are modeled using the OF graph bindings specified in
	Documentation/devicetree/bindings/graph.txt.

- video port 0 for the VOP input, the remote endpoint maybe vopb or vopl
- video port 1 for either a panel or subsequent encoder

Example:

lvds_panel: lvds-panel {
	compatible = "auo,b101ean01";
	enable-gpios = <&gpio7 21 GPIO_ACTIVE_HIGH>;
	data-mapping = "jeida-24";

	ports {
		panel_in_lvds: endpoint {
			remote-endpoint = <&lvds_out_panel>;
		};
	};
};

For Rockchip RK3288:

	lvds: lvds@ff96c000 {
		compatible = "rockchip,rk3288-lvds";
		rockchip,grf = <&grf>;
		reg = <0xff96c000 0x4000>;
		clocks = <&cru PCLK_LVDS_PHY>;
		clock-names = "pclk_lvds";
		pinctrl-names = "lcdc";
		pinctrl-0 = <&lcdc_ctl>;
		avdd1v0-supply = <&vdd10_lcd>;
		avdd1v8-supply = <&vcc18_lcd>;
		avdd3v3-supply = <&vcca_33>;
		rockchip,output = "rgb";
		ports {
			#address-cells = <1>;
			#size-cells = <0>;

			lvds_in: port@0 {
				reg = <0>;

				lvds_in_vopb: endpoint@0 {
					reg = <0>;
					remote-endpoint = <&vopb_out_lvds>;
				};
				lvds_in_vopl: endpoint@1 {
					reg = <1>;
					remote-endpoint = <&vopl_out_lvds>;
				};
			};

			lvds_out: port@1 {
				reg = <1>;

				lvds_out_panel: endpoint {
					remote-endpoint = <&panel_in_lvds>;
				};
			};
		};
	};
```

## Documentation/devicetree/bindings/display/rockchip/rockchip-rgb.txt
```
Rockchip RGB interface
================================

Required properties:
- compatible: matching the soc type:
	- "rockchip,px30-rgb";
	- "rockchip,rk1808-rgb";
	- "rockchip,rk3066-rgb";
	- "rockchip,rk3128-rgb";
	- "rockchip,rk3288-rgb";
	- "rockchip,rk3308-rgb";
	- "rockchip,rk3368-rgb";
	- "rockchip,rv1108-rgb";

Optional properties:
- phys : phandle for the PHY device
- phy-names : should be "phy"
- pinctrl-names: the pin control state names; should contain "default"
- pinctrl-0: the default pinctrl state (active)
- pinctrl-1: the "sleep" pinctrl state
- rockchip,data-sync: boolean to enable data sync

The rgb has two video ports described by:
	Documentation/devicetree/bindings/media/video-interfaces.txt
Their connections are modeled using the OF graph bindings specified in
	Documentation/devicetree/bindings/graph.txt.

- video port 0 for the VOP input
- video port 1 for either a panel or bridge

Example:

&grf {
	rgb: rgb {
		compatible = "rockchip,rk3288-rgb";
		pinctrl-names = "default", "sleep";
		pinctrl-0 = <&lcdc_rgb_pins>;
		pinctrl-1 = <&lcdc_sleep_pins>;
		phys = <&video_phy>;
		phy-names = "phy";
		status = "disabled";

		ports {
			#address-cells = <1>;
			#size-cells = <0>;

			port@0 {
				reg = <0>;
				#address-cells = <1>;
				#size-cells = <0>;

				rgb_in_vopb: endpoint@0 {
					reg = <0>;
					remote-endpoint = <&vopb_out_rgb>;
				};

				rgb_in_vopl: endpoint@1 {
					reg = <1>;
					remote-endpoint = <&vopl_out_rgb>;
				};
			};
		};
	};
};
```

## Documentation/devicetree/bindings/display/rockchip/rockchip-vop.txt
```
device-tree bindings for rockchip soc display controller (vop)

VOP (Visual Output Processor) is the Display Controller for the Rockchip
series of SoCs which transfers the image data from a video memory
buffer to an external LCD interface.

Required properties:
- compatible: value should be one of the following
		"rockchip,rk3036-vop";
		"rockchip,rk3126-vop";
		"rockchip,px30-vop-lit";
		"rockchip,px30-vop-big";
		"rockchip,rk3066-vop";
		"rockchip,rk3188-vop";
		"rockchip,rk3288-vop";
		"rockchip,rk3368-vop";
		"rockchip,rk3366-vop";
		"rockchip,rk3399-vop-big";
		"rockchip,rk3399-vop-lit";
		"rockchip,rk3228-vop";
		"rockchip,rk3328-vop";

- reg: Must contain one entry corresponding to the base address and length
	of the register space. Can optionally contain a second entry
	corresponding to the CRTC gamma LUT address.

- interrupts: should contain a list of all VOP IP block interrupts in the
		 order: VSYNC, LCD_SYSTEM. The interrupt specifier
		 format depends on the interrupt controller used.

- clocks: must include clock specifiers corresponding to entries in the
		clock-names property.

- clock-names: Must contain
		aclk_vop: for ddr buffer transfer.
		hclk_vop: for ahb bus to R/W the phy regs.
		dclk_vop: pixel clock.

- resets: Must contain an entry for each entry in reset-names.
  See ../reset/reset.txt for details.
- reset-names: Must include the following entries:
  - axi
  - ahb
  - dclk

- iommus: required a iommu node

- port: A port node with endpoint definitions as defined in
  Documentation/devicetree/bindings/media/video-interfaces.txt.

Example:
SoC specific DT entry:
	vopb: vopb@ff930000 {
		compatible = "rockchip,rk3288-vop";
		reg = <0x0 0xff930000 0x0 0x19c>, <0x0 0xff931000 0x0 0x1000>;
		interrupts = <GIC_SPI 15 IRQ_TYPE_LEVEL_HIGH>;
		clocks = <&cru ACLK_VOP0>, <&cru DCLK_VOP0>, <&cru HCLK_VOP0>;
		clock-names = "aclk_vop", "dclk_vop", "hclk_vop";
		resets = <&cru SRST_LCDC1_AXI>, <&cru SRST_LCDC1_AHB>, <&cru SRST_LCDC1_DCLK>;
		reset-names = "axi", "ahb", "dclk";
		iommus = <&vopb_mmu>;
		vopb_out: port {
			#address-cells = <1>;
			#size-cells = <0>;
			vopb_out_edp: endpoint@0 {
				reg = <0>;
				remote-endpoint=<&edp_in_vopb>;
			};
			vopb_out_hdmi: endpoint@1 {
				reg = <1>;
				remote-endpoint=<&hdmi_in_vopb>;
			};
		};
	};
```

## Documentation/devicetree/bindings/display/rockchip/rockchip-vop.yaml
```yaml
# SPDX-License-Identifier: GPL-2.0
%YAML 1.2
---
$id: http://devicetree.org/schemas/display/rockchip/rockchip-vop.yaml#
$schema: http://devicetree.org/meta-schemas/core.yaml#

title: Rockchip SoC display controller (VOP)

description:
  VOP (Video Output Processor) is the display controller for the Rockchip
  series of SoCs which transfers the image data from a video memory
  buffer to an external LCD interface.

maintainers:
  - Sandy Huang <hjc@rock-chips.com>
  - Heiko Stuebner <heiko@sntech.de>

properties:
  compatible:
    enum:
      - rockchip,px30-vop-big
      - rockchip,px30-vop-lit
      - rockchip,rk3036-vop
      - rockchip,rk3066-vop
      - rockchip,rk3126-vop
      - rockchip,rk3188-vop
      - rockchip,rk3228-vop
      - rockchip,rk3288-vop
      - rockchip,rk3328-vop
      - rockchip,rk3366-vop
      - rockchip,rk3368-vop
      - rockchip,rk3399-vop-big
      - rockchip,rk3399-vop-lit

  reg:
    minItems: 1
    items:
      - description:
          Must contain one entry corresponding to the base address and length
          of the register space.
      - description:
          Can optionally contain a second entry corresponding to
          the CRTC gamma LUT address.

  interrupts:
    maxItems: 1
    description:
      The VOP interrupt is shared by several interrupt sources, such as
      frame start (VSYNC), line flag and other status interrupts.

  clocks:
    items:
      - description: Clock for ddr buffer transfer.
      - description: Pixel clock.
      - description: Clock for the ahb bus to R/W the phy regs.

  clock-names:
    items:
      - const: aclk_vop
      - const: dclk_vop
      - const: hclk_vop

  resets:
    maxItems: 3

  reset-names:
    items:
      - const: axi
      - const: ahb
      - const: dclk

  port:
    $ref: /schemas/graph.yaml#/properties/port

  assigned-clocks:
    maxItems: 2

  assigned-clock-rates:
    maxItems: 2

  iommus:
    maxItems: 1

  power-domains:
    maxItems: 1

required:
  - compatible
  - reg
  - interrupts
  - clocks
  - clock-names
  - resets
  - reset-names
  - port

additionalProperties: false

examples:
  - |
    #include <dt-bindings/clock/rk3288-cru.h>
    #include <dt-bindings/interrupt-controller/arm-gic.h>
    #include <dt-bindings/power/rk3288-power.h>
    vopb: vopb@ff930000 {
      compatible = "rockchip,rk3288-vop";
      reg = <0xff930000 0x19c>,
            <0xff931000 0x1000>;
      interrupts = <GIC_SPI 15 IRQ_TYPE_LEVEL_HIGH>;
      clocks = <&cru ACLK_VOP0>,
               <&cru DCLK_VOP0>,
               <&cru HCLK_VOP0>;
      clock-names = "aclk_vop", "dclk_vop", "hclk_vop";
      power-domains = <&power RK3288_PD_VIO>;
      resets = <&cru SRST_LCDC1_AXI>,
               <&cru SRST_LCDC1_AHB>,
               <&cru SRST_LCDC1_DCLK>;
      reset-names = "axi", "ahb", "dclk";
      iommus = <&vopb_mmu>;
      vopb_out: port {
        #address-cells = <1>;
        #size-cells = <0>;
        vopb_out_edp: endpoint@0 {
          reg = <0>;
          remote-endpoint = <&edp_in_vopb>;
        };
        vopb_out_hdmi: endpoint@1 {
          reg = <1>;
          remote-endpoint = <&hdmi_in_vopb>;
        };
      };
    };
```
