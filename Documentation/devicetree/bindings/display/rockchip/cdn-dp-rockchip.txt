## Documentation/devicetree/bindings/display/rockchip/rockchip,lvds.yaml
```yaml
# SPDX-License-Identifier: GPL-2.0
%YAML 1.2
---
$id: http://devicetree.org/schemas/display/rockchip/rockchip,lvds.yaml#
$schema: http://devicetree.org/meta-schemas/core.yaml#

title: Rockchip low-voltage differential signal (LVDS) transmitter

maintainers:
  - Sandy Huang <hjc@rock-chips.com>
  - Heiko Stuebner <heiko@sntech.de>

properties:
  compatible:
    enum:
      - rockchip,px30-lvds
      - rockchip,rk3288-lvds

  reg:
    maxItems: 1

  clocks:
    maxItems: 1

  clock-names:
    const: pclk_lvds

  avdd1v0-supply:
    description: 1.0V analog power.

  avdd1v8-supply:
    description: 1.8V analog power.

  avdd3v3-supply:
    description: 3.3V analog power.

  rockchip,grf:
    $ref: /schemas/types.yaml#/definitions/phandle
    description: Phandle to the general register files syscon.

  rockchip,output:
    $ref: /schemas/types.yaml#/definitions/string
    enum: [rgb, lvds, duallvds]
    description: This describes the output interface.

  phys:
    maxItems: 1

  phy-names:
    const: dphy

  pinctrl-names:
    const: lcdc

  pinctrl-0: true

  power-domains:
    maxItems: 1

  ports:
    $ref: /schemas/graph.yaml#/properties/ports

    properties:
      port@0:
        $ref: /schemas/graph.yaml#/properties/port
        description:
          Video port 0 for the VOP input.
          The remote endpoint maybe vopb or vopl.

      port@1:
        $ref: /schemas/graph.yaml#/properties/port
        description:
          Video port 1 for either a panel or subsequent encoder.

    required:
      - port@0
      - port@1

required:
  - compatible
  - rockchip,grf
  - rockchip,output
  - ports

allOf:
  - if:
      properties:
        compatible:
          contains:
            const: rockchip,px30-lvds

    then:
      properties:
        reg: false
        clocks: false
        clock-names: false
        avdd1v0-supply: false
        avdd1v8-supply: false
        avdd3v3-supply: false

      required:
        - phys
        - phy-names

  - if:
      properties:
        compatible:
          contains:
            const: rockchip,rk3288-lvds

    then:
      properties:
        phys: false
        phy-names: false

      required:
        - reg
        - clocks
        - clock-names
        - avdd1v0-supply
        - avdd1v8-supply
        - avdd3v3-supply

additionalProperties: false

examples:
  - |
    #include <dt-bindings/clock/rk3288-cru.h>

    lvds: lvds@ff96c000 {
      compatible = "rockchip,rk3288-lvds";
      reg = <0xff96c000 0x4000>;
      clocks = <&cru PCLK_LVDS_PHY>;
      clock-names = "pclk_lvds";
      avdd1v0-supply = <&vdd10_lcd>;
      avdd1v8-supply = <&vcc18_lcd>;
      avdd3v3-supply = <&vcca_33>;
      pinctrl-names = "lcdc";
      pinctrl-0 = <&lcdc_ctl>;
      rockchip,grf = <&grf>;
      rockchip,output = "rgb";

      ports {
        #address-cells = <1>;
        #size-cells = <0>;

        lvds_in: port@0 {
          reg = <0>;
          #address-cells = <1>;
          #size-cells = <0>;

          lvds_in_vopb: endpoint@0 {
            reg = <0>;
            remote-endpoint = <&vopb_out_lvds>;
          };
          lvds_in_vopl: endpoint@1 {
            reg = <1>;
            remote-endpoint = <&vopl_out_lvds>;
          };
        };

        lvds_out: port@1 {
          reg = <1>;

          lvds_out_panel: endpoint {
            remote-endpoint = <&panel_in_lvds>;
          };
        };
      };
    };
```

## Documentation/devicetree/bindings/display/rockchip/rockchip,rk3066-hdmi.txt
```
Rockchip specific extensions for rk3066 HDMI
============================================

Required properties:
- compatible:
	"rockchip,rk3066-hdmi";
- reg:
	Physical base address and length of the controller's registers.
- clocks, clock-names:
	Phandle to HDMI controller clock, name should be "hclk".
- interrupts:
	HDMI interrupt number.
- power-domains:
	Phandle to the RK3066_PD_VIO power domain.
- rockchip,grf:
	This soc uses GRF regs to switch the HDMI TX input between vop0 and vop1.
- ports:
	Contains one port node with two endpoints, numbered 0 and 1,
	connected respectively to vop0 and vop1.
	Contains one port node with one endpoint
	connected to a hdmi-connector node.
- pinctrl-0, pinctrl-name:
	Switch the iomux for the HPD/I2C pins to HDMI function.

Example:
	hdmi: hdmi@10116000 {
		compatible = "rockchip,rk3066-hdmi";
		reg = <0x10116000 0x2000>;
		interrupts = <GIC_SPI 64 IRQ_TYPE_LEVEL_HIGH>;
		clocks = <&cru HCLK_HDMI>;
		clock-names = "hclk";
		power-domains = <&power RK3066_PD_VIO>;
		rockchip,grf = <&grf>;
		pinctrl-names = "default";
		pinctrl-0 = <&hdmii2c_xfer>, <&hdmi_hpd>;

		ports {
			#address-cells = <1>;
			#size-cells = <0>;
			hdmi_in: port@0 {
				reg = <0>;
				#address-cells = <1>;
				#size-cells = <0>;
				hdmi_in_vop0: endpoint@0 {
					reg = <0>;
					remote-endpoint = <&vop0_out_hdmi>;
				};
				hdmi_in_vop1: endpoint@1 {
					reg = <1>;
					remote-endpoint = <&vop1_out_hdmi>;
				};
			};
			hdmi_out: port@1 {
				reg = <1>;
				hdmi_out_con: endpoint {
					remote-endpoint = <&hdmi_con_in>;
				};
			};
		};
	};

&pinctrl {
		hdmi {
			hdmi_hpd: hdmi-hpd {
				rockchip,pins = <0 RK_PA0 1 &pcfg_pull_default>;
			};
			hdmii2c_xfer: hdmii2c-xfer {
				rockchip,pins = <0 RK_PA1 1 &pcfg_pull_none>,
						<0 RK_PA2 1 &pcfg_pull_none>;
			};
		};
};
```

## Documentation/devicetree/bindings/display/rockchip/rockchip,rk3066-hdmi.yaml
```yaml
# SPDX-License-Identifier: GPL-2.0
%YAML 1.2
---
$id: http://devicetree.org/schemas/display/rockchip/rockchip,rk3066-hdmi.yaml#
$schema: http://devicetree.org/meta-schemas/core.yaml#

title: Rockchip rk3066 HDMI controller

maintainers:
  - Sandy Huang <hjc@rock-chips.com>
  - Heiko Stuebner <heiko@sntech.de>

properties:
  compatible:
    const: rockchip,rk3066-hdmi

  reg:
    maxItems: 1

  interrupts:
    maxItems: 1

  clocks:
    maxItems: 1

  clock-names:
    const: hclk

  power-domains:
    maxItems: 1

  rockchip,grf:
    $ref: /schemas/types.yaml#/definitions/phandle
    description:
      This soc uses GRF regs to switch the HDMI TX input between vop0 and vop1.

  ports:
    $ref: /schemas/graph.yaml#/properties/ports

    properties:
      port@0:
        $ref: /schemas/graph.yaml#/properties/port
        description:
          Port node with two endpoints, numbered 0 and 1,
          connected respectively to vop0 and vop1.

      port@1:
        $ref: /schemas/graph.yaml#/properties/port
        description:
          Port node with one endpoint connected to a hdmi-connector node.

    required:
      - port@0
      - port@1

required:
  - compatible
  - reg
  - interrupts
  - clocks
  - clock-names
  - pinctrl-0
  - pinctrl-names
  - power-domains
  - rockchip,grf
  - ports

additionalProperties: false

examples:
  - |
    #include <dt-bindings/clock/rk3066a-cru.h>
    #include <dt-bindings/interrupt-controller/arm-gic.h>
    #include <dt-bindings/pinctrl/rockchip.h>
    #include <dt-bindings/power/rk3066-power.h>
    hdmi: hdmi@10116000 {
      compatible = "rockchip,rk3066-hdmi";
      reg = <0x10116000 0x2000>;
      interrupts = <GIC_SPI 64 IRQ_TYPE_LEVEL_HIGH>;
      clocks = <&cru HCLK_HDMI>;
      clock-names = "hclk";
      pinctrl-0 = <&hdmii2c_xfer>, <&hdmi_hpd>;
      pinctrl-names = "default";
      power-domains = <&power RK3066_PD_VIO>;
      rockchip,grf = <&grf>;

      ports {
        #address-cells = <1>;
        #size-cells = <0>;
        hdmi_in: port@0 {
          reg = <0>;
          #address-cells = <1>;
          #size-cells = <0>;
          hdmi_in_vop0: endpoint@0 {
            reg = <0>;
            remote-endpoint = <&vop0_out_hdmi>;
          };
          hdmi_in_vop1: endpoint@1 {
            reg = <1>;
            remote-endpoint = <&vop1_out_hdmi>;
          };
        };
        hdmi_out: port@1 {
          reg = <1>;
          hdmi_out_con: endpoint {
            remote-endpoint = <&hdmi_con_in>;
          };
        };
      };
    };

    pinctrl {
      hdmi {
        hdmi_hpd: hdmi-hpd {
          rockchip,pins = <0 RK_PA0 1 &pcfg_pull_default>;
        };
        hdmii2c_xfer: hdmii2c-xfer {
          rockchip,pins = <0 RK_PA1 1 &pcfg_pull_none>,
                          <0 RK_PA2 1 &pcfg_pull_none>;
        };
      };
    };
```

## Documentation/devicetree/bindings/display/rockchip/rockchip,rk3399-cdn-dp.yaml
```yaml
# SPDX-License-Identifier: GPL-2.0-only OR BSD-2-Clause
%YAML 1.2
---
$id: http://devicetree.org/schemas/display/rockchip/rockchip,rk3399-cdn-dp.yaml#
$schema: http://devicetree.org/meta-schemas/core.yaml#

title: Rockchip RK3399 specific extensions to the CDN Display Port

maintainers:
  - Andy Yan <andy.yan@rock-chip.com>
  - Heiko Stuebner <heiko@sntech.de>
  - Sandy Huang <hjc@rock-chips.com>

allOf:
  - $ref: /schemas/sound/dai-common.yaml#

properties:
  compatible:
    items:
      - const: rockchip,rk3399-cdn-dp

  reg:
    maxItems: 1

  clocks:
    items:
      - description: DP core work clock
      - description: APB clock
      - description: SPDIF interface clock
      - description: GRF clock

  clock-names:
    items:
      - const: core-clk
      - const: pclk
      - const: spdif
      - const: grf

  extcon:
    $ref: /schemas/types.yaml#/definitions/phandle-array
    minItems: 1
    items:
      - description: Extcon device providing the cable state for DP PHY device 0
      - description: Extcon device providing the cable state for DP PHY device 1
    description:
      List of phandle to the extcon device providing the cable state for the DP PHY.

  interrupts:
    maxItems: 1

  phys:
    minItems: 1
    items:
      - description: DP output to the DP PHY device 0
      - description: DP output to the DP PHY device 1
    description:
      RK3399 have two DP-USB PHY, specifying one PHY which want to use, or
      specify two PHYs here to let the driver determine which PHY to use.

  ports:
    $ref: /schemas/graph.yaml#/properties/ports

    properties:
      port@0:
        $ref: /schemas/graph.yaml#/properties/port
        description: Input of the CDN DP

        properties:
          endpoint@0:
            description: Connection to the VOPB

          endpoint@1:
            description: Connection to the VOPL

      port@1:
        $ref: /schemas/graph.yaml#/properties/port
        description: Output of the CDN DP

    required:
      - port@0
      - port@1

  power-domains:
    maxItems: 1

  resets:
    maxItems: 4

  reset-names:
    items:
      - const: spdif
      - const: dptx
      - const: apb
      - const: core

  rockchip,grf:
    $ref: /schemas/types.yaml#/definitions/phandle
    description:
      Phandle to GRF register to control HPD.

  "#sound-dai-cells":
    const: 1

required:
  - compatible
  - reg
  - clocks
  - clock-names
  - interrupts
  - phys
  - ports
  - resets
  - reset-names
  - rockchip,grf
  - "#sound-dai-cells"

unevaluatedProperties: false

examples:
  - |
    #include <dt-bindings/clock/rk3399-cru.h>
    #include <dt-bindings/interrupt-controller/arm-gic.h>
    #include <dt-bindings/power/rk3399-power.h>
    soc {
        #address-cells = <2>;
        #size-cells = <2>;

        dp@fec00000 {
            compatible = "rockchip,rk3399-cdn-dp";
            reg = <0x0 0xfec00000 0x0 0x100000>;
            assigned-clocks = <&cru SCLK_DP_CORE>;
            assigned-clock-rates = <100000000>;
            interrupts = <GIC_SPI 9 IRQ_TYPE_LEVEL_HIGH>;
            clocks = <&cru SCLK_DP_CORE>, <&cru PCLK_DP_CTRL>, <&cru SCLK_SPDIF_REC_DPTX>,
                    <&cru PCLK_VIO_GRF>;
            clock-names = "core-clk", "pclk", "spdif", "grf";
            power-domains = <&power RK3399_PD_HDCP>;
            phys = <&tcphy0_dp>, <&tcphy1_dp>;
            resets = <&cru SRST_DPTX_SPDIF_REC>, <&cru SRST_P_UPHY0_DPTX>,
                    <&cru SRST_P_UPHY0_APB>, <&cru SRST_DP_CORE>;
            reset-names = "spdif", "dptx", "apb", "core";
            rockchip,grf = <&grf>;
            #sound-dai-cells = <1>;

            ports {
                #address-cells = <1>;
                #size-cells = <0>;

                dp_in: port@0 {
                    reg = <0>;
                    #address-cells = <1>;
                    #size-cells = <0>;

                    dp_in_vopb: endpoint@0 {
                        reg = <0>;
                        remote-endpoint = <&vopb_out_dp>;
                    };

                    dp_in_vopl: endpoint@1 {
                        reg = <1>;
                        remote-endpoint = <&vopl_out_dp>;
                    };
                };

                dp_out: port@1 {
                    reg = <1>;
                };
            };
        };
    };
```
