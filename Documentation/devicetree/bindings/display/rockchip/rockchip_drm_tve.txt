## Documentation/devicetree/bindings/display/samsung/samsung,exynos5-dp.yaml
```yaml
# SPDX-License-Identifier: GPL-2.0-only OR BSD-2-Clause
%YAML 1.2
---
$id: http://devicetree.org/schemas/display/samsung/samsung,exynos5-dp.yaml#
$schema: http://devicetree.org/meta-schemas/core.yaml#

title: Samsung Exynos5250/Exynos5420 SoC Display Port

maintainers:
  - Inki Dae <inki.dae@samsung.com>
  - Seung-Woo Kim <sw0312.kim@samsung.com>
  - Kyungmin Park <kyungmin.park@samsung.com>
  - Krzysztof Kozlowski <krzk@kernel.org>

properties:
  compatible:
    const: samsung,exynos5-dp

  reg:
    maxItems: 1

  clocks:
    maxItems: 1

  clock-names:
    items:
      - const: dp

  display-timings:
    $ref: /schemas/display/panel/display-timings.yaml#

  interrupts:
    maxItems: 1

  hpd-gpios:
    description:
      Hotplug detect GPIO.
      Indicates which GPIO should be used for hotplug detection

  phys:
    maxItems: 1

  phy-names:
    items:
      - const: dp

  power-domains:
    maxItems: 1

  interlaced:
    type: boolean
    deprecated: true
    description:
      Interlace scan mode. Progressive if defined, interlaced if not defined.

  vsync-active-high:
    type: boolean
    deprecated: true
    description:
      VSYNC polarity configuration. High if defined, low if not defined

  hsync-active-high:
    type: boolean
    deprecated: true
    description:
      HSYNC polarity configuration. High if defined, low if not defined

  ports:
    $ref: /schemas/graph.yaml#/properties/ports

    properties:
      port:
        $ref: /schemas/graph.yaml#/properties/port
        description:
          Port node with one endpoint connected to a dp-connector node.

    required:
      - port

  samsung,hpd-gpios:
    maxItems: 1
    deprecated: true

  samsung,ycbcr-coeff:
    $ref: /schemas/types.yaml#/definitions/uint32
    deprecated: true
    description:
      Deprecated prop that can parsed from drm_display_mode.

  samsung,dynamic-range:
    $ref: /schemas/types.yaml#/definitions/uint32
    deprecated: true
    description:
      Deprecated prop that can parsed from drm_display_mode.

  samsung,color-space:
    $ref: /schemas/types.yaml#/definitions/uint32
    deprecated: true
    description:
      Deprecated prop that can parsed from drm_display_info.

  samsung,color-depth:
    $ref: /schemas/types.yaml#/definitions/uint32
    deprecated: true
    description:
      Deprecated prop that can parsed from drm_display_info.

  samsung,link-rate:
    $ref: /schemas/types.yaml#/definitions/uint32
    deprecated: true
    description:
      Deprecated prop that can reading from monitor by dpcd method.

  samsung,lane-count:
    $ref: /schemas/types.yaml#/definitions/uint32
    deprecated: true
    description:
      Deprecated prop that can reading from monitor by dpcd method.

required:
  - compatible
  - reg
  - clocks
  - clock-names
  - interrupts
  - phys
  - phy-names

additionalProperties: false

examples:
  - |
    #include <dt-bindings/clock/exynos5250.h>
    #include <dt-bindings/gpio/gpio.h>
    #include <dt-bindings/interrupt-controller/arm-gic.h>

    dp-controller@145b0000 {
        compatible = "samsung,exynos5-dp";
        reg = <0x145b0000 0x1000>;
        clocks = <&clock CLK_DP>;
        clock-names = "dp";
        interrupts = <10 3>;
        interrupt-parent = <&combiner>;
        phys = <&dp_phy>;
        phy-names = "dp";
        pinctrl-0 = <&dp_hpd>;
        pinctrl-names = "default";
        power-domains = <&pd_disp1>;

        samsung,color-space = <0>;
        samsung,color-depth = <1>;
        samsung,link-rate = <0x0a>;
        samsung,lane-count = <2>;
        hpd-gpios = <&gpx0 7 GPIO_ACTIVE_HIGH>;

        ports {
            port {
                dp_out: endpoint {
                    remote-endpoint = <&bridge_in>;
                };
            };
        };
    };
```

## Documentation/devicetree/bindings/display/samsung/samsung,exynos5433-decon.yaml
```yaml
# SPDX-License-Identifier: (GPL-2.0-only OR BSD-2-Clause)
%YAML 1.2
---
$id: http://devicetree.org/schemas/display/samsung/samsung,exynos5433-decon.yaml#
$schema: http://devicetree.org/meta-schemas/core.yaml#

title: Samsung Exynos5433 SoC Display and Enhancement Controller (DECON)

maintainers:
  - Inki Dae <inki.dae@samsung.com>
  - Seung-Woo Kim <sw0312.kim@samsung.com>
  - Kyungmin Park <kyungmin.park@samsung.com>
  - Krzysztof Kozlowski <krzk@kernel.org>

description: |
  DECON (Display and Enhancement Controller) is the Display Controller for the
  Exynos5433 series of SoCs which transfers the image data from a video memory
  buffer to an external LCD interface.

properties:
  compatible:
    enum:
      - samsung,exynos5433-decon
      - samsung,exynos5433-decon-tv

  clocks:
    minItems: 11
    maxItems: 11

  clock-names:
    items:
      - const: pclk
      - const: aclk_decon
      - const: aclk_smmu_decon0x
      - const: aclk_xiu_decon0x
      - const: pclk_smmu_decon0x
      - const: aclk_smmu_decon1x
      - const: aclk_xiu_decon1x
      - const: pclk_smmu_decon1x
      - const: sclk_decon_vclk
      - const: sclk_decon_eclk
      - const: dsd

  interrupts:
    minItems: 3
    maxItems: 4
    description: |
      Interrupts depend on mode of work:
       - video mode: vsync
       - command mode: lcd_sys
       - command mode with software trigger: lcd_sys, te

  interrupt-names:
    minItems: 3
    items:
      - const: fifo
      - const: vsync
      - const: lcd_sys
      - const: te

  iommus:
    minItems: 2
    maxItems: 2

  iommu-names:
    items:
      - const: m0
      - const: m1

  ports:
    $ref: /schemas/graph.yaml#/properties/ports
    description:
      Contains a port which is connected to mic node.

  power-domains:
    maxItems: 1

  reg:
    maxItems: 1

  samsung,disp-sysreg:
    $ref: /schemas/types.yaml#/definitions/phandle
    description:
      Phandle to DISP system controller interface.

required:
  - compatible
  - clocks
  - clock-names
  - interrupts
  - interrupt-names
  - ports
  - reg

additionalProperties: false

examples:
  - |
    #include <dt-bindings/clock/exynos5433.h>
    #include <dt-bindings/interrupt-controller/arm-gic.h>

    display-controller@13800000 {
        compatible = "samsung,exynos5433-decon";
        reg = <0x13800000 0x2104>;
        clocks = <&cmu_disp CLK_PCLK_DECON>,
                 <&cmu_disp CLK_ACLK_DECON>,
                 <&cmu_disp CLK_ACLK_SMMU_DECON0X>,
                 <&cmu_disp CLK_ACLK_XIU_DECON0X>,
                 <&cmu_disp CLK_PCLK_SMMU_DECON0X>,
                 <&cmu_disp CLK_ACLK_SMMU_DECON1X>,
                 <&cmu_disp CLK_ACLK_XIU_DECON1X>,
                 <&cmu_disp CLK_PCLK_SMMU_DECON1X>,
                 <&cmu_disp CLK_SCLK_DECON_VCLK>,
                 <&cmu_disp CLK_SCLK_DECON_ECLK>,
                 <&cmu_disp CLK_SCLK_DSD>;
        clock-names = "pclk",
                      "aclk_decon",
                      "aclk_smmu_decon0x",
                      "aclk_xiu_decon0x",
                      "pclk_smmu_decon0x",
                      "aclk_smmu_decon1x",
                      "aclk_xiu_decon1x",
                      "pclk_smmu_decon1x",
                      "sclk_decon_vclk",
                      "sclk_decon_eclk",
                      "dsd";
        power-domains = <&pd_disp>;
        interrupt-names = "fifo", "vsync", "lcd_sys";
        interrupts = <GIC_SPI 201 IRQ_TYPE_LEVEL_HIGH>,
                     <GIC_SPI 202 IRQ_TYPE_LEVEL_HIGH>,
                     <GIC_SPI 203 IRQ_TYPE_LEVEL_HIGH>;
        samsung,disp-sysreg = <&syscon_disp>;
        iommus = <&sysmmu_decon0x>, <&sysmmu_decon1x>;
        iommu-names = "m0", "m1";

        ports {
            #address-cells = <1>;
            #size-cells = <0>;

            port@0 {
                reg = <0>;
                decon_to_mic: endpoint {
                    remote-endpoint = <&mic_to_decon>;
                };
            };
        };
    };
```

## Documentation/devicetree/bindings/display/samsung/samsung,exynos5433-mic.yaml
```yaml
# SPDX-License-Identifier: GPL-2.0-only
%YAML 1.2
---
$id: http://devicetree.org/schemas/display/samsung/samsung,exynos5433-mic.yaml#
$schema: http://devicetree.org/meta-schemas/core.yaml#

title: Samsung Exynos5433 SoC Mobile Image Compressor (MIC)

maintainers:
  - Inki Dae <inki.dae@samsung.com>
  - Seung-Woo Kim <sw0312.kim@samsung.com>
  - Kyungmin Park <kyungmin.park@samsung.com>
  - Krzysztof Kozlowski <krzk@kernel.org>

description: |
  MIC (Mobile Image Compressor) resides between DECON and MIPI DSI. MIPI DSI is
  not capable of transferring high resoltuion frame data as DECON can send. MIC
  solves this problem by compressing the frame data by 1/2 before it is
  transferred through MIPI DSI. The compressed frame data must be uncompressed
  in the panel PCB.

properties:
  compatible:
    const: samsung,exynos5433-mic

  clocks:
    maxItems: 2

  clock-names:
    items:
      - const: pclk_mic0
      - const: sclk_rgb_vclk_to_mic0

  ports:
    $ref: /schemas/graph.yaml#/properties/ports
    description:
      Contains a port which is connected to mic node.

  power-domains:
    maxItems: 1

  reg:
    maxItems: 1

  samsung,disp-syscon:
    $ref: /schemas/types.yaml#/definitions/phandle
    description:
      Phandle to DISP system controller interface.

required:
  - compatible
  - clocks
  - clock-names
  - ports
  - reg
  - samsung,disp-syscon

additionalProperties: false

examples:
  - |
    #include <dt-bindings/clock/exynos5433.h>
    #include <dt-bindings/interrupt-controller/arm-gic.h>

    image-processor@13930000 {
        compatible = "samsung,exynos5433-mic";
        reg = <0x13930000 0x48>;
        clocks = <&cmu_disp CLK_PCLK_MIC0>,
                 <&cmu_disp CLK_SCLK_RGB_VCLK_TO_MIC0>;
        clock-names = "pclk_mic0",
                      "sclk_rgb_vclk_to_mic0";
        power-domains = <&pd_disp>;
        samsung,disp-syscon = <&syscon_disp>;

        ports {
            #address-cells = <1>;
            #size-cells = <0>;

            port@0 {
                reg = <0>;
                mic_to_decon: endpoint {
                    remote-endpoint = <&decon_to_mic>;
                };
            };

            port@1 {
                reg = <1>;
                mic_to_dsi: endpoint {
                    remote-endpoint = <&dsi_to_mic>;
                };
            };
        };
    };
```

## Documentation/devicetree/bindings/display/samsung/samsung,exynos7-decon.yaml
```yaml
# SPDX-License-Identifier: (GPL-2.0-only OR BSD-2-Clause)
%YAML 1.2
---
$id: http://devicetree.org/schemas/display/samsung/samsung,exynos7-decon.yaml#
$schema: http://devicetree.org/meta-schemas/core.yaml#

title: Samsung Exynos7 SoC Display and Enhancement Controller (DECON)

maintainers:
  - Inki Dae <inki.dae@samsung.com>
  - Joonyoung Shim <jy0922.shim@samsung.com>
  - Seung-Woo Kim <sw0312.kim@samsung.com>
  - Kyungmin Park <kyungmin.park@samsung.com>
  - Krzysztof Kozlowski <krzysztof.kozlowski@canonical.com>

description: |
  DECON (Display and Enhancement Controller) is the Display Controller for the
  Exynos7 series of SoCs which transfers the image data from a video memory
  buffer to an external LCD interface.

properties:
  compatible:
    const: samsung,exynos7-decon

  clocks:
    minItems: 4
    maxItems: 4

  clock-names:
    items:
      - const: pclk_decon0
      - const: aclk_decon0
      - const: decon0_eclk
      - const: decon0_vclk

  display-timings:
    $ref: ../panel/display-timings.yaml#

  i80-if-timings:
    type: object
    description: timing configuration for lcd i80 interface support
    properties:
      cs-setup:
        $ref: /schemas/types.yaml#/definitions/uint32
        description:
          Clock cycles for the active period of address signal is enabled until
          chip select is enabled.
        default: 0

      wr-active:
        $ref: /schemas/types.yaml#/definitions/uint32
        description:
          Clock cycles for the active period of CS is enabled.
        default: 1

      wr-hold:
        $ref: /schemas/types.yaml#/definitions/uint32
        description:
          Clock cycles for the active period of CS is disabled until write
          signal is disabled.
        default: 0

      wr-setup:
        $ref: /schemas/types.yaml#/definitions/uint32
        description:
          Clock cycles for the active period of CS signal is enabled until
          write signal is enabled.
        default: 0

  interrupts:
    items:
      - description: FIFO level
      - description: VSYNC
      - description: LCD system

  interrupt-names:
    items:
      - const: fifo
      - const: vsync
      - const: lcd_sys

  power-domains:
    maxItems: 1

  reg:
    maxItems: 1

required:
  - compatible
  - clocks
  - clock-names
  - interrupts
  - interrupt-names
  - reg

additionalProperties: false

examples:
  - |
    #include <dt-bindings/clock/exynos7-clk.h>
    #include <dt-bindings/interrupt-controller/arm-gic.h>

    display-controller@13930000 {
        compatible = "samsung,exynos7-decon";
        reg = <0x13930000 0x1000>;
        interrupt-names = "fifo", "vsync", "lcd_sys";
        interrupts = <GIC_SPI 190 IRQ_TYPE_LEVEL_HIGH>,
                     <GIC_SPI 189 IRQ_TYPE_LEVEL_HIGH>,
                     <GIC_SPI 188 IRQ_TYPE_LEVEL_HIGH>;
        clocks = <&clock_disp 100>, /* PCLK_DECON_INT */
                 <&clock_disp 101>, /* ACLK_DECON_INT */
                 <&clock_disp 102>, /* SCLK_DECON_INT_ECLK */
                 <&clock_disp 103>; /* SCLK_DECON_INT_EXTCLKPLL */
        clock-names = "pclk_decon0",
                      "aclk_decon0",
                      "decon0_eclk",
                      "decon0_vclk";
        pinctrl-0 = <&lcd_clk &pwm1_out>;
        pinctrl-names = "default";
    };
```
