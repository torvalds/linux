## Documentation/devicetree/bindings/display/samsung/samsung,fimd.yaml
```yaml
# SPDX-License-Identifier: GPL-2.0-only
%YAML 1.2
---
$id: http://devicetree.org/schemas/display/samsung/samsung,fimd.yaml#
$schema: http://devicetree.org/meta-schemas/core.yaml#

title: Samsung S3C/S5P/Exynos SoC Fully Interactive Mobile Display (FIMD)

maintainers:
  - Inki Dae <inki.dae@samsung.com>
  - Seung-Woo Kim <sw0312.kim@samsung.com>
  - Kyungmin Park <kyungmin.park@samsung.com>
  - Krzysztof Kozlowski <krzk@kernel.org>

properties:
  compatible:
    enum:
      - samsung,s3c6400-fimd
      - samsung,s5pv210-fimd
      - samsung,exynos3250-fimd
      - samsung,exynos4210-fimd
      - samsung,exynos5250-fimd
      - samsung,exynos5420-fimd

  '#address-cells':
    const: 1

  clocks:
    maxItems: 2

  clock-names:
    items:
      - const: sclk_fimd
      - const: fimd

  display-timings:
    $ref: ../panel/display-timings.yaml#

  i80-if-timings:
    type: object
    additionalProperties: false
    description: |
      Timing configuration for lcd i80 interface support.
      The parameters are defined as::
      VCLK(internal)  __|??????|_____|??????|_____|??????|_____|??????|_____|??
                        :            :            :            :            :
      Address Output  --:<XXXXXXXXXXX:XXXXXXXXXXXX:XXXXXXXXXXXX:XXXXXXXXXXXX:XX
                        | cs-setup+1 |            :            :            :
                        |<---------->|            :            :            :
      Chip Select     ???????????????|____________:____________:____________|??
                                     | wr-setup+1 |            | wr-hold+1  |
                                     |<---------->|            |<---------->|
      Write Enable    ????????????????????????????|____________|???????????????
                                                  | wr-active+1|
                                                  |<---------->|
      Video Data      ----------------------------<XXXXXXXXXXXXXXXXXXXXXXXXX>--

    properties:
      cs-setup:
        $ref: /schemas/types.yaml#/definitions/uint32
        description:
          Clock cycles for the active period of address signal is enabled until
          chip select is enabled.
        default: 0

      wr-active:
        $ref: /schemas/types.yaml#/definitions/uint32
        description:
          Clock cycles for the active period of CS is enabled.
        default: 1

      wr-hold:
        $ref: /schemas/types.yaml#/definitions/uint32
        description:
          Clock cycles for the active period of CS is disabled until write
          signal is disabled.
        default: 0

      wr-setup:
        $ref: /schemas/types.yaml#/definitions/uint32
        description:
          Clock cycles for the active period of CS signal is enabled until
          write signal is enabled.
        default: 0

  iommus:
    minItems: 1
    maxItems: 2

  iommu-names:
    items:
      - const: m0
      - const: m1

  interrupts:
    items:
      - description: FIFO level
      - description: VSYNC
      - description: LCD system

  interrupt-names:
    items:
      - const: fifo
      - const: vsync
      - const: lcd_sys

  power-domains:
    maxItems: 1

  reg:
    maxItems: 1

  samsung,invert-vden:
    type: boolean
    description:
      Video enable signal is inverted.

  samsung,invert-vclk:
    type: boolean
    description:
      Video clock signal is inverted.

  samsung,sysreg:
    $ref: /schemas/types.yaml#/definitions/phandle
    description:
      Phandle to System Register syscon.

  '#size-cells':
    const: 0

patternProperties:
  "^port@[0-4]+$":
    $ref: /schemas/graph.yaml#/properties/port
    description: |
      Contains ports with port with index::
       0 - for CAMIF0 input,
       1 - for CAMIF1 input,
       2 - for CAMIF2 input,
       3 - for parallel output,
       4 - for write-back interface

required:
  - compatible
  - clocks
  - clock-names
  - interrupts
  - interrupt-names
  - reg

allOf:
  - if:
      properties:
        compatible:
          contains:
            const: samsung,exynos5420-fimd
    then:
      properties:
        iommus:
          minItems: 2
          maxItems: 2

additionalProperties: false

examples:
  - |
    #include <dt-bindings/clock/exynos4.h>

    fimd@11c00000 {
        compatible = "samsung,exynos4210-fimd";
        interrupt-parent = <&combiner>;
        reg = <0x11c00000 0x20000>;
        interrupt-names = "fifo", "vsync", "lcd_sys";
        interrupts = <11 0>, <11 1>, <11 2>;
        clocks = <&clock CLK_SCLK_FIMD0>, <&clock CLK_FIMD0>;
        clock-names = "sclk_fimd", "fimd";
        power-domains = <&pd_lcd0>;
        iommus = <&sysmmu_fimd0>;
        samsung,sysreg = <&sys_reg>;

        #address-cells = <1>;
        #size-cells = <0>;

        samsung,invert-vden;
        samsung,invert-vclk;

        pinctrl-0 = <&lcd_clk>, <&lcd_data24>;
        pinctrl-names = "default";

        port@3 {
            reg = <3>;

            fimd_dpi_ep: endpoint {
                remote-endpoint = <&lcd_ep>;
            };
        };
    };
```

## Documentation/devicetree/bindings/display/sharp,ls010b7dh04.yaml
```yaml
# SPDX-License-Identifier: (GPL-2.0-only OR BSD-2-Clause)
%YAML 1.2
---
$id: http://devicetree.org/schemas/display/sharp,ls010b7dh04.yaml#
$schema: http://devicetree.org/meta-schemas/core.yaml#

title: Sharp Memory LCD panels

maintainers:
  - Alex Lanzano <lanzano.alex@gmail.com>

description:
  Sharp Memory LCDs are a series of monochrome displays that operate over
  a SPI bus. The displays require a signal (VCOM) to be generated to prevent
  DC bias build up resulting in pixels being unable to change. Three modes
  can be used to provide the VCOM signal ("software", "external", "pwm").

properties:
  compatible:
    enum:
      - sharp,ls010b7dh04
      - sharp,ls011b7dh03
      - sharp,ls012b7dd01
      - sharp,ls013b7dh03
      - sharp,ls013b7dh05
      - sharp,ls018b7dh02
      - sharp,ls027b7dh01
      - sharp,ls027b7dh01a
      - sharp,ls032b7dd02
      - sharp,ls044q7dh01

  reg:
    maxItems: 1

  spi-max-frequency:
    maximum: 2000000

  sharp,vcom-mode:
    $ref: /schemas/types.yaml#/definitions/string
    description: |
      software - This mode relies on a software operation to send a
      "maintain display" message to the display, toggling the vcom
      bit on and off with each message

      external - This mode relies on an external clock to generate
      the signal on the EXTCOMM pin

      pwm - This mode relies on a pwm device to generate the signal
      on the EXTCOMM pin

    enum: [software, external, pwm]

  enable-gpios: true

  pwms:
    maxItems: 1
    description: External VCOM signal

required:
  - compatible
  - reg
  - sharp,vcom-mode

allOf:
  - $ref: panel/panel-common.yaml#
  - $ref: /schemas/spi/spi-peripheral-props.yaml#

  - if:
      properties:
        sharp,vcom-mode:
          const: pwm
    then:
      required:
        - pwms

unevaluatedProperties: false

examples:
  - |
    spi {
        #address-cells = <1>;
        #size-cells = <0>;

        display@0 {
            compatible = "sharp,ls013b7dh03";
            reg = <0>;
            spi-cs-high;
            spi-max-frequency = <1000000>;
            sharp,vcom-mode = "software";
        };
    };
...
```

## Documentation/devicetree/bindings/display/simple-framebuffer.txt
```
Simple Framebuffer

A simple frame-buffer describes a frame-buffer setup by firmware or
the bootloader, with the assumption that the display hardware has already
been set up to scan out from the memory pointed to by the reg property.

Since simplefb nodes represent runtime information they must be sub-nodes of
the chosen node (*). Simplefb nodes must be named "framebuffer@<address>".

If the devicetree contains nodes for the display hardware used by a simplefb,
then the simplefb node must contain a property called "display", which
contains a phandle pointing to the primary display hw node, so that the OS
knows which simplefb to disable when handing over control to a driver for the
real hardware. The bindings for the hw nodes must specify which node is
considered the primary node.

It is advised to add display# aliases to help the OS determine how to number
things. If display# aliases are used, then if the simplefb node contains a
"display" property then the /aliases/display# path must point to the display
hw node the "display" property points to, otherwise it must point directly
to the simplefb node.

If a simplefb node represents the preferred console for user interaction,
then the chosen node's stdout-path property should point to it, or to the
primary display hw node, as with display# aliases. If display aliases are
used then it should be set to the alias instead.

It is advised that devicetree files contain pre-filled, disabled framebuffer
nodes, so that the firmware only needs to update the mode information and
enable them. This way if e.g. later on support for more display clocks get
added, the simplefb nodes will already contain this info and the firmware
does not need to be updated.

If pre-filled framebuffer nodes are used, the firmware may need extra
information to find the right node. In that case an extra platform specific
compatible and platform specific properties should be used and documented,
see e.g. simple-framebuffer-sunxi.txt .

Required properties:
- compatible: "simple-framebuffer"
- reg: Should contain the location and size of the framebuffer memory.
- width: The width of the framebuffer in pixels.
- height: The height of the framebuffer in pixels.
- stride: The number of bytes in each line of the framebuffer.
- format: The format of the framebuffer surface. Valid values are:
  - r5g6b5 (16-bit pixels, d[15:11]=r, d[10:5]=g, d[4:0]=b).
  - a8b8g8r8 (32-bit pixels, d[31:24]=a, d[23:16]=b, d[15:8]=g, d[7:0]=r).

Optional properties:
- clocks : List of clocks used by the framebuffer.
- *-supply : Any number of regulators used by the framebuffer. These should
	     be named according to the names in the device's design.

  The above resources are expected to already be configured correctly.
  The OS must ensure they are not modified or disabled while the simple
  framebuffer remains active.

- display : phandle pointing to the primary display hardware node

Example:

aliases {
	display0 = &lcdc0;
}

chosen {
	framebuffer0: framebuffer@1d385000 {
		compatible = "simple-framebuffer";
		reg = <0x1d385000 (1600 * 1200 * 2)>;
		width = <1600>;
		height = <1200>;
		stride = <(1600 * 2)>;
		format = "r5g6b5";
		clocks = <&ahb_gates 36>, <&ahb_gates 43>, <&ahb_gates 44>;
		lcd-supply = <&reg_dc1sw>;
		display = <&lcdc0>;
	};
	stdout-path = "display0";
};

soc@1c00000 {
	lcdc0: lcdc@1c0c000 {
		compatible = "allwinner,sun4i-a10-lcdc";
		...
	};
};


*) Older devicetree files may have a compatible = "simple-framebuffer" node
in a different place, operating systems must first enumerate any compatible
nodes found under chosen and then check for other compatible nodes.
```
