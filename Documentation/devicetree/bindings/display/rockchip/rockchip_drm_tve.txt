## Documentation/devicetree/bindings/display/simple-framebuffer.yaml
```yaml
# SPDX-License-Identifier: GPL-2.0
%YAML 1.2
---
$id: http://devicetree.org/schemas/display/simple-framebuffer.yaml#
$schema: http://devicetree.org/meta-schemas/core.yaml#

title: Simple Framebuffer Device Tree Bindings

maintainers:
  - Bartlomiej Zolnierkiewicz <b.zolnierkie@samsung.com>
  - Hans de Goede <hdegoede@redhat.com>

description: |+
  A simple frame-buffer describes a frame-buffer setup by firmware or
  the bootloader, with the assumption that the display hardware has
  already been set up to scan out from the memory pointed to by the
  reg property.

  Since simplefb nodes represent runtime information they must be
  sub-nodes of the chosen node (*). Simplefb nodes must be named
  framebuffer@<address>.

  If the devicetree contains nodes for the display hardware used by a
  simplefb, then the simplefb node must contain a property called
  display, which contains a phandle pointing to the primary display
  hw node, so that the OS knows which simplefb to disable when handing
  over control to a driver for the real hardware. The bindings for the
  hw nodes must specify which node is considered the primary node.

  It is advised to add display# aliases to help the OS determine how
  to number things. If display# aliases are used, then if the simplefb
  node contains a display property then the /aliases/display# path
  must point to the display hw node the display property points to,
  otherwise it must point directly to the simplefb node.

  If a simplefb node represents the preferred console for user
  interaction, then the chosen node stdout-path property should point
  to it, or to the primary display hw node, as with display#
  aliases. If display aliases are used then it should be set to the
  alias instead.

  It is advised that devicetree files contain pre-filled, disabled
  framebuffer nodes, so that the firmware only needs to update the
  mode information and enable them. This way if e.g. later on support
  for more display clocks get added, the simplefb nodes will already
  contain this info and the firmware does not need to be updated.

  If pre-filled framebuffer nodes are used, the firmware may need
  extra information to find the right node. In that case an extra
  platform specific compatible and platform specific properties should
  be used and documented.

properties:
  compatible:
    items:
      - enum:
          - apple,simple-framebuffer
          - allwinner,simple-framebuffer
          - amlogic,simple-framebuffer
      - const: simple-framebuffer

  reg:
    description: Location and size of the framebuffer memory

  clocks:
    description: List of clocks used by the framebuffer.

  power-domains:
    description: List of power domains used by the framebuffer.

  width:
    $ref: /schemas/types.yaml#/definitions/uint32
    description: Width of the framebuffer in pixels

  height:
    $ref: /schemas/types.yaml#/definitions/uint32
    description: Height of the framebuffer in pixels

  stride:
    $ref: /schemas/types.yaml#/definitions/uint32
    description: Number of bytes of a line in the framebuffer

  format:
    description: >
      Format of the framebuffer:
        * `a8b8g8r8` - 32-bit pixels, d[31:24]=a, d[23:16]=b, d[15:8]=g, d[7:0]=r
        * `r5g6b5` - 16-bit pixels, d[15:11]=r, d[10:5]=g, d[4:0]=b
        * `x2r10g10b10` - 32-bit pixels, d[29:20]=r, d[19:10]=g, d[9:0]=b
        * `x8r8g8b8` - 32-bit pixels, d[23:16]=r, d[15:8]=g, d[7:0]=b
    enum:
      - a8b8g8r8
      - r5g6b5
      - x2r10g10b10
      - x8r8g8b8

  display:
    $ref: /schemas/types.yaml#/definitions/phandle
    description: Primary display hardware node

  allwinner,pipeline:
    description: Pipeline used by the framebuffer on Allwinner SoCs
    enum:
      - de_be0-lcd0
      - de_be0-lcd0-hdmi
      - de_be0-lcd0-tve0
      - de_be1-lcd0
      - de_be1-lcd1-hdmi
      - de_fe0-de_be0-lcd0
      - de_fe0-de_be0-lcd0-hdmi
      - de_fe0-de_be0-lcd0-tve0
      - mixer0-lcd0
      - mixer0-lcd0-hdmi
      - mixer1-lcd1-hdmi
      - mixer1-lcd1-tve

  amlogic,pipeline:
    description: Pipeline used by the framebuffer on Amlogic SoCs
    enum:
      - vpu-cvbs
      - vpu-hdmi

patternProperties:
  "^[a-zA-Z0-9-]+-supply$":
    $ref: /schemas/types.yaml#/definitions/phandle
    description:
      Regulators used by the framebuffer. These should be named
      according to the names in the device design.

required:
  # The binding requires also reg, width, height, stride and format,
  # but usually they will be filled by the bootloader.
  - compatible

allOf:
  - if:
      properties:
        compatible:
          contains:
            const: allwinner,simple-framebuffer

    then:
      required:
        - allwinner,pipeline

  - if:
      properties:
        compatible:
          contains:
            const: amlogic,simple-framebuffer

    then:
      required:
        - amlogic,pipeline


additionalProperties: false

examples:
  - |
    / {
        compatible = "foo";
        model = "foo";
        #address-cells = <1>;
        #size-cells = <1>;

        chosen {
            #address-cells = <1>;
            #size-cells = <1>;
            framebuffer0: framebuffer@1d385000 {
                compatible = "allwinner,simple-framebuffer", "simple-framebuffer";
                allwinner,pipeline = "de_be0-lcd0";
                reg = <0x1d385000 3840000>;
                width = <1600>;
                height = <1200>;
                stride = <3200>;
                format = "r5g6b5";
                clocks = <&ahb_gates 36>, <&ahb_gates 43>, <&ahb_gates 44>;
                lcd-supply = <&reg_dc1sw>;
                display = <&lcdc0>;
            };
        };
    };

...
```

## Documentation/devicetree/bindings/display/sitronix,st7567.yaml
```yaml
# SPDX-License-Identifier: (GPL-2.0-only OR BSD-2-Clause)
%YAML 1.2
---
$id: http://devicetree.org/schemas/display/sitronix,st7567.yaml#
$schema: http://devicetree.org/meta-schemas/core.yaml#

title: Sitronix ST7567 Display Controller

maintainers:
  - Javier Martinez Canillas <javierm@redhat.com>

description:
  Sitronix ST7567 is a driver and controller for monochrome
  dot matrix LCD panels.

allOf:
  - $ref: panel/panel-common.yaml#

properties:
  compatible:
    const: sitronix,st7567

  reg:
    maxItems: 1

  sitronix,inverted:
    type: boolean
    description:
      Display pixels are inverted, i.e. 0 is white and 1 is black.

  width-mm: true
  height-mm: true
  panel-timing: true

required:
  - compatible
  - reg
  - width-mm
  - height-mm
  - panel-timing

additionalProperties: false

examples:
  - |
    i2c {
        #address-cells = <1>;
        #size-cells = <0>;

        display@3f {
            compatible = "sitronix,st7567";
            reg = <0x3f>;
            width-mm = <37>;
            height-mm = <27>;

            panel-timing {
                hactive = <128>;
                vactive = <64>;
                hback-porch = <0>;
                vback-porch = <0>;
                clock-frequency = <0>;
                hfront-porch = <0>;
                hsync-len = <0>;
                vfront-porch = <0>;
                vsync-len = <0>;
            };
          };
     };
```

## Documentation/devicetree/bindings/display/sitronix,st7571.yaml
```yaml
# SPDX-License-Identifier: (GPL-2.0-only OR BSD-2-Clause)
%YAML 1.2
---
$id: http://devicetree.org/schemas/display/sitronix,st7571.yaml#
$schema: http://devicetree.org/meta-schemas/core.yaml#

title: Sitronix ST7571 Display Controller

maintainers:
  - Marcus Folkesson <marcus.folkesson@gmail.com>

description:
  Sitronix ST7571 is a driver and controller for 4-level gray
  scale and monochrome dot matrix LCD panels.

allOf:
  - $ref: panel/panel-common.yaml#

properties:
  compatible:
    const: sitronix,st7571

  reg:
    maxItems: 1

  sitronix,grayscale:
    type: boolean
    description:
      Display supports 4-level grayscale.

  sitronix,inverted:
    type: boolean
    description:
      Display pixels are inverted, i.e. 0 is white and 1 is black.

  reset-gpios: true
  width-mm: true
  height-mm: true
  panel-timing: true

required:
  - compatible
  - reg
  - reset-gpios
  - width-mm
  - height-mm
  - panel-timing

additionalProperties: false

examples:
  - |
    #include <dt-bindings/gpio/gpio.h>

    i2c {
      #address-cells = <1>;
      #size-cells = <0>;

      display@3f {
        compatible = "sitronix,st7571";
        reg = <0x3f>;
        reset-gpios = <&gpio0 3 GPIO_ACTIVE_LOW>;
        width-mm = <37>;
        height-mm = <27>;

        panel-timing {
          hactive = <128>;
          vactive = <96>;
          hback-porch = <0>;
          vback-porch = <0>;
          clock-frequency = <0>;
          hfront-porch = <0>;
          hsync-len = <0>;
          vfront-porch = <0>;
          vsync-len = <0>;
        };
      };
    };
```

## Documentation/devicetree/bindings/display/sitronix,st7586.txt
```
Sitronix ST7586 display panel

Required properties:
- compatible:	"lego,ev3-lcd".
- a0-gpios:	The A0 signal (since this binding is for serial mode, this is
                the pin labeled D1 on the controller, not the pin labeled A0)
- reset-gpios:	Reset pin

The node for this driver must be a child node of a SPI controller, hence
all mandatory properties described in ../spi/spi-bus.txt must be specified.

Optional properties:
- rotation:	panel rotation in degrees counter clockwise (0,90,180,270)

Example:
	display@0{
		compatible = "lego,ev3-lcd";
		reg = <0>;
		spi-max-frequency = <10000000>;
		a0-gpios = <&gpio 43 GPIO_ACTIVE_HIGH>;
		reset-gpios = <&gpio 80 GPIO_ACTIVE_HIGH>;
	};
```

## Documentation/devicetree/bindings/display/sitronix,st7586.yaml
```yaml
# SPDX-License-Identifier: (GPL-2.0-only OR BSD-2-Clause)
%YAML 1.2
---
$id: http://devicetree.org/schemas/display/sitronix,st7586.yaml#
$schema: http://devicetree.org/meta-schemas/core.yaml#

title: Sitronix ST7586 Display Controller

maintainers:
  - David Lechner <david@lechnology.com>

description:
  Sitronix ST7586 is a driver and controller for 4-level gray
  scale and monochrome dot matrix LCD panels.
  https://topwaydisplay.com/sites/default/files/2020-04/ST7586S.pdf

$ref: panel/panel-common.yaml#

additionalProperties: false

properties:
  compatible:
    const: lego,ev3-lcd

  reg:
    maxItems: 1

  spi-max-frequency:
    maximum: 50000000

  a0-gpios:
    description:
      The A0 signal (for serial mode, this is the pin labeled D1 on the
      controller, not the pin labeled A0)
    maxItems: 1

  reset-gpios: true
  rotation: true

required:
  - compatible
  - reg
  - a0-gpios
  - reset-gpios

examples:
  - |
    #include <dt-bindings/gpio/gpio.h>

    spi {
        #address-cells = <1>;
        #size-cells = <0>;

        display@0 {
            compatible = "lego,ev3-lcd";
            reg = <0>;
            spi-max-frequency = <10000000>;
            a0-gpios = <&gpio 43 GPIO_ACTIVE_HIGH>;
            reset-gpios = <&gpio 80 GPIO_ACTIVE_HIGH>;
        };
    };
```

## Documentation/devicetree/bindings/display/sitronix,st7735r.txt
```
Sitronix ST7735R display panels

This binding is for display panels using a Sitronix ST7735R controller in SPI
mode.

Required properties:
- compatible:	"jianda,jd-t18003-t01", "sitronix,st7735r"
- dc-gpios:	Display data/command selection (D/CX)
- reset-gpios:	Reset signal (RSTX)

The node for this driver must be a child node of a SPI controller, hence
all mandatory properties described in ../spi/spi-bus.txt must be specified.

Optional properties:
- rotation:	panel rotation in degrees counter clockwise (0,90,180,270)
- backlight:	phandle of the backlight device attached to the panel

Example:

	backlight: backlight {
		compatible = "gpio-backlight";
		gpios = <&gpio 44 GPIO_ACTIVE_HIGH>;
	}

	...

	display@0{
		compatible = "jianda,jd-t18003-t01", "sitronix,st7735r";
		reg = <0>;
		spi-max-frequency = <32000000>;
		dc-gpios = <&gpio 43 GPIO_ACTIVE_HIGH>;
		reset-gpios = <&gpio 80 GPIO_ACTIVE_HIGH>;
		rotation = <270>;
		backlight = &backlight;
	};
```

## Documentation/devicetree/bindings/display/sitronix,st7735r.yaml
```yaml
# SPDX-License-Identifier: GPL-2.0-only
%YAML 1.2
---
$id: http://devicetree.org/schemas/display/sitronix,st7735r.yaml#
$schema: http://devicetree.org/meta-schemas/core.yaml#

title: Sitronix ST7735R Display Panels Device Tree Bindings

maintainers:
  - David Lechner <david@lechnology.com>

description:
  This binding is for display panels using a Sitronix ST7715R or ST7735R
  controller in SPI mode.

allOf:
  - $ref: panel/panel-common.yaml#

properties:
  compatible:
    oneOf:
      - description:
          Adafruit 1.8" 160x128 Color TFT LCD (Product ID 358 or 618)
        items:
          - enum:
              - jianda,jd-t18003-t01
          - const: sitronix,st7735r
      - description:
          Okaya 1.44" 128x128 Color TFT LCD (E.g. Renesas YRSK-LCD-PMOD)
        items:
          - enum:
              - okaya,rh128128t
          - const: sitronix,st7715r

  dc-gpios:
    maxItems: 1
    description: Display data/command selection (D/CX)

  backlight: true
  reg: true
  spi-max-frequency: true
  reset-gpios: true
  rotation: true

required:
  - compatible
  - reg
  - dc-gpios

additionalProperties: false

examples:
  - |
    #include <dt-bindings/gpio/gpio.h>

    backlight: backlight {
            compatible = "gpio-backlight";
            gpios = <&gpio 44 GPIO_ACTIVE_HIGH>;
    };

    spi {
            #address-cells = <1>;
            #size-cells = <0>;

            display@0{
                    compatible = "jianda,jd-t18003-t01", "sitronix,st7735r";
                    reg = <0>;
                    spi-max-frequency = <32000000>;
                    dc-gpios = <&gpio 43 GPIO_ACTIVE_HIGH>;
                    reset-gpios = <&gpio 80 GPIO_ACTIVE_HIGH>;
                    rotation = <270>;
                    backlight = <&backlight>;
            };
    };

...
```

## Documentation/devicetree/bindings/display/sitronix,st7920.yaml
```yaml
# SPDX-License-Identifier: (GPL-2.0-only OR BSD-2-Clause)
%YAML 1.2
---
$id: http://devicetree.org/schemas/display/sitronix,st7920.yaml#
$schema: http://devicetree.org/meta-schemas/core.yaml#

title: Sitronix ST7920 LCD Display Controllers

maintainers:
  - Iker Pedrosa <ikerpedrosam@gmail.com>

description:
  The Sitronix ST7920 is a controller for monochrome dot-matrix graphical LCDs,
  most commonly used for 128x64 pixel displays.

properties:
  compatible:
    const: sitronix,st7920

  reg:
    maxItems: 1

  vdd-supply:
    description: Regulator that provides 5V Vdd power supply

  reset-gpios:
    maxItems: 1

  spi-max-frequency:
    maximum: 600000

required:
  - compatible
  - reg
  - spi-max-frequency

allOf:
  - $ref: /schemas/spi/spi-peripheral-props.yaml#

unevaluatedProperties: false

examples:
  - |
    #include <dt-bindings/gpio/gpio.h>

    spi {
        #address-cells = <1>;
        #size-cells = <0>;

        display@0 {
            compatible = "sitronix,st7920";
            reg = <0>;
            vdd-supply = <&reg_5v>;
            reset-gpios = <&gpio 25 GPIO_ACTIVE_LOW>;
            spi-max-frequency = <600000>;
            spi-cs-high;
        };
    };
```
