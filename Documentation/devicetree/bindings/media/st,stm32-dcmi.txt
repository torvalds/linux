## Documentation/devicetree/bindings/media/st,stm32-dcmi.txt
```
STMicroelectronics STM32 Digital Camera Memory Interface (DCMI)

Required properties:
- compatible: "st,stm32-dcmi"
- reg: physical base address and length of the registers set for the device
- interrupts: should contain IRQ line for the DCMI
- resets: reference to a reset controller,
          see Documentation/devicetree/bindings/reset/st,stm32-rcc.txt
- clocks: list of clock specifiers, corresponding to entries in
          the clock-names property
- clock-names: must contain "mclk", which is the DCMI peripherial clock
- pinctrl: the pincontrol settings to configure muxing properly
           for pins that connect to DCMI device.
           See Documentation/devicetree/bindings/pinctrl/st,stm32-pinctrl.yaml.
- dmas: phandle to DMA controller node,
        see Documentation/devicetree/bindings/dma/stm32-dma.txt
- dma-names: must contain "tx", which is the transmit channel from DCMI to DMA

DCMI supports a single port node with parallel bus. It should contain one
'port' child node with child 'endpoint' node. Please refer to the bindings
defined in Documentation/devicetree/bindings/media/video-interfaces.txt.

Example:

	dcmi: dcmi@50050000 {
		compatible = "st,stm32-dcmi";
		reg = <0x50050000 0x400>;
		interrupts = <78>;
		resets = <&rcc STM32F4_AHB2_RESET(DCMI)>;
		clocks = <&rcc 0 STM32F4_AHB2_CLOCK(DCMI)>;
		clock-names = "mclk";
		pinctrl-names = "default";
		pinctrl-0 = <&dcmi_pins>;
		dmas = <&dma2 1 1 0x414 0x3>;
		dma-names = "tx";
		port {
			dcmi_0: endpoint {
				remote-endpoint = <...>;
				bus-width = <8>;
				hsync-active = <0>;
				vsync-active = <0>;
				pclk-sample = <1>;
			};
		};
	};
```

## Documentation/devicetree/bindings/media/st,stm32-dcmi.yaml
```yaml
# SPDX-License-Identifier: (GPL-2.0-only OR BSD-2-Clause)
%YAML 1.2
---
$id: http://devicetree.org/schemas/media/st,stm32-dcmi.yaml#
$schema: http://devicetree.org/meta-schemas/core.yaml#

title: STMicroelectronics STM32 Digital Camera Memory Interface (DCMI)

maintainers:
  - Hugues Fruchet <hugues.fruchet@foss.st.com>

properties:
  compatible:
    const: st,stm32-dcmi

  reg:
    maxItems: 1

  interrupts:
    maxItems: 1

  clocks:
    maxItems: 1

  clock-names:
    items:
      - const: mclk

  dmas:
    maxItems: 1

  dma-names:
    items:
      - const: tx

  resets:
    maxItems: 1

  access-controllers:
    minItems: 1
    maxItems: 2

  port:
    $ref: /schemas/graph.yaml#/$defs/port-base
    unevaluatedProperties: false
    description:
      DCMI supports a single port node with parallel bus.

    properties:
      endpoint:
        $ref: video-interfaces.yaml#
        unevaluatedProperties: false

        properties:
          bus-type:
            enum: [5, 6]
            default: 5

          bus-width:
            enum: [8, 10, 12, 14]
            default: 8

        allOf:
          - if:
              properties:
                bus-type:
                  const: 6

            then:
              properties:
                hsync-active: false
                vsync-active: false
                bus-width:
                  enum: [8]

        required:
          - bus-type
          - pclk-sample

required:
  - compatible
  - reg
  - interrupts
  - clocks
  - clock-names
  - resets
  - dmas
  - dma-names
  - port

additionalProperties: false

examples:
  - |
    #include <dt-bindings/interrupt-controller/arm-gic.h>
    #include <dt-bindings/clock/stm32mp1-clks.h>
    #include <dt-bindings/media/video-interfaces.h>
    #include <dt-bindings/reset/stm32mp1-resets.h>

    dcmi: dcmi@4c006000 {
        compatible = "st,stm32-dcmi";
        reg = <0x4c006000 0x400>;
        interrupts = <GIC_SPI 78 IRQ_TYPE_LEVEL_HIGH>;
        resets = <&rcc CAMITF_R>;
        clocks = <&rcc DCMI>;
        clock-names = "mclk";
        dmas = <&dmamux1 75 0x400 0x0d>;
        dma-names = "tx";

        port {
             dcmi_0: endpoint {
                   remote-endpoint = <&ov5640_0>;
                   bus-type = <MEDIA_BUS_TYPE_PARALLEL>;
                   bus-width = <8>;
                   hsync-active = <0>;
                   vsync-active = <0>;
                   pclk-sample = <1>;
             };
        };
    };

...
```

## Documentation/devicetree/bindings/media/st,stm32-dcmipp.yaml
```yaml
# SPDX-License-Identifier: (GPL-2.0-only OR BSD-2-Clause)
%YAML 1.2
---
$id: http://devicetree.org/schemas/media/st,stm32-dcmipp.yaml#
$schema: http://devicetree.org/meta-schemas/core.yaml#

title: STMicroelectronics STM32 DCMIPP Digital Camera Memory Interface Pixel Processor

maintainers:
  - Hugues Fruchet <hugues.fruchet@foss.st.com>
  - Alain Volmat <alain.volmat@foss.st.com>

properties:
  compatible:
    enum:
      - st,stm32mp13-dcmipp
      - st,stm32mp25-dcmipp

  reg:
    maxItems: 1

  interrupts:
    maxItems: 1

  clocks:
    items:
      - description: bus clock
      - description: csi clock
    minItems: 1

  clock-names:
    items:
      - const: kclk
      - const: mclk
    minItems: 1

  resets:
    maxItems: 1

  access-controllers:
    minItems: 1
    maxItems: 2

  port:
    $ref: /schemas/graph.yaml#/$defs/port-base
    unevaluatedProperties: false
    description:
      DCMIPP supports a single port node with parallel bus.

    properties:
      endpoint:
        $ref: video-interfaces.yaml#
        unevaluatedProperties: false

        properties:
          bus-type:
            enum: [4, 5, 6]
            default: 5

          bus-width:
            enum: [8, 10, 12, 14]
            default: 8

          pclk-sample: true
          hsync-active: true
          vsync-active: true

required:
  - compatible
  - reg
  - interrupts
  - clocks
  - resets
  - port

allOf:
  - if:
      properties:
        compatible:
          contains:
            enum:
              - st,stm32mp13-dcmipp
    then:
      properties:
        clocks:
          maxItems: 1

        clock-names:
          maxItems: 1

        port:
          properties:
            endpoint:
              properties:
                bus-type:
                  enum: [5, 6]
    else:
      properties:
        clocks:
          minItems: 2

        clock-names:
          minItems: 2

additionalProperties: false

examples:
  - |
    #include <dt-bindings/interrupt-controller/arm-gic.h>
    #include <dt-bindings/clock/stm32mp13-clks.h>
    #include <dt-bindings/reset/stm32mp13-resets.h>
    dcmipp@5a000000 {
        compatible = "st,stm32mp13-dcmipp";
        reg = <0x5a000000 0x400>;
        interrupts = <GIC_SPI 79 IRQ_TYPE_LEVEL_HIGH>;
        resets = <&rcc DCMIPP_R>;
        clocks = <&rcc DCMIPP_K>;

        port {
             endpoint {
                   remote-endpoint = <&mipid02_2>;
                   bus-width = <8>;
                   hsync-active = <0>;
                   vsync-active = <0>;
                   pclk-sample = <0>;
             };
        };
    };

...
```

## Documentation/devicetree/bindings/media/st,stm32-dma2d.yaml
```yaml
# SPDX-License-Identifier: (GPL-2.0-only OR BSD-2-Clause)
%YAML 1.2
---
$id: http://devicetree.org/schemas/media/st,stm32-dma2d.yaml#
$schema: http://devicetree.org/meta-schemas/core.yaml#

title: STMicroelectronics STM32 Chrom-Art Accelerator DMA2D

description:
  Chrom-ART Accelerator(DMA2D), graphical hardware accelerator
  enabling enhanced graphical user interface with minimum CPU load

  It can perform the following operations.

  - Filling a part or the whole of a destination image with a specific color.
  - Copying a part or the whole of a source image into a part or the whole of
    a destination image.
  - Copying a part or the whole of a source image into a part or the whole of
    a destination image with a pixel format conversion.
  - Blending a part and/or two complete source images with different pixel
    format and copy the result into a part or the whole of a destination image
    with a different color format. (TODO)


maintainers:
  - Dillon Min <dillon.minfei@gmail.com>

properties:
  compatible:
    const: st,stm32-dma2d

  reg:
    maxItems: 1

  interrupts:
    maxItems: 1

  clocks:
    maxItems: 1

  clock-names:
    items:
      - const: dma2d

  resets:
    maxItems: 1

required:
  - compatible
  - reg
  - interrupts
  - clocks
  - clock-names
  - resets

additionalProperties: false

examples:
  - |
    #include <dt-bindings/clock/stm32fx-clock.h>
    #include <dt-bindings/mfd/stm32f4-rcc.h>
    dma2d: dma2d@4002b000 {
        compatible = "st,stm32-dma2d";
        reg = <0x4002b000 0xc00>;
        interrupts = <90>;
        resets = <&rcc STM32F4_AHB1_RESET(DMA2D)>;
        clocks = <&rcc 0 STM32F4_AHB1_CLOCK(DMA2D)>;
        clock-names = "dma2d";
    };

...
```

## Documentation/devicetree/bindings/media/st,stm32mp25-csi.yaml
```yaml
# SPDX-License-Identifier: (GPL-2.0-only OR BSD-2-Clause)
%YAML 1.2
---
$id: http://devicetree.org/schemas/media/st,stm32mp25-csi.yaml#
$schema: http://devicetree.org/meta-schemas/core.yaml#

title: STMicroelectronics STM32 CSI controller

description:
  The STM32 CSI controller, coupled with a D-PHY allows connecting a CSI-2
  based camera to the DCMIPP camera pipeline.

maintainers:
  - Alain Volmat <alain.volmat@foss.st.com>

properties:
  compatible:
    enum:
      - st,stm32mp25-csi

  reg:
    maxItems: 1

  interrupts:
    maxItems: 1

  clocks:
    maxItems: 3

  clock-names:
    items:
      - const: pclk
      - const: txesc
      - const: csi2phy

  resets:
    maxItems: 1

  vdd-supply:
    description: Digital core power supply (0.91V)

  vdda18-supply:
    description: System analog power supply (1.8V)

  access-controllers:
    minItems: 1
    maxItems: 2

  ports:
    $ref: /schemas/graph.yaml#/properties/ports

    properties:
      port@0:
        $ref: /schemas/graph.yaml#/$defs/port-base
        unevaluatedProperties: false
        description:
          Input port node

        properties:
          endpoint:
            $ref: video-interfaces.yaml#
            unevaluatedProperties: false

            properties:
              data-lanes:
                minItems: 1
                items:
                  - const: 1
                  - const: 2

            required:
              - data-lanes

      port@1:
        $ref: /schemas/graph.yaml#/properties/port
        description:
          Output port node

required:
  - compatible
  - reg
  - interrupts
  - clocks
  - clock-names
  - resets
  - ports

additionalProperties: false

examples:
  - |
    #include <dt-bindings/clock/st,stm32mp25-rcc.h>
    #include <dt-bindings/interrupt-controller/arm-gic.h>
    #include <dt-bindings/media/video-interfaces.h>
    #include <dt-bindings/reset/st,stm32mp25-rcc.h>
    csi@48020000 {
        compatible = "st,stm32mp25-csi";
        reg = <0x48020000 0x2000>;
        interrupts = <GIC_SPI 142 IRQ_TYPE_LEVEL_HIGH>;
        resets = <&rcc CSI_R>;
        clocks = <&rcc CK_KER_CSI>, <&rcc CK_KER_CSITXESC>, <&rcc CK_KER_CSIPHY>;
        clock-names = "pclk", "txesc", "csi2phy";

        ports {
            #address-cells = <1>;
            #size-cells = <0>;
            port@0 {
                reg = <0>;
                endpoint {
                    remote-endpoint = <&imx335_ep>;
                    data-lanes = <1 2>;
                };
            };

            port@1 {
                reg = <1>;
                endpoint {
                    remote-endpoint = <&dcmipp_0>;
                };
            };
        };
    };

...
```

## Documentation/devicetree/bindings/media/st,stm32mp25-video-codec.yaml
```yaml
# SPDX-License-Identifier: (GPL-2.0 OR BSD-2-Clause)
%YAML 1.2
---
$id: http://devicetree.org/schemas/media/st,stm32mp25-video-codec.yaml#
$schema: http://devicetree.org/meta-schemas/core.yaml#

title: STMicroelectronics STM32MP25 VDEC video decoder & VENC video encoder

maintainers:
  - Hugues Fruchet <hugues.fruchet@foss.st.com>

description:
  The STMicroelectronics STM32MP25 SOCs embeds a VDEC video hardware
  decoder peripheral based on Verisilicon VC8000NanoD IP (former Hantro G1)
  and a VENC video hardware encoder peripheral based on Verisilicon
  VC8000NanoE IP (former Hantro H1).

properties:
  compatible:
    enum:
      - st,stm32mp25-vdec
      - st,stm32mp25-venc

  reg:
    maxItems: 1

  interrupts:
    maxItems: 1

  clocks:
    maxItems: 1

required:
  - compatible
  - reg
  - interrupts
  - clocks

additionalProperties: false

examples:
  - |
    #include <dt-bindings/interrupt-controller/arm-gic.h>
    video-codec@580d0000 {
        compatible = "st,stm32mp25-vdec";
        reg = <0x580d0000 0x3c8>;
        interrupts = <GIC_SPI 117 IRQ_TYPE_LEVEL_HIGH>;
        clocks = <&ck_icn_p_vdec>;
    };
```

## Documentation/devicetree/bindings/media/st-rc.txt
```
Device-Tree bindings for ST IRB IP

Required properties:
	- compatible: Should contain "st,comms-irb".
	- reg: Base physical address of the controller and length of memory
	  mapped region.
	- interrupts: interrupt-specifier for the sole interrupt generated by
	  the device. The interrupt specifier format depends on the interrupt
	  controller parent.
	- rx-mode: can be "infrared" or "uhf". This property specifies the L1
	  protocol used for receiving remote control signals. rx-mode should
	  be present iff the rx pins are wired up.
	- tx-mode: should be "infrared". This property specifies the L1
	  protocol used for transmitting remote control signals. tx-mode should
	  be present iff the tx pins are wired up.

Optional properties:
	- pinctrl-names, pinctrl-0: the pincontrol settings to configure muxing
	  properly for IRB pins.
	- clocks : phandle with clock-specifier pair for IRB.

Example node:

	rc: rc@fe518000 {
		compatible	= "st,comms-irb";
		reg		= <0xfe518000 0x234>;
		interrupts	= <0 203 0>;
		rx-mode		= "infrared";
	};
```
