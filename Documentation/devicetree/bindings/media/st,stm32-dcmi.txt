## Documentation/devicetree/bindings/media/starfive,jh7110-camss.yaml
```yaml
# SPDX-License-Identifier: (GPL-2.0 OR BSD-2-Clause)
%YAML 1.2
---
$id: http://devicetree.org/schemas/media/starfive,jh7110-camss.yaml#
$schema: http://devicetree.org/meta-schemas/core.yaml#

title: Starfive SoC CAMSS ISP

maintainers:
  - Jack Zhu <jack.zhu@starfivetech.com>
  - Changhuang Liang <changhuang.liang@starfivetech.com>

description:
  The Starfive CAMSS ISP is a Camera interface for Starfive JH7110 SoC. It
  consists of a VIN controller (Video In Controller, a top-level control unit)
  and an ISP.

properties:
  compatible:
    const: starfive,jh7110-camss

  reg:
    maxItems: 2

  reg-names:
    items:
      - const: syscon
      - const: isp

  clocks:
    maxItems: 7

  clock-names:
    items:
      - const: apb_func
      - const: wrapper_clk_c
      - const: dvp_inv
      - const: axiwr
      - const: mipi_rx0_pxl
      - const: ispcore_2x
      - const: isp_axi

  resets:
    maxItems: 6

  reset-names:
    items:
      - const: wrapper_p
      - const: wrapper_c
      - const: axird
      - const: axiwr
      - const: isp_top_n
      - const: isp_top_axi

  power-domains:
    items:
      - description: JH7110 ISP Power Domain Switch Controller.

  interrupts:
    maxItems: 4

  ports:
    $ref: /schemas/graph.yaml#/properties/ports

    properties:
      port@0:
        $ref: /schemas/graph.yaml#/$defs/port-base
        unevaluatedProperties: false
        description: Input port for receiving DVP data.

        properties:
          endpoint:
            $ref: video-interfaces.yaml#
            unevaluatedProperties: false

            properties:
              bus-type:
                enum: [5, 6]

              bus-width:
                enum: [8, 10, 12]

              data-shift:
                enum: [0, 2]
                default: 0

              hsync-active:
                enum: [0, 1]
                default: 1

              vsync-active:
                enum: [0, 1]
                default: 1

            required:
              - bus-type
              - bus-width

      port@1:
        $ref: /schemas/graph.yaml#/properties/port
        description: Input port for receiving CSI data.

    required:
      - port@0
      - port@1

required:
  - compatible
  - reg
  - reg-names
  - clocks
  - clock-names
  - resets
  - reset-names
  - power-domains
  - interrupts
  - ports

additionalProperties: false

examples:
  - |
    isp@19840000 {
        compatible = "starfive,jh7110-camss";
        reg = <0x19840000 0x10000>,
              <0x19870000 0x30000>;
        reg-names = "syscon", "isp";
        clocks = <&ispcrg 0>,
                 <&ispcrg 13>,
                 <&ispcrg 2>,
                 <&ispcrg 12>,
                 <&ispcrg 1>,
                 <&syscrg 51>,
                 <&syscrg 52>;
        clock-names = "apb_func",
                      "wrapper_clk_c",
                      "dvp_inv",
                      "axiwr",
                      "mipi_rx0_pxl",
                      "ispcore_2x",
                      "isp_axi";
        resets = <&ispcrg 0>,
                 <&ispcrg 1>,
                 <&ispcrg 10>,
                 <&ispcrg 11>,
                 <&syscrg 41>,
                 <&syscrg 42>;
        reset-names = "wrapper_p",
                      "wrapper_c",
                      "axird",
                      "axiwr",
                      "isp_top_n",
                      "isp_top_axi";
        power-domains = <&pwrc 5>;
        interrupts = <92>, <87>, <88>, <90>;

        ports {
            #address-cells = <1>;
            #size-cells = <0>;
            port@0 {
                reg = <0>;
                vin_from_sc2235: endpoint {
                    remote-endpoint = <&sc2235_to_vin>;
                    bus-type = <5>;
                    bus-width = <8>;
                    data-shift = <2>;
                    hsync-active = <1>;
                    vsync-active = <0>;
                    pclk-sample = <1>;
                };
            };

            port@1 {
                reg = <1>;
                vin_from_csi2rx: endpoint {
                    remote-endpoint = <&csi2rx_to_vin>;
                };
            };
        };
    };
```

## Documentation/devicetree/bindings/media/stih-cec.txt
```
STMicroelectronics STIH4xx HDMI CEC driver

Required properties:
 - compatible : value should be "st,stih-cec"
 - reg : Physical base address of the IP registers and length of memory
	 mapped region.
 - clocks : from common clock binding: handle to HDMI CEC clock
 - interrupts : HDMI CEC interrupt number to the CPU.
 - pinctrl-names: Contains only one value - "default"
 - pinctrl-0: Specifies the pin control groups used for CEC hardware.
 - resets: Reference to a reset controller
 - hdmi-phandle: Phandle to the HDMI controller, see also cec.txt.

Example for STIH407:

sti-cec@94a087c {
	compatible = "st,stih-cec";
	reg = <0x94a087c 0x64>;
	clocks = <&clk_sysin>;
	clock-names = "cec-clk";
	interrupts = <GIC_SPI 140 IRQ_TYPE_NONE>;
	interrupt-names = "cec-irq";
	pinctrl-names = "default";
	pinctrl-0 = <&pinctrl_cec0_default>;
	resets = <&softreset STIH407_LPM_SOFTRESET>;
	hdmi-phandle = <&hdmi>;
};
```

## Documentation/devicetree/bindings/media/stih407-c8sectpfe.txt
```
STMicroelectronics STi c8sectpfe binding
============================================

This document describes the c8sectpfe device bindings that is used to get transport
stream data into the SoC on the TS pins, and into DDR for further processing.

It is typically used in conjunction with one or more demodulator and tuner devices
which converts from the RF to digital domain. Demodulators and tuners are usually
located on an external DVB frontend card connected to SoC TS input pins.

Currently 7 TS input (tsin) channels are supported on the stih407 family SoC.

Required properties (controller (parent) node):
- compatible	: Should be "stih407-c8sectpfe"

- reg		: Address and length of register sets for each device in
		  "reg-names"

- reg-names	: The names of the register addresses corresponding to the
		  registers filled in "reg":
			- c8sectpfe: c8sectpfe registers
			- c8sectpfe-ram: c8sectpfe internal sram

- clocks	: phandle list of c8sectpfe clocks
- clock-names	: should be "c8sectpfe"
See: Documentation/devicetree/bindings/clock/clock-bindings.txt

- pinctrl-names	: a pinctrl state named tsin%d-serial or tsin%d-parallel (where %d is tsin-num)
		   must be defined for each tsin child node.
- pinctrl-0	: phandle referencing pin configuration for this tsin configuration
See: Documentation/devicetree/bindings/pinctrl/pinctrl-bindings.txt


Required properties (tsin (child) node):

- tsin-num	: tsin id of the InputBlock (must be between 0 to 6)
- i2c-bus	: phandle to the I2C bus DT node which the demodulators & tuners on this tsin channel are connected.
- reset-gpios	: reset gpio for this tsin channel.

Optional properties (tsin (child) node):

- invert-ts-clk		: Bool property to control sense of ts input clock (data stored on falling edge of clk).
- serial-not-parallel	: Bool property to configure input bus width (serial on ts_data<7>).
- async-not-sync	: Bool property to control if data is received in asynchronous mode
			   (all bits/bytes with ts_valid or ts_packet asserted are valid).

- dvb-card		: Describes the NIM card connected to this tsin channel.

Example:

/* stih410 SoC b2120 + b2004a + stv0367-pll(NIMB) + stv0367-tda18212 (NIMA) DT example) */

	c8sectpfe@8a20000 {
		compatible = "st,stih407-c8sectpfe";
		reg = <0x08a20000 0x10000>, <0x08a00000 0x4000>;
		reg-names = "stfe", "stfe-ram";
		interrupts = <GIC_SPI 34 IRQ_TYPE_NONE>, <GIC_SPI 35 IRQ_TYPE_NONE>;
		interrupt-names = "stfe-error-irq", "stfe-idle-irq";
		pinctrl-0	= <&pinctrl_tsin0_serial>;
		pinctrl-1	= <&pinctrl_tsin0_parallel>;
		pinctrl-2	= <&pinctrl_tsin3_serial>;
		pinctrl-3	= <&pinctrl_tsin4_serial_alt3>;
		pinctrl-4	= <&pinctrl_tsin5_serial_alt1>;
		pinctrl-names	= "tsin0-serial",
				  "tsin0-parallel",
				  "tsin3-serial",
				  "tsin4-serial",
				  "tsin5-serial";
		clocks = <&clk_s_c0_flexgen CLK_PROC_STFE>;
		clock-names = "c8sectpfe";

		/* tsin0 is TSA on NIMA */
		tsin0: port@0 {
			tsin-num		= <0>;
			serial-not-parallel;
			i2c-bus			= <&ssc2>;
			reset-gpios		= <&pio15 4 GPIO_ACTIVE_HIGH>;
			dvb-card		= <STV0367_TDA18212_NIMA_1>;
		};

		tsin3: port@3 {
			tsin-num		= <3>;
			serial-not-parallel;
			i2c-bus			= <&ssc3>;
			reset-gpios		= <&pio15 7 GPIO_ACTIVE_HIGH>;
			dvb-card		= <STV0367_TDA18212_NIMB_1>;
		};
	};
```

## Documentation/devicetree/bindings/media/sun6i-csi.txt
```
Allwinner V3s Camera Sensor Interface
-------------------------------------

Allwinner V3s SoC features a CSI module(CSI1) with parallel interface.

Required properties:
  - compatible: value must be one of:
    * "allwinner,sun6i-a31-csi"
    * "allwinner,sun8i-h3-csi"
    * "allwinner,sun8i-v3s-csi"
    * "allwinner,sun50i-a64-csi"
  - reg: base address and size of the memory-mapped region.
  - interrupts: interrupt associated to this IP
  - clocks: phandles to the clocks feeding the CSI
    * bus: the CSI interface clock
    * mod: the CSI module clock
    * ram: the CSI DRAM clock
  - clock-names: the clock names mentioned above
  - resets: phandles to the reset line driving the CSI

The CSI node should contain one 'port' child node with one child 'endpoint'
node, according to the bindings defined in
Documentation/devicetree/bindings/media/video-interfaces.txt.

Endpoint node properties for CSI
---------------------------------
See the video-interfaces.txt for a detailed description of these properties.
- remote-endpoint	: (required) a phandle to the bus receiver's endpoint
			   node
- bus-width:		: (required) must be 8, 10, 12 or 16
- pclk-sample		: (optional) (default: sample on falling edge)
- hsync-active		: (required; parallel-only)
- vsync-active		: (required; parallel-only)

Example:

csi1: csi@1cb4000 {
	compatible = "allwinner,sun8i-v3s-csi";
	reg = <0x01cb4000 0x1000>;
	interrupts = <GIC_SPI 84 IRQ_TYPE_LEVEL_HIGH>;
	clocks = <&ccu CLK_BUS_CSI>,
		 <&ccu CLK_CSI1_SCLK>,
		 <&ccu CLK_DRAM_CSI>;
	clock-names = "bus", "mod", "ram";
	resets = <&ccu RST_BUS_CSI>;

	port {
		/* Parallel bus endpoint */
		csi1_ep: endpoint {
			remote-endpoint = <&adv7611_ep>;
			bus-width = <16>;

			/* If hsync-active/vsync-active are missing,
			   embedded BT.656 sync is used */
			hsync-active = <0>; /* Active low */
			vsync-active = <0>; /* Active low */
			pclk-sample = <1>;  /* Rising */
		};
	};
};
```

## Documentation/devicetree/bindings/media/sunxi-ir.txt
```
Device-Tree bindings for SUNXI IR controller found in sunXi SoC family

Required properties:
- compatible	    : "allwinner,sun4i-a10-ir" or "allwinner,sun5i-a13-ir"
- clocks	    : list of clock specifiers, corresponding to
		      entries in clock-names property;
- clock-names	    : should contain "apb" and "ir" entries;
- interrupts	    : should contain IR IRQ number;
- reg		    : should contain IO map address for IR.

Optional properties:
- linux,rc-map-name: see rc.txt file in the same directory.
- resets : phandle + reset specifier pair
- clock-frequency  : IR Receiver clock frequency, in Hertz. Defaults to 8 MHz
		     if missing.

Example:

ir0: ir@1c21800 {
	compatible = "allwinner,sun4i-a10-ir";
	clocks = <&apb0_gates 6>, <&ir0_clk>;
	clock-names = "apb", "ir";
	clock-frequency = <3000000>;
	resets = <&apb0_rst 1>;
	interrupts = <0 5 1>;
	reg = <0x01C21800 0x40>;
	linux,rc-map-name = "rc-rc6-mce";
};
```

## Documentation/devicetree/bindings/media/tango-ir.txt
```
Sigma Designs Tango IR NEC/RC-5/RC-6 decoder (SMP86xx and SMP87xx)

Required properties:

- compatible: "sigma,smp8642-ir"
- reg: address/size of NEC+RC5 area, address/size of RC6 area
- interrupts: spec for IR IRQ
- clocks: spec for IR clock (typically the crystal oscillator)

Optional properties:

- linux,rc-map-name: see Documentation/devicetree/bindings/media/rc.txt

Example:

	ir@10518 {
		compatible = "sigma,smp8642-ir";
		reg = <0x10518 0x18>, <0x105e0 0x1c>;
		interrupts = <21 IRQ_TYPE_EDGE_RISING>;
		clocks = <&xtal>;
	};
```

## Documentation/devicetree/bindings/media/tegra-cec.txt
```
* Tegra HDMI CEC hardware

The HDMI CEC module is present in Tegra SoCs and its purpose is to
handle communication between HDMI connected devices over the CEC bus.

Required properties:
  - compatible : value should be one of the following:
	"nvidia,tegra114-cec"
	"nvidia,tegra124-cec"
	"nvidia,tegra210-cec"
  - reg : Physical base address of the IP registers and length of memory
	  mapped region.
  - interrupts : HDMI CEC interrupt number to the CPU.
  - clocks : from common clock binding: handle to HDMI CEC clock.
  - clock-names : from common clock binding: must contain "cec",
		  corresponding to the entry in the clocks property.
  - hdmi-phandle : phandle to the HDMI controller, see also cec.txt.

Example:

cec@70015000 {
	compatible = "nvidia,tegra124-cec";
	reg = <0x0 0x70015000 0x0 0x00001000>;
	interrupts = <GIC_SPI 3 IRQ_TYPE_LEVEL_HIGH>;
	clocks = <&tegra_car TEGRA124_CLK_CEC>;
	clock-names = "cec";
};
```
