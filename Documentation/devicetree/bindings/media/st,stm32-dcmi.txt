## Documentation/devicetree/bindings/media/ti,omap3isp.yaml
```yaml
# SPDX-License-Identifier: (GPL-2.0-only OR BSD-2-Clause)
%YAML 1.2
---
$id: http://devicetree.org/schemas/media/ti,omap3isp.yaml#
$schema: http://devicetree.org/meta-schemas/core.yaml#

title: Texas Instruments OMAP 3 Image Signal Processor (ISP)

maintainers:
  - Laurent Pinchart <laurent.pinchart@ideasonboard.com>
  - Sakari Ailus <sakari.ailus@iki.fi>

description:
  The OMAP 3 ISP is an image signal processor present in OMAP 3 SoCs.

properties:
  compatible:
    const: ti,omap3-isp

  reg:
    items:
      - description: Core ISP registers up to the end of the SBL block
      - description: CSI PHYs and receivers registers

  interrupts:
    maxItems: 1

  iommus:
    maxItems: 1

  syscon:
    $ref: /schemas/types.yaml#/definitions/phandle-array
    items:
      - items:
          - description: phandle to System Control Module
          - description: register offset to Complex I/O or CSI-PHY register
    description:
      Phandle and register offset to the Complex I/O or CSI-PHY register

  ti,phy-type:
    $ref: /schemas/types.yaml#/definitions/uint32
    enum: [0, 1]
    description:
      0 - OMAP3ISP_PHY_TYPE_COMPLEX_IO (e.g. OMAP 3430)
      1 - OMAP3ISP_PHY_TYPE_CSIPHY (e.g. OMAP 3630)

  '#clock-cells':
    const: 1
    description:
      The ISP provides two external clocks, cam_xclka and cam_xclkb,
      at indices 0 and 1 respectively.

  vdd-csiphy1-supply:
    description: Voltage supply of the CSI-2 PHY 1

  vdd-csiphy2-supply:
    description: Voltage supply of the CSI-2 PHY 2

  ports:
    $ref: /schemas/graph.yaml#/properties/ports

    properties:
      port@0:
        $ref: /schemas/graph.yaml#/$defs/port-base
        unevaluatedProperties: false
        description: Parallel (CCDC) interface

        properties:
          endpoint:
            $ref: /schemas/media/video-interfaces.yaml#
            unevaluatedProperties: false

      port@1:
        $ref: /schemas/graph.yaml#/$defs/port-base
        unevaluatedProperties: false
        description: |
          CSIPHY1 interface:
            OMAP 3630: CSI2C / CCP2B
            OMAP 3430: CSI1 (CSIb)

        properties:
          endpoint:
            $ref: /schemas/media/video-interfaces.yaml#
            unevaluatedProperties: false

            properties:
              lane-polarities:
                minItems: 2
                maxItems: 3

              data-lanes:
                minItems: 1
                maxItems: 2
                items:
                  minimum: 1
                  maximum: 3

              clock-lanes:
                minimum: 1
                maximum: 3

      port@2:
        $ref: /schemas/graph.yaml#/$defs/port-base
        unevaluatedProperties: false
        description: |
          CSIPHY2 interface:
            OMAP 3630: CSI2A / CCP2B
            OMAP 3430: CSI2 (CSIa)

        properties:
          endpoint:
            $ref: /schemas/media/video-interfaces.yaml#
            unevaluatedProperties: false

            properties:
              lane-polarities:
                minItems: 2
                maxItems: 3

              data-lanes:
                minItems: 1
                maxItems: 2
                items:
                  minimum: 1
                  maximum: 3

              clock-lanes:
                minimum: 1
                maximum: 3

required:
  - compatible
  - reg
  - interrupts
  - iommus
  - syscon
  - ti,phy-type
  - '#clock-cells'

additionalProperties: false

examples:
  - |
    #include <dt-bindings/media/omap3-isp.h>

    isp@480bc000 {
        compatible = "ti,omap3-isp";
        reg = <0x480bc000 0x12fc>,
              <0x480bd800 0x0600>;
        interrupts = <24>;
        iommus = <&mmu_isp>;
        syscon = <&scm_conf 0x2f0>;
        ti,phy-type = <OMAP3ISP_PHY_TYPE_CSIPHY>;
        #clock-cells = <1>;
        vdd-csiphy1-supply = <&vaux2>;
        vdd-csiphy2-supply = <&vaux2>;

        ports {
            #address-cells = <1>;
            #size-cells = <0>;

            port@0 {
                reg = <0>;
                parallel_ep: endpoint {
                    remote-endpoint = <&parallel>;
                };
            };

            port@1 {
                reg = <1>;
                csi1_ep: endpoint {
                    remote-endpoint = <&smia_1>;
                    clock-lanes = <1>;
                    data-lanes = <2>;
                    lane-polarities = <0 0>;
                };
            };

            port@2 {
                reg = <2>;
                csi2a_ep: endpoint {
                    remote-endpoint = <&smia_2>;
                    clock-lanes = <2>;
                    data-lanes = <1 3>;
                    lane-polarities = <1 1 1>;
                };
            };
        };
    };
```

## Documentation/devicetree/bindings/media/ti,vip.yaml
```yaml
# SPDX-License-Identifier: (GPL-2.0-only OR BSD-2-Clause)
# Copyright (C) 2025 Texas Instruments Incorporated -  http://www.ti.com/
%YAML 1.2
---
$id: http://devicetree.org/schemas/media/ti,vip.yaml#
$schema: http://devicetree.org/meta-schemas/core.yaml#

title: Texas Instruments DRA7x Video Input Port (VIP)

maintainers:
  - Yemike Abhilash Chandra <y-abhilashchandra@ti.com>

description: |-
  Video Input Port (VIP) can be found on devices such as DRA7xx and
  provides the system interface and the processing capability to
  connect parallel image-sensor as well as BT.656/1120 capable encoder
  chip to DRA7x device.

  Each VIP instance supports 2 independently configurable external
  video input capture slices (Slice 0 and Slice 1) each providing
  up to two video input ports (Port A and Port B).

properties:
  compatible:
    enum:
      - ti,dra7-vip

  reg:
    maxItems: 1

  interrupts:
    items:
      - description: IRQ index 0 is used for Slice0 interrupts
      - description: IRQ index 1 is used for Slice1 interrupts

  ti,ctrl-module:
    description:
      Reference to the device control module that provides clock-edge
      inversion control for VIP ports. These controls allow the
      VIP to sample pixel data on the correct clock edge.
    $ref: /schemas/types.yaml#/definitions/phandle-array
    items:
      items:
        - description: phandle to device control module
        - description: offset to the CTRL_CORE_SMA_SW_1 register
        - description: Bit field to slice 0 port A
        - description: Bit field to slice 0 port B
        - description: Bit field to slice 1 port A
        - description: Bit field to slice 1 port B
    maxItems: 1

  ports:
    $ref: /schemas/graph.yaml#/properties/ports

    patternProperties:
      '^port@[0-3]$':
        $ref: /schemas/graph.yaml#/$defs/port-base
        unevaluatedProperties: false
        description: |
          Each VIP instance supports 2 independently configurable external video
          input capture slices (Slice 0 and Slice 1) each providing up to two video
          input ports (Port A and Port B). These ports represent the following
          port@0 -> Slice 0 Port A
          port@1 -> Slice 0 Port B
          port@2 -> Slice 1 Port A
          port@3 -> Slice 1 Port B

        properties:
          endpoint:
            $ref: /schemas/media/video-interfaces.yaml#
            unevaluatedProperties: false

            properties:
              bus-width:
                enum: [8, 16, 24]
                default: 8

required:
  - compatible
  - reg
  - interrupts
  - ti,ctrl-module
  - ports

additionalProperties: false

examples:
  - |
    #include <dt-bindings/interrupt-controller/arm-gic.h>
    #include <dt-bindings/interrupt-controller/irq.h>

    video@48970000 {
      compatible = "ti,dra7-vip";
      reg = <0x48970000 0x1000>;
      interrupts = <GIC_SPI 351 IRQ_TYPE_LEVEL_HIGH>,
                   <GIC_SPI 392 IRQ_TYPE_LEVEL_HIGH>;
      ti,ctrl-module = <&scm_conf 0x534 0x0 0x2 0x1 0x3>;

      ports {
        #address-cells = <1>;
        #size-cells = <0>;

        vin1a: port@0 {
          reg = <0>;

          vin1a_ep: endpoint {
            remote-endpoint = <&camera1>;
            hsync-active = <1>;
            vsync-active = <1>;
            pclk-sample = <0>;
            bus-width = <8>;
          };
        };

        vin1b: port@1 {
          reg = <1>;

          vin1b_ep: endpoint {
            remote-endpoint = <&camera2>;
            hsync-active = <1>;
            vsync-active = <1>;
            pclk-sample = <0>;
            bus-width = <8>;
          };
        };

        vin2a: port@2 {
          reg = <2>;

          vin2a_ep: endpoint {
            remote-endpoint = <&camera3>;
            hsync-active = <1>;
            vsync-active = <1>;
            pclk-sample = <0>;
            bus-width = <16>;
          };
        };

        vin2b: port@3 {
          reg = <3>;

          vin2b_ep: endpoint {
            remote-endpoint = <&camera4>;
            hsync-active = <1>;
            vsync-active = <1>;
            pclk-sample = <0>;
            bus-width = <8>;
          };
        };
      };
    };
...
```

## Documentation/devicetree/bindings/media/ti,vpe.yaml
```yaml
# SPDX-License-Identifier: (GPL-2.0-only OR BSD-2-Clause)
%YAML 1.2
---
$id: http://devicetree.org/schemas/media/ti,vpe.yaml#
$schema: http://devicetree.org/meta-schemas/core.yaml#

title: Texas Instruments DRA7x Video Processing Engine (VPE) Device Tree Bindings

maintainers:
  - Benoit Parrot <bparrot@ti.com>

description: |-
  The Video Processing Engine (VPE) is a key component for image post
  processing applications. VPE consist of a single memory to memory
  path which can perform chroma up/down sampling, deinterlacing,
  scaling and color space conversion.

properties:
  compatible:
      const: ti,dra7-vpe

  reg:
    items:
      - description: The VPE main register region
      - description: Scaler (SC) register region
      - description: Color Space Conversion (CSC) register region
      - description: Video Port Direct Memory Access (VPDMA) register region

  reg-names:
    items:
      - const: vpe_top
      - const: sc
      - const: csc
      - const: vpdma

  interrupts:
    maxItems: 1

required:
  - compatible
  - reg
  - reg-names
  - interrupts

additionalProperties: false

examples:
  - |
    #include <dt-bindings/interrupt-controller/arm-gic.h>

    vpe: vpe@489d0000 {
        compatible = "ti,dra7-vpe";
        reg = <0x489d0000 0x120>,
              <0x489d0700 0x80>,
              <0x489d5700 0x18>,
              <0x489dd000 0x400>;
        reg-names = "vpe_top",
                    "sc",
                    "csc",
                    "vpdma";
        interrupts = <GIC_SPI 354 IRQ_TYPE_LEVEL_HIGH>;
    };

...
```

## Documentation/devicetree/bindings/media/ti-am437x-vpfe.txt
```
Texas Instruments AM437x CAMERA (VPFE)
--------------------------------------

The Video Processing Front End (VPFE) is a key component for image capture
applications. The capture module provides the system interface and the
processing capability to connect RAW image-sensor modules and video decoders
to the AM437x device.

Required properties:
- compatible: must be "ti,am437x-vpfe"
- reg: physical base address and length of the registers set for the device;
- interrupts: should contain IRQ line for the VPFE;
- ti,am437x-vpfe-interface: can be one of the following,
	0 - Raw Bayer Interface.
	1 - 8 Bit BT656 Interface.
	2 - 10 Bit BT656 Interface.
	3 - YCbCr 8 Bit Interface.
	4 - YCbCr 16 Bit Interface.

VPFE supports a single port node with parallel bus. It should contain one
'port' child node with child 'endpoint' node. Please refer to the bindings
defined in Documentation/devicetree/bindings/media/video-interfaces.txt.

Example:
	vpfe: vpfe@f0034000 {
		compatible = "ti,am437x-vpfe";
		reg = <0x48328000 0x2000>;
		interrupts = <GIC_SPI 50 IRQ_TYPE_LEVEL_HIGH>;

		pinctrl-names = "default", "sleep";
		pinctrl-0 = <&vpfe_pins_default>;
		pinctrl-1 = <&vpfe_pins_sleep>;

		port {
			#address-cells = <1>;
			#size-cells = <0>;

			vpfe0_ep: endpoint {
				remote-endpoint = <&ov2659_1>;
				ti,am437x-vpfe-interface = <0>;
				bus-width = <8>;
				hsync-active = <0>;
				vsync-active = <0>;
			};
		};
	};

	i2c1: i2c@4802a000 {

		ov2659@30 {
			compatible = "ti,ov2659";
			reg = <0x30>;

			port {
				ov2659_1: endpoint {
					remote-endpoint = <&vpfe0_ep>;
					bus-width = <8>;
					mclk-frequency = <12000000>;
				};
			};
	};
```

## Documentation/devicetree/bindings/media/ti-cal.txt
```
Texas Instruments DRA72x CAMERA ADAPTATION LAYER (CAL)
------------------------------------------------------

The Camera Adaptation Layer (CAL) is a key component for image capture
applications. The capture module provides the system interface and the
processing capability to connect CSI2 image-sensor modules to the
DRA72x device.

Required properties:
- compatible:
 Should be "ti,dra72-cal", for DRA72 controllers
 Should be "ti,dra72-pre-es2-cal", for DRA72 controllers pre ES2.0
 Should be "ti,dra76-cal", for DRA76 controllers
 Should be "ti,am654-cal", for AM654 controllers
- reg:	CAL Top level, Receiver Core #0, Receiver Core #1 and Camera RX
	control address space
- reg-names: cal_top, cal_rx_core0, cal_rx_core1 and camerrx_control
	     registers
- interrupts: should contain IRQ line for the CAL;
- ti,camerrx-control: phandle to the device control module and offset to
		      the control_camerarx_core register.
		      This node is meant to replace the "camerrx_control"
		      reg entry above but "camerrx_control" is still
		      handled for backward compatibility.

CAL supports 2 camera port nodes on MIPI bus. Each CSI2 camera port nodes
should contain a 'port' child node with child 'endpoint' node. Please
refer to the bindings defined in
Documentation/devicetree/bindings/media/video-interfaces.txt.

Example:
	cal: cal@4845b000 {
		compatible = "ti,dra72-cal";
		reg = <0x4845B000 0x400>,
		      <0x4845B800 0x40>,
		      <0x4845B900 0x40>;
		reg-names = "cal_top",
			    "cal_rx_core0",
			    "cal_rx_core1";
		interrupts = <GIC_SPI 119 IRQ_TYPE_LEVEL_HIGH>;
		ti,camerrx-control = <&scm_conf 0xE94>;
		#address-cells = <1>;
		#size-cells = <0>;

		ports {
			#address-cells = <1>;
			#size-cells = <0>;

			csi2_0: port@0 {
				reg = <0>;
				csi2_phy0: endpoint {
					remote-endpoint = <&csi2_cam0>;
					clock-lanes = <0>;
					data-lanes = <1 2>;
				};
			};
			csi2_1: port@1 {
				reg = <1>;
			};
		};
	};

	i2c5: i2c@4807c000 {
		clock-frequency = <400000>;

		camera-sensor@3c {
			compatible = "ovti,ov5640";
			reg = <0x3c>;

			clocks = <&clk_fixed>;
			clock-names = "xclk";

			port {
				csi2_cam0: endpoint {
					remote-endpoint = <&csi2_phy0>;
					clock-lanes = <0>;
					data-lanes = <1 2>;
				};
			};
		};
	};
```
