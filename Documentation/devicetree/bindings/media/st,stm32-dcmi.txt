## Documentation/devicetree/bindings/media/ti,cal.yaml
```yaml
# SPDX-License-Identifier: (GPL-2.0-only OR BSD-2-Clause)
%YAML 1.2
---
$id: http://devicetree.org/schemas/media/ti,cal.yaml#
$schema: http://devicetree.org/meta-schemas/core.yaml#

title: Texas Instruments DRA72x CAMERA ADAPTATION LAYER (CAL)

maintainers:
  - Benoit Parrot <bparrot@ti.com>

description: |-
  The Camera Adaptation Layer (CAL) is a key component for image capture
  applications. The capture module provides the system interface and the
  processing capability to connect CSI2 image-sensor modules to the
  DRA72x device.

  CAL supports 2 camera port nodes on MIPI bus.

properties:
  compatible:
    enum:
      # for DRA72 controllers
      - ti,dra72-cal
      # for DRA72 controllers pre ES2.0
      - ti,dra72-pre-es2-cal
      # for DRA76 controllers
      - ti,dra76-cal
      # for AM654 controllers
      - ti,am654-cal

  reg:
    minItems: 2
    items:
      - description: The CAL main register region
      - description: The RX Core0 (DPHY0) register region
      - description: The RX Core1 (DPHY1) register region

  reg-names:
    minItems: 2
    items:
      - const: cal_top
      - const: cal_rx_core0
      - const: cal_rx_core1

  interrupts:
    maxItems: 1

  ti,camerrx-control:
    $ref: "/schemas/types.yaml#/definitions/phandle-array"
    items:
      - items:
          - description: phandle to device control module
          - description: offset to the control_camerarx_core register
    description:
      phandle to the device control module and offset to the
      control_camerarx_core register

  clocks:
    maxItems: 1

  clock-names:
    const: fck

  power-domains:
    description:
      List of phandle and PM domain specifier as documented in
      Documentation/devicetree/bindings/power/power_domain.txt
    maxItems: 1

  ports:
    $ref: /schemas/graph.yaml#/properties/ports

    properties:
      port@0:
        $ref: /schemas/graph.yaml#/$defs/port-base
        unevaluatedProperties: false
        description: CSI2 Port #0

        properties:
          endpoint:
            $ref: video-interfaces.yaml#
            unevaluatedProperties: false

            properties:
              clock-lanes:
                maxItems: 1

              data-lanes:
                minItems: 1
                maxItems: 4

      port@1:
        $ref: /schemas/graph.yaml#/$defs/port-base
        unevaluatedProperties: false
        description: CSI2 Port #1

        properties:
          endpoint:
            $ref: video-interfaces.yaml#
            unevaluatedProperties: false

            properties:
              clock-lanes:
                maxItems: 1

              data-lanes:
                minItems: 1
                maxItems: 4

    required:
      - port@0

required:
  - compatible
  - reg
  - reg-names
  - interrupts
  - ti,camerrx-control

additionalProperties: false

examples:
  - |
    #include <dt-bindings/interrupt-controller/arm-gic.h>

    cal: cal@4845b000 {
        compatible = "ti,dra72-cal";
        reg = <0x4845B000 0x400>,
              <0x4845B800 0x40>,
              <0x4845B900 0x40>;
        reg-names = "cal_top",
                    "cal_rx_core0",
                    "cal_rx_core1";
        interrupts = <GIC_SPI 119 IRQ_TYPE_LEVEL_HIGH>;
        ti,camerrx-control = <&scm_conf 0xE94>;

        ports {
              #address-cells = <1>;
              #size-cells = <0>;

              csi2_0: port@0 {
                    reg = <0>;
                    csi2_phy0: endpoint {
                           remote-endpoint = <&csi2_cam0>;
                           clock-lanes = <0>;
                           data-lanes = <1 2>;
                    };
              };
        };
    };

    i2c {
        clock-frequency = <400000>;
        #address-cells = <1>;
        #size-cells = <0>;

        camera-sensor@3c {
               compatible = "ovti,ov5640";
               reg = <0x3c>;
               AVDD-supply = <&reg_2p8v>;
               DOVDD-supply = <&reg_1p8v>;
               DVDD-supply = <&reg_1p5v>;
               clocks = <&clk_ov5640_fixed>;
               clock-names = "xclk";

               port {
                    csi2_cam0: endpoint {
                            remote-endpoint = <&csi2_phy0>;
                            clock-lanes = <0>;
                            data-lanes = <1 2>;
                    };
               };
        };
    };

...
```

## Documentation/devicetree/bindings/media/ti,da850-vpif.txt
```
Texas Instruments VPIF
----------------------

The TI Video Port InterFace (VPIF) is the primary component for video
capture and display on the DA850/AM18x family of TI DaVinci/Sitara
SoCs.

TI Document reference: SPRUH82C, Chapter 35
http://www.ti.com/lit/pdf/spruh82

Required properties:
- compatible: must be "ti,da850-vpif"
- reg: physical base address and length of the registers set for the device;
- interrupts: should contain IRQ line for the VPIF

Video Capture:

VPIF has a 16-bit parallel bus input, supporting 2 8-bit channels or a
single 16-bit channel.  It should contain at least one port child node
with child 'endpoint' node. Please refer to the bindings defined in
Documentation/devicetree/bindings/media/video-interfaces.txt.

Example using 2 8-bit input channels, one of which is connected to an
I2C-connected TVP5147 decoder:

	vpif: vpif@217000 {
		compatible = "ti,da850-vpif";
		reg = <0x217000 0x1000>;
		interrupts = <92>;

		port {
			vpif_ch0: endpoint@0 {
				  reg = <0>;
				  bus-width = <8>;
				  remote-endpoint = <&composite>;
			};

			vpif_ch1: endpoint@1 {
				  reg = <1>;
				  bus-width = <8>;
				  data-shift = <8>;
			};
		};
	};

[ ... ]

&i2c0 {

	tvp5147@5d {
		compatible = "ti,tvp5147";
		reg = <0x5d>;
		status = "okay";

		port {
			composite: endpoint {
				hsync-active = <1>;
				vsync-active = <1>;
				pclk-sample = <0>;

				/* VPIF channel 0 (lower 8-bits) */
				remote-endpoint = <&vpif_ch0>;
				bus-width = <8>;
			};
		};
	};
};


Alternatively, an example when the bus is configured as a single
16-bit input (e.g. for raw-capture mode):

	vpif: vpif@217000 {
		compatible = "ti,da850-vpif";
		reg = <0x217000 0x1000>;
		interrupts = <92>;

		port {
			vpif_ch0: endpoint {
				  bus-width = <16>;
			};
		};
	};
```

## Documentation/devicetree/bindings/media/ti,j721e-csi2rx-shim.yaml
```yaml
# SPDX-License-Identifier: (GPL-2.0-only OR BSD-2-Clause)
%YAML 1.2
---
$id: http://devicetree.org/schemas/media/ti,j721e-csi2rx-shim.yaml#
$schema: http://devicetree.org/meta-schemas/core.yaml#

title: TI J721E CSI2RX Shim

description: |
  The TI J721E CSI2RX Shim is a wrapper around Cadence CSI2RX bridge that
  enables sending captured frames to memory over PSI-L DMA. In the J721E
  Technical Reference Manual (SPRUIL1B) it is referred to as "SHIM" under the
  CSI_RX_IF section.

maintainers:
  - Jai Luthra <jai.luthra@linux.dev>

properties:
  compatible:
    const: ti,j721e-csi2rx-shim

  dmas:
    minItems: 1
    maxItems: 32

  dma-names:
    minItems: 1
    items:
      - const: rx0
      - const: rx1
      - const: rx2
      - const: rx3
      - const: rx4
      - const: rx5
      - const: rx6
      - const: rx7
      - const: rx8
      - const: rx9
      - const: rx10
      - const: rx11
      - const: rx12
      - const: rx13
      - const: rx14
      - const: rx15
      - const: rx16
      - const: rx17
      - const: rx18
      - const: rx19
      - const: rx20
      - const: rx21
      - const: rx22
      - const: rx23
      - const: rx24
      - const: rx25
      - const: rx26
      - const: rx27
      - const: rx28
      - const: rx29
      - const: rx30
      - const: rx31

  reg:
    maxItems: 1

  power-domains:
    maxItems: 1

  ranges: true

  "#address-cells": true

  "#size-cells": true

patternProperties:
  "^csi-bridge@":
    type: object
    description: CSI2 bridge node.
    $ref: cdns,csi2rx.yaml#

required:
  - compatible
  - reg
  - dmas
  - dma-names
  - power-domains
  - ranges
  - "#address-cells"
  - "#size-cells"

additionalProperties: false

examples:
  - |
    #include <dt-bindings/soc/ti,sci_pm_domain.h>

    ti_csi2rx0: ticsi2rx@4500000 {
        compatible = "ti,j721e-csi2rx-shim";
        dmas = <&main_udmap 0x4940>, <&main_udmap 0x4941>;
        dma-names = "rx0", "rx1";
        reg = <0x4500000 0x1000>;
        power-domains = <&k3_pds 26 TI_SCI_PD_EXCLUSIVE>;
        #address-cells = <1>;
        #size-cells = <1>;
        ranges;

        cdns_csi2rx: csi-bridge@4504000 {
            compatible = "ti,j721e-csi2rx", "cdns,csi2rx";
            reg = <0x4504000 0x1000>;
            clocks = <&k3_clks 26 2>, <&k3_clks 26 0>, <&k3_clks 26 2>,
              <&k3_clks 26 2>, <&k3_clks 26 3>, <&k3_clks 26 3>;
            clock-names = "sys_clk", "p_clk", "pixel_if0_clk",
              "pixel_if1_clk", "pixel_if2_clk", "pixel_if3_clk";
            phys = <&dphy0>;
            phy-names = "dphy";

            ports {
                #address-cells = <1>;
                #size-cells = <0>;

                csi2_0: port@0 {

                    reg = <0>;

                    csi2rx0_in_sensor: endpoint {
                        remote-endpoint = <&csi2_cam0>;
                        bus-type = <4>; /* CSI2 DPHY. */
                        clock-lanes = <0>;
                        data-lanes = <1 2>;
                    };
                };
            };
        };
    };
```

## Documentation/devicetree/bindings/media/ti,omap3isp.txt
```
OMAP 3 ISP Device Tree bindings
===============================

The DT definitions can be found in include/dt-bindings/media/omap3-isp.h.

Required properties
===================

compatible	: must contain "ti,omap3-isp"

reg		: the two registers sets (physical address and length) for the
		  ISP. The first set contains the core ISP registers up to
		  the end of the SBL block. The second set contains the
		  CSI PHYs and receivers registers.
interrupts	: the ISP interrupt specifier
iommus		: phandle and IOMMU specifier for the IOMMU that serves the ISP
syscon		: the phandle and register offset to the Complex I/O or CSI-PHY
		  register
ti,phy-type	: 0 -- OMAP3ISP_PHY_TYPE_COMPLEX_IO (e.g. 3430)
		  1 -- OMAP3ISP_PHY_TYPE_CSIPHY (e.g. 3630)
#clock-cells	: Must be 1 --- the ISP provides two external clocks,
		  cam_xclka and cam_xclkb, at indices 0 and 1,
		  respectively. Please find more information on common
		  clock bindings in ../clock/clock-bindings.txt.

Port nodes (optional)
---------------------

More documentation on these bindings is available in
video-interfaces.txt in the same directory.

reg		: The interface:
		  0 - parallel (CCDC)
		  1 - CSIPHY1 -- CSI2C / CCP2B on 3630;
		      CSI1 -- CSIb on 3430
		  2 - CSIPHY2 -- CSI2A / CCP2B on 3630;
		      CSI2 -- CSIa on 3430

Optional properties
===================

vdd-csiphy1-supply : voltage supply of the CSI-2 PHY 1
vdd-csiphy2-supply : voltage supply of the CSI-2 PHY 2

Endpoint nodes
--------------

lane-polarities	: lane polarity (required on CSI-2)
		  0 -- not inverted; 1 -- inverted
data-lanes	: an array of data lanes from 1 to 3. The length can
		  be either 1 or 2. (required on CSI-2)
clock-lanes	: the clock lane (from 1 to 3). (required on CSI-2)


Example
=======

		isp@480bc000 {
			compatible = "ti,omap3-isp";
			reg = <0x480bc000 0x12fc
			       0x480bd800 0x0600>;
			interrupts = <24>;
			iommus = <&mmu_isp>;
			syscon = <&scm_conf 0x2f0>;
			ti,phy-type = <OMAP3ISP_PHY_TYPE_CSIPHY>;
			#clock-cells = <1>;
			ports {
				#address-cells = <1>;
				#size-cells = <0>;
			};
		};
```
