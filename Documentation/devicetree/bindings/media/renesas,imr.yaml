## Documentation/devicetree/bindings/media/rockchip-mipi-dphy.txt
```
Rockchip SoC MIPI RX D-PHY
-------------------------------------------------------------

Required properties:
- compatible: value should be one of the following
	"rockchip,rk1808-mipi-dphy-rx"
	"rockchip,rk3288-mipi-dphy"
	"rockchip,rk3326-mipi-dphy"
	"rockchip,rk3368-mipi-dphy"
	"rockchip,rk3399-mipi-dphy"
	"rockchip,rv1126-csi-dphy"
- clocks : list of clock specifiers, corresponding to entries in
	clock-names property;
- clock-names: required clock name.

MIPI RX0 D-PHY use registers in "general register files", it
should be a child of the GRF.
MIPI TX1RX1 D-PHY have its own registers, it must have a reg property.

Optional properties:
- reg: offset and length of the register set for the device.
- rockchip,grf: MIPI TX1RX1 D-PHY not only has its own register but also
		the GRF, so it is only necessary for MIPI TX1RX1 D-PHY.

port node
-------------------

The device node should contain two 'port' child nodes, according to the bindings
defined in Documentation/devicetree/bindings/media/video-interfaces.txt.

The first port show the sensors connected in this mipi-dphy.
- endpoint:
	- remote-endpoint: Linked to a sensor with a MIPI CSI-2 video bus.
	- data-lanes : (required) an array specifying active physical MIPI-CSI2
			data input lanes and their mapping to logical lanes; the
			D-PHY can't reroute lanes, so the array's content should
			be consecutive and only its length is meaningful.
			For CCP2, v4l2 fwnode endpoint parse this read by u32.
	- bus-type: data bus type. Possible values are:
			0 - autodetect based on other properties (MIPI CSI-2 D-PHY, parallel or Bt656)
			1 - MIPI CSI-2 C-PHY, no support
			2 - MIPI CSI1, no support
			3 - CCP2, using for lvds
The port node must contain at least one endpoint. It could have multiple endpoints
linked to different sensors, but please note that they are not supposed to be
actived at the same time.

The second port should be connected to isp node.
- endpoint:
	- remote-endpoint:  Linked to Rockchip ISP1, which is defined
		in rockchip-isp1.txt.

Device node example
-------------------

grf: syscon@ff770000 {
	compatible = "rockchip,rk3288-grf", "syscon", "simple-mfd";

...

	mipi_dphy_rx0: mipi-dphy-rx0 {
		compatible = "rockchip,rk3399-mipi-dphy";
		clocks = <&cru SCLK_MIPIDPHY_REF>,
			<&cru SCLK_DPHY_RX0_CFG>,
			<&cru PCLK_VIO_GRF>;
		clock-names = "dphy-ref", "dphy-cfg", "grf";
		power-domains = <&power RK3399_PD_VIO>;

		ports {
			#address-cells = <1>;
			#size-cells = <0>;

			port@0 {
				reg = <0>;
				#address-cells = <1>;
				#size-cells = <0>;

				mipi_in_wcam: endpoint@0 {
					reg = <0>;
					remote-endpoint = <&wcam_out>;
					data-lanes = <1 2>;
				};
				mipi_in_ucam: endpoint@1 {
					reg = <1>;
					remote-endpoint = <&ucam_out>;
					data-lanes = <1>;
				};
			};

			port@1 {
				reg = <1>;

				dphy_rx0_out: endpoint {
					remote-endpoint = <&isp0_mipi_in>;
				};
			};
		};
	};
};

example for rv1126 node
csi_dphy0 {
	compatible = "rockchip,rv1126-csi-dphy";
	reg = <0xff4b0000 0x8000>;
	clocks = <&cru PCLK_CSIPHY0>;
	clock-names = "pclk";
	rockchip,grf = <&grf>;
	status = "okay";
	ports {
		#address-cells = <1>;
		#size-cells = <0>;
		port@0 {
			reg = <0>;
			#address-cells = <1>;
			#size-cells = <0>;

			mipi_in_ucam0: endpoint@1 {
				reg = <1>;
				remote-endpoint = <&ucam_out0>;
				/*data-lanes = <1 2 3 4>; //for mipi*/
				data-lanes = <4>; //for lvds, note: this diff to mipi
				bus-type = <3>; //for lvds
			};
		};
		port@1 {
			reg = <1>;
			#address-cells = <1>;
			#size-cells = <0>;

			csidphy0_out: endpoint@0 {
				reg = <0>;
				remote-endpoint = <&isp_in>;
			};
		};
	};
};
```

## Documentation/devicetree/bindings/media/rockchip-rga.txt
```
device-tree bindings for rockchip 2D raster graphic acceleration controller (RGA)

RGA is a standalone 2D raster graphic acceleration unit. It accelerates 2D
graphics operations, such as point/line drawing, image scaling, rotation,
BitBLT, alpha blending and image blur/sharpness.

Required properties:
- compatible: value should be one of the following
  "rockchip,rk3228-rga", "rockchip,rk3288-rga": for Rockchip RK3228
  "rockchip,rk3288-rga": for Rockchip RK3288
  "rockchip,rk3399-rga": for Rockchip RK3399

- interrupts: RGA interrupt specifier.

- clocks: phandle to RGA sclk/hclk/aclk clocks

- clock-names: should be "aclk", "hclk" and "sclk"

- resets: Must contain an entry for each entry in reset-names.
  See ../reset/reset.txt for details.
- reset-names: should be "core", "axi" and "ahb"

Example:
SoC-specific DT entry:
	rga: rga@ff680000 {
		compatible = "rockchip,rk3399-rga";
		reg = <0xff680000 0x10000>;
		interrupts = <GIC_SPI 55 IRQ_TYPE_LEVEL_HIGH>;
		clocks = <&cru ACLK_RGA>, <&cru HCLK_RGA>, <&cru SCLK_RGA_CORE>;
		clock-names = "aclk", "hclk", "sclk";

		resets = <&cru SRST_RGA_CORE>, <&cru SRST_A_RGA>, <&cru SRST_H_RGA>;
		reset-names = "core, "axi", "ahb";
	};
```

## Documentation/devicetree/bindings/media/rockchip-rga.yaml
```yaml
# SPDX-License-Identifier: GPL-2.0
%YAML 1.2
---
$id: http://devicetree.org/schemas/media/rockchip-rga.yaml#
$schema: http://devicetree.org/meta-schemas/core.yaml#

title: Rockchip 2D raster graphic acceleration controller (RGA)

description:
  RGA is a standalone 2D raster graphic acceleration unit. It accelerates 2D
  graphics operations, such as point/line drawing, image scaling, rotation,
  BitBLT, alpha blending and image blur/sharpness.

maintainers:
  - Jacob Chen <jacob-chen@iotwrt.com>
  - Ezequiel Garcia <ezequiel@collabora.com>

properties:
  compatible:
    oneOf:
      - const: rockchip,rk3288-rga
      - const: rockchip,rk3399-rga
      - items:
          - enum:
              - rockchip,rk3228-rga
              - rockchip,rk3568-rga
          - const: rockchip,rk3288-rga

  reg:
    maxItems: 1

  interrupts:
    maxItems: 1

  clocks:
    maxItems: 3

  clock-names:
    items:
      - const: aclk
      - const: hclk
      - const: sclk

  power-domains:
    maxItems: 1

  resets:
    maxItems: 3

  reset-names:
    items:
      - const: core
      - const: axi
      - const: ahb

required:
  - compatible
  - reg
  - interrupts
  - clocks
  - clock-names
  - resets
  - reset-names

additionalProperties: false

examples:
  - |
    #include <dt-bindings/clock/rk3399-cru.h>
    #include <dt-bindings/interrupt-controller/arm-gic.h>
    #include <dt-bindings/power/rk3399-power.h>
    rga: rga@ff680000 {
      compatible = "rockchip,rk3399-rga";
      reg = <0xff680000 0x10000>;
      interrupts = <GIC_SPI 55 IRQ_TYPE_LEVEL_HIGH>;
      clocks = <&cru ACLK_RGA>,
               <&cru HCLK_RGA>,
               <&cru SCLK_RGA_CORE>;
      clock-names = "aclk", "hclk", "sclk";
      power-domains = <&power RK3399_PD_RGA>;
      resets = <&cru SRST_RGA_CORE>,
               <&cru SRST_A_RGA>,
               <&cru SRST_H_RGA>;
      reset-names = "core", "axi", "ahb";
    };
```

## Documentation/devicetree/bindings/media/rockchip-tsp.txt
```
device-tree bindings for rockchip Transport Stream Processing Module (TSP)

TSP is designed for processing Transport Stream Packets,
including receiving TS packets, PID filtering, TS descrambling,
De-multiplexing and TS outputting.Processed data are transferred to
memory buffer which are continued to be processing by software.

Required properties:
- compatible: value should be one of the following
		"rockchip,rk312x-tsp";
		"rockchip,rk3228-tsp";
		"rockchip,rk3288-tsp";
		"rockchip,rk3328-tsp";
		"rockchip,rk3368-tsp";

- reg : offset and length of the register set for the device.

- interrupts: TSP interrupt specifier.

- interrupts-name: should be "irq_tsp".

- clocks: phandle to TSP sclk/hclk/aclk clocks

- clock-names: should be "clk_tsp", "hclk_tsp" and "aclk_tsp"

- pinctrl-names: use "default"

- pinctrl-0: pin config for iomux

Example:
SoC-specific DT entry:
	tsp: tsp@ff050000 {
		compatible = "rockchip,rk3328-tsp";
		reg = <0x0 0xff050000 0x0 0x10000>;
		rockchip,grf = <&grf>;
		interrupts = <GIC_SPI 72 IRQ_TYPE_LEVEL_HIGH>;
		interrupt-names = "irq_tsp";
		clocks = <&cru SCLK_TSP>, <&cru ACLK_TSP>, <&cru HCLK_TSP>;
		clock-names = "clk_tsp", "aclk_tsp", "hclk_tsp";
		pinctrl-names = "default";
		pinctrl-0 = <&tsp_d0
			     &tsp_d1
			     &tsp_d2
			     &tsp_d3
			     &tsp_d4
			     &tsp_d5
			     &tsp_d6
			     &tsp_d7
			     &tsp_sync
			     &tsp_clk
			     &tsp_fail
			     &tsp_valid>;
		status = "disabled";
	};
```

## Documentation/devicetree/bindings/media/rockchip-vpu.txt
```
device-tree bindings for rockchip VPU codec

Rockchip (Video Processing Unit) present in various Rockchip platforms,
such as RK3288, RK3328 and RK3399.

Required properties:
- compatible: value should be one of the following
		"rockchip,rk3288-vpu";
		"rockchip,rk3328-vpu";
		"rockchip,rk3399-vpu";
- interrupts: encoding and decoding interrupt specifiers
- interrupt-names: should be
		"vepu", "vdpu" on RK3288 and RK3399,
		"vdpu" on RK3328.
- clocks: phandle to VPU aclk, hclk clocks
- clock-names: should be "aclk" and "hclk"
- power-domains: phandle to power domain node
- iommus: phandle to a iommu node

Example:
SoC-specific DT entry:
	vpu: video-codec@ff9a0000 {
		compatible = "rockchip,rk3288-vpu";
		reg = <0x0 0xff9a0000 0x0 0x800>;
		interrupts = <GIC_SPI 9 IRQ_TYPE_LEVEL_HIGH>,
			     <GIC_SPI 10 IRQ_TYPE_LEVEL_HIGH>;
		interrupt-names = "vepu", "vdpu";
		clocks = <&cru ACLK_VCODEC>, <&cru HCLK_VCODEC>;
		clock-names = "aclk", "hclk";
		power-domains = <&power RK3288_PD_VIDEO>;
		iommus = <&vpu_mmu>;
	};

	vpu: video-codec@ff350000 {
		compatible = "rockchip,rk3328-vpu";
		reg = <0x0 0xff350000 0x0 0x800>;
		interrupts = <GIC_SPI 9 IRQ_TYPE_LEVEL_HIGH>;
		interrupt-names = "vdpu";
		clocks = <&cru ACLK_VPU>, <&cru HCLK_VPU>;
		clock-names = "aclk", "hclk";
		power-domains = <&power RK3328_PD_VPU>;
		iommus = <&vpu_mmu>;
	};
```

## Documentation/devicetree/bindings/media/rockchip-vpu.yaml
```yaml
# SPDX-License-Identifier: (GPL-2.0 OR BSD-2-Clause)

%YAML 1.2
---
$id: "http://devicetree.org/schemas/media/rockchip-vpu.yaml#"
$schema: "http://devicetree.org/meta-schemas/core.yaml#"

title: Hantro G1 VPU codecs implemented on Rockchip SoCs

maintainers:
  - Ezequiel Garcia <ezequiel@collabora.com>

description:
  Hantro G1 video encode and decode accelerators present on Rockchip SoCs.

properties:
  compatible:
    oneOf:
      - enum:
          - rockchip,rk3036-vpu
          - rockchip,rk3066-vpu
          - rockchip,rk3288-vpu
          - rockchip,rk3328-vpu
          - rockchip,rk3399-vpu
          - rockchip,px30-vpu
      - items:
          - const: rockchip,rk3188-vpu
          - const: rockchip,rk3066-vpu
      - items:
          - const: rockchip,rk3228-vpu
          - const: rockchip,rk3399-vpu

  reg:
    maxItems: 1

  interrupts:
    minItems: 1
    maxItems: 2

  interrupt-names:
    oneOf:
      - const: vdpu
      - items:
          - const: vepu
          - const: vdpu

  clocks:
    oneOf:
      - maxItems: 2
      - maxItems: 4

  clock-names:
    oneOf:
      - items:
          - const: aclk
          - const: hclk
      - items:
          - const: aclk_vdpu
          - const: hclk_vdpu
          - const: aclk_vepu
          - const: hclk_vepu

  power-domains:
    maxItems: 1

  iommus:
    maxItems: 1

required:
  - compatible
  - reg
  - interrupts
  - interrupt-names
  - clocks
  - clock-names

additionalProperties: false

examples:
  - |
        #include <dt-bindings/clock/rk3288-cru.h>
        #include <dt-bindings/interrupt-controller/arm-gic.h>
        #include <dt-bindings/power/rk3288-power.h>

        vpu: video-codec@ff9a0000 {
                compatible = "rockchip,rk3288-vpu";
                reg = <0xff9a0000 0x800>;
                interrupts = <GIC_SPI 9 IRQ_TYPE_LEVEL_HIGH>,
                             <GIC_SPI 10 IRQ_TYPE_LEVEL_HIGH>;
                interrupt-names = "vepu", "vdpu";
                clocks = <&cru ACLK_VCODEC>, <&cru HCLK_VCODEC>;
                clock-names = "aclk", "hclk";
                power-domains = <&power RK3288_PD_VIDEO>;
                iommus = <&vpu_mmu>;
        };
```

## Documentation/devicetree/bindings/media/s5p-cec.txt
```
* Samsung HDMI CEC driver

The HDMI CEC module is present is Samsung SoCs and its purpose is to
handle communication between HDMI connected devices over the CEC bus.

Required properties:
  - compatible : value should be following
	"samsung,s5p-cec"

  - reg : Physical base address of the IP registers and length of memory
	  mapped region.

  - interrupts : HDMI CEC interrupt number to the CPU.
  - clocks : from common clock binding: handle to HDMI CEC clock.
  - clock-names : from common clock binding: must contain "hdmicec",
		  corresponding to entry in the clocks property.
  - samsung,syscon-phandle - phandle to the PMU system controller
  - hdmi-phandle - phandle to the HDMI controller, see also cec.txt.

Optional:
  - needs-hpd : if present the CEC support is only available when the HPD
		is high. See cec.txt for more details.

Example:

hdmicec: cec@100B0000 {
	compatible = "samsung,s5p-cec";
	reg = <0x100B0000 0x200>;
	interrupts = <0 114 0>;
	clocks = <&clock CLK_HDMI_CEC>;
	clock-names = "hdmicec";
	samsung,syscon-phandle = <&pmu_system_controller>;
	hdmi-phandle = <&hdmi>;
	pinctrl-names = "default";
	pinctrl-0 = <&hdmi_cec>;
	status = "okay";
};
```
