## Documentation/devicetree/bindings/media/rockchip,vdec.yaml
```yaml
# SPDX-License-Identifier: (GPL-2.0 OR BSD-2-Clause)
%YAML 1.2
---
$id: http://devicetree.org/schemas/media/rockchip,vdec.yaml#
$schema: http://devicetree.org/meta-schemas/core.yaml#

title: Rockchip Video Decoder (VDec)

maintainers:
  - Heiko Stuebner <heiko@sntech.de>

description: |-
  Rockchip SoCs have variants of the same stateless Video Decoder that can
  decodes H.264, HEVC, VP9 and AV1 streams, depending on the variant.

properties:
  compatible:
    oneOf:
      - const: rockchip,rk3399-vdec
      - const: rockchip,rk3576-vdec
      - const: rockchip,rk3588-vdec
      - items:
          - enum:
              - rockchip,rk3228-vdec
              - rockchip,rk3328-vdec
          - const: rockchip,rk3399-vdec

  reg:
    minItems: 1
    items:
      - description: The function configuration registers base
      - description: The link table configuration registers base
      - description: The cache configuration registers base

  reg-names:
    items:
      - const: function
      - const: link
      - const: cache

  interrupts:
    maxItems: 1

  clocks:
    minItems: 4
    items:
      - description: The Video Decoder AXI interface clock
      - description: The Video Decoder AHB interface clock
      - description: The Video Decoded CABAC clock
      - description: The Video Decoder core clock
      - description: The Video decoder HEVC CABAC clock

  clock-names:
    minItems: 4
    items:
      - const: axi
      - const: ahb
      - const: cabac
      - const: core
      - const: hevc_cabac

  assigned-clocks: true

  assigned-clock-rates: true

  resets:
    items:
      - description: The Video Decoder AXI interface reset
      - description: The Video Decoder AHB interface reset
      - description: The Video Decoded CABAC reset
      - description: The Video Decoder core reset
      - description: The Video decoder HEVC CABAC reset

  reset-names:
    items:
      - const: axi
      - const: ahb
      - const: cabac
      - const: core
      - const: hevc_cabac

  power-domains:
    maxItems: 1

  iommus:
    maxItems: 1

  sram:
    $ref: /schemas/types.yaml#/definitions/phandle
    description: |
      phandle to a reserved on-chip SRAM regions.
      Some SoCs, like rk3588 provide on-chip SRAM to store temporary
      buffers during decoding.

required:
  - compatible
  - reg
  - interrupts
  - clocks
  - clock-names
  - power-domains

allOf:
  - if:
      properties:
        compatible:
          contains:
            enum:
              - rockchip,rk3576-vdec
              - rockchip,rk3588-vdec
    then:
      properties:
        reg:
          minItems: 3
        reg-names:
          minItems: 3
        clocks:
          minItems: 5
        clock-names:
          minItems: 5
        resets:
          minItems: 5
        reset-names:
          minItems: 5
    else:
      properties:
        reg:
          maxItems: 1
        reg-names: false
        clocks:
          maxItems: 4
        clock-names:
          maxItems: 4
        resets: false
        reset-names: false
        sram: false

additionalProperties: false

examples:
  - |
    #include <dt-bindings/interrupt-controller/arm-gic.h>
    #include <dt-bindings/clock/rk3399-cru.h>
    #include <dt-bindings/power/rk3399-power.h>

    vdec: video-codec@ff660000 {
        compatible = "rockchip,rk3399-vdec";
        reg = <0xff660000 0x400>;
        interrupts = <GIC_SPI 116 IRQ_TYPE_LEVEL_HIGH 0>;
        clocks = <&cru ACLK_VDU>, <&cru HCLK_VDU>,
                 <&cru SCLK_VDU_CA>, <&cru SCLK_VDU_CORE>;
        clock-names = "axi", "ahb", "cabac", "core";
        power-domains = <&power RK3399_PD_VDU>;
        iommus = <&vdec_mmu>;
    };

...
```

## Documentation/devicetree/bindings/media/rockchip-cif.txt
```
Rockchip SoC Camera Interface
----------------------------------------------

Rockchip CIF is a camera interface for the Rockchip series of SoCs
like px30, rk3288, rk312x, RV1108 to receive frame data from camera or CCIR656 encoder,
and transfer the data into system main memory by AXI bus.

Required properties:
- compatible: value should be one of the following
	"rockchip,px30-cif";
	"rockchip,rk3128-cif";
	"rockchip,rk3288-cif";
- reg : offset and length of the register set for the device.
- interrupts: should contain cif interrupt.
- clocks: phandle to the required clocks.
- clock-names: required clock name.

Optional properties:
- iommus: iommu node attached to cif if exist.
- resets: CRU reset of cif if exist.

port node
-------------------

The device node should contain one 'port' child node with child 'endpoint'
nodes, according to the bindings defined in Documentation/devicetree/bindings/
media/video-interfaces.txt.

- endpoint(parallel):
	- remote-endpoint: Connecting to a sensor with a parallel video bus.
	- parallel_bus properties: Refer to Documentation/devicetree/bindings/
		media/video-interfaces.txt.

The port node must contain at least one endpoint.
It could have multiple endpoints, but please note the hardware don't support
two sensors work at a time, they are supposed to work asynchronously.

Device node example
-------------------

	cif: cif@ff490000 {
		compatible = "rockchip,px30-cif";
		reg = <0x0 0xff490000 0x0 0x200>;
		interrupts = <GIC_SPI 69 IRQ_TYPE_LEVEL_HIGH>;
		clocks = <&cru ACLK_CIF>, <&cru HCLK_CIF>, <&cru PCLK_CIF>, <&cru SCLK_CIF_OUT>;
		clock-names = "aclk_cif", "hclk_cif", "pclk_cif", "cif_out";
		resets = <&cru SRST_CIF_A>, <&cru SRST_CIF_H>, <&cru SRST_CIF_PCLKIN>;
		reset-names = "rst_cif_a", "rst_cif_h", "rst_cif_pclkin";
		power-domains = <&power PX30_PD_VI>;
		iommus = <&vip_mmu>;
		status = "okay";
		port {
			cif_in: endpoint {
				remote-endpoint = <&gc2155_out>;
				vsync-active = <0>;
				hsync-active = <1>;
			};
		};
	};

	cif: cif@1010a000 {
		compatible = "rockchip,rk3128-cif";
		reg = <0x1010a000 0x200>;

		clocks = <&cru ACLK_CIF>, <&cru HCLK_CIF>,
			 <&cru SCLK_CIF_OUT>;
		clock-names = "aclk_cif", "hclk_cif",
			      "sclk_cif_out";
		resets = <&cru SRST_CIF0>;
		reset-names = "rst_cif";
		interrupts = <GIC_SPI 8 IRQ_TYPE_LEVEL_HIGH>;
		/* px3se has not iommu attached */
		/* iommus = <&cif_mmu>; */
		power-domains = <&power RK3128_PD_VIO>;

		status = "okay";

		port {
			cif_in: endpoint {
				remote-endpoint = <&adv7181_out>;
				vsync-active = <0>;
				hsync-active = <1>;
			};
		};
	};
```

## Documentation/devicetree/bindings/media/rockchip-isp1.txt
```
Rockchip SoC Image Signal Processing unit v1
----------------------------------------------

Rockchip ISP1 is the Camera interface for the Rockchip series of SoCs
which contains image processing, scaling, and compression funcitons.

Required properties:
- compatible: value should be one of the following
	"rockchip,rk1808-rkisp1";
	"rockchip,rk3288-rkisp1";
	"rockchip,rk3326-rkisp1";
	"rockchip,rk3368-rkisp1";
	"rockchip,rk3399-rkisp1";
- reg : offset and length of the register set for the device.
- interrupts: should contain ISP interrupt.
- clocks: phandle to the required clocks.
- clock-names: required clock name.
- iommus: required a iommu node.

port node
-------------------

The device node should contain one 'port' child node with child 'endpoint'
nodes, according to the bindings defined in Documentation/devicetree/bindings/
media/video-interfaces.txt.

- endpoint(parallel):
	- remote-endpoint: Connecting to a sensor with a parallel video bus.
	- parallel_bus properties: Refer to Documentation/devicetree/bindings/
		media/video-interfaces.txt.
- endpoint(mipi):
	- remote-endpoint: Connecting to Rockchip MIPI-DPHY,
		which is defined in rockchip-mipi-dphy.txt.

The port node must contain at least one endpoint, either parallel or mipi.
It could have multiple endpoints, but please note the hardware don't support
two sensors work at a time, they are supposed to work asynchronously.

Device node example
-------------------

	isp0: isp0@ff910000 {
		compatible = "rockchip,rk3399-rkisp1";
		reg = <0x0 0xff910000 0x0 0x4000>;
		interrupts = <GIC_SPI 43 IRQ_TYPE_LEVEL_HIGH 0>;
		clocks = <&cru SCLK_ISP0>,
			 <&cru ACLK_ISP0>, <&cru ACLK_ISP0_WRAPPER>,
			 <&cru HCLK_ISP0>, <&cru HCLK_ISP0_WRAPPER>;
		clock-names = "clk_isp",
			      "aclk_isp", "aclk_isp_wrap",
			      "hclk_isp", "hclk_isp_wrap";
		power-domains = <&power RK3399_PD_ISP0>;
		iommus = <&isp0_mmu>;

		port {
			#address-cells = <1>;
			#size-cells = <0>;

			/* mipi */
			isp0_mipi_in: endpoint@0 {
				reg = <0>;
				remote-endpoint = <&dphy_rx0_out>;
			};

			/* parallel */
			isp0_parallel_in: endpoint@1 {
				reg = <1>;
				remote-endpoint = <&ov5640_out>;
				bus-width = <8>;
			};
		};
	};
```

## Documentation/devicetree/bindings/media/rockchip-isp1.yaml
```yaml
# SPDX-License-Identifier: (GPL-2.0+ OR MIT)
%YAML 1.2
---
$id: http://devicetree.org/schemas/media/rockchip-isp1.yaml#
$schema: http://devicetree.org/meta-schemas/core.yaml#

title: Rockchip SoC Image Signal Processing unit v1

maintainers:
  - Helen Koike <helen.koike@collabora.com>

description: |
  Rockchip ISP1 is the Camera interface for the Rockchip series of SoCs
  which contains image processing, scaling, and compression functions.

properties:
  compatible:
    enum:
      - rockchip,px30-cif-isp
      - rockchip,rk3399-cif-isp

  reg:
    maxItems: 1

  interrupts:
    minItems: 1
    maxItems: 3

  interrupt-names:
    items:
      - const: isp
      - const: mi
      - const: mipi

  clocks:
    minItems: 3
    items:
      # isp0 and isp1
      - description: ISP clock
      - description: ISP AXI clock
      - description: ISP AHB clock
      # only for isp1
      - description: ISP Pixel clock

  clock-names:
    minItems: 3
    items:
      # isp0 and isp1
      - const: isp
      - const: aclk
      - const: hclk
      # only for isp1
      - const: pclk

  iommus:
    maxItems: 1

  phys:
    maxItems: 1
    description: phandle for the PHY port

  phy-names:
    const: dphy

  power-domains:
    maxItems: 1

  ports:
    $ref: /schemas/graph.yaml#/properties/ports

    properties:
      port@0:
        $ref: /schemas/graph.yaml#/$defs/port-base
        unevaluatedProperties: false
        description: connection point for sensors at MIPI-DPHY RX0

        properties:
          endpoint:
            $ref: video-interfaces.yaml#
            unevaluatedProperties: false

            properties:
              data-lanes:
                minItems: 1
                maxItems: 4

    required:
      - port@0

required:
  - compatible
  - reg
  - interrupts
  - clocks
  - clock-names
  - iommus
  - phys
  - phy-names
  - power-domains
  - ports

allOf:
  - if:
      properties:
        compatible:
          contains:
            const: rockchip,rk3399-cif-isp
    then:
      properties:
        clocks:
          minItems: 3
          maxItems: 4
        clock-names:
          minItems: 3
          maxItems: 4

  - if:
      properties:
        compatible:
          contains:
            const: rockchip,px30-cif-isp
    then:
      required:
        - interrupt-names

additionalProperties: false

examples:
  - |

    #include <dt-bindings/clock/rk3399-cru.h>
    #include <dt-bindings/interrupt-controller/arm-gic.h>
    #include <dt-bindings/power/rk3399-power.h>

    parent0: parent {
        #address-cells = <2>;
        #size-cells = <2>;

        isp0: isp0@ff910000 {
            compatible = "rockchip,rk3399-cif-isp";
            reg = <0x0 0xff910000 0x0 0x4000>;
            interrupts = <GIC_SPI 43 IRQ_TYPE_LEVEL_HIGH 0>;
            clocks = <&cru SCLK_ISP0>,
                     <&cru ACLK_ISP0_WRAPPER>,
                     <&cru HCLK_ISP0_WRAPPER>;
            clock-names = "isp", "aclk", "hclk";
            iommus = <&isp0_mmu>;
            phys = <&dphy>;
            phy-names = "dphy";
            power-domains = <&power RK3399_PD_ISP0>;

            ports {
                #address-cells = <1>;
                #size-cells = <0>;

                port@0 {
                    reg = <0>;
                    #address-cells = <1>;
                    #size-cells = <0>;

                    mipi_in_wcam: endpoint@0 {
                        reg = <0>;
                        remote-endpoint = <&wcam_out>;
                        data-lanes = <1 2>;
                    };

                    mipi_in_ucam: endpoint@1 {
                        reg = <1>;
                        remote-endpoint = <&ucam_out>;
                        data-lanes = <1>;
                    };
                };
            };
        };

        i2c7: i2c {
            #address-cells = <1>;
            #size-cells = <0>;

            wcam: camera@36 {
                compatible = "ovti,ov5695";
                reg = <0x36>;

                port {
                    wcam_out: endpoint {
                        remote-endpoint = <&mipi_in_wcam>;
                        data-lanes = <1 2>;
                    };
                };
            };

            ucam: camera@3c {
                compatible = "ovti,ov2685";
                reg = <0x3c>;

                  port {
                      ucam_out: endpoint {
                          remote-endpoint = <&mipi_in_ucam>;
                          data-lanes = <1>;
                      };
                  };
            };
        };
    };

  - |

    #include <dt-bindings/interrupt-controller/arm-gic.h>
    #include <dt-bindings/power/px30-power.h>

    parent1: parent {
        #address-cells = <2>;
        #size-cells = <2>;

        isp: isp@ff4a0000 {
            compatible = "rockchip,px30-cif-isp";
            reg = <0x0 0xff4a0000 0x0 0x8000>;
            interrupts = <GIC_SPI 70 IRQ_TYPE_LEVEL_HIGH>,
                         <GIC_SPI 73 IRQ_TYPE_LEVEL_HIGH>,
                         <GIC_SPI 74 IRQ_TYPE_LEVEL_HIGH>;
            interrupt-names = "isp", "mi", "mipi";
            clocks = <&cru SCLK_ISP0>,
                     <&cru ACLK_ISP0_WRAPPER>,
                     <&cru HCLK_ISP0_WRAPPER>,
                     <&cru PCLK_ISP1_WRAPPER>;
            clock-names = "isp", "aclk", "hclk", "pclk";
            iommus = <&isp_mmu>;
            phys = <&csi_dphy>;
            phy-names = "dphy";
            power-domains = <&power PX30_PD_VI>;

            ports {
                #address-cells = <1>;
                #size-cells = <0>;

                port@0 {
                    reg = <0>;
                    #address-cells = <1>;
                    #size-cells = <0>;

                    mipi_in_ucam1: endpoint@0 {
                        reg = <0>;
                        remote-endpoint = <&ucam1_out>;
                        data-lanes = <1 2>;
                    };
                };
            };
        };

        i2c2: i2c {
            #address-cells = <1>;
            #size-cells = <0>;

            ov5695: camera@36 {
                compatible = "ovti,ov5647";
                reg = <0x36>;
                clocks = <&cru SCLK_CIF_OUT>;

                port {
                    ucam1_out: endpoint {
                        remote-endpoint = <&mipi_in_ucam1>;
                        data-lanes = <1 2>;
                    };
                };
            };
        };
    };
```
