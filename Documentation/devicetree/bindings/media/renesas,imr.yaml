## Documentation/devicetree/bindings/media/renesas,imr.yaml
```yaml
# SPDX-License-Identifier: (GPL-2.0-only OR BSD-2-Clause)
%YAML 1.2
---
$id: http://devicetree.org/schemas/media/renesas,imr.yaml#
$schema: http://devicetree.org/meta-schemas/core.yaml#

title: Renesas R-Car Image Renderer (Distortion Correction Engine)

maintainers:
  - Sergei Shtylyov <sergei.shtylyov@gmail.com>

description: |
  The image renderer, or the distortion correction engine, is a drawing
  processor with a simple instruction system capable of referencing video
  capture data or data in an external memory as 2D texture data and performing
  texture mapping and drawing with respect to any shape that is split into
  triangular objects.

  The image renderer light extended 4 (IMR-LX4) is found in R-Car Gen3 SoCs.

properties:
  compatible:
    items:
      - enum:
          - renesas,r8a7795-imr-lx4 # R-Car H3
          - renesas,r8a7796-imr-lx4 # R-Car M3-W
      - const: renesas,imr-lx4      # R-Car Gen3

  reg:
    maxItems: 1

  interrupts:
    maxItems: 1

  clocks:
    maxItems: 1

  power-domains:
    maxItems: 1

  resets:
    maxItems: 1

required:
  - compatible
  - reg
  - interrupts
  - clocks
  - power-domains
  - resets

additionalProperties: false

examples:
  - |
    #include <dt-bindings/clock/r8a7795-cpg-mssr.h>
    #include <dt-bindings/interrupt-controller/arm-gic.h>
    #include <dt-bindings/power/r8a7795-sysc.h>

    imr-lx4@fe860000 {
            compatible = "renesas,r8a7795-imr-lx4", "renesas,imr-lx4";
            reg = <0xfe860000 0x2000>;
            interrupts = <GIC_SPI 192 IRQ_TYPE_LEVEL_HIGH>;
            clocks = <&cpg CPG_MOD 823>;
            power-domains = <&sysc R8A7795_PD_A3VC>;
            resets = <&cpg 823>;
    };
```

## Documentation/devicetree/bindings/media/renesas,isp.yaml
```yaml
# SPDX-License-Identifier: GPL-2.0-only OR BSD-2-Clause
# Copyright (C) 2021 Renesas Electronics Corp.
%YAML 1.2
---
$id: http://devicetree.org/schemas/media/renesas,isp.yaml#
$schema: http://devicetree.org/meta-schemas/core.yaml#

title: Renesas R-Car ISP Channel Selector

maintainers:
  - Niklas Söderlund <niklas.soderlund@ragnatech.se>

description:
  The R-Car ISP Channel Selector provides MIPI CSI-2 VC and DT filtering
  capabilities for the Renesas R-Car family of devices. It is used in
  conjunction with the R-Car VIN and CSI-2 modules, which provides the video
  capture capabilities.

properties:
  compatible:
    items:
      - enum:
          - renesas,r8a779a0-isp # V3U
          - renesas,r8a779g0-isp # V4H
          - renesas,r8a779h0-isp # V4M
      - const: renesas,rcar-gen4-isp # Generic R-Car Gen4
  reg:
    minItems: 1
    maxItems: 2

  reg-names:
    minItems: 1
    items:
      - const: cs
      - const: core

  interrupts:
    minItems: 1
    maxItems: 2

  interrupt-names:
    minItems: 1
    items:
      - const: cs
      - const: core

  clocks:
    minItems: 1
    maxItems: 2

  clock-names:
    minItems: 1
    items:
      - const: cs
      - const: core

  power-domains:
    maxItems: 1

  resets:
    minItems: 1
    maxItems: 2

  reset-names:
    minItems: 1
    items:
      - const: cs
      - const: core

  renesas,vspx:
    $ref: /schemas/types.yaml#/definitions/phandle
    description:
      A phandle to the companion VSPX responsible for the Streaming Bridge
      functionality. The Streaming Bridge is responsible for feeding image
      and configuration data to the ISP when operating in memory-to-memory
      mode.

  ports:
    $ref: /schemas/graph.yaml#/properties/ports

    properties:
      port@0:
        $ref: /schemas/graph.yaml#/properties/port
        description:
          Input port node, multiple endpoints describing the connected R-Car
          CSI-2 receivers.

      port@1:
        $ref: /schemas/graph.yaml#/properties/port
        description:
          Single endpoint describing the R-Car VIN connected to output port 0.

      port@2:
        $ref: /schemas/graph.yaml#/properties/port
        description:
          Single endpoint describing the R-Car VIN connected to output port 1.

      port@3:
        $ref: /schemas/graph.yaml#/properties/port
        description:
          Single endpoint describing the R-Car VIN connected to output port 2.

      port@4:
        $ref: /schemas/graph.yaml#/properties/port
        description:
          Single endpoint describing the R-Car VIN connected to output port 3.

      port@5:
        $ref: /schemas/graph.yaml#/properties/port
        description:
          Single endpoint describing the R-Car VIN connected to output port 4.

      port@6:
        $ref: /schemas/graph.yaml#/properties/port
        description:
          Single endpoint describing the R-Car VIN connected to output port 5.

      port@7:
        $ref: /schemas/graph.yaml#/properties/port
        description:
          Single endpoint describing the R-Car VIN connected to output port 6.

      port@8:
        $ref: /schemas/graph.yaml#/properties/port
        description:
          Single endpoint describing the R-Car VIN connected to output port 7.

    required:
      - port@0
      - port@1
      - port@2
      - port@3
      - port@4
      - port@5
      - port@6
      - port@7
      - port@8

required:
  - compatible
  - reg
  - reg-names
  - interrupts
  - interrupt-names
  - clocks
  - clock-names
  - power-domains
  - resets
  - reset-names
  - ports

additionalProperties: false

examples:
  - |
    #include <dt-bindings/clock/r8a779a0-cpg-mssr.h>
    #include <dt-bindings/interrupt-controller/arm-gic.h>
    #include <dt-bindings/power/r8a779a0-sysc.h>

    isp1: isp@fed20000 {
            compatible = "renesas,r8a779a0-isp", "renesas,rcar-gen4-isp";
            reg = <0xfed20000 0x10000>, <0xfee00000 0x100000>;
            reg-names = "cs", "core";
            interrupts = <GIC_SPI 154 IRQ_TYPE_LEVEL_HIGH>,
                         <GIC_SPI 155 IRQ_TYPE_LEVEL_HIGH>;
            interrupt-names = "cs", "core";
            clocks = <&cpg CPG_MOD 613>, <&cpg CPG_MOD 17>;
            clock-names = "cs", "core";
            power-domains = <&sysc R8A779A0_PD_A3ISP01>;
            resets = <&cpg 613>, <&cpg 17>;
            reset-names = "cs", "core";

            renesas,vspx = <&vspx1>;

            ports {
                    #address-cells = <1>;
                    #size-cells = <0>;

                    port@0 {
                            #address-cells = <1>;
                            #size-cells = <0>;

                            reg = <0>;
                            isp1csi41: endpoint@1 {
                                    reg = <1>;
                                    remote-endpoint = <&csi41isp1>;
                            };
                    };

                    port@1 {
                            reg = <1>;
                            isp1vin08: endpoint {
                                    remote-endpoint = <&vin08isp1>;
                            };
                    };

                    port@2 {
                            reg = <2>;
                            isp1vin09: endpoint {
                                    remote-endpoint = <&vin09isp1>;
                            };
                    };

                    port@3 {
                            reg = <3>;
                            isp1vin10: endpoint {
                                    remote-endpoint = <&vin10isp1>;
                            };
                    };

                    port@4 {
                            reg = <4>;
                            isp1vin11: endpoint {
                                    remote-endpoint = <&vin11isp1>;
                            };
                    };

                    port@5 {
                            reg = <5>;
                            isp1vin12: endpoint {
                                    remote-endpoint = <&vin12isp1>;
                            };
                    };

                    port@6 {
                            reg = <6>;
                            isp1vin13: endpoint {
                                    remote-endpoint = <&vin13isp1>;
                            };
                    };

                    port@7 {
                            reg = <7>;
                            isp1vin14: endpoint {
                                    remote-endpoint = <&vin14isp1>;
                            };
                    };

                    port@8 {
                            reg = <8>;
                            isp1vin15: endpoint {
                                    remote-endpoint = <&vin15isp1>;
                            };
                    };
            };
    };
```

## Documentation/devicetree/bindings/media/renesas,jpu.txt
```
* Renesas JPEG Processing Unit

The JPEG processing unit (JPU) incorporates the JPEG codec with an encoding
and decoding function conforming to the JPEG baseline process, so that the JPU
can encode image data and decode JPEG data quickly.

Required properties:
- compatible: "renesas,jpu-<soctype>", "renesas,rcar-gen2-jpu" as fallback.
	Examples with soctypes are:
	  - "renesas,jpu-r8a7790" for R-Car H2
	  - "renesas,jpu-r8a7791" for R-Car M2-W
	  - "renesas,jpu-r8a7792" for R-Car V2H
	  - "renesas,jpu-r8a7793" for R-Car M2-N

  - reg: Base address and length of the registers block for the JPU.
  - interrupts: JPU interrupt specifier.
  - clocks: A phandle + clock-specifier pair for the JPU functional clock.

Example: R8A7790 (R-Car H2) JPU node
	jpeg-codec@fe980000 {
		compatible = "renesas,jpu-r8a7790", "renesas,rcar-gen2-jpu";
		reg = <0 0xfe980000 0 0x10300>;
		interrupts = <0 272 IRQ_TYPE_LEVEL_HIGH>;
		clocks = <&mstp1_clks R8A7790_CLK_JPU>;
	};
```

## Documentation/devicetree/bindings/media/renesas,jpu.yaml
```yaml
# SPDX-License-Identifier: (GPL-2.0-only OR BSD-2-Clause)
%YAML 1.2
---
$id: http://devicetree.org/schemas/media/renesas,jpu.yaml#
$schema: http://devicetree.org/meta-schemas/core.yaml#

title: Renesas JPEG Processing Unit

maintainers:
  - Mikhail Ulyanov <mikhail.ulyanov@cogentembedded.com>

description:
  The JPEG processing unit (JPU) incorporates the JPEG codec with an encoding
  and decoding function conforming to the JPEG baseline process, so that the
  JPU can encode image data and decode JPEG data quickly.

properties:
  compatible:
    items:
      - enum:
          - renesas,jpu-r8a7790      # R-Car H2
          - renesas,jpu-r8a7791      # R-Car M2-W
          - renesas,jpu-r8a7792      # R-Car V2H
          - renesas,jpu-r8a7793      # R-Car M2-N
      - const: renesas,rcar-gen2-jpu # R-Car Gen2

  reg:
    maxItems: 1

  interrupts:
    maxItems: 1

  clocks:
    maxItems: 1

  power-domains:
    maxItems: 1

  resets:
    maxItems: 1

required:
  - compatible
  - reg
  - interrupts
  - clocks
  - power-domains
  - resets

additionalProperties: false

examples:
  - |
    #include <dt-bindings/clock/r8a7790-cpg-mssr.h>
    #include <dt-bindings/interrupt-controller/arm-gic.h>
    #include <dt-bindings/power/r8a7790-sysc.h>

    jpeg-codec@fe980000 {
            compatible = "renesas,jpu-r8a7790", "renesas,rcar-gen2-jpu";
            reg = <0xfe980000 0x10300>;
            interrupts = <GIC_SPI 272 IRQ_TYPE_LEVEL_HIGH>;
            clocks = <&cpg CPG_MOD 106>;
            power-domains = <&sysc R8A7790_PD_ALWAYS_ON>;
            resets = <&cpg 106>;
    };
```

## Documentation/devicetree/bindings/media/renesas,r9a09g057-ivc.yaml
```yaml
# SPDX-License-Identifier: (GPL-2.0-only OR BSD-2-Clause)
%YAML 1.2
---
$id: http://devicetree.org/schemas/media/renesas,r9a09g057-ivc.yaml#
$schema: http://devicetree.org/meta-schemas/core.yaml#

title: Renesas RZ/V2H(P) Input Video Control Block

maintainers:
  - Daniel Scally <dan.scally@ideasonboard.com>

description:
  The IVC block is a module that takes video frames from memory and feeds them
  to the Image Signal Processor for processing.

properties:
  compatible:
    const: renesas,r9a09g057-ivc # RZ/V2H(P)

  reg:
    maxItems: 1

  interrupts:
    maxItems: 1

  clocks:
    items:
      - description: Input Video Control block register access clock
      - description: Video input data AXI bus clock
      - description: ISP system clock

  clock-names:
    items:
      - const: reg
      - const: axi
      - const: isp

  power-domains:
    maxItems: 1

  resets:
    items:
      - description: Input Video Control block register access reset
      - description: Video input data AXI bus reset
      - description: ISP core reset

  reset-names:
    items:
      - const: reg
      - const: axi
      - const: isp

  port:
    $ref: /schemas/graph.yaml#/properties/port
    description: Output parallel video bus

    properties:
      endpoint:
        $ref: /schemas/graph.yaml#/properties/endpoint

required:
  - compatible
  - reg
  - interrupts
  - clocks
  - clock-names
  - power-domains
  - resets
  - reset-names
  - port

additionalProperties: false

examples:
  - |
    #include <dt-bindings/clock/renesas,r9a09g057-cpg.h>
    #include <dt-bindings/interrupt-controller/arm-gic.h>

    isp-input@16040000 {
      compatible = "renesas,r9a09g057-ivc";
      reg = <0x16040000 0x230>;

      clocks = <&cpg CPG_MOD 0xe3>,
               <&cpg CPG_MOD 0xe4>,
               <&cpg CPG_MOD 0xe5>;
      clock-names = "reg", "axi", "isp";

      power-domains = <&cpg>;

      resets = <&cpg 0xd4>,
               <&cpg 0xd1>,
               <&cpg 0xd3>;
      reset-names = "reg", "axi", "isp";

      interrupts = <GIC_SPI 861 IRQ_TYPE_EDGE_RISING>;

      port {
        ivc_out: endpoint {
          remote-endpoint = <&isp_in>;
        };
      };
    };
...
```
