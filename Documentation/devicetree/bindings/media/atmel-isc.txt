## Documentation/devicetree/bindings/media/cdns,csi2tx.txt
```
Cadence MIPI-CSI2 TX controller
===============================

The Cadence MIPI-CSI2 TX controller is a CSI-2 bridge supporting up to
4 CSI lanes in output, and up to 4 different pixel streams in input.

Required properties:
  - compatible: must be set to "cdns,csi2tx" or "cdns,csi2tx-1.3"
    for version 1.3 of the controller, "cdns,csi2tx-2.1" for v2.1
  - reg: base address and size of the memory mapped region
  - clocks: phandles to the clocks driving the controller
  - clock-names: must contain:
    * esc_clk: escape mode clock
    * p_clk: register bank clock
    * pixel_if[0-3]_clk: pixel stream output clock, one for each stream
                         implemented in hardware, between 0 and 3

Optional properties
  - phys: phandle to the D-PHY. If it is set, phy-names need to be set
  - phy-names: must contain "dphy"

Required subnodes:
  - ports: A ports node with one port child node per device input and output
           port, in accordance with the video interface bindings defined in
           Documentation/devicetree/bindings/media/video-interfaces.txt. The
           port nodes are numbered as follows.

           Port Description
           -----------------------------
           0    CSI-2 output
           1    Stream 0 input
           2    Stream 1 input
           3    Stream 2 input
           4    Stream 3 input

           The stream input port nodes are optional if they are not
           connected to anything at the hardware level or implemented
           in the design. Since there is only one endpoint per port,
           the endpoints are not numbered.

Example:

csi2tx: csi-bridge@0d0e1000 {
	compatible = "cdns,csi2tx";
	reg = <0x0d0e1000 0x1000>;
	clocks = <&byteclock>, <&byteclock>,
		 <&coreclock>, <&coreclock>,
		 <&coreclock>, <&coreclock>;
	clock-names = "p_clk", "esc_clk",
		      "pixel_if0_clk", "pixel_if1_clk",
		      "pixel_if2_clk", "pixel_if3_clk";

	ports {
		#address-cells = <1>;
		#size-cells = <0>;

		port@0 {
			reg = <0>;

			csi2tx_out: endpoint {
				remote-endpoint = <&remote_in>;
				clock-lanes = <0>;
				data-lanes = <1 2>;
			};
		};

		port@1 {
			reg = <1>;

			csi2tx_in_stream0: endpoint {
				remote-endpoint = <&stream0_out>;
			};
		};

		port@2 {
			reg = <2>;

			csi2tx_in_stream1: endpoint {
				remote-endpoint = <&stream1_out>;
			};
		};

		port@3 {
			reg = <3>;

			csi2tx_in_stream2: endpoint {
				remote-endpoint = <&stream2_out>;
			};
		};

		port@4 {
			reg = <4>;

			csi2tx_in_stream3: endpoint {
				remote-endpoint = <&stream3_out>;
			};
		};
	};
};
```

## Documentation/devicetree/bindings/media/cec-gpio.txt
```
* HDMI CEC GPIO driver

The HDMI CEC GPIO module supports CEC implementations where the CEC line
is hooked up to a pull-up GPIO line and - optionally - the HPD line is
hooked up to another GPIO line.

Please note: the maximum voltage for the CEC line is 3.63V, for the HPD and
5V lines it is 5.3V. So you may need some sort of level conversion circuitry
when connecting them to a GPIO line.

Required properties:
  - compatible: value must be "cec-gpio".
  - cec-gpios: gpio that the CEC line is connected to. The line should be
    tagged as open drain.

If the CEC line is associated with an HDMI receiver/transmitter, then the
following property is also required:

  - hdmi-phandle - phandle to the HDMI controller, see also cec.txt.

If the CEC line is not associated with an HDMI receiver/transmitter, then
the following property is optional and can be used for debugging HPD changes:

  - hpd-gpios: gpio that the HPD line is connected to.

This property is optional and can be used for debugging changes on the 5V line:

  - v5-gpios: gpio that the 5V line is connected to.

Example for the Raspberry Pi 3 where the CEC line is connected to
pin 26 aka BCM7 aka CE1 on the GPIO pin header, the HPD line is
connected to pin 11 aka BCM17 and the 5V line is connected to pin
15 aka BCM22 (some level shifter is needed for the HPD and 5V lines!):

#include <dt-bindings/gpio/gpio.h>

cec-gpio {
	compatible = "cec-gpio";
	cec-gpios = <&gpio 7 (GPIO_ACTIVE_HIGH|GPIO_OPEN_DRAIN)>;
	hpd-gpios = <&gpio 17 GPIO_ACTIVE_HIGH>;
	v5-gpios = <&gpio 22 GPIO_ACTIVE_HIGH>;
};
```

## Documentation/devicetree/bindings/media/cec/cec-common.yaml
```yaml
# SPDX-License-Identifier: GPL-2.0 OR BSD-2-Clause
%YAML 1.2
---
$id: http://devicetree.org/schemas/media/cec/cec-common.yaml#
$schema: http://devicetree.org/meta-schemas/core.yaml#

title: HDMI CEC Adapters Common Properties

maintainers:
  - Hans Verkuil <hverkuil@kernel.org>

properties:
  $nodename:
    pattern: "^cec(@[0-9a-f]+|-[0-9]+)?$"

  hdmi-phandle:
    $ref: /schemas/types.yaml#/definitions/phandle
    description:
      Phandle to the HDMI controller.

  needs-hpd:
    type: boolean
    description:
      The CEC support is only available when the HPD is high. Some boards only
      let the CEC pin through if the HPD is high, for example if there is a
      level converter that uses the HPD to power up or down.

additionalProperties: true
```

## Documentation/devicetree/bindings/media/cec/cec-gpio.yaml
```yaml
# SPDX-License-Identifier: GPL-2.0-only OR BSD-2-Clause
%YAML 1.2
---
$id: http://devicetree.org/schemas/media/cec/cec-gpio.yaml#
$schema: http://devicetree.org/meta-schemas/core.yaml#

title: HDMI CEC GPIO

maintainers:
  - Hans Verkuil <hverkuil-cisco@xs4all.nl>

description: |
  The HDMI CEC GPIO module supports CEC implementations where the CEC line is
  hooked up to a pull-up GPIO line and - optionally - the HPD line is hooked up
  to another GPIO line.

  Please note:: the maximum voltage for the CEC line is 3.63V, for the HPD and
  5V lines it is 5.3V. So you may need some sort of level conversion
  circuitry when connecting them to a GPIO line.

properties:
  compatible:
    const: cec-gpio

  cec-gpios:
    maxItems: 1
    description:
      GPIO that the CEC line is connected to. The line should be tagged as open
      drain.

  hpd-gpios:
    maxItems: 1
    description:
      GPIO that the HPD line is connected to.  Used for debugging HPD changes
      when the CEC line is not associated with an HDMI receiver/transmitter.

  v5-gpios:
    maxItems: 1
    description:
      GPIO that the 5V line is connected to.  Used for debugging changes on the
      5V line.

required:
  - compatible
  - cec-gpios

allOf:
  - $ref: cec-common.yaml#
  - if:
      required:
        - hdmi-phandle
    then:
      properties:
        hpd-gpios: false

  - if:
      required:
        - hpd-gpios
    then:
      properties:
        hdmi-phandle: false

unevaluatedProperties: false

examples:
  - |
    #include <dt-bindings/gpio/gpio.h>

    cec {
        compatible = "cec-gpio";
        cec-gpios = <&gpio 7 (GPIO_ACTIVE_HIGH|GPIO_OPEN_DRAIN)>;
        hpd-gpios = <&gpio 17 GPIO_ACTIVE_HIGH>;
        v5-gpios = <&gpio 22 GPIO_ACTIVE_HIGH>;
    };
```

## Documentation/devicetree/bindings/media/cec/nvidia,tegra114-cec.yaml
```yaml
# SPDX-License-Identifier: GPL-2.0-only OR BSD-2-Clause
%YAML 1.2
---
$id: http://devicetree.org/schemas/media/cec/nvidia,tegra114-cec.yaml#
$schema: http://devicetree.org/meta-schemas/core.yaml#

title: NVIDIA Tegra HDMI CEC

maintainers:
  - Hans Verkuil <hverkuil-cisco@xs4all.nl>

allOf:
  - $ref: cec-common.yaml#

properties:
  compatible:
    enum:
      - nvidia,tegra114-cec
      - nvidia,tegra124-cec
      - nvidia,tegra210-cec

  clocks:
    maxItems: 1

  clock-names:
    items:
      - const: cec

  interrupts:
    maxItems: 1

  reg:
    maxItems: 1

required:
  - compatible
  - clocks
  - clock-names
  - hdmi-phandle
  - interrupts
  - reg

unevaluatedProperties: false

examples:
  - |
    #include <dt-bindings/clock/tegra124-car.h>
    #include <dt-bindings/interrupt-controller/arm-gic.h>

    cec@70015000 {
        compatible = "nvidia,tegra124-cec";
        reg = <0x70015000 0x00001000>;
        interrupts = <GIC_SPI 3 IRQ_TYPE_LEVEL_HIGH>;
        clocks = <&tegra_car TEGRA124_CLK_CEC>;
        clock-names = "cec";
        hdmi-phandle = <&hdmi>;
    };
```

## Documentation/devicetree/bindings/media/cec/samsung,s5p-cec.yaml
```yaml
# SPDX-License-Identifier: GPL-2.0-only OR BSD-2-Clause
%YAML 1.2
---
$id: http://devicetree.org/schemas/media/cec/samsung,s5p-cec.yaml#
$schema: http://devicetree.org/meta-schemas/core.yaml#

title: Samsung S5PV210 and Exynos HDMI CEC

maintainers:
  - Krzysztof Kozlowski <krzk@kernel.org>
  - Marek Szyprowski <m.szyprowski@samsung.com>

allOf:
  - $ref: cec-common.yaml#

properties:
  compatible:
    const: samsung,s5p-cec

  clocks:
    maxItems: 1

  clock-names:
    items:
      - const: hdmicec

  interrupts:
    maxItems: 1

  samsung,syscon-phandle:
    $ref: /schemas/types.yaml#/definitions/phandle
    description:
      Phandle to PMU system controller interface

  reg:
    maxItems: 1

required:
  - compatible
  - clocks
  - clock-names
  - hdmi-phandle
  - interrupts
  - samsung,syscon-phandle
  - reg

unevaluatedProperties: false

examples:
  - |
    #include <dt-bindings/clock/exynos5420.h>
    #include <dt-bindings/interrupt-controller/arm-gic.h>

    cec@101b0000 {
        compatible = "samsung,s5p-cec";
        reg = <0x101B0000 0x200>;

        clocks = <&clock CLK_HDMI_CEC>;
        clock-names = "hdmicec";
        interrupts = <GIC_SPI 114 IRQ_TYPE_LEVEL_HIGH>;
        hdmi-phandle = <&hdmi>;
        needs-hpd;
        pinctrl-names = "default";
        pinctrl-0 = <&hdmi_cec>;
        samsung,syscon-phandle = <&pmu_system_controller>;
    };
```

## Documentation/devicetree/bindings/media/cec/st,stih-cec.yaml
```yaml
# SPDX-License-Identifier: GPL-2.0-only OR BSD-2-Clause
%YAML 1.2
---
$id: http://devicetree.org/schemas/media/cec/st,stih-cec.yaml#
$schema: http://devicetree.org/meta-schemas/core.yaml#

title: STMicroelectronics STIH4xx HDMI CEC

maintainers:
  - Alain Volmat <alain.volmat@foss.st.com>

allOf:
  - $ref: cec-common.yaml#

properties:
  compatible:
    const: st,stih-cec

  clocks:
    maxItems: 1

  clock-names:
    items:
      - const: cec-clk

  interrupts:
    maxItems: 1

  interrupt-names:
    items:
      - const: cec-irq

  resets:
    maxItems: 1

  reg:
    maxItems: 1

required:
  - compatible
  - clocks
  - hdmi-phandle
  - interrupts
  - resets
  - reg

unevaluatedProperties: false

examples:
  - |
    #include <dt-bindings/interrupt-controller/arm-gic.h>
    #include <dt-bindings/reset/stih407-resets.h>

    cec@94a087c {
        compatible = "st,stih-cec";
        reg = <0x94a087c 0x64>;

        clocks = <&clk_sysin>;
        clock-names = "cec-clk";
        hdmi-phandle = <&sti_hdmi>;
        interrupts = <GIC_SPI 140 IRQ_TYPE_LEVEL_HIGH>;
        interrupt-names = "cec-irq";
        pinctrl-names = "default";
        pinctrl-0 = <&pinctrl_cec0_default>;
        resets = <&softreset STIH407_LPM_SOFTRESET>;
    };
```

## Documentation/devicetree/bindings/media/cec/st,stm32-cec.yaml
```yaml
# SPDX-License-Identifier: (GPL-2.0-only OR BSD-2-Clause)
%YAML 1.2
---
$id: http://devicetree.org/schemas/media/cec/st,stm32-cec.yaml#
$schema: http://devicetree.org/meta-schemas/core.yaml#

title: STMicroelectronics STM32 CEC

maintainers:
  - Yannick Fertre <yannick.fertre@foss.st.com>

properties:
  compatible:
    const: st,stm32-cec

  reg:
    maxItems: 1

  interrupts:
    maxItems: 1

  clocks:
    items:
      - description: Module Clock
      - description: Bus Clock

  clock-names:
    items:
      - const: cec
      - const: hdmi-cec

required:
  - compatible
  - reg
  - interrupts
  - clocks
  - clock-names

additionalProperties: false

examples:
  - |
    #include <dt-bindings/interrupt-controller/arm-gic.h>
    #include <dt-bindings/clock/stm32mp1-clks.h>
    cec: cec@40006c00 {
        compatible = "st,stm32-cec";
        reg = <0x40006c00 0x400>;
        interrupts = <GIC_SPI 94 IRQ_TYPE_LEVEL_HIGH>;
        clocks = <&rcc CEC_K>, <&clk_lse>;
        clock-names = "cec", "hdmi-cec";
    };

...
```

## Documentation/devicetree/bindings/media/cedrus.txt
```
Device-tree bindings for the VPU found in Allwinner SoCs, referred to as the
Video Engine (VE) in Allwinner literature.

The VPU can only access the first 256 MiB of DRAM, that are DMA-mapped starting
from the DRAM base. This requires specific memory allocation and handling.

Required properties:
- compatible		: must be one of the following compatibles:
			- "allwinner,sun4i-a10-video-engine"
			- "allwinner,sun5i-a13-video-engine"
			- "allwinner,sun7i-a20-video-engine"
			- "allwinner,sun8i-a33-video-engine"
			- "allwinner,sun8i-h3-video-engine"
			- "allwinner,sun50i-a64-video-engine"
			- "allwinner,sun50i-h5-video-engine"
- reg			: register base and length of VE;
- clocks		: list of clock specifiers, corresponding to entries in
			  the clock-names property;
- clock-names		: should contain "ahb", "mod" and "ram" entries;
- resets		: phandle for reset;
- interrupts		: VE interrupt number;
- allwinner,sram	: SRAM region to use with the VE.

Optional properties:
- memory-region		: CMA pool to use for buffers allocation instead of the
			  default CMA pool.

Example:

reserved-memory {
	#address-cells = <1>;
	#size-cells = <1>;
	ranges;

	/* Address must be kept in the lower 256 MiBs of DRAM for VE. */
	cma_pool: cma@4a000000 {
		compatible = "shared-dma-pool";
		size = <0x6000000>;
		alloc-ranges = <0x4a000000 0x6000000>;
		reusable;
		linux,cma-default;
	};
};

video-codec@1c0e000 {
	compatible = "allwinner,sun7i-a20-video-engine";
	reg = <0x01c0e000 0x1000>;

	clocks = <&ccu CLK_AHB_VE>, <&ccu CLK_VE>,
		 <&ccu CLK_DRAM_VE>;
	clock-names = "ahb", "mod", "ram";

	resets = <&ccu RST_VE>;
	interrupts = <GIC_SPI 53 IRQ_TYPE_LEVEL_HIGH>;
	allwinner,sram = <&ve_sram 1>;
};
```

## Documentation/devicetree/bindings/media/cnm,wave521c.yaml
```yaml
# SPDX-License-Identifier: (GPL-2.0 OR BSD-2-Clause)
%YAML 1.2
---
$id: http://devicetree.org/schemas/media/cnm,wave521c.yaml#
$schema: http://devicetree.org/meta-schemas/core.yaml#

title: Chips&Media Wave 5 Series multi-standard codec IP

maintainers:
  - Nas Chung <nas.chung@chipsnmedia.com>
  - Jackson Lee <jackson.lee@chipsnmedia.com>

description:
  The Chips&Media WAVE codec IP is a multi format video encoder/decoder

properties:
  compatible:
    items:
      - enum:
          - ti,j721s2-wave521c
      - const: cnm,wave521c

  reg:
    maxItems: 1

  clocks:
    items:
      - description: VCODEC clock

  interrupts:
    maxItems: 1

  power-domains:
    maxItems: 1

  resets:
    maxItems: 1

  sram:
    $ref: /schemas/types.yaml#/definitions/phandle
    description:
      The VPU uses the SRAM to store some of the reference data instead of
      storing it on DMA memory. It is mainly used for the purpose of reducing
      bandwidth.

required:
  - compatible
  - reg
  - clocks

additionalProperties: false

examples:
  - |
    vpu: video-codec@12345678 {
        compatible = "ti,j721s2-wave521c", "cnm,wave521c";
        reg = <0x12345678 0x1000>;
        clocks = <&clks 42>;
        interrupts = <42>;
        sram = <&sram>;
    };
```
