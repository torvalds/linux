## Documentation/devicetree/bindings/media/coda.txt
```
Chips&Media Coda multi-standard codec IP
========================================

Coda codec IPs are present in i.MX SoCs in various versions,
called VPU (Video Processing Unit).

Required properties:
- compatible : should be "fsl,<chip>-src" for i.MX SoCs:
  (a) "fsl,imx27-vpu" for CodaDx6 present in i.MX27
  (b) "fsl,imx51-vpu" for CodaHx4 present in i.MX51
  (c) "fsl,imx53-vpu" for CODA7541 present in i.MX53
  (d) "fsl,imx6q-vpu" for CODA960 present in i.MX6q
- reg: should be register base and length as documented in the
  SoC reference manual
- interrupts : Should contain the VPU interrupt. For CODA960,
  a second interrupt is needed for the MJPEG unit.
- clocks : Should contain the ahb and per clocks, in the order
  determined by the clock-names property.
- clock-names : Should be "ahb", "per"
- iram : phandle pointing to the SRAM device node

Example:

vpu: vpu@63ff4000 {
	compatible = "fsl,imx53-vpu";
	reg = <0x63ff4000 0x1000>;
	interrupts = <9>;
	clocks = <&clks 63>, <&clks 63>;
	clock-names = "ahb", "per";
	iram = <&ocram>;
};
```

## Documentation/devicetree/bindings/media/coda.yaml
```yaml
# SPDX-License-Identifier: (GPL-2.0 OR BSD-2-Clause)
%YAML 1.2
---
$id: http://devicetree.org/schemas/media/coda.yaml#
$schema: http://devicetree.org/meta-schemas/core.yaml#

title: Chips&Media Coda multi-standard codec IP

maintainers:
  - Philipp Zabel <p.zabel@pengutronix.de>

description: |-
  Coda codec IPs are present in i.MX SoCs in various versions,
  called VPU (Video Processing Unit).

properties:
  compatible:
    oneOf:
      - items:
          - const: fsl,imx27-vpu
          - const: cnm,codadx6
      - items:
          - const: fsl,imx51-vpu
          - const: cnm,codahx4
      - items:
          - const: fsl,imx53-vpu
          - const: cnm,coda7541
      - items:
          - enum:
              - fsl,imx6dl-vpu
              - fsl,imx6q-vpu
          - const: cnm,coda960

  reg:
    maxItems: 1

  clocks:
    items:
      - description: PER clock
      - description: AHB interface clock

  clock-names:
    items:
      - const: per
      - const: ahb

  interrupts:
    minItems: 1
    items:
      - description: BIT processor interrupt
      - description: JPEG unit interrupt

  interrupt-names:
    minItems: 1
    items:
      - const: bit
      - const: jpeg

  power-domains:
    maxItems: 1

  resets:
    maxItems: 1

  iram:
    $ref: /schemas/types.yaml#/definitions/phandle
    description: phandle pointing to the SRAM device node

required:
  - compatible
  - reg
  - interrupts
  - clocks
  - clock-names

additionalProperties: false

allOf:
  - if:
      properties:
        compatible:
          contains:
            const: cnm,coda960
    then:
      properties:
        interrupts:
          minItems: 2

        interrupt-names:
          minItems: 2
    else:
      properties:
        interrupts:
          maxItems: 1

        power-domains: false

examples:
  - |
    vpu: video-codec@63ff4000 {
        compatible = "fsl,imx53-vpu", "cnm,coda7541";
        reg = <0x63ff4000 0x1000>;
        interrupts = <9>;
        clocks = <&clks 63>, <&clks 63>;
        clock-names = "per", "ahb";
        iram = <&ocram>;
    };
```

## Documentation/devicetree/bindings/media/exynos-fimc-lite.txt
```
Exyyess4x12/Exyyess5 SoC series camera host interface (FIMC-LITE)

Required properties:

- compatible	: should be one of:
		  "samsung,exyyess4212-fimc-lite" for Exyyess4212/4412 SoCs,
		  "samsung,exyyess5250-fimc-lite" for Exyyess5250 compatible
		   devices;
- reg		: physical base address and size of the device memory mapped
		  registers;
- interrupts	: should contain FIMC-LITE interrupt;
- clocks	: FIMC LITE gate clock should be specified in this property.
- clock-names	: should contain "flite" entry.

Each FIMC device should have an alias in the aliases yesde, in the form of
fimc-lite<n>, where <n> is an integer specifying the IP block instance.
```

## Documentation/devicetree/bindings/media/exynos-jpeg-codec.txt
```
Samsung S5P/EXYNOS SoC series JPEG codec

Required properties:

- compatible	: should be one of:
		  "samsung,s5pv210-jpeg", "samsung,exynos4210-jpeg",
		  "samsung,exynos3250-jpeg";
- reg		: address and length of the JPEG codec IP register set;
- interrupts	: specifies the JPEG codec IP interrupt;
- clock-names   : should contain:
		   - "jpeg" for the core gate clock,
		   - "sclk" for the special clock (optional).
- clocks	: should contain the clock specifier and clock ID list
		  matching entries in the clock-names property; from
		  the common clock bindings.
```

## Documentation/devicetree/bindings/media/exynos4-fimc-is.txt
```
Exyyess4x12 SoC series Imaging Subsystem (FIMC-IS)

The FIMC-IS is a subsystem for processing image signal from an image sensor.
The Exyyess4x12 SoC series FIMC-IS V1.5 comprises of a dedicated ARM Cortex-A5
processor, ISP, DRC and FD IP blocks and peripheral devices such as UART, I2C
and SPI bus controllers, PWM and ADC.

fimc-is yesde
------------

Required properties:
- compatible	: should be "samsung,exyyess4212-fimc-is" for Exyyess4212 and
		  Exyyess4412 SoCs;
- reg		: physical base address and length of the registers set;
- interrupts	: must contain two FIMC-IS interrupts, in order: ISP0, ISP1;
- clocks	: list of clock specifiers, corresponding to entries in
		  clock-names property;
- clock-names	: must contain "ppmuispx", "ppmuispx", "lite0", "lite1"
		  "mpll", "sysreg", "isp", "drc", "fd", "mcuisp", "gicisp",
		  "pwm_isp", "mcuctl_isp", "uart", "ispdiv0", "ispdiv1",
		  "mcuispdiv0", "mcuispdiv1", "aclk200", "div_aclk200",
		  "aclk400mcuisp", "div_aclk400mcuisp" entries,
		  matching entries in the clocks property.
pmu subyesde
-----------

Required properties:
 - reg : must contain PMU physical base address and size of the register set.

The following are the FIMC-IS peripheral device yesdes and can be specified
either standalone or as the fimc-is yesde child yesdes.

i2c-isp (ISP I2C bus controller) yesdes
------------------------------------------

Required properties:

- compatible	: should be "samsung,exyyess4212-i2c-isp" for Exyyess4212 and
		  Exyyess4412 SoCs;
- reg		: physical base address and length of the registers set;
- clocks	: must contain gate clock specifier for this controller;
- clock-names	: must contain "i2c_isp" entry.

For the above yesdes it is required to specify a pinctrl state named "default",
according to the pinctrl bindings defined in ../pinctrl/pinctrl-bindings.txt.

Device tree yesdes of the image sensors' controlled directly by the FIMC-IS
firmware must be child yesdes of their corresponding ISP I2C bus controller yesde.
The data link of these image sensors must be specified using the common video
interfaces bindings, defined in video-interfaces.txt.
```

## Documentation/devicetree/bindings/media/exynos5-gsc.txt
```
* Samsung Exynos5 G-Scaler device

G-Scaler is used for scaling and color space conversion on EXYNOS5 SoCs.

Required properties:
- compatible: should be "samsung,exynos5-gsc"
- reg: should contain G-Scaler physical address location and length.
- interrupts: should contain G-Scaler interrupt number

Optional properties:
- samsung,sysreg: handle to syscon used to control the system registers to
  set writeback input and destination

Example:

gsc_0:  gsc@0x13e00000 {
	compatible = "samsung,exynos5-gsc";
	reg = <0x13e00000 0x1000>;
	interrupts = <0 85 0>;
};

Aliases:
Each G-Scaler node should have a numbered alias in the aliases node,
in the form of gscN, N = 0...3. G-Scaler driver uses these aliases
to retrieve the device IDs using "of_alias_get_id()" call.

Example:

aliases {
	gsc0 =&gsc_0;
	gsc1 =&gsc_1;
	gsc2 =&gsc_2;
	gsc3 =&gsc_3;
};
```

## Documentation/devicetree/bindings/media/fsl,imx-capture-subsystem.yaml
```yaml
# SPDX-License-Identifier: (GPL-2.0-only OR BSD-2-Clause)
%YAML 1.2
---
$id: http://devicetree.org/schemas/media/fsl,imx-capture-subsystem.yaml#
$schema: http://devicetree.org/meta-schemas/core.yaml#

title: Freescale i.MX Media Video Device

description:
  This is the media controller node for video capture support. It is a
  virtual device that lists the camera serial interface nodes that the
  media device will control

maintainers:
  - Frank Li <Frank.Li@nxp.com>

properties:
  compatible:
    const: fsl,imx-capture-subsystem

  ports:
    $ref: /schemas/types.yaml#/definitions/phandle-array
    description:
      Should contain a list of phandles pointing to camera
      sensor interface ports of IPU devices.

required:
  - compatible

additionalProperties: false

examples:
  - |
    capture-subsystem {
        compatible = "fsl,imx-capture-subsystem";
        ports = <&ipu1_csi0>, <&ipu1_csi1>;
    };
```

## Documentation/devicetree/bindings/media/fsl,imx6-mipi-csi2.yaml
```yaml
# SPDX-License-Identifier: (GPL-2.0-only OR BSD-2-Clause)
%YAML 1.2
---
$id: http://devicetree.org/schemas/media/fsl,imx6-mipi-csi2.yaml#
$schema: http://devicetree.org/meta-schemas/core.yaml#

title: MIPI CSI-2 Receiver core in the i.MX SoC

description:
  This is the device node for the MIPI CSI-2 Receiver core in the i.MX
  SoC. This is a Synopsys Designware MIPI CSI-2 host controller core
  combined with a D-PHY core mixed into the same register block. In
  addition this device consists of an i.MX-specific "CSI2IPU gasket"
  glue logic, also controlled from the same register block. The CSI2IPU
  gasket demultiplexes the four virtual channel streams from the host
  controller's 32-bit output image bus onto four 16-bit parallel busses
  to the i.MX IPU CSIs.

maintainers:
  - Frank Li <Frank.Li@nxp.com>

properties:
  compatible:
    const: fsl,imx6-mipi-csi2

  reg:
    maxItems: 1

  clocks:
    items:
      - description: hsi_tx (the D-PHY clock)
      - description: video_27m (D-PHY PLL reference clock)
      - description: eim_podf;

  clock-names:
    items:
      - const: dphy
      - const: ref
      - const: pix

  interrupts:
    items:
      - description: CSI-2 ERR1 irq
      - description: CSI-2 ERR2 irq

  '#address-cells':
    const: 1

  '#size-cells':
    const: 0

  port@0:
    $ref: /schemas/graph.yaml#/$defs/port-base
    unevaluatedProperties: false
    description:
      Input port node, single endpoint describing the CSI-2 transmitter.

    properties:
      endpoint:
        $ref: video-interfaces.yaml#
        unevaluatedProperties: false

        properties:
          clock-lanes:
            const: 0

          data-lanes:
            minItems: 1
            items:
              - const: 1
              - const: 2
              - const: 3
              - const: 4

        required:
          - data-lanes

patternProperties:
  '^port@[1-4]$':
    $ref: /schemas/graph.yaml#/$defs/port-base
    unevaluatedProperties: false
    description:
      ports 1 through 4 are output ports connecting with parallel bus sink
      endpoint nodes and correspond to the four MIPI CSI-2 virtual channel
      outputs.

    properties:
      endpoint@0:
        $ref: video-interfaces.yaml#
        unevaluatedProperties: false

      endpoint@1:
        $ref: video-interfaces.yaml#
        unevaluatedProperties: false

required:
  - compatible
  - reg
  - clocks
  - clock-names

additionalProperties: false

examples:
  - |
    #include <dt-bindings/clock/imx6qdl-clock.h>

    mipi@21dc000 {
        compatible = "fsl,imx6-mipi-csi2";
        reg = <0x021dc000 0x4000>;
        #address-cells = <1>;
        #size-cells = <0>;
        clocks = <&clks IMX6QDL_CLK_HSI_TX>,
                 <&clks IMX6QDL_CLK_VIDEO_27M>,
                 <&clks IMX6QDL_CLK_EIM_PODF>;
        clock-names = "dphy", "ref", "pix";

        port@0 {
            reg = <0>;

            endpoint {
                remote-endpoint = <&ov5640_to_mipi_csi2>;
                clock-lanes = <0>;
                data-lanes = <1 2>;
            };
        };

        port@1 {
            reg = <1>;
            #address-cells = <1>;
            #size-cells = <0>;

            endpoint@0 {
                reg = <0>;
                remote-endpoint = <&ipu1_csi0_mux_from_mipi_vc0>;
            };

            endpoint@1 {
                reg = <1>;
                remote-endpoint = <&ipu1_csi1_mux_from_mipi_vc0>;
            };
        };
    };
```

## Documentation/devicetree/bindings/media/fsl,imx6q-vdoa.yaml
```yaml
# SPDX-License-Identifier: (GPL-2.0-only OR BSD-2-Clause)
%YAML 1.2
---
$id: http://devicetree.org/schemas/media/fsl,imx6q-vdoa.yaml#
$schema: http://devicetree.org/meta-schemas/core.yaml#

title: Freescale Video Data Order Adapter

description:
  The Video Data Order Adapter (VDOA) is present on the i.MX6q. Its sole purpose
  is to reorder video data from the macroblock tiled order produced by the CODA
  960 VPU to the conventional raster-scan order for scanout.

maintainers:
  - Frank Li <Frank.Li@nxp.com>

properties:
  compatible:
    const: "fsl,imx6q-vdoa"

  reg:
    maxItems: 1

  interrupts:
    maxItems: 1

  clocks:
    maxItems: 1

additionalProperties: false

examples:
  - |
    #include <dt-bindings/interrupt-controller/irq.h>
    #include <dt-bindings/clock/imx6qdl-clock.h>

    vdoa@21e4000 {
        compatible = "fsl,imx6q-vdoa";
        reg = <0x021e4000 0x4000>;
        interrupts = <0 18 IRQ_TYPE_LEVEL_HIGH>;
        clocks = <&clks IMX6QDL_CLK_VDOA>;
    };
```
