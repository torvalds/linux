## Documentation/devicetree/bindings/media/atmel-isc.txt
```
Atmel Image Sensor Controller (ISC)
----------------------------------------------

Required properties for ISC:
- compatible
	Must be "atmel,sama5d2-isc".
- reg
	Physical base address and length of the registers set for the device.
- interrupts
	Should contain IRQ line for the ISC.
- clocks
	List of clock specifiers, corresponding to entries in
	the clock-names property;
	Please refer to clock-bindings.txt.
- clock-names
	Required elements: "hclock", "iscck", "gck".
- #clock-cells
	Should be 0.
- clock-output-names
	Should be "isc-mck".
- pinctrl-names, pinctrl-0
	Please refer to pinctrl-bindings.txt.

ISC supports a single port node with parallel bus. It should contain one
'port' child node with child 'endpoint' node. Please refer to the bindings
defined in Documentation/devicetree/bindings/media/video-interfaces.txt.

Example:
isc: isc@f0008000 {
	compatible = "atmel,sama5d2-isc";
	reg = <0xf0008000 0x4000>;
	interrupts = <46 IRQ_TYPE_LEVEL_HIGH 5>;
	clocks = <&isc_clk>, <&iscck>, <&isc_gclk>;
	clock-names = "hclock", "iscck", "gck";
	#clock-cells = <0>;
	clock-output-names = "isc-mck";
	pinctrl-names = "default";
	pinctrl-0 = <&pinctrl_isc_base &pinctrl_isc_data_8bit &pinctrl_isc_data_9_10 &pinctrl_isc_data_11_12>;

	port {
		isc_0: endpoint {
			remote-endpoint = <&ov7740_0>;
			hsync-active = <1>;
			vsync-active = <0>;
			pclk-sample = <1>;
		};
	};
};

i2c1: i2c@fc028000 {
	ov7740: camera@21 {
		compatible = "ovti,ov7740";
		reg = <0x21>;
		clocks = <&isc>;
		clock-names = "xvclk";
		assigned-clocks = <&isc>;
		assigned-clock-rates = <24000000>;

		port {
			ov7740_0: endpoint {
				remote-endpoint = <&isc_0>;
			};
		};
	};
};
```

## Documentation/devicetree/bindings/media/atmel-isi.txt
```
Atmel Image Sensor Interface (ISI)
----------------------------------

Required properties for ISI:
- compatible: must be "atmel,at91sam9g45-isi" or "microchip,sam9x60-isi".
- reg: physical base address and length of the registers set for the device.
- interrupts: should contain IRQ line for the ISI.
- clocks: list of clock specifiers, corresponding to entries in the clock-names
	property; please refer to clock-bindings.txt.
- clock-names: required elements: "isi_clk".
- pinctrl-names, pinctrl-0: please refer to pinctrl-bindings.txt.

ISI supports a single port node with parallel bus. It shall contain one
'port' child node with child 'endpoint' node. Please refer to the bindings
defined in Documentation/devicetree/bindings/media/video-interfaces.txt.

Endpoint node properties
------------------------

- bus-width: <8> or <10> (mandatory)
- hsync-active (default: active high)
- vsync-active (default: active high)
- pclk-sample (default: sample on falling edge)
- remote-endpoint: A phandle to the bus receiver's endpoint node (mandatory).

Example:

isi: isi@f0034000 {
	compatible = "atmel,at91sam9g45-isi";
	reg = <0xf0034000 0x4000>;
	interrupts = <37 IRQ_TYPE_LEVEL_HIGH 5>;
	pinctrl-names = "default";
	pinctrl-0 = <&pinctrl_isi_data_0_7>;
	clocks = <&isi_clk>;
	clock-names = "isi_clk";
	port {
		isi_0: endpoint {
			remote-endpoint = <&ov2640_0>;
			bus-width = <8>;
			vsync-active = <1>;
			hsync-active = <1>;
		};
	};
};

i2c1: i2c@f0018000 {
	ov2640: camera@30 {
		compatible = "ovti,ov2640";
		reg = <0x30>;
		pinctrl-names = "default";
		pinctrl-0 = <&pinctrl_pck0_as_isi_mck &pinctrl_sensor_power &pinctrl_sensor_reset>;
		resetb-gpios = <&pioE 11 GPIO_ACTIVE_LOW>;
		pwdn-gpios = <&pioE 13 GPIO_ACTIVE_HIGH>;
		clocks = <&pck0>;
		clock-names = "xvclk";
		assigned-clocks = <&pck0>;
		assigned-clock-rates = <25000000>;

		port {
			ov2640_0: endpoint {
				remote-endpoint = <&isi_0>;
				bus-width = <8>;
			};
		};
	};
};
```

## Documentation/devicetree/bindings/media/brcm,bcm2835-unicam.yaml
```yaml
# SPDX-License-Identifier: (GPL-2.0-only OR BSD-2-Clause)
%YAML 1.2
---
$id: http://devicetree.org/schemas/media/brcm,bcm2835-unicam.yaml#
$schema: http://devicetree.org/meta-schemas/core.yaml#

title: Broadcom BCM283x Camera Interface (Unicam)

maintainers:
  - Raspberry Pi Kernel Maintenance <kernel-list@raspberrypi.com>

description: |-
  The Unicam block on BCM283x SoCs is the receiver for either
  CSI-2 or CCP2 data from image sensors or similar devices.

  The main platform using this SoC is the Raspberry Pi family of boards.  On
  the Pi the VideoCore firmware can also control this hardware block, and
  driving it from two different processors will cause issues.  To avoid this,
  the firmware checks the device tree configuration during boot. If it finds
  device tree nodes whose name starts with 'csi' then it will stop the firmware
  accessing the block, and it can then safely be used via the device tree
  binding.

properties:
  compatible:
    const: brcm,bcm2835-unicam

  reg:
    items:
      - description: Unicam block.
      - description: Clock Manager Image (CMI) block.

  reg-names:
    items:
      - const: unicam
      - const: cmi

  interrupts:
    maxItems: 1

  clocks:
    items:
      - description: Clock to drive the LP state machine of Unicam.
      - description: Clock for the VPU (core clock).

  clock-names:
    items:
      - const: lp
      - const: vpu

  power-domains:
    items:
      - description: Unicam power domain

  brcm,num-data-lanes:
    $ref: /schemas/types.yaml#/definitions/uint32
    enum: [ 2, 4 ]
    description: |
      Number of CSI-2 data lanes supported by this Unicam instance. The number
      of data lanes actively used is specified with the data-lanes endpoint
      property.

  port:
    $ref: /schemas/graph.yaml#/$defs/port-base
    unevaluatedProperties: false

    properties:
      endpoint:
        $ref: /schemas/media/video-interfaces.yaml#
        additionalProperties: false

        properties:
          bus-type:
            enum: [ 3, 4 ]

          clock-noncontinuous: true
          data-lanes: true
          remote-endpoint: true

        required:
          - bus-type
          - data-lanes
          - remote-endpoint

    required:
      - endpoint

required:
  - compatible
  - reg
  - reg-names
  - interrupts
  - clocks
  - clock-names
  - power-domains
  - brcm,num-data-lanes
  - port

additionalProperties: False

examples:
  - |
    #include <dt-bindings/clock/bcm2835.h>
    #include <dt-bindings/interrupt-controller/arm-gic.h>
    #include <dt-bindings/media/video-interfaces.h>
    #include <dt-bindings/power/raspberrypi-power.h>

    csi1: csi@7e801000 {
        compatible = "brcm,bcm2835-unicam";
        reg = <0x7e801000 0x800>,
              <0x7e802004 0x4>;
        reg-names = "unicam", "cmi";
        interrupts = <GIC_SPI 103 IRQ_TYPE_LEVEL_HIGH>;
        clocks = <&clocks BCM2835_CLOCK_CAM1>,
                 <&firmware_clocks 4>;
        clock-names = "lp", "vpu";
        power-domains = <&power RPI_POWER_DOMAIN_UNICAM1>;
        brcm,num-data-lanes = <2>;
        port {
                csi1_ep: endpoint {
                        remote-endpoint = <&imx219_0>;
                        bus-type = <MEDIA_BUS_TYPE_CSI2_DPHY>;
                        data-lanes = <1 2>;
                };
        };
    };
...
```

## Documentation/devicetree/bindings/media/cdns,csi2rx.txt
```
Cadence MIPI-CSI2 RX controller
===============================

The Cadence MIPI-CSI2 RX controller is a CSI-2 bridge supporting up to 4 CSI
lanes in input, and 4 different pixel streams in output.

Required properties:
  - compatible: must be set to "cdns,csi2rx" and an SoC-specific compatible
  - reg: base address and size of the memory mapped region
  - clocks: phandles to the clocks driving the controller
  - clock-names: must contain:
    * sys_clk: main clock
    * p_clk: register bank clock
    * pixel_if[0-3]_clk: pixel stream output clock, one for each stream
                         implemented in hardware, between 0 and 3

Optional properties:
  - phys: phandle to the external D-PHY, phy-names must be provided
  - phy-names: must contain "dphy", if the implementation uses an
               external D-PHY

Required subnodes:
  - ports: A ports node with one port child node per device input and output
           port, in accordance with the video interface bindings defined in
           Documentation/devicetree/bindings/media/video-interfaces.txt. The
           port nodes are numbered as follows:

           Port Description
           -----------------------------
           0    CSI-2 input
           1    Stream 0 output
           2    Stream 1 output
           3    Stream 2 output
           4    Stream 3 output

           The stream output port nodes are optional if they are not
           connected to anything at the hardware level or implemented
           in the design.Since there is only one endpoint per port,
           the endpoints are not numbered.


Example:

csi2rx: csi-bridge@0d060000 {
	compatible = "cdns,csi2rx";
	reg = <0x0d060000 0x1000>;
	clocks = <&byteclock>, <&byteclock>
		 <&coreclock>, <&coreclock>,
		 <&coreclock>, <&coreclock>;
	clock-names = "sys_clk", "p_clk",
		      "pixel_if0_clk", "pixel_if1_clk",
		      "pixel_if2_clk", "pixel_if3_clk";

	ports {
		#address-cells = <1>;
		#size-cells = <0>;

		port@0 {
			reg = <0>;

			csi2rx_in_sensor: endpoint {
				remote-endpoint = <&sensor_out_csi2rx>;
				clock-lanes = <0>;
				data-lanes = <1 2>;
			};
		};

		port@1 {
			reg = <1>;

			csi2rx_out_grabber0: endpoint {
				remote-endpoint = <&grabber0_in_csi2rx>;
			};
		};

		port@2 {
			reg = <2>;

			csi2rx_out_grabber1: endpoint {
				remote-endpoint = <&grabber1_in_csi2rx>;
			};
		};

		port@3 {
			reg = <3>;

			csi2rx_out_grabber2: endpoint {
				remote-endpoint = <&grabber2_in_csi2rx>;
			};
		};

		port@4 {
			reg = <4>;

			csi2rx_out_grabber3: endpoint {
				remote-endpoint = <&grabber3_in_csi2rx>;
			};
		};
	};
};
```

## Documentation/devicetree/bindings/media/cdns,csi2rx.yaml
```yaml
# SPDX-License-Identifier: (GPL-2.0 OR BSD-2-Clause)
%YAML 1.2
---
$id: http://devicetree.org/schemas/media/cdns,csi2rx.yaml#
$schema: http://devicetree.org/meta-schemas/core.yaml#

title: Cadence MIPI-CSI2 RX controller

maintainers:
  - Maxime Ripard <mripard@kernel.org>

description:
  The Cadence MIPI-CSI2 RX controller is a CSI-2 bridge supporting up to 4 CSI
  lanes in input, and 4 different pixel streams in output.

properties:
  compatible:
    items:
      - enum:
          - starfive,jh7110-csi2rx
          - ti,j721e-csi2rx
      - const: cdns,csi2rx

  reg:
    maxItems: 1

  interrupts:
    maxItems: 2

  interrupt-names:
    items:
      - const: error_irq
      - const: irq

  clocks:
    items:
      - description: CSI2Rx system clock
      - description: Gated Register bank clock for APB interface
      - description: pixel Clock for Stream interface 0
      - description: pixel Clock for Stream interface 1
      - description: pixel Clock for Stream interface 2
      - description: pixel Clock for Stream interface 3

  clock-names:
    items:
      - const: sys_clk
      - const: p_clk
      - const: pixel_if0_clk
      - const: pixel_if1_clk
      - const: pixel_if2_clk
      - const: pixel_if3_clk

  resets:
    items:
      - description: CSI2Rx system reset
      - description: Gated Register bank reset for APB interface
      - description: pixel reset for Stream interface 0
      - description: pixel reset for Stream interface 1
      - description: pixel reset for Stream interface 2
      - description: pixel reset for Stream interface 3

  reset-names:
    items:
      - const: sys
      - const: reg_bank
      - const: pixel_if0
      - const: pixel_if1
      - const: pixel_if2
      - const: pixel_if3

  phys:
    maxItems: 1
    description: MIPI D-PHY

  phy-names:
    items:
      - const: dphy

  ports:
    $ref: /schemas/graph.yaml#/properties/ports

    properties:
      port@0:
        $ref: /schemas/graph.yaml#/$defs/port-base
        unevaluatedProperties: false
        description:
          Input port node, single endpoint describing the CSI-2 transmitter.

        properties:
          endpoint:
            $ref: video-interfaces.yaml#
            unevaluatedProperties: false

            properties:
              bus-type:
                const: 4

              clock-lanes:
                const: 0

              data-lanes:
                minItems: 1
                maxItems: 4
                items:
                  maximum: 4

            required:
              - data-lanes

      port@1:
        $ref: /schemas/graph.yaml#/properties/port
        description:
          Stream 0 Output port node

      port@2:
        $ref: /schemas/graph.yaml#/properties/port
        description:
          Stream 1 Output port node

      port@3:
        $ref: /schemas/graph.yaml#/properties/port
        description:
          Stream 2 Output port node

      port@4:
        $ref: /schemas/graph.yaml#/properties/port
        description:
          Stream 3 Output port node

    required:
      - port@0

required:
  - compatible
  - reg
  - clocks
  - clock-names
  - ports

additionalProperties: false

examples:
  - |
    csi@d060000 {
        compatible = "starfive,jh7110-csi2rx", "cdns,csi2rx";
        reg = <0x0d060000 0x1000>;
        clocks = <&byteclock 7>, <&byteclock 6>,
                 <&coreclock 8>, <&coreclock 9>,
                 <&coreclock 10>, <&coreclock 11>;
        clock-names = "sys_clk", "p_clk",
                      "pixel_if0_clk", "pixel_if1_clk",
                      "pixel_if2_clk", "pixel_if3_clk";
        resets = <&bytereset 9>, <&bytereset 4>,
                 <&corereset 5>, <&corereset 6>,
                 <&corereset 7>, <&corereset 8>;
        reset-names = "sys", "reg_bank",
                      "pixel_if0", "pixel_if1",
                      "pixel_if2", "pixel_if3";
        phys = <&csi_phy>;
        phy-names = "dphy";

        ports {
                #address-cells = <1>;
                #size-cells = <0>;

                port@0 {
                    reg = <0>;

                    csi2rx_in_sensor: endpoint {
                        remote-endpoint = <&sensor_out_csi2rx>;
                        clock-lanes = <0>;
                        data-lanes = <1 2>;
                    };
                };

                port@1 {
                    reg = <1>;

                    csi2rx_out_grabber0: endpoint {
                        remote-endpoint = <&grabber0_in_csi2rx>;
                    };
                };

                port@2 {
                    reg = <2>;

                    csi2rx_out_grabber1: endpoint {
                        remote-endpoint = <&grabber1_in_csi2rx>;
                    };
                };

                port@3 {
                    reg = <3>;

                    csi2rx_out_grabber2: endpoint {
                        remote-endpoint = <&grabber2_in_csi2rx>;
                    };
                };

                port@4 {
                    reg = <4>;

                    csi2rx_out_grabber3: endpoint {
                        remote-endpoint = <&grabber3_in_csi2rx>;
                    };
                };
        };
    };

...
```
