## Documentation/devicetree/bindings/media/i2c/ov12d2q.txt
```
* Omnivision OV12D2Q MIPI CSI-2 sensor

Required Properties:
- compatible: should be "ovti,ov12d2q"
- clocks: reference to the 24M xvclk input clock.
- clock-names: should be "xvclk".
- dovdd-supply: Digital I/O voltage supply, 1.8 volts
- avdd-supply: Analog voltage supply, 2.8 volts
- dvdd-supply: Digital core voltage supply, 1.2 volts
- reset-gpios: Low active reset gpio
- pwdn-gpios: High active pwdn gpio

The device node must contain one 'port' child node for its digital output
video port, in accordance with the video interface bindings defined in
Documentation/devicetree/bindings/media/video-interfaces.txt.

Example:

	i2c0@1c22000 {
		ov12d2q: ov12d2q@36 {
			compatible = "ovti,ov12d2q";
			reg = <0x36>;
			clocks = <&cru CLK_MIPICSI_OUT>;
			clock-names = "xvclk";
			power-domains = <&power RV1126_PD_VI>;
			pinctrl-names = "rockchip,camera_default";
			pinctrl-0 = <&mipicsi_clk0>;
			avdd-supply = <&vcc_avdd>;
			dovdd-supply = <&vcc_dovdd>;
			dvdd-supply = <&vcc_dvdd>;
			pwdn-gpios = <&gpio1 RK_PD4 GPIO_ACTIVE_HIGH>;
			reset-gpios = <&gpio1 RK_PD5 GPIO_ACTIVE_LOW>;
			rockchip,camera-module-index = <1>;
			rockchip,camera-module-facing = "front";
			rockchip,camera-module-name = "default";
			rockchip,camera-module-lens-name = "default";
			port {
				ucam_out0: endpoint {
					remote-endpoint = <&mipi_in_ucam0>;
					data-lanes = <1 2 3 4>;
				};
			};
		};
	};
```

## Documentation/devicetree/bindings/media/i2c/ov2640.txt
```
* Omnivision OV2640 CMOS sensor

The Omnivision OV2640 sensor supports multiple resolutions output, such as
CIF, SVGA, UXGA. It also can support the YUV422/420, RGB565/555 or raw RGB
output formats.

Required Properties:
- compatible: should be "ovti,ov2640"
- clocks: reference to the xvclk input clock.
- clock-names: should be "xvclk".

Optional Properties:
- resetb-gpios: reference to the GPIO connected to the resetb pin, if any.
- pwdn-gpios: reference to the GPIO connected to the pwdn pin, if any.

The device node must contain one 'port' child node for its digital output
video port, in accordance with the video interface bindings defined in
Documentation/devicetree/bindings/media/video-interfaces.txt.

Example:

	i2c1: i2c@f0018000 {
		ov2640: camera@30 {
			compatible = "ovti,ov2640";
			reg = <0x30>;
			pinctrl-names = "default";
			pinctrl-0 = <&pinctrl_pck0_as_isi_mck &pinctrl_sensor_power &pinctrl_sensor_reset>;
			resetb-gpios = <&pioE 11 GPIO_ACTIVE_LOW>;
			pwdn-gpios = <&pioE 13 GPIO_ACTIVE_HIGH>;
			clocks = <&pck0>;
			clock-names = "xvclk";
			assigned-clocks = <&pck0>;
			assigned-clock-rates = <25000000>;

			port {
				ov2640_0: endpoint {
					remote-endpoint = <&isi_0>;
				};
			};
		};
	};
```

## Documentation/devicetree/bindings/media/i2c/ov2659.txt
```
* OV2659 1/5-Inch 2Mp SOC Camera

The Omnivision OV2659 is a 1/5-inch SOC camera, with an active array size of
1632H x 1212V. It is programmable through a SCCB. The OV2659 sensor supports
multiple resolutions output, such as UXGA, SVGA, 720p. It also can support
YUV422, RGB565/555 or raw RGB output formats.

Required Properties:
- compatible: Must be "ovti,ov2659"
- reg: I2C slave address
- clocks: reference to the xvclk input clock.
- clock-names: should be "xvclk".
- link-frequencies: target pixel clock frequency.

Optional Properties:
- powerdown-gpios: reference to the GPIO connected to the pwdn pin, if any.
  Active high with internal pull down resistor.
- reset-gpios: reference to the GPIO connected to the resetb pin, if any.
  Active low with internal pull up resistor.

For further reading on port node refer to
Documentation/devicetree/bindings/media/video-interfaces.txt.

Example:

	i2c0@1c22000 {
		...
		...
		 ov2659@30 {
			compatible = "ovti,ov2659";
			reg = <0x30>;

			clocks = <&clk_ov2659 0>;
			clock-names = "xvclk";

			powerdown-gpios = <&gpio6 14 GPIO_ACTIVE_HIGH>;
			reset-gpios = <&gpio6 15 GPIO_ACTIVE_LOW>;

			port {
				ov2659_0: endpoint {
					remote-endpoint = <&vpfe_ep>;
					link-frequencies = /bits/ 64 <70000000>;
				};
			};
		};
		...
	};
```

## Documentation/devicetree/bindings/media/i2c/ov2680.txt
```
* Omnivision OV2680 MIPI CSI-2 sensor

Required Properties:
- compatible: should be "ovti,ov2680".
- clocks: reference to the xvclk input clock.
- clock-names: should be "xvclk".
- DOVDD-supply: Digital I/O voltage supply.
- DVDD-supply: Digital core voltage supply.
- AVDD-supply: Analog voltage supply.

Optional Properties:
- reset-gpios: reference to the GPIO connected to the powerdown/reset pin,
               if any. This is an active low signal to the OV2680.

The device node must contain one 'port' child node for its digital output
video port, and this port must have a single endpoint in accordance with
 the video interface bindings defined in
Documentation/devicetree/bindings/media/video-interfaces.txt.

Endpoint node required properties for CSI-2 connection are:
- remote-endpoint: a phandle to the bus receiver's endpoint node.
- clock-lanes: should be set to <0> (clock lane on hardware lane 0).
- data-lanes: should be set to <1> (one CSI-2 lane supported).

Example:

&i2c2 {
	ov2680: camera-sensor@36 {
		compatible = "ovti,ov2680";
		reg = <0x36>;
		clocks = <&osc>;
		clock-names = "xvclk";
		reset-gpios = <&gpio1 3 GPIO_ACTIVE_LOW>;
		DOVDD-supply = <&sw2_reg>;
		DVDD-supply = <&sw2_reg>;
		AVDD-supply = <&reg_peri_3p15v>;

		port {
			ov2680_to_mipi: endpoint {
				remote-endpoint = <&mipi_from_sensor>;
				clock-lanes = <0>;
				data-lanes = <1>;
			};
		};
	};
};
```

## Documentation/devicetree/bindings/media/i2c/ov2685.txt
```
* Omnivision OV2685 MIPI CSI-2 sensor

Required Properties:
- compatible: shall be "ovti,ov2685"
- clocks: reference to the xvclk input clock
- clock-names: shall be "xvclk"
- avdd-supply: Analog voltage supply, 2.8 volts
- dovdd-supply: Digital I/O voltage supply, 1.8 volts
- dvdd-supply: Digital core voltage supply, 1.8 volts
- reset-gpios: Low active reset gpio

The device node shall contain one 'port' child node with an
'endpoint' subnode for its digital output video port,
in accordance with the video interface bindings defined in
Documentation/devicetree/bindings/media/video-interfaces.txt.
The endpoint optional property 'data-lanes' shall be "<1>".

Example:
&i2c7 {
	ov2685: camera-sensor@3c {
		compatible = "ovti,ov2685";
		reg = <0x3c>;
		pinctrl-names = "default";
		pinctrl-0 = <&clk_24m_cam>;

		clocks = <&cru SCLK_TESTCLKOUT1>;
		clock-names = "xvclk";

		avdd-supply = <&pp2800_cam>;
		dovdd-supply = <&pp1800>;
		dvdd-supply = <&pp1800>;
		reset-gpios = <&gpio2 3 GPIO_ACTIVE_LOW>;

		port {
			ucam_out: endpoint {
				remote-endpoint = <&mipi_in_ucam>;
				data-lanes = <1>;
			};
		};
	};
};
```

## Documentation/devicetree/bindings/media/i2c/ov5640.txt
```
* Omnivision OV5640 MIPI CSI-2 / parallel sensor

Required Properties:
- compatible: should be "ovti,ov5640"
- clocks: reference to the xclk input clock.
- clock-names: should be "xclk".
- DOVDD-supply: Digital I/O voltage supply, 1.8 volts
- AVDD-supply: Analog voltage supply, 2.8 volts
- DVDD-supply: Digital core voltage supply, 1.5 volts

Optional Properties:
- reset-gpios: reference to the GPIO connected to the reset pin, if any.
	       This is an active low signal to the OV5640.
- powerdown-gpios: reference to the GPIO connected to the powerdown pin,
		   if any. This is an active high signal to the OV5640.
- rotation: as defined in
	    Documentation/devicetree/bindings/media/video-interfaces.txt,
	    valid values are 0 (sensor mounted upright) and 180 (sensor
	    mounted upside down).

The device node must contain one 'port' child node for its digital output
video port, in accordance with the video interface bindings defined in
Documentation/devicetree/bindings/media/video-interfaces.txt.

OV5640 can be connected to a MIPI CSI-2 bus or a parallel bus endpoint.

Endpoint node required properties for CSI-2 connection are:
- remote-endpoint: a phandle to the bus receiver's endpoint node.
- clock-lanes: should be set to <0> (clock lane on hardware lane 0)
- data-lanes: should be set to <1> or <1 2> (one or two CSI-2 lanes supported)

Endpoint node required properties for parallel connection are:
- remote-endpoint: a phandle to the bus receiver's endpoint node.
- bus-width: shall be set to <8> for 8 bits parallel bus
	     or <10> for 10 bits parallel bus
- data-shift: shall be set to <2> for 8 bits parallel bus
	      (lines 9:2 are used) or <0> for 10 bits parallel bus
- hsync-active: active state of the HSYNC signal, 0/1 for LOW/HIGH respectively.
- vsync-active: active state of the VSYNC signal, 0/1 for LOW/HIGH respectively.
- pclk-sample: sample data on rising (1) or falling (0) edge of the pixel clock
	       signal.

Examples:

&i2c1 {
	ov5640: camera@3c {
		compatible = "ovti,ov5640";
		pinctrl-names = "default";
		pinctrl-0 = <&pinctrl_ov5640>;
		reg = <0x3c>;
		clocks = <&clks IMX6QDL_CLK_CKO>;
		clock-names = "xclk";
		DOVDD-supply = <&vgen4_reg>; /* 1.8v */
		AVDD-supply = <&vgen3_reg>;  /* 2.8v */
		DVDD-supply = <&vgen2_reg>;  /* 1.5v */
		powerdown-gpios = <&gpio1 19 GPIO_ACTIVE_HIGH>;
		reset-gpios = <&gpio1 20 GPIO_ACTIVE_LOW>;
		rotation = <180>;

		port {
			/* MIPI CSI-2 bus endpoint */
			ov5640_to_mipi_csi2: endpoint {
				remote-endpoint = <&mipi_csi2_from_ov5640>;
				clock-lanes = <0>;
				data-lanes = <1 2>;
			};
		};
	};
};

&i2c1 {
	ov5640: camera@3c {
		compatible = "ovti,ov5640";
		pinctrl-names = "default";
		pinctrl-0 = <&pinctrl_ov5640>;
		reg = <0x3c>;
		clocks = <&clk_ext_camera>;
		clock-names = "xclk";

		port {
			/* Parallel bus endpoint */
			ov5640_to_parallel: endpoint {
				remote-endpoint = <&parallel_from_ov5640>;
				bus-width = <8>;
				data-shift = <2>; /* lines 9:2 are used */
				hsync-active = <0>;
				vsync-active = <0>;
				pclk-sample = <1>;
			};
		};
	};
};
```

## Documentation/devicetree/bindings/media/i2c/ov5645.txt
```
* Omnivision 1/4-Inch 5Mp CMOS Digital Image Sensor

The Omnivision OV5645 is a 1/4-Inch CMOS active pixel digital image sensor with
an active array size of 2592H x 1944V. It is programmable through a serial I2C
interface.

Required Properties:
- compatible: Value should be "ovti,ov5645".
- clocks: Reference to the xclk clock.
- clock-names: Should be "xclk".
- clock-frequency: Frequency of the xclk clock.
- enable-gpios: Chip enable GPIO. Polarity is GPIO_ACTIVE_HIGH. This corresponds
  to the hardware pin PWDNB which is physically active low.
- reset-gpios: Chip reset GPIO. Polarity is GPIO_ACTIVE_LOW. This corresponds to
  the hardware pin RESETB.
- vdddo-supply: Chip digital IO regulator.
- vdda-supply: Chip analog regulator.
- vddd-supply: Chip digital core regulator.

The device node must contain one 'port' child node for its digital output
video port, in accordance with the video interface bindings defined in
Documentation/devicetree/bindings/media/video-interfaces.txt.

Example:

	&i2c1 {
		...

		ov5645: ov5645@3c {
			compatible = "ovti,ov5645";
			reg = <0x3c>;

			enable-gpios = <&gpio1 6 GPIO_ACTIVE_HIGH>;
			reset-gpios = <&gpio5 20 GPIO_ACTIVE_LOW>;
			pinctrl-names = "default";
			pinctrl-0 = <&camera_rear_default>;

			clocks = <&clks 200>;
			clock-names = "xclk";
			clock-frequency = <24000000>;

			vdddo-supply = <&camera_dovdd_1v8>;
			vdda-supply = <&camera_avdd_2v8>;
			vddd-supply = <&camera_dvdd_1v2>;

			port {
				ov5645_ep: endpoint {
					clock-lanes = <1>;
					data-lanes = <0 2>;
					remote-endpoint = <&csi0_ep>;
				};
			};
		};
	};
```
