## Documentation/devicetree/bindings/media/i2c/maxim,max96714.yaml
```yaml
# SPDX-License-Identifier: (GPL-2.0-only OR BSD-2-Clause)
# Copyright (C) 2024 Collabora Ltd.
%YAML 1.2
---
$id: http://devicetree.org/schemas/media/i2c/maxim,max96714.yaml#
$schema: http://devicetree.org/meta-schemas/core.yaml#

title: Maxim MAX96714 GMSL2 to CSI-2 Deserializer

maintainers:
  - Julien Massot <julien.massot@collabora.com>

description:
  The MAX96714 deserializer converts GMSL2 serial inputs into MIPI
  CSI-2 D-PHY formatted output. The device allows the GMSL2 link to
  simultaneously transmit bidirectional control-channel data while forward
  video transmissions are in progress. The MAX96714 can connect to one
  remotely located serializer using industry-standard coax or STP
  interconnects. The device cans operate in pixel or tunnel mode. In pixel mode
  the MAX96714 can select individual video stream, while the tunnel mode forward all
  the MIPI data received by the serializer.

  The GMSL2 serial link operates at a fixed rate of 3Gbps or 6Gbps in the
  forward direction and 187.5Mbps in the reverse direction.
  MAX96714F only supports a fixed rate of 3Gbps in the forward direction.

properties:
  compatible:
    oneOf:
      - const: maxim,max96714f
      - items:
          - enum:
              - maxim,max96714
          - const: maxim,max96714f

  reg:
    maxItems: 1

  powerdown-gpios:
    maxItems: 1
    description:
      Specifier for the GPIO connected to the PWDNB pin.

  ports:
    $ref: /schemas/graph.yaml#/properties/ports

    properties:
      port@0:
        $ref: /schemas/graph.yaml#/properties/port
        unevaluatedProperties: false
        description: GMSL Input
        properties:
          endpoint:
            $ref: /schemas/media/video-interfaces.yaml#
            unevaluatedProperties: false
            description:
              Endpoint for GMSL2-Link port.

      port@1:
        $ref: /schemas/graph.yaml#/$defs/port-base
        unevaluatedProperties: false
        description: CSI-2 Output port

        properties:
          endpoint:
            $ref: /schemas/media/video-interfaces.yaml#
            unevaluatedProperties: false

            properties:
              data-lanes:
                minItems: 1
                maxItems: 4

              lane-polarities:
                minItems: 1
                maxItems: 5

              link-frequencies:
                maxItems: 1

            required:
              - data-lanes

    required:
      - port@1

  i2c-gate:
    $ref: /schemas/i2c/i2c-gate.yaml
    unevaluatedProperties: false
    description:
      The MAX96714 will pass through and forward the I2C requests from the
      incoming I2C bus over the GMSL2 link. Therefore it supports an i2c-gate
      subnode to configure a serializer.

  port0-poc-supply:
    description: Regulator providing Power over Coax for the GMSL port

required:
  - compatible
  - reg
  - ports

additionalProperties: false

examples:
  - |
    #include <dt-bindings/gpio/gpio.h>
    #include <dt-bindings/media/video-interfaces.h>

    i2c {
        #address-cells = <1>;
        #size-cells = <0>;

        deserializer@28 {
            compatible = "maxim,max96714f";
            reg = <0x28>;
            powerdown-gpios = <&main_gpio0 37 GPIO_ACTIVE_LOW>;

            ports {
                #address-cells = <1>;
                #size-cells = <0>;
                port@0 {
                    reg = <0>;
                    max96714_gmsl_in: endpoint {
                        remote-endpoint = <&max96917f_gmsl_out>;
                    };
                };

                port@1 {
                    reg = <1>;
                    max96714_csi_out: endpoint {
                        data-lanes = <1 2 3 4>;
                        link-frequencies = /bits/ 64 <400000000>;
                        remote-endpoint = <&csi_in>;
                    };
                };
            };

            i2c-gate {
                #address-cells = <1>;
                #size-cells = <0>;

                serializer@40 {
                    compatible = "maxim,max96717f";
                    reg = <0x40>;
                    gpio-controller;
                    #gpio-cells = <2>;
                    #clock-cells = <0>;

                    ports {
                        #address-cells = <1>;
                        #size-cells = <0>;

                        port@0 {
                            reg = <0>;
                            max96717f_csi_in: endpoint {
                                data-lanes = <1 2>;
                                lane-polarities = <1 0 1>;
                                remote-endpoint = <&sensor_out>;
                            };
                        };

                        port@1 {
                            reg = <1>;
                            max96917f_gmsl_out: endpoint {
                                remote-endpoint = <&max96714_gmsl_in>;
                            };
                        };
                    };
                };
            };
        };
    };
...
```

## Documentation/devicetree/bindings/media/i2c/melexis,mlx90640.txt
```
* Melexis MLX90640 FIR Sensor

Melexis MLX90640 FIR sensor support which allows recording of thermal data
with 32x24 resolution excluding 2 lines of coefficient data that is used by
userspace to render processed frames.

Required Properties:
 - compatible : Must be "melexis,mlx90640"
 - reg : i2c address of the device

Example:

	i2c0@1c22000 {
		...
		mlx90640@33 {
			compatible = "melexis,mlx90640";
			reg = <0x33>;
		};
		...
	};
```

## Documentation/devicetree/bindings/media/i2c/mipi-ccs.yaml
```yaml
# SPDX-License-Identifier: (GPL-2.0-only OR BSD-2-Clause)
# Copyright (C) 2014--2020 Intel Corporation
%YAML 1.2
---
$id: http://devicetree.org/schemas/media/i2c/mipi-ccs.yaml#
$schema: http://devicetree.org/meta-schemas/core.yaml#

title: MIPI CCS, SMIA++ and SMIA compliant camera sensors

maintainers:
  - Sakari Ailus <sakari.ailus@linux.intel.com>

description:

  CCS (Camera Command Set) is a raw Bayer camera sensor standard defined by the
  MIPI Alliance; see
  <URL:https://www.mipi.org/specifications/camera-command-set>.

  SMIA (Standard Mobile Imaging Architecture) is an image sensor standard
  defined jointly by Nokia and ST. SMIA++, defined by Nokia, is an extension of
  that.

  More detailed documentation can be found in
  Documentation/devicetree/bindings/media/video-interfaces.txt .

properties:
  compatible:
    oneOf:
      - items:
          - const: mipi-ccs-1.1
          - const: mipi-ccs
      - items:
          - const: mipi-ccs-1.0
          - const: mipi-ccs
      - const: nokia,smia

  reg:
    maxItems: 1

  vana-supply:
    description: Analogue voltage supply (VANA), sensor dependent.

  vcore-supply:
    description: Core voltage supply (VCore), sensor dependent.

  vio-supply:
    description: I/O voltage supply (VIO), sensor dependent.

  clocks:
    description: External clock to the sensor.
    maxItems: 1

  clock-frequency:
    description: Frequency of the external clock to the sensor in Hz.

  reset-gpios:
    description: Reset GPIO. Also commonly called XSHUTDOWN in hardware
      documentation.
    maxItems: 1

  flash-leds:
    description: Flash LED phandles. See ../video-interfaces.txt for details.

  lens-focus:
    description: Lens focus controller phandles. See ../video-interfaces.txt
      for details.

  rotation:
    description: Rotation of the sensor.  See ../video-interfaces.txt for
      details.
    enum: [ 0, 180 ]

  port:
    $ref: /schemas/graph.yaml#/$defs/port-base
    additionalProperties: false

    properties:
      endpoint:
        $ref: /schemas/media/video-interfaces.yaml#
        unevaluatedProperties: false

        properties:
          link-frequencies: true
          data-lanes: true
          bus-type:
            enum:
              - 1 # CSI-2 C-PHY
              - 3 # CCP2
              - 4 # CSI-2 D-PHY

        required:
          - link-frequencies
          - data-lanes
          - bus-type

required:
  - compatible
  - reg
  - clock-frequency
  - clocks

additionalProperties: false

examples:
  - |
    #include <dt-bindings/gpio/gpio.h>
    #include <dt-bindings/media/video-interfaces.h>

    i2c2 {
        #address-cells = <1>;
        #size-cells = <0>;

        clock-frequency = <400000>;

        camera-sensor@10 {
            compatible = "mipi-ccs-1.0", "mipi-ccs";
            reg = <0x10>;
            reset-gpios = <&gpio3 20 GPIO_ACTIVE_LOW>;
            vana-supply = <&vaux3>;
            clocks = <&omap3_isp 0>;
            clock-frequency = <9600000>;
            port {
                ccs_ep: endpoint {
                    data-lanes = <1 2>;
                    remote-endpoint = <&csi2a_ep>;
                    link-frequencies = /bits/ 64 <199200000 210000000
                                                  499200000>;
                    bus-type = <MEDIA_BUS_TYPE_CSI2_DPHY>;
                };
            };
        };
    };
...
```

## Documentation/devicetree/bindings/media/i2c/mt9m001.txt
```
MT9M001: 1/2-Inch Megapixel Digital Image Sensor

The MT9M001 is an SXGA-format with a 1/2-inch CMOS active-pixel digital
image sensor. It is programmable through I2C interface.

Required Properties:

- compatible: shall be "onnn,mt9m001".
- clocks: reference to the master clock into sensor

Optional Properties:

- reset-gpios: GPIO handle which is connected to the reset pin of the chip.
  Active low.
- standby-gpios: GPIO handle which is connected to the standby pin of the chip.
  Active high.

The device node must contain one 'port' child node with one 'endpoint' child
sub-node for its digital output video port, in accordance with the video
interface bindings defined in:
Documentation/devicetree/bindings/media/video-interfaces.txt

Example:

	&i2c1 {
		camera-sensor@5d {
			compatible = "onnn,mt9m001";
			reg = <0x5d>;
			reset-gpios = <&gpio0 0 GPIO_ACTIVE_LOW>;
			standby-gpios = <&gpio0 1 GPIO_ACTIVE_HIGH>;
			clocks = <&camera_clk>;
			port {
				mt9m001_out: endpoint {
					remote-endpoint = <&vcap_in>;
				};
			};
		};
	};
```

## Documentation/devicetree/bindings/media/i2c/mt9m111.txt
```
Micron 1.3Mp CMOS Digital Image Sensor

The Micron MT9M111 is a CMOS active pixel digital image sensor with an active
array size of 1280H x 1024V. It is programmable through a simple two-wire serial
interface.

Required Properties:
- compatible: value should be "micron,mt9m111"
- clocks: reference to the master clock.
- clock-names: shall be "mclk".

The device node must contain one 'port' child node with one 'endpoint' child
sub-node for its digital output video port, in accordance with the video
interface bindings defined in:
Documentation/devicetree/bindings/media/video-interfaces.txt

Optional endpoint properties:
- pclk-sample: For information see ../video-interfaces.txt. The value is set to
  0 if it isn't specified.

Example:

	i2c_master {
		mt9m111@5d {
			compatible = "micron,mt9m111";
			reg = <0x5d>;
			clocks = <&mclk>;
			clock-names = "mclk";

			port {
				mt9m111_1: endpoint {
					remote-endpoint = <&pxa_camera>;
					pclk-sample = <1>;
				};
			};
		};
	};
```

## Documentation/devicetree/bindings/media/i2c/mt9p031.txt
```
* Aptina 1/2.5-Inch 5Mp CMOS Digital Image Sensor

The Aptina MT9P031 is a 1/2.5-inch CMOS active pixel digital image sensor with
an active array size of 2592H x 1944V. It is programmable through a simple
two-wire serial interface.

Required Properties:
- compatible: value should be either one among the following
	(a) "aptina,mt9p031" for mt9p031 sensor
	(b) "aptina,mt9p031m" for mt9p031m sensor

- input-clock-frequency: Input clock frequency.

- pixel-clock-frequency: Pixel clock frequency.

Optional Properties:
- reset-gpios: Chip reset GPIO

For further reading on port node refer to
Documentation/devicetree/bindings/media/video-interfaces.txt.

Example:

	i2c0@1c22000 {
		...
		...
		mt9p031@5d {
			compatible = "aptina,mt9p031";
			reg = <0x5d>;
			reset-gpios = <&gpio3 30 0>;

			port {
				mt9p031_1: endpoint {
					input-clock-frequency = <6000000>;
					pixel-clock-frequency = <96000000>;
				};
			};
		};
		...
	};
```

## Documentation/devicetree/bindings/media/i2c/mt9v032.txt
```
* Aptina 1/3-Inch WVGA CMOS Digital Image Sensor

The Aptina MT9V032 is a 1/3-inch CMOS active pixel digital image sensor with
an active array size of 752H x 480V. It is programmable through a simple
two-wire serial interface.

Required Properties:

- compatible: value should be either one among the following
	(a) "aptina,mt9v022" for MT9V022 color sensor
	(b) "aptina,mt9v022m" for MT9V022 monochrome sensor
	(c) "aptina,mt9v024" for MT9V024 color sensor
	(d) "aptina,mt9v024m" for MT9V024 monochrome sensor
	(e) "aptina,mt9v032" for MT9V032 color sensor
	(f) "aptina,mt9v032m" for MT9V032 monochrome sensor
	(g) "aptina,mt9v034" for MT9V034 color sensor
	(h) "aptina,mt9v034m" for MT9V034 monochrome sensor

Optional Properties:

- link-frequencies: List of allowed link frequencies in Hz. Each frequency is
	expressed as a 64-bit big-endian integer.
- reset-gpios: GPIO handle which is connected to the reset pin of the chip.
- standby-gpios: GPIO handle which is connected to the standby pin of the chip.

For further reading on port node refer to
Documentation/devicetree/bindings/media/video-interfaces.txt.

Example:

	mt9v032@5c {
		compatible = "aptina,mt9v032";
		reg = <0x5c>;

		port {
			mt9v032_out: endpoint {
				link-frequencies = /bits/ 64
					<13000000 26600000 27000000>;
			};
		};
	};
```

## Documentation/devicetree/bindings/media/i2c/nokia,smia.txt
```
SMIA/SMIA++ sensor

SMIA (Standard Mobile Imaging Architecture) is an image sensor standard
defined jointly by Nokia and ST. SMIA++, defined by Nokia, is an extension
of that. These definitions are valid for both types of sensors.

More detailed documentation can be found in
Documentation/devicetree/bindings/media/video-interfaces.txt .


Mandatory properties
--------------------

- compatible: "nokia,smia"
- reg: I2C address (0x10, or an alternative address)
- vana-supply: Analogue voltage supply (VANA), typically 2,8 volts (sensor
  dependent).
- clocks: External clock to the sensor
- clock-frequency: Frequency of the external clock to the sensor
- link-frequencies: List of allowed data link frequencies. An array of
  64-bit elements.


Optional properties
-------------------

- nokia,nvm-size: The size of the NVM, in bytes. If the size is not given,
  the NVM contents will not be read.
- reset-gpios: XSHUTDOWN GPIO


Endpoint node mandatory properties
----------------------------------

- clock-lanes: <0>
- data-lanes: <1..n>
- remote-endpoint: A phandle to the bus receiver's endpoint node.


Example
-------

&i2c2 {
	clock-frequency = <400000>;

	smiapp_1: camera@10 {
		compatible = "nokia,smia";
		reg = <0x10>;
		reset-gpios = <&gpio3 20 0>;
		vana-supply = <&vaux3>;
		clocks = <&omap3_isp 0>;
		clock-frequency = <9600000>;
		nokia,nvm-size = <512>; /* 8 * 64 */
		link-frequencies = /bits/ 64 <199200000 210000000 499200000>;
		port {
			smiapp_1_1: endpoint {
				clock-lanes = <0>;
				data-lanes = <1 2>;
				remote-endpoint = <&csi2a_ep>;
			};
		};
	};
};
```
