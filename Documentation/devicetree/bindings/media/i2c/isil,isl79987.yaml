## Documentation/devicetree/bindings/media/i2c/isil,isl79987.yaml
```yaml
# SPDX-License-Identifier: (GPL-2.0-only OR BSD-2-Clause)
%YAML 1.2
---
$id: http://devicetree.org/schemas/media/i2c/isil,isl79987.yaml#
$schema: http://devicetree.org/meta-schemas/core.yaml#

title: Intersil ISL79987 Analog to MIPI CSI-2 decoder

maintainers:
  - Michael Tretter <m.tretter@pengutronix.de>
  - Marek Vasut <marex@denx.de>

description:
  The Intersil ISL79987 is an analog to MIPI CSI-2 decoder which is capable of
  receiving up to four analog stream and multiplexing them into up to four MIPI
  CSI-2 virtual channels, using one MIPI clock lane and 1/2 data lanes.

properties:
  compatible:
    enum:
      - isil,isl79987

  reg:
    maxItems: 1

  reset-gpios:
    maxItems: 1
    description:
      A GPIO spec for the RSTB pin (active high)

  powerdown-gpios:
    maxItems: 1
    description:
      A GPIO spec for the Power Down pin (active high)

  ports:
    $ref: /schemas/graph.yaml#/properties/ports
    properties:
      port@0:
        $ref: /schemas/graph.yaml#/$defs/port-base
        unevaluatedProperties: false
        description: Output port

        properties:
          endpoint:
            $ref: /schemas/media/video-interfaces.yaml#
            unevaluatedProperties: false

            properties:
              data-lanes:
                minItems: 1
                maxItems: 2

            required:
              - data-lanes

    patternProperties:
      "^port@[1-4]$":
        $ref: /schemas/graph.yaml#/properties/port
        description: Input ports

    required:
      - port@0

additionalProperties: false

required:
  - compatible
  - reg
  - ports

examples:
  - |
    #include <dt-bindings/gpio/gpio.h>

    i2c {
      #address-cells = <1>;
      #size-cells = <0>;

      isl7998x_mipi@44 {
        compatible = "isil,isl79987";
        reg = <0x44>;
        powerdown-gpios = <&gpio3 27 GPIO_ACTIVE_HIGH>;
        reset-gpios = <&gpio3 28 GPIO_ACTIVE_HIGH>;

        ports {
          #address-cells = <1>;
          #size-cells = <0>;

          port@0 {
            reg = <0>;
            isl79987_out: endpoint {
              remote-endpoint = <&mipi_csi2_in>;
              data-lanes = <1 2>;
            };
          };

          port@1 {
            reg = <1>;
            endpoint {
              remote-endpoint = <&camera_0>;
            };
          };

          port@2 {
            reg = <2>;
            endpoint {
              remote-endpoint = <&camera_1>;
            };
          };
        };
      };
    };
```

## Documentation/devicetree/bindings/media/i2c/lt7911d.txt
```
* Lontium lt7911d type-c/DP to MIPI-CSI Bridge

Required Properties:
- compatible: should be "lontium,lt7911d".
- clocks: reference to the 27M xvclk input clock.
- clock-names: should be "xvclk".
- reset-gpios: Low active reset gpio.
- power-gpios: High active power gpio.
- hpd-ctl-gpios: High active hpd control gpio.
		 If inverted circuit, choose low active.
- plugin-det-gpios: Low active plugin detect gpio.
- interrupts: GPIO connected to the gpio5.
- data-lanes: should be <1 2 3 4> for four-lane operation,
	      or <1 2> for two-lane operation.

Attention:
LT7911D device address 0x2b(7bit)

Example:
&i2c7 {
	status = "okay";

	lt7911d: lt7911d@2b {
		compatible = "lontium,lt7911d";
		status = "okay";
		reg = <0x2b>;
		clocks = <&cru CLK_MIPI_CAMARAOUT_M1>;
		clock-names = "xvclk";
		interrupt-parent = <&gpio3>;
		interrupts = <RK_PD4 IRQ_TYPE_EDGE_RISING>;
		power-domains = <&power RK3588_PD_VI>;
		pinctrl-names = "default";
		pinctrl-0 = <&mipim1_camera1_clk>;
		reset-gpios = <&gpio3 RK_PC6 GPIO_ACTIVE_LOW>;
		power-gpios = <&gpio0 RK_PD6 GPIO_ACTIVE_HIGH>;
		hpd-ctl-gpios = <&gpio3 RK_PC5 GPIO_ACTIVE_HIGH>;
		plugin-det-gpios = <&gpio0 RK_PD6 GPIO_ACTIVE_LOW>;
		rockchip,camera-module-index = <0>;
		rockchip,camera-module-facing = "back";
		rockchip,camera-module-name = "LT7911D";
		rockchip,camera-module-lens-name = "NC";
		port {
			lt7911d_out: endpoint {
				remote-endpoint = <&hdmi_mipi_in>;
				data-lanes = <1 2 3 4>;
			};
		};
	};
};
```

## Documentation/devicetree/bindings/media/i2c/lt7911uxc.txt
```
* Lontium lt7911uxc type-c/DP to MIPI-CSI Bridge

Required Properties:
- compatible: should be "lontium,lt7911uxc".
- clocks: reference to the 27M xvclk input clock.
- clock-names: should be "xvclk".
- reset-gpios: Low active reset gpio.
- power-gpios: High active power gpio.
- plugin-det-gpios: Low active plugin detect gpio.
- interrupts: GPIO connected to lt7911uxc gpio0.
- data-lanes: should be <1 2 3 4> for four-lane DPHY,
              or <1 2 3> for three-trios CPHY.

Optional Properties:
- bus-type: should be <1> if use CPHY.
            should be <4> or default config if use DPHY.

Attention:
LT7911UXC device address 0x43(7bit)

Example:
&i2c5 {
	status = "okay";

	lt7911uxc: lt7911uxc@43 {
		compatible = "lontium,lt7911uxc";
		status = "okay";
		reg = <0x43>;
		clocks = <&ext_cam_clk>;
		clock-names = "xvclk";
		interrupt-parent = <&gpio1>;
		interrupts = <RK_PA1 IRQ_TYPE_EDGE_RISING>;
		power-domains = <&power RK3588_PD_VI>;
		reset-gpios = <&gpio2 RK_PC4 GPIO_ACTIVE_LOW>;
		power-gpios = <&gpio0 RK_PC6 GPIO_ACTIVE_HIGH>;
		plugin-det-gpios = <&gpio0 RK_PD6 GPIO_ACTIVE_LOW>;
		rockchip,camera-module-index = <0>;
		rockchip,camera-module-facing = "back";
		rockchip,camera-module-name = "LT7911UXC";
		rockchip,camera-module-lens-name = "LT7911UXC";
		port {
			lt7911uxc_out: endpoint {
				remote-endpoint = <&dp_mipi_in1>;
				bus-type = <1>;
				data-lanes = <1 2 3>;
			};
		};
	};
};
```

## Documentation/devicetree/bindings/media/i2c/max2175.txt
```
Maxim Integrated MAX2175 RF to Bits tuner
-----------------------------------------

The MAX2175 IC is an advanced analog/digital hybrid-radio receiver with
RF to Bits® front-end designed for software-defined radio solutions.

Required properties:
--------------------
- compatible: "maxim,max2175" for MAX2175 RF-to-bits tuner.
- clocks: clock specifier.
- port: child port node corresponding to the I2S output, in accordance with
	the video interface bindings defined in
	Documentation/devicetree/bindings/media/video-interfaces.txt. The port
	node must contain at least one endpoint.

Optional properties:
--------------------
- maxim,master	      : phandle to the master tuner if it is a slave. This
			is used to define two tuners in diversity mode
			(1 master, 1 slave). By default each tuner is an
			individual master.
- maxim,refout-load   : load capacitance value (in picofarads) on reference
			output drive level. The possible load values are:
			 0 (default - refout disabled)
			10
			20
			30
			40
			60
			70
- maxim,am-hiz-filter : empty property indicates the AM Hi-Z filter is used
			in this hardware for AM antenna input.

Example:
--------

Board specific DTS file

/* Fixed XTAL clock node */
maxim_xtal: clock {
	compatible = "fixed-clock";
	#clock-cells = <0>;
	clock-frequency = <36864000>;
};

/* A tuner device instance under i2c bus */
max2175_0: tuner@60 {
	compatible = "maxim,max2175";
	reg = <0x60>;
	clocks = <&maxim_xtal>;
	maxim,refout-load = <10>;

	port {
		max2175_0_ep: endpoint {
			remote-endpoint = <&slave_rx_device>;
		};
	};

};
```

## Documentation/devicetree/bindings/media/i2c/maxim,max9286.yaml
```yaml
# SPDX-License-Identifier: (GPL-2.0-only OR BSD-2-Clause)
# Copyright (C) 2019 Renesas Electronics Corp.
%YAML 1.2
---
$id: http://devicetree.org/schemas/media/i2c/maxim,max9286.yaml#
$schema: http://devicetree.org/meta-schemas/core.yaml#

title: Maxim Integrated Quad GMSL Deserializer

maintainers:
  - Jacopo Mondi <jacopo+renesas@jmondi.org>
  - Kieran Bingham <kieran.bingham+renesas@ideasonboard.com>
  - Laurent Pinchart <laurent.pinchart+renesas@ideasonboard.com>
  - Niklas Söderlund <niklas.soderlund+renesas@ragnatech.se>

description: |
  The MAX9286 deserializer receives video data on up to 4 Gigabit Multimedia
  Serial Links (GMSL) and outputs them on a CSI-2 D-PHY port using up to 4 data
  lanes.

  In addition to video data, the GMSL links carry a bidirectional control
  channel that encapsulates I2C messages. The MAX9286 forwards all I2C traffic
  not addressed to itself to the other side of the links, where a GMSL
  serializer will output it on a local I2C bus. In the other direction all I2C
  traffic received over GMSL by the MAX9286 is output on the local I2C bus.

properties:
  '#address-cells':
    const: 1

  '#size-cells':
    const: 0

  compatible:
    const: maxim,max9286

  reg:
    description: I2C device address
    maxItems: 1

  poc-supply:
    description: Regulator providing Power over Coax to the cameras

  enable-gpios:
    description: GPIO connected to the \#PWDN pin with inverted polarity
    maxItems: 1

  gpio-controller: true

  '#gpio-cells':
    const: 2

  maxim,reverse-channel-microvolt:
    minimum: 30000
    maximum: 200000
    default: 170000
    description: |
      Initial amplitude of the reverse control channel, in micro volts.

      The initial amplitude shall be adjusted to a value compatible with the
      configuration of the connected remote serializer.

      Some camera modules (for example RDACM20) include an on-board MCU that
      pre-programs the embedded serializer with power supply noise immunity
      (high-threshold) enabled. A typical value of the deserializer's reverse
      channel amplitude to communicate with pre-programmed serializers is
      170000 micro volts.

      A typical value for the reverse channel amplitude to communicate with
      a remote serializer whose high-threshold noise immunity is not enabled
      is 100000 micro volts

  ports:
    $ref: /schemas/graph.yaml#/properties/ports

    properties:
      port@0:
        $ref: /schemas/graph.yaml#/properties/port
        description: GMSL Input 0

      port@1:
        $ref: /schemas/graph.yaml#/properties/port
        description: GMSL Input 1

      port@2:
        $ref: /schemas/graph.yaml#/properties/port
        description: GMSL Input 2

      port@3:
        $ref: /schemas/graph.yaml#/properties/port
        description: GMSL Input 3

      port@4:
        $ref: /schemas/graph.yaml#/$defs/port-base
        unevaluatedProperties: false
        description: CSI-2 Output

        properties:
          endpoint:
            $ref: /schemas/media/video-interfaces.yaml#
            unevaluatedProperties: false

            properties:
              data-lanes: true

            required:
              - data-lanes

    required:
      - port@4

  i2c-mux:
    type: object
    $ref: /schemas/i2c/i2c-mux.yaml#
    unevaluatedProperties: false
    description: |
      Each GMSL link is modelled as a child bus of an i2c bus multiplexer/switch.

    patternProperties:
      "^i2c@[0-3]$":
        type: object
        description: |
          Child node of the i2c bus multiplexer which represents a GMSL link.
          Each serializer device on the GMSL link remote end is represented with
          an i2c-mux child node. The MAX9286 chip supports up to 4 GMSL
          channels.

        properties:
          reg:
            description: The index of the GMSL channel.
            maxItems: 1

        patternProperties:
          "^camera@[a-f0-9]+$":
            type: object
            description: |
              The remote camera device, composed by a GMSL serializer and a
              connected video source.

            properties:
              compatible:
                description: The remote device compatible string.

              reg:
                minItems: 2
                maxItems: 3
                description: |
                  The I2C addresses to be assigned to the remote devices through
                  address reprogramming. The number of entries depends on the
                  requirements of the currently connected remote device.

              port:
                $ref: /schemas/graph.yaml#/properties/port
                description: Connection to the MAX9286 sink.

            required:
              - compatible
              - reg
              - port

            additionalProperties: false

required:
  - compatible
  - reg
  - ports
  - i2c-mux
  - gpio-controller

additionalProperties: false

examples:
  - |
    #include <dt-bindings/gpio/gpio.h>

    i2c@e66d8000 {
      #address-cells = <1>;
      #size-cells = <0>;

      reg = <0 0xe66d8000>;

      gmsl-deserializer@2c {
        compatible = "maxim,max9286";
        reg = <0x2c>;
        poc-supply = <&camera_poc_12v>;
        enable-gpios = <&gpio 13 GPIO_ACTIVE_HIGH>;

        gpio-controller;
        #gpio-cells = <2>;

        maxim,reverse-channel-microvolt = <170000>;

        ports {
          #address-cells = <1>;
          #size-cells = <0>;

          port@0 {
            reg = <0>;

            max9286_in0: endpoint {
              remote-endpoint = <&rdacm20_out0>;
            };
          };

          port@1 {
            reg = <1>;

            max9286_in1: endpoint {
              remote-endpoint = <&rdacm20_out1>;
            };
          };

          port@2 {
            reg = <2>;

            max9286_in2: endpoint {
              remote-endpoint = <&rdacm20_out2>;
            };
          };

          port@3 {
            reg = <3>;

            max9286_in3: endpoint {
              remote-endpoint = <&rdacm20_out3>;
            };
          };

          port@4 {
            reg = <4>;

            max9286_out: endpoint {
              data-lanes = <1 2 3 4>;
              remote-endpoint = <&csi40_in>;
            };
          };
        };

        i2c-mux {
          #address-cells = <1>;
          #size-cells = <0>;

          i2c@0 {
            #address-cells = <1>;
            #size-cells = <0>;
            reg = <0>;

            camera@51 {
              compatible = "imi,rdacm20";
              reg = <0x51>, <0x61>;

              port {
                rdacm20_out0: endpoint {
                  remote-endpoint = <&max9286_in0>;
                };
              };

            };
          };

          i2c@1 {
            #address-cells = <1>;
            #size-cells = <0>;
            reg = <1>;

            camera@52 {
              compatible = "imi,rdacm20";
              reg = <0x52>, <0x62>;

              port {
                rdacm20_out1: endpoint {
                  remote-endpoint = <&max9286_in1>;
                };
              };
            };
          };

          i2c@2 {
            #address-cells = <1>;
            #size-cells = <0>;
            reg = <2>;

            camera@53 {
              compatible = "imi,rdacm20";
              reg = <0x53>, <0x63>;

              port {
                rdacm20_out2: endpoint {
                  remote-endpoint = <&max9286_in2>;
                };
              };
            };
          };

          i2c@3 {
            #address-cells = <1>;
            #size-cells = <0>;
            reg = <3>;

            camera@54 {
              compatible = "imi,rdacm20";
              reg = <0x54>, <0x64>;

              port {
                rdacm20_out3: endpoint {
                  remote-endpoint = <&max9286_in3>;
                };
              };
            };
          };
        };
      };
    };
```
