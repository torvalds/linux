## Documentation/devicetree/bindings/media/i2c/nokia,smia.yaml
```yaml
# SPDX-License-Identifier: (GPL-2.0-only OR BSD-2-Clause)
# Copyright (C) 2014--2020 Intel Corporation

$id: http://devicetree.org/schemas/media/i2c/nokia,smia.yaml#
$schema: http://devicetree.org/meta-schemas/core.yaml#

title: SMIA/SMIA++ sensor

maintainers:
  - Sakari Ailus <sakari.ailus@linux.intel.com>

description:

  SMIA (Standard Mobile Imaging Architecture) is an image sensor standard
  defined jointly by Nokia and ST. SMIA++, defined by Nokia, is an extension of
  that. These definitions are valid for both types of sensors.

  More detailed documentation can be found in
  Documentation/devicetree/bindings/media/video-interfaces.txt .

properties:
  compatible:
    const: nokia,smia

  reg:
    maxItems: 1

  vana-supply:
    description: Analogue voltage supply (VANA), typically 2,8 volts (sensor
      dependent).
    maxItems: 1

  clocks:
    description: External clock to the sensor.
    maxItems: 1

  clock-frequency:
    description: Frequency of the external clock to the sensor in Hz.

  reset-gpios:
    description: Reset GPIO. Also commonly called XSHUTDOWN in hardware
      documentation.
    maxItems: 1

  flash-leds:
    description: Flash LED phandles. See ../video-interfaces.txt for details.

  lens-focus:
    description: Lens focus controller phandles. See ../video-interfaces.txt
      for details.

  rotation:
    description: Rotation of the sensor.  See ../video-interfaces.txt for
      details.
    enum: [ 0, 180 ]

  port:
    type: object
    properties:
      endpoint:
        type: object
        properties:
          link-frequencies:
            $ref: /schemas/types.yaml#/definitions/uint64-array
            description: List of allowed data link frequencies.
          data-lanes:
            minItems: 1
            maxItems: 8
        required:
          - link-frequencies
          - data-lanes

required:
  - compatible
  - reg
  - clock-frequency
  - clocks

additionalProperties: false

examples:
  - |
    i2c2 {
        #address-cells = <1>;
        #size-cells = <0>;

        clock-frequency = <400000>;

        camera-sensor@10 {
            compatible = "nokia,smia";
            reg = <0x10>;
            reset-gpios = <&gpio3 20 0>;
            vana-supply = <&vaux3>;
            clocks = <&omap3_isp 0>;
            clock-frequency = <9600000>;
            port {
                smiapp_ep: endpoint {
                    data-lanes = <1 2>;
                    remote-endpoint = <&csi2a_ep>;
                    link-frequencies = /bits/ 64 <199200000 210000000
                                                  499200000>;
                };
            };
        };
    };
...
```

## Documentation/devicetree/bindings/media/i2c/nxp,tda19971.yaml
```yaml
# SPDX-License-Identifier: (GPL-2.0-only OR BSD-2-Clause)
%YAML 1.2
---
$id: http://devicetree.org/schemas/media/i2c/nxp,tda19971.yaml#
$schema: http://devicetree.org/meta-schemas/core.yaml#

title: NXP TDA1997x HDMI receiver

maintainers:
  - Frank Li <Frank.Li@nxp.com>

description: |
  The TDA19971/73 are HDMI video receivers.

  The TDA19971 Video port output pins can be used as follows:
   - RGB 8bit per color (24 bits total): R[11:4] B[11:4] G[11:4]
   - YUV444 8bit per color (24 bits total): Y[11:4] Cr[11:4] Cb[11:4]
   - YUV422 semi-planar 8bit per component (16 bits total): Y[11:4] CbCr[11:4]
   - YUV422 semi-planar 10bit per component (20 bits total): Y[11:2] CbCr[11:2]
   - YUV422 semi-planar 12bit per component (24 bits total): - Y[11:0] CbCr[11:0]
   - YUV422 BT656 8bit per component (8 bits total): YCbCr[11:4] (2-cycles)
   - YUV422 BT656 10bit per component (10 bits total): YCbCr[11:2] (2-cycles)
   - YUV422 BT656 12bit per component (12 bits total): YCbCr[11:0] (2-cycles)

  The TDA19973 Video port output pins can be used as follows:
   - RGB 12bit per color (36 bits total): R[11:0] B[11:0] G[11:0]
   - YUV444 12bit per color (36 bits total): Y[11:0] Cb[11:0] Cr[11:0]
   - YUV422 semi-planar 12bit per component (24 bits total): Y[11:0] CbCr[11:0]
   - YUV422 BT656 12bit per component (12 bits total): YCbCr[11:0] (2-cycles)

  The Video port output pins are mapped via 4-bit 'pin groups' allowing
  for a variety of connection possibilities including swapping pin order within
  pin groups. The video_portcfg device-tree property consists of register mapping
  pairs which map a chip-specific VP output register to a 4-bit pin group. If
  the pin group needs to be bit-swapped you can use the *_S pin-group defines.

properties:
  compatible:
    enum:
      - nxp,tda19971
      - nxp,tda19973

  reg:
    maxItems: 1

  interrupts:
    maxItems: 1

  DOVDD-supply: true

  DVDD-supply: true

  AVDD-supply: true

  '#sound-dai-cells':
    const: 0

  port:
    $ref: /schemas/graph.yaml#/$defs/port-base
    unevaluatedProperties: false

    properties:
      endpoint:
        $ref: /schemas/media/video-interfaces.yaml#
        unevaluatedProperties: false

  nxp,vidout-portcfg:
    $ref: /schemas/types.yaml#/definitions/uint32-matrix
    minItems: 1
    maxItems: 4
    items:
      items:
        - description: Video Port control registers index.
          maximum: 8
          minimum: 0
        - description: pin(pinswapped) groups

    description:
      array of pairs mapping VP output pins to pin groups.

  nxp,audout-format:
    enum:
      - i2s
      - spdif

  nxp,audout-width:
    $ref: /schemas/types.yaml#/definitions/uint32
    enum: [8, 16, 24, 32]
    description:
      width of audio output data bus.

  nxp,audout-layout:
    $ref: /schemas/types.yaml#/definitions/uint32
    enum: [0, 1]
    description:
      data layout (0=AP0 used, 1=AP0/AP1/AP2/AP3 used).

  nxp,audout-mclk-fs:
    $ref: /schemas/types.yaml#/definitions/uint32
    description:
      Multiplication factor between stream rate and codec mclk.

required:
  - compatible
  - reg
  - interrupts
  - DOVDD-supply
  - AVDD-supply
  - DVDD-supply

additionalProperties: false

examples:
  - |
    #include <dt-bindings/interrupt-controller/irq.h>
    #include <dt-bindings/media/tda1997x.h>

    i2c {
        #address-cells = <1>;
        #size-cells = <0>;

        hdmi-receiver@48 {
            compatible = "nxp,tda19971";
            reg = <0x48>;
            pinctrl-names = "default";
            pinctrl-0 = <&pinctrl_tda1997x>;
            interrupt-parent = <&gpio1>;
            interrupts = <7 IRQ_TYPE_LEVEL_LOW>;
            DOVDD-supply = <&reg_3p3v>;
            AVDD-supply = <&reg_1p8v>;
            DVDD-supply = <&reg_1p8v>;
            /* audio */
            #sound-dai-cells = <0>;
            nxp,audout-format = "i2s";
            nxp,audout-layout = <0>;
            nxp,audout-width = <16>;
            nxp,audout-mclk-fs = <128>;
            /*
             * The 8bpp YUV422 semi-planar mode outputs CbCr[11:4]
             * and Y[11:4] across 16bits in the same pixclk cycle.
             */
            nxp,vidout-portcfg =
                /* Y[11:8]<->VP[15:12]<->CSI_DATA[19:16] */
                < TDA1997X_VP24_V15_12 TDA1997X_G_Y_11_8 >,
                /* Y[7:4]<->VP[11:08]<->CSI_DATA[15:12] */
                < TDA1997X_VP24_V11_08 TDA1997X_G_Y_7_4 >,
                /* CbCc[11:8]<->VP[07:04]<->CSI_DATA[11:8] */
                < TDA1997X_VP24_V07_04 TDA1997X_R_CR_CBCR_11_8 >,
                /* CbCr[7:4]<->VP[03:00]<->CSI_DATA[7:4] */
                < TDA1997X_VP24_V03_00 TDA1997X_R_CR_CBCR_7_4 >;

            port {
                endpoint {
                    remote-endpoint = <&ipu1_csi0_mux_from_parallel_sensor>;
                    bus-width = <16>;
                    hsync-active = <1>;
                    vsync-active = <1>;
                    data-active = <1>;
                };
            };
        };
    };
```

## Documentation/devicetree/bindings/media/i2c/onnn,ar0521.yaml
```yaml
# SPDX-License-Identifier: (GPL-2.0-only OR BSD-2-Clause)
%YAML 1.2
---
$id: http://devicetree.org/schemas/media/i2c/onnn,ar0521.yaml#
$schema: http://devicetree.org/meta-schemas/core.yaml#

title: ON Semiconductor AR0521 MIPI CSI-2 sensor

maintainers:
  - Krzysztof Hałasa <khalasa@piap.pl>

description: |-
  The AR0521 is a raw CMOS image sensor with MIPI CSI-2 and
  I2C-compatible control interface.

properties:
  compatible:
    const: onnn,ar0521

  reg:
    maxItems: 1

  clocks:
    maxItems: 1

  clock-names:
    const: extclk

  vaa-supply:
    description:
      Definition of the regulator used as analog (2.7 V) voltage supply.

  vdd-supply:
    description:
      Definition of the regulator used as digital core (1.2 V) voltage supply.

  vdd_io-supply:
    description:
      Definition of the regulator used as digital I/O (1.8 V) voltage supply.

  reset-gpios:
    description: reset GPIO, usually active low
    maxItems: 1

  port:
    $ref: /schemas/graph.yaml#/$defs/port-base
    unevaluatedProperties: false
    description: |
      Video output port.

    properties:
      endpoint:
        $ref: /schemas/media/video-interfaces.yaml#
        unevaluatedProperties: false

        properties:
          bus-type:
            const: 4
          data-lanes:
            anyOf:
              - items:
                  - const: 1
              - items:
                  - const: 1
                  - const: 2
              - items:
                  - const: 1
                  - const: 2
                  - const: 3
                  - const: 4

required:
  - compatible
  - reg
  - clocks
  - clock-names
  - vaa-supply
  - vdd-supply
  - vdd_io-supply
  - port

additionalProperties: false

examples:
  - |
    #include <dt-bindings/gpio/gpio.h>
    #include <dt-bindings/clock/imx6qdl-clock.h>

    i2c {
            #address-cells = <1>;
            #size-cells = <0>;

            ar0521: camera-sensor@36 {
                    compatible = "onnn,ar0521";
                    reg = <0x36>;
                    pinctrl-names = "default";
                    pinctrl-0 = <&pinctrl_mipi_camera>;
                    clocks = <&clks IMX6QDL_CLK_CKO>;
                    clock-names = "extclk";
                    reset-gpios = <&gpio1 7 GPIO_ACTIVE_LOW>;
                    vaa-supply = <&reg_2p7v>;
                    vdd-supply = <&reg_1p2v>;
                    vdd_io-supply = <&reg_1p8v>;

                    port {
                           mipi_camera_to_mipi_csi2: endpoint {
                                    remote-endpoint = <&mipi_csi2_in>;
                                    data-lanes = <1 2 3 4>;
                            };
                    };
            };
    };
```

## Documentation/devicetree/bindings/media/i2c/onnn,mt9m114.yaml
```yaml
# SPDX-License-Identifier: (GPL-2.0-only OR BSD-2-Clause)
%YAML 1.2
---
$id: http://devicetree.org/schemas/media/i2c/onnn,mt9m114.yaml#
$schema: http://devicetree.org/meta-schemas/core.yaml#

title: onsemi 1/6-inch 720p CMOS Digital Image Sensor

maintainers:
  - Laurent Pinchart <laurent.pinchart@ideasonboard.com>

description: |-
  The onsemi MT9M114 is a 1/6-inch 720p (1.26 Mp) CMOS digital image sensor
  with an active pixel-array size of 1296H x 976V. It is programmable through
  an I2C interface and outputs image data over a 8-bit parallel or 1-lane MIPI
  CSI-2 connection.

properties:
  compatible:
    const: onnn,mt9m114

  reg:
    description: I2C device address
    enum:
      - 0x48
      - 0x5d

  clocks:
    description: EXTCLK clock signal
    maxItems: 1

  vdd-supply:
    description:
      Core digital voltage supply, 1.8V

  vddio-supply:
    description:
      I/O digital voltage supply, 1.8V or 2.8V

  vaa-supply:
    description:
      Analog voltage supply, 2.8V

  reset-gpios:
    description: |-
      Reference to the GPIO connected to the RESET_BAR pin, if any (active
      low).

  port:
    $ref: /schemas/graph.yaml#/$defs/port-base
    additionalProperties: false

    properties:
      endpoint:
        $ref: /schemas/media/video-interfaces.yaml#
        additionalProperties: false

        properties:
          bus-type:
            enum: [4, 5, 6]

          link-frequencies: true
          remote-endpoint: true

          # The number and mapping of lanes (for CSI-2), and the bus width and
          # signal polarities (for parallel and BT.656) are fixed and must not
          # be specified.

        required:
          - bus-type
          - link-frequencies

  slew-rate:
    $ref: /schemas/types.yaml#/definitions/uint32
    description:
      Slew rate ot the output pads DOUT[7:0], LINE_VALID, FRAME_VALID and
      PIXCLK. Higher values imply steeper voltage-flanks on the pads.
    minimum: 0
    maximum: 7
    default: 7

required:
  - compatible
  - reg
  - clocks
  - vdd-supply
  - vddio-supply
  - vaa-supply
  - port

additionalProperties: false

examples:
  - |
    #include <dt-bindings/gpio/gpio.h>
    #include <dt-bindings/media/video-interfaces.h>

    i2c0 {
        #address-cells = <1>;
        #size-cells = <0>;

        sensor@48 {
            compatible = "onnn,mt9m114";
            reg = <0x48>;

            clocks = <&clk24m 0>;

            reset-gpios = <&gpio5 21 GPIO_ACTIVE_LOW>;

            vddio-supply = <&reg_cam_1v8>;
            vdd-supply = <&reg_cam_1v8>;
            vaa-supply = <&reg_2p8v>;

            port {
                endpoint {
                    bus-type = <MEDIA_BUS_TYPE_CSI2_DPHY>;
                    link-frequencies = /bits/ 64 <384000000>;
                    remote-endpoint = <&mipi_csi_in>;
                };
            };
        };
    };
...
```

## Documentation/devicetree/bindings/media/i2c/os05a20.txt
```
* Ovti os05a20 MIPI sensor

Required Properties:
- compatible: should be "ovti,os05a20"
- clocks: reference to the 24M xvclk input clock.
- clock-names: should be "xvclk".
- dovdd-supply: Digital I/O voltage supply, 1.8 volts
- avdd-supply: Analog voltage supply, 2.8 volts
- dvdd-supply: Digital core voltage supply, 1.2 volts
- reset-gpios: Low active reset gpio

Attention:
os05a20 device address 0x36(7bit) or 0x10(7bit) is decided by SID pin;

The device node must contain one 'port' child node for its digital output
video port, in accordance with the video interface bindings defined in
Documentation/devicetree/bindings/media/video-interfaces.txt.

Example:
//rv1126 evb13 board
&i2c1 {
	status = "okay";
	os05a20: os05a20@36 {
		compatible = "ovti,os05a20";
		reg = <0x36>;
		clocks = <&cru CLK_MIPICSI_OUT>;
		clock-names = "xvclk";
		power-domains = <&power RV1126_PD_VI>;
		pinctrl-names = "rockchip,camera_default";
		pinctrl-0 = <&mipicsi_clk0>;
		avdd-supply = <&vcc_avdd>;
		dovdd-supply = <&vcc_dovdd>;
		dvdd-supply = <&vcc_dvdd>;
		power-gpios = <&gpio3 RK_PA6 GPIO_ACTIVE_HIGH>;
		pwdn-gpios = <&gpio1 RK_PD4 GPIO_ACTIVE_HIGH>;
		rockchip,camera-module-index = <1>;
		rockchip,camera-module-facing = "front";
		rockchip,camera-module-name = "JSD3425-C1";
		rockchip,camera-module-lens-name = "JSD3425-C1-36IRC-4M-F20";
		ir-cut = <&cam_ircut0>;
		port {
			ucam_out0: endpoint {
				remote-endpoint = <&mipi_in_ucam0>;
				data-lanes = <1 2 3 4>;
			};
		};
	};
};
```
