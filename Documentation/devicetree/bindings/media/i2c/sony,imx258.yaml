## Documentation/devicetree/bindings/media/i2c/sony,imx335.yaml
```yaml
# SPDX-License-Identifier: (GPL-2.0-only OR BSD-2-Clause)
# Copyright (C) 2021 Intel Corporation
%YAML 1.2
---
$id: http://devicetree.org/schemas/media/i2c/sony,imx335.yaml#
$schema: http://devicetree.org/meta-schemas/core.yaml#

title: Sony IMX335 Sensor

maintainers:
  - Paul J. Murphy <paul.j.murphy@intel.com>
  - Daniele Alessandrelli <daniele.alessandrelli@intel.com>

description:
  IMX335 sensor is a Sony CMOS active pixel digital image sensor with an active
  array size of 2592H x 1944V. It is programmable through I2C interface. The
  I2C client address is fixed to 0x1a as per sensor data sheet. Image data is
  sent through MIPI CSI-2.

properties:
  compatible:
    const: sony,imx335
  reg:
    description: I2C address
    maxItems: 1

  assigned-clocks: true
  assigned-clock-parents: true
  assigned-clock-rates: true

  clocks:
    description: Clock frequency from 6 to 27 MHz, 37.125MHz, 74.25MHz
    maxItems: 1

  avdd-supply:
    description: Analog power supply (2.9V)

  ovdd-supply:
    description: Interface power supply (1.8V)

  dvdd-supply:
    description: Digital power supply (1.2V)

  reset-gpios:
    description: Reference to the GPIO connected to the XCLR pin, if any.
    maxItems: 1

  port:
    additionalProperties: false
    $ref: /schemas/graph.yaml#/$defs/port-base

    properties:
      endpoint:
        $ref: /schemas/media/video-interfaces.yaml#
        unevaluatedProperties: false

        properties:
          data-lanes: true
          link-frequencies: true

        required:
          - data-lanes
          - link-frequencies

    required:
      - endpoint

required:
  - compatible
  - reg
  - clocks
  - port

additionalProperties: false

examples:
  - |
    i2c {
        #address-cells = <1>;
        #size-cells = <0>;

        camera@1a {
            compatible = "sony,imx335";
            reg = <0x1a>;
            clocks = <&imx335_clk>;

            assigned-clocks = <&imx335_clk>;
            assigned-clock-parents = <&imx335_clk_parent>;
            assigned-clock-rates = <24000000>;

            avdd-supply = <&camera_vdda_2v9>;
            ovdd-supply = <&camera_vddo_1v8>;
            dvdd-supply = <&camera_vddd_1v2>;

            port {
                imx335: endpoint {
                    remote-endpoint = <&cam>;
                    data-lanes = <1 2 3 4>;
                    link-frequencies = /bits/ 64 <594000000>;
                };
            };
        };
    };
...
```

## Documentation/devicetree/bindings/media/i2c/sony,imx355.yaml
```yaml
# SPDX-License-Identifier: (GPL-2.0-only OR BSD-2-Clause)
%YAML 1.2
---
$id: http://devicetree.org/schemas/media/i2c/sony,imx355.yaml#
$schema: http://devicetree.org/meta-schemas/core.yaml#

title: Sony IMX355 Sensor

maintainers:
  - Richard Acayan <mailingradian@gmail.com>

description:
  The IMX355 sensor is a 3280x2464 image sensor, commonly found as the front
  camera in smartphones.

allOf:
  - $ref: /schemas/media/video-interface-devices.yaml#

properties:
  compatible:
    const: sony,imx355

  reg:
    maxItems: 1

  clocks:
    maxItems: 1

  avdd-supply:
    description: Analog power supply.

  dvdd-supply:
    description: Digital power supply.

  dovdd-supply:
    description: Interface power supply.

  reset-gpios:
    description: Reset GPIO (active low).
    maxItems: 1

  port:
    $ref: /schemas/graph.yaml#/$defs/port-base
    additionalProperties: false

    properties:
      endpoint:
        $ref: /schemas/media/video-interfaces.yaml
        unevaluatedProperties: false

        properties:
          data-lanes:
            minItems: 4
            maxItems: 4

        required:
          - link-frequencies

    required:
      - endpoint

required:
  - compatible
  - reg
  - clocks
  - avdd-supply
  - dvdd-supply
  - dovdd-supply
  - port

unevaluatedProperties: false

examples:
  - |
    #include <dt-bindings/clock/qcom,camcc-sdm845.h>
    #include <dt-bindings/gpio/gpio.h>

    i2c {
        #address-cells = <1>;
        #size-cells = <0>;

        camera@1a {
            compatible = "sony,imx355";
            reg = <0x1a>;

            clocks = <&camcc CAM_CC_MCLK2_CLK>;

            assigned-clocks = <&camcc CAM_CC_MCLK2_CLK>;
            assigned-clock-rates = <24000000>;

            reset-gpios = <&tlmm 9 GPIO_ACTIVE_LOW>;

            avdd-supply = <&cam_front_ldo>;
            dvdd-supply = <&cam_front_ldo>;
            dovdd-supply = <&cam_vio_ldo>;

            pinctrl-names = "default";
            pinctrl-0 = <&cam_front_default>;

            rotation = <270>;
            orientation = <0>;

            port {
                cam_front_endpoint: endpoint {
                    data-lanes = <1 2 3 4>;
                    link-frequencies = /bits/ 64 <360000000>;
                    remote-endpoint = <&camss_endpoint1>;
                };
            };
        };
    };
```

## Documentation/devicetree/bindings/media/i2c/sony,imx412.yaml
```yaml
# SPDX-License-Identifier: (GPL-2.0-only OR BSD-2-Clause)
# Copyright (C) 2021 Intel Corporation
%YAML 1.2
---
$id: http://devicetree.org/schemas/media/i2c/sony,imx412.yaml#
$schema: http://devicetree.org/meta-schemas/core.yaml#

title: Sony IMX412 Sensor

maintainers:
  - Paul J. Murphy <paul.j.murphy@intel.com>
  - Daniele Alessandrelli <daniele.alessandrelli@intel.com>

description:
  IMX412 sensor is a Sony CMOS active pixel digital image sensor with an active
  array size of 4072H x 3176V. It is programmable through I2C interface. The
  I2C client address is fixed to 0x1a as per sensor data sheet. Image data is
  sent through MIPI CSI-2.

properties:
  compatible:
    enum:
      - sony,imx412
      - sony,imx577
  reg:
    description: I2C address
    maxItems: 1

  assigned-clocks: true
  assigned-clock-parents: true
  assigned-clock-rates: true

  clocks:
    description: Clock frequency 6MHz, 12MHz, 18MHz, 24MHz or 27MHz
    maxItems: 1

  dovdd-supply:
    description: Interface power supply.

  avdd-supply:
    description: Analog power supply.

  dvdd-supply:
    description: Digital power supply.

  reset-gpios:
    description: Reference to the GPIO connected to the XCLR pin, if any.
    maxItems: 1

  port:
    additionalProperties: false
    $ref: /schemas/graph.yaml#/$defs/port-base

    properties:
      endpoint:
        $ref: /schemas/media/video-interfaces.yaml#
        unevaluatedProperties: false

        properties:
          data-lanes: true
          link-frequencies: true

        required:
          - data-lanes
          - link-frequencies

    required:
      - endpoint

required:
  - compatible
  - reg
  - clocks
  - port

additionalProperties: false

examples:
  - |
    i2c0 {
        #address-cells = <1>;
        #size-cells = <0>;

        camera@1a {
            compatible = "sony,imx412";
            reg = <0x1a>;
            clocks = <&imx412_clk>;

            assigned-clocks = <&imx412_clk>;
            assigned-clock-parents = <&imx412_clk_parent>;
            assigned-clock-rates = <24000000>;

            port {
                imx412: endpoint {
                    remote-endpoint = <&cam>;
                    data-lanes = <1 2 3 4>;
                    link-frequencies = /bits/ 64 <600000000>;
                };
            };
        };
    };
...
```

## Documentation/devicetree/bindings/media/i2c/sony,imx415.yaml
```yaml
# SPDX-License-Identifier: (GPL-2.0 OR BSD-2-Clause)
%YAML 1.2
---
$id: http://devicetree.org/schemas/media/i2c/sony,imx415.yaml#
$schema: http://devicetree.org/meta-schemas/core.yaml#

title: Sony IMX415 CMOS Image Sensor

maintainers:
  - Michael Riesch <michael.riesch@wolfvision.net>

description: |-
  The Sony IMX415 is a diagonal 6.4 mm (Type 1/2.8) CMOS active pixel type
  solid-state image sensor with a square pixel array and 8.46 M effective
  pixels. This chip operates with analog 2.9 V, digital 1.1 V, and interface
  1.8 V triple power supply, and has low power consumption.
  The IMX415 is programmable through I2C interface. The sensor output is
  available via CSI-2 serial data output (two or four lanes).

allOf:
  - $ref: ../video-interface-devices.yaml#

properties:
  compatible:
    const: sony,imx415

  reg:
    maxItems: 1

  clocks:
    description: Input clock (24 MHz, 27 MHz, 37.125 MHz, 72 MHz or 74.25 MHz)
    maxItems: 1

  avdd-supply:
    description: Analog power supply (2.9 V)

  dvdd-supply:
    description: Digital power supply (1.1 V)

  ovdd-supply:
    description: Interface power supply (1.8 V)

  reset-gpios:
    description: Sensor reset (XCLR) GPIO
    maxItems: 1

  flash-leds: true

  lens-focus: true

  orientation: true

  rotation: true

  port:
    $ref: /schemas/graph.yaml#/$defs/port-base

    properties:
      endpoint:
        $ref: /schemas/media/video-interfaces.yaml#
        unevaluatedProperties: false

        properties:
          data-lanes:
            oneOf:
              - items:
                  - const: 1
                  - const: 2
              - items:
                  - const: 1
                  - const: 2
                  - const: 3
                  - const: 4

        required:
          - data-lanes
          - link-frequencies

    required:
      - endpoint

required:
  - compatible
  - reg
  - clocks
  - avdd-supply
  - dvdd-supply
  - ovdd-supply
  - port

additionalProperties: false

examples:
  - |
    #include <dt-bindings/gpio/gpio.h>

    i2c {
        #address-cells = <1>;
        #size-cells = <0>;

        imx415: camera-sensor@1a {
            compatible = "sony,imx415";
            reg = <0x1a>;
            avdd-supply = <&vcc2v9_cam>;
            clocks = <&clock_cam>;
            dvdd-supply = <&vcc1v1_cam>;
            lens-focus = <&vcm>;
            orientation = <2>;
            ovdd-supply = <&vcc1v8_cam>;
            reset-gpios = <&gpio_expander 14 GPIO_ACTIVE_LOW>;
            rotation = <180>;

            port {
                imx415_ep: endpoint {
                    data-lanes = <1 2 3 4>;
                    link-frequencies = /bits/ 64 <445500000>;
                    remote-endpoint = <&mipi_in>;
                };
            };
        };
    };
...
```

## Documentation/devicetree/bindings/media/i2c/sony,imx678.yaml
```yaml
# SPDX-License-Identifier: (GPL-2.0-only OR BSD-2-Clause)
# Copyright (C) 2026 Ideas on Board Oy
%YAML 1.2
---
$id: http://devicetree.org/schemas/media/i2c/sony,imx678.yaml#
$schema: http://devicetree.org/meta-schemas/core.yaml#

title: Sony IMX678 Sensor

maintainers:
  - Jai Luthra <jai.luthra@ideasonboard.com>

description:
  Sony IMX678 diagonal 8.86 mm (Type 1/1.8) CMOS active pixel type solid-state
  image sensor with a square pixel array and 8.40M (3856x2180) effective pixels.

allOf:
  - $ref: /schemas/media/video-interface-devices.yaml#

properties:
  compatible:
    items:
      - enum:
          - sony,imx678-aamr
          - sony,imx678-aaqr
      - const: sony,imx678
    description:
      The IMX678 sensor exists in a colour variant (IMX678-AAQR) and a mono
      variant (IMX678-AAMR). The variant-specific compatible describes the
      exact sensor variant, with the generic IMX678 compatible as a fallback.

  reg:
    maxItems: 1

  clocks:
    description: |
      Input clock (INCK). Only the rates listed in the datasheet are supported:
      13.5, 18, 24, 27, 36, 37.125, 72, and 74.25 MHz.
    maxItems: 1

  avdd-supply:
    description: Analog power supply (3.3V)

  ovdd-supply:
    description: Interface power supply (1.8V)

  dvdd-supply:
    description: Digital power supply (1.1V)

  reset-gpios:
    description: Sensor RESETN (XCLR) GPIO
    maxItems: 1

  port:
    $ref: /schemas/graph.yaml#/$defs/port-base
    additionalProperties: false

    properties:
      endpoint:
        $ref: /schemas/media/video-interfaces.yaml#
        unevaluatedProperties: false

        properties:
          data-lanes:
            oneOf:
              - items:
                  - const: 1
                  - const: 2
              - items:
                  - const: 1
                  - const: 2
                  - const: 3
                  - const: 4
              - items:
                  - const: 1
                  - const: 2
                  - const: 3
                  - const: 4
                  - const: 5
                  - const: 6
                  - const: 7
                  - const: 8

        required:
          - data-lanes
          - link-frequencies

    required:
      - endpoint

required:
  - compatible
  - reg
  - clocks
  - avdd-supply
  - ovdd-supply
  - dvdd-supply
  - port

unevaluatedProperties: false

examples:
  - |
    #include <dt-bindings/gpio/gpio.h>

    i2c {
        #address-cells = <1>;
        #size-cells = <0>;

        camera@1a {
            compatible = "sony,imx678-aaqr", "sony,imx678";
            reg = <0x1a>;
            clocks = <&imx678_clk>;

            avdd-supply = <&camera_avdd_3v3>;
            ovdd-supply = <&camera_ovdd_1v8>;
            dvdd-supply = <&camera_dvdd_1v1>;

            reset-gpios = <&gpio 0 GPIO_ACTIVE_LOW>;

            port {
                imx678: endpoint {
                    remote-endpoint = <&cam>;
                    data-lanes = <1 2 3 4>;
                    link-frequencies = /bits/ 64 <720000000>;
                };
            };
        };
    };
...
```
