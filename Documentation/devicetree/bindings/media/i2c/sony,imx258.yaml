## Documentation/devicetree/bindings/media/i2c/st,st-mipid02.txt
```
STMicroelectronics MIPID02 CSI-2 to PARALLEL bridge

MIPID02 has two CSI-2 input ports, only one of those ports can be active at a
time. Active port input stream will be de-serialized and its content outputted
through PARALLEL output port.
CSI-2 first input port is a dual lane 800Mbps per lane whereas CSI-2 second
input port is a single lane 800Mbps. Both ports support clock and data lane
polarity swap. First port also supports data lane swap.
PARALLEL output port has a maximum width of 12 bits.
Supported formats are RAW6, RAW7, RAW8, RAW10, RAW12, RGB565, RGB888, RGB444,
YUV420 8-bit, YUV422 8-bit and YUV420 10-bit.

Required Properties:
- compatible: shall be "st,st-mipid02"
- clocks: reference to the xclk input clock.
- clock-names: shall be "xclk".
- VDDE-supply: sensor digital IO supply. Must be 1.8 volts.
- VDDIN-supply: sensor internal regulator supply. Must be 1.8 volts.

Optional Properties:
- reset-gpios: reference to the GPIO connected to the xsdn pin, if any.
	       This is an active low signal to the mipid02.

Required subnodes:
  - ports: A ports node with one port child node per device input and output
	   port, in accordance with the video interface bindings defined in
	   Documentation/devicetree/bindings/media/video-interfaces.txt. The
	   port nodes are numbered as follows:

	   Port Description
	   -----------------------------
	   0    CSI-2 first input port
	   1    CSI-2 second input port
	   2    PARALLEL output

Endpoint node required property for CSI-2 connection is:
- data-lanes: shall be <1> for Port 1. for Port 0 dual-lane operation shall be
<1 2> or <2 1>. For Port 0 single-lane operation shall be <1> or <2>.
Endpoint node optional property for CSI-2 connection is:
- lane-polarities: any lane can be inverted or not.

Endpoint node required property for PARALLEL connection is:
- bus-width: shall be set to <6>, <7>, <8>, <10> or <12>.
Endpoint node optional properties for PARALLEL connection are:
- hsync-active: active state of the HSYNC signal, 0/1 for LOW/HIGH respectively.
LOW being the default.
- vsync-active: active state of the VSYNC signal, 0/1 for LOW/HIGH respectively.
LOW being the default.

Example:

mipid02: csi2rx@14 {
	compatible = "st,st-mipid02";
	reg = <0x14>;
	status = "okay";
	clocks = <&clk_ext_camera_12>;
	clock-names = "xclk";
	VDDE-supply = <&vdd>;
	VDDIN-supply = <&vdd>;
	ports {
		#address-cells = <1>;
		#size-cells = <0>;
		port@0 {
			reg = <0>;

			ep0: endpoint {
				data-lanes = <1 2>;
				remote-endpoint = <&mipi_csi2_in>;
			};
		};
		port@2 {
			reg = <2>;

			ep2: endpoint {
				bus-width = <8>;
				hsync-active = <0>;
				vsync-active = <0>;
				remote-endpoint = <&parallel_out>;
			};
		};
	};
};
```

## Documentation/devicetree/bindings/media/i2c/st,st-mipid02.yaml
```yaml
# SPDX-License-Identifier: (GPL-2.0-only OR BSD-2-Clause)
%YAML 1.2
---
$id: http://devicetree.org/schemas/media/i2c/st,st-mipid02.yaml#
$schema: http://devicetree.org/meta-schemas/core.yaml#

title: STMicroelectronics MIPID02 CSI-2 to PARALLEL bridge

maintainers:
  - Benjamin Mugnier <benjamin.mugnier@foss.st.com>
  - Sylvain Petinot <sylvain.petinot@foss.st.com>

description:
  MIPID02 has two CSI-2 input ports, only one of those ports can be
  active at a time. Active port input stream will be de-serialized
  and its content outputted through PARALLEL output port.
  CSI-2 first input port is a dual lane 800Mbps per lane whereas CSI-2
  second input port is a single lane 800Mbps. Both ports support clock
  and data lane polarity swap. First port also supports data lane swap.
  PARALLEL output port has a maximum width of 12 bits.
  Supported formats are RAW6, RAW7, RAW8, RAW10, RAW12, RGB565, RGB888,
  RGB444, YUV420 8-bit, YUV422 8-bit and YUV420 10-bit.

properties:
  compatible:
    const: st,st-mipid02

  reg:
    maxItems: 1

  clocks:
    maxItems: 1

  clock-names:
    const: xclk

  VDDE-supply:
    description:
      Sensor digital IO supply. Must be 1.8 volts.

  VDDIN-supply:
    description:
      Sensor internal regulator supply. Must be 1.8 volts.

  reset-gpios:
    description:
      Reference to the GPIO connected to the xsdn pin, if any.
      This is an active low signal to the mipid02.

  ports:
    $ref: /schemas/graph.yaml#/properties/ports
    properties:
      port@0:
        $ref: /schemas/graph.yaml#/$defs/port-base
        unevaluatedProperties: false
        description: CSI-2 first input port
        properties:
          endpoint:
            $ref: /schemas/media/video-interfaces.yaml#
            unevaluatedProperties: false

            properties:
              data-lanes:
                description:
                  Single-lane operation shall be <1> or <2> .
                  Dual-lane operation shall be <1 2> or <2 1> .
                minItems: 1
                maxItems: 2

              lane-polarities:
                description:
                  Any lane can be inverted or not.
                minItems: 1
                maxItems: 2

            required:
              - data-lanes

      port@1:
        $ref: /schemas/graph.yaml#/$defs/port-base
        unevaluatedProperties: false
        description: CSI-2 second input port
        properties:
          endpoint:
            $ref: /schemas/media/video-interfaces.yaml#
            unevaluatedProperties: false

            properties:
              data-lanes:
                description:
                  Single-lane operation shall be <1> or <2> .
                maxItems: 1

              lane-polarities:
                description:
                  Any lane can be inverted or not.
                maxItems: 1

            required:
              - data-lanes

      port@2:
        $ref: /schemas/graph.yaml#/$defs/port-base
        unevaluatedProperties: false
        description: Output port
        properties:
          endpoint:
            $ref: /schemas/media/video-interfaces.yaml#
            unevaluatedProperties: false

            properties:
              bus-width:
                enum: [6, 7, 8, 10, 12]

            required:
              - bus-width

    anyOf:
      - required:
          - port@0
      - required:
          - port@1

    required:
      - port@2

additionalProperties: false

required:
  - compatible
  - reg
  - clocks
  - clock-names
  - VDDE-supply
  - VDDIN-supply
  - ports

examples:
  - |
    i2c {
        #address-cells = <1>;
        #size-cells = <0>;
        mipid02: csi2rx@14 {
            compatible = "st,st-mipid02";
            reg = <0x14>;
            clocks = <&clk_ext_camera_12>;
            clock-names = "xclk";
            VDDE-supply = <&vdd>;
            VDDIN-supply = <&vdd>;
            ports {
                #address-cells = <1>;
                #size-cells = <0>;
                port@0 {
                    reg = <0>;

                    ep0: endpoint {
                        data-lanes = <1 2>;
                        remote-endpoint = <&mipi_csi2_in>;
                    };
                };
                port@2 {
                    reg = <2>;

                    ep2: endpoint {
                        bus-width = <8>;
                        hsync-active = <0>;
                        vsync-active = <0>;
                        remote-endpoint = <&parallel_out>;
                    };
                };
            };
        };
    };

...
```

## Documentation/devicetree/bindings/media/i2c/st,st-vgxy61.yaml
```yaml
# SPDX-License-Identifier: (GPL-2.0 OR BSD-2-Clause)
# Copyright (c) 2022 STMicroelectronics SA.
%YAML 1.2
---
$id: http://devicetree.org/schemas/media/i2c/st,st-vgxy61.yaml#
$schema: http://devicetree.org/meta-schemas/core.yaml#

title: STMicroelectronics VGxy61 HDR Global Shutter Sensor Family

maintainers:
  - Benjamin Mugnier <benjamin.mugnier@foss.st.com>
  - Sylvain Petinot <sylvain.petinot@foss.st.com>

description: |-
  STMicroelectronics VGxy61 family has a CSI-2 output port. CSI-2 output is a
  quad lanes 800Mbps per lane.
  Supported formats are RAW8, RAW10, RAW12, RAW14 and RAW16.
  Following part number are supported
  - VG5661 and VG6661 are 1.6 Mpx (1464 x 1104) monochrome and color sensors.
  Maximum frame rate is 75 fps.
  - VG5761 and VG6761 are 2.3 Mpx (1944 x 1204) monochrome and color sensors.
  Maximum frame rate is 60 fps.

properties:
  compatible:
    const: st,st-vgxy61

  reg:
    maxItems: 1

  clocks:
    maxItems: 1

  VCORE-supply:
    description:
      Sensor digital core supply. Must be 1.2 volts.

  VDDIO-supply:
    description:
      Sensor digital IO supply. Must be 1.8 volts.

  VANA-supply:
    description:
      Sensor analog supply. Must be 2.8 volts.

  reset-gpios:
    description:
      Reference to the GPIO connected to the reset pin, if any.
      This is an active low signal to the vgxy61.

  st,strobe-gpios-polarity:
    description:
      Invert polarity of illuminator's lights strobe GPIOs.
      These GPIOs directly drive the illuminator LEDs.
    type: boolean

  port:
    $ref: /schemas/graph.yaml#/$defs/port-base
    additionalProperties: false

    properties:
      endpoint:
        $ref: /schemas/media/video-interfaces.yaml#
        unevaluatedProperties: false

        properties:
          data-lanes:
            description:
              CSI lanes to use
            items:
              - const: 1
              - const: 2
              - const: 3
              - const: 4

          remote-endpoint: true

        required:
          - data-lanes

required:
  - compatible
  - clocks
  - VCORE-supply
  - VDDIO-supply
  - VANA-supply
  - port

additionalProperties: false

examples:
  - |
    #include <dt-bindings/gpio/gpio.h>
    i2c {
        #address-cells = <1>;
        #size-cells = <0>;
        vgxy61: csi2tx@10 {
            compatible = "st,st-vgxy61";
            reg = <0x10>;
            clocks = <&clk_ext_camera>;
            VCORE-supply = <&v1v2>;
            VDDIO-supply = <&v1v8>;
            VANA-supply = <&v2v8>;
            reset-gpios = <&mfxgpio 18 GPIO_ACTIVE_LOW>;
            port {
                ep0: endpoint {
                    data-lanes = <1 2 3 4>;
                    remote-endpoint = <&mipi_csi2_out>;
                };
            };
        };
    };
...
```

## Documentation/devicetree/bindings/media/i2c/st,vd55g1.yaml
```yaml
# SPDX-License-Identifier: (GPL-2.0 OR BSD-2-Clause)
# Copyright (c) 2025 STMicroelectronics SA.
%YAML 1.2
---
$id: http://devicetree.org/schemas/media/i2c/st,vd55g1.yaml#
$schema: http://devicetree.org/meta-schemas/core.yaml#

title: STMicroelectronics VD55G1 Global Shutter Image Sensor

maintainers:
  - Benjamin Mugnier <benjamin.mugnier@foss.st.com>
  - Sylvain Petinot <sylvain.petinot@foss.st.com>

description: |-
 The STMicroelectronics VD55G1 is a global shutter image sensor with an active
 array size of 804H x 704V. It is programmable through I2C interface. The I2C
 address is fixed to 0x10.

 Image data is sent through MIPI CSI-2, which is configured as only 1 data
 lane. The sensor provides 4 GPIOS that can be used for external LED signal
 (synchronized with sensor integration periods).

allOf:
  - $ref: /schemas/media/video-interface-devices.yaml#

properties:
  compatible:
    const: st,vd55g1

  reg:
    maxItems: 1

  clocks:
    maxItems: 1

  vcore-supply:
    description: Digital core power supply (1.15V)

  vddio-supply:
    description: Digital IO power supply (1.8V)

  vana-supply:
    description: Analog power supply (2.8V)

  reset-gpios:
    description: Sensor reset active low GPIO (XSHUTDOWN)
    maxItems: 1

  st,leds:
    description:
      List sensor's GPIOs used to control strobe light sources during exposure
      time. The numbers identify the sensor pin on which the illumination
      system is connected. GPIOs are active-high.
    $ref: /schemas/types.yaml#/definitions/uint32-array
    minItems: 1
    maxItems: 4
    items:
      minimum: 0
      maximum: 3

  port:
    $ref: /schemas/graph.yaml#/$defs/port-base
    additionalProperties: false

    properties:
      endpoint:
        $ref: /schemas/media/video-interfaces.yaml#
        unevaluatedProperties: false

        properties:
          data-lanes:
            items:
              - const: 1

          link-frequencies:
            maxItems: 1
            items:
              minimum: 125000000
              maximum: 600000000

          lane-polarities:
            minItems: 1
            maxItems: 2

        required:
          - data-lanes
          - link-frequencies

required:
  - compatible
  - reg
  - clocks
  - vcore-supply
  - vddio-supply
  - vana-supply
  - reset-gpios
  - port

unevaluatedProperties: false

examples:
  - |
    #include <dt-bindings/gpio/gpio.h>

    i2c {
        #address-cells = <1>;
        #size-cells = <0>;

        camera-sensor@10 {
            compatible = "st,vd55g1";
            reg = <0x10>;

            clocks = <&camera_clk_12M>;

            vcore-supply = <&camera_vcore_v1v15>;
            vddio-supply = <&camera_vddio_v1v8>;
            vana-supply = <&camera_vana_v2v8>;

            reset-gpios = <&gpio 5 GPIO_ACTIVE_LOW>;
            st,leds = <2>;

            orientation = <2>;
            rotation = <0>;

            port {
                endpoint {
                    data-lanes = <1>;
                    link-frequencies = /bits/ 64 <600000000>;
                    remote-endpoint = <&csiphy0_ep>;
                };
            };
        };
    };
```
