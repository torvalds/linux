## Documentation/devicetree/bindings/media/i2c/st,vd56g3.yaml
```yaml
# SPDX-License-Identifier: (GPL-2.0 OR BSD-2-Clause)
# Copyright (c) 2024 STMicroelectronics SA.
%YAML 1.2
---
$id: http://devicetree.org/schemas/media/i2c/st,vd56g3.yaml#
$schema: http://devicetree.org/meta-schemas/core.yaml#

title: STMicroelectronics VD56G3 Global Shutter Image Sensor

maintainers:
  - Benjamin Mugnier <benjamin.mugnier@foss.st.com>
  - Sylvain Petinot <sylvain.petinot@foss.st.com>

description: |-
  The STMicroelectronics VD56G3 is a 1.5 M pixel global shutter image sensor
  with an active array size of 1124 x 1364 (portrait orientation). It is
  programmable through I2C, the address is fixed to 0x10. The sensor output is
  available via CSI-2, which is configured as either 1 or 2 data lanes. The
  sensor provides 8 GPIOS that can be used for external LED signal
  (synchronized with sensor integration periods)

allOf:
  - $ref: /schemas/media/video-interface-devices.yaml#

properties:
  compatible:
    enum:
      - st,vd56g3
      - st,vd66gy
    description:
      Two variants are availables; VD56G3 is a monochrome sensor while VD66GY
      is a colour variant.

  reg:
    maxItems: 1

  clocks:
    maxItems: 1

  vcore-supply:
    description: Digital core power supply (1.15V)

  vddio-supply:
    description: Digital IO power supply (1.8V)

  vana-supply:
    description: Analog power supply (2.8V)

  reset-gpios:
    description: Sensor reset active low GPIO (XSHUTDOWN)
    maxItems: 1

  st,leds:
    description:
      List sensor's GPIOs used to control strobe light sources during exposure
      time. The numbers identify the sensor pin on which the illumination system
      is connected. GPIOs are active-high.
    $ref: /schemas/types.yaml#/definitions/uint32-array
    minItems: 1
    maxItems: 8
    items:
      minimum: 0
      maximum: 7

  port:
    $ref: /schemas/graph.yaml#/$defs/port-base
    additionalProperties: false

    properties:
      endpoint:
        $ref: /schemas/media/video-interfaces.yaml#
        unevaluatedProperties: false

        properties:
          data-lanes:
            minItems: 1
            maxItems: 2
            items:
              enum: [1, 2]

          link-frequencies:
            maxItems: 1
            items:
              enum: [402000000, 750000000]

          lane-polarities:
            minItems: 1
            maxItems: 3
            description: Any lane can be inverted or not.

        required:
          - data-lanes
          - link-frequencies

required:
  - compatible
  - reg
  - clocks
  - vcore-supply
  - vddio-supply
  - vana-supply
  - reset-gpios
  - port

unevaluatedProperties: false

examples:
  - |
    #include <dt-bindings/gpio/gpio.h>

    i2c {
        #address-cells = <1>;
        #size-cells = <0>;

        camera-sensor@10 {
            compatible = "st,vd56g3";
            reg = <0x10>;

            clocks = <&camera_clk_12M>;

            vcore-supply = <&camera_vcore_v1v15>;
            vddio-supply = <&camera_vddio_v1v8>;
            vana-supply = <&camera_vana_v2v8>;

            reset-gpios = <&gpio 5 GPIO_ACTIVE_LOW>;
            st,leds = <6>;

            orientation = <2>;
            rotation = <0>;

            port {
                endpoint {
                    data-lanes = <1 2>;
                    link-frequencies = /bits/ 64 <402000000>;
                    remote-endpoint = <&csiphy0_ep>;
                };
            };
        };
    };
```

## Documentation/devicetree/bindings/media/i2c/tc358743.txt
```
* Toshiba TC358743 HDMI-RX to MIPI CSI2-TX Bridge

The Toshiba TC358743 HDMI-RX to MIPI CSI2-TX (H2C) is a bridge that converts
a HDMI stream to MIPI CSI-2 TX. It is programmable through I2C.

Required Properties:

- compatible: value should be "toshiba,tc358743"
- clocks, clock-names: should contain a phandle link to the reference clock
		       source, the clock input is named "refclk".

Optional Properties:

- reset-gpios: gpio phandle GPIO connected to the reset pin
- interrupts: GPIO connected to the interrupt pin
- data-lanes: should be <1 2 3 4> for four-lane operation,
	      or <1 2> for two-lane operation
- clock-lanes: should be <0>
- clock-noncontinuous: Presence of this boolean property decides whether the
		       MIPI CSI-2 clock is continuous or non-continuous.
- link-frequencies: List of allowed link frequencies in Hz. Each frequency is
		    expressed as a 64-bit big-endian integer. The frequency
		    is half of the bps per lane due to DDR transmission.

For further information on the MIPI CSI-2 endpoint node properties, see
Documentation/devicetree/bindings/media/video-interfaces.txt.

Example:

	tc358743@f {
		compatible = "toshiba,tc358743";
		reg = <0x0f>;
		clocks = <&hdmi_osc>;
		clock-names = "refclk";
		reset-gpios = <&gpio6 9 GPIO_ACTIVE_LOW>;
		interrupt-parent = <&gpio2>;
		interrupts = <5 IRQ_TYPE_LEVEL_HIGH>;

		port {
			tc358743_out: endpoint {
				remote-endpoint = <&mipi_csi2_in>;
				data-lanes = <1 2 3 4>;
				clock-lanes = <0>;
				clock-noncontinuous;
				link-frequencies = /bits/ 64 <297000000>;
			};
		};
	};
```

## Documentation/devicetree/bindings/media/i2c/tda1997x.txt
```
Device-Tree bindings for the NXP TDA1997x HDMI receiver

The TDA19971/73 are HDMI video receivers.

The TDA19971 Video port output pins can be used as follows:
 - RGB 8bit per color (24 bits total): R[11:4] B[11:4] G[11:4]
 - YUV444 8bit per color (24 bits total): Y[11:4] Cr[11:4] Cb[11:4]
 - YUV422 semi-planar 8bit per component (16 bits total): Y[11:4] CbCr[11:4]
 - YUV422 semi-planar 10bit per component (20 bits total): Y[11:2] CbCr[11:2]
 - YUV422 semi-planar 12bit per component (24 bits total): - Y[11:0] CbCr[11:0]
 - YUV422 BT656 8bit per component (8 bits total): YCbCr[11:4] (2-cycles)
 - YUV422 BT656 10bit per component (10 bits total): YCbCr[11:2] (2-cycles)
 - YUV422 BT656 12bit per component (12 bits total): YCbCr[11:0] (2-cycles)

The TDA19973 Video port output pins can be used as follows:
 - RGB 12bit per color (36 bits total): R[11:0] B[11:0] G[11:0]
 - YUV444 12bit per color (36 bits total): Y[11:0] Cb[11:0] Cr[11:0]
 - YUV422 semi-planar 12bit per component (24 bits total): Y[11:0] CbCr[11:0]
 - YUV422 BT656 12bit per component (12 bits total): YCbCr[11:0] (2-cycles)

The Video port output pins are mapped via 4-bit 'pin groups' allowing
for a variety of connection possibilities including swapping pin order within
pin groups. The video_portcfg device-tree property consists of register mapping
pairs which map a chip-specific VP output register to a 4-bit pin group. If
the pin group needs to be bit-swapped you can use the *_S pin-group defines.

Required Properties:
 - compatible          :
  - "nxp,tda19971" for the TDA19971
  - "nxp,tda19973" for the TDA19973
 - reg                 : I2C slave address
 - interrupts          : The interrupt number
 - DOVDD-supply        : Digital I/O supply
 - DVDD-supply         : Digital Core supply
 - AVDD-supply         : Analog supply
 - nxp,vidout-portcfg  : array of pairs mapping VP output pins to pin groups.

Optional Properties:
 - nxp,audout-format   : DAI bus format: "i2s" or "spdif".
 - nxp,audout-width    : width of audio output data bus (1-4).
 - nxp,audout-layout   : data layout (0=AP0 used, 1=AP0/AP1/AP2/AP3 used).
 - nxp,audout-mclk-fs  : Multiplication factor between stream rate and codec
                         mclk.

The port node shall contain one endpoint child node for its digital
output video port, in accordance with the video interface bindings defined in
Documentation/devicetree/bindings/media/video-interfaces.txt.

Optional Endpoint Properties:
  The following three properties are defined in video-interfaces.txt and
  are valid for the output parallel bus endpoint:
  - hsync-active: Horizontal synchronization polarity. Defaults to active high.
  - vsync-active: Vertical synchronization polarity. Defaults to active high.
  - data-active: Data polarity. Defaults to active high.

Examples:
 - VP[15:0] connected to IMX6 CSI_DATA[19:4] for 16bit YUV422
   16bit I2S layout0 with a 128*fs clock (A_WS, AP0, A_CLK pins)
	hdmi-receiver@48 {
		compatible = "nxp,tda19971";
		pinctrl-names = "default";
		pinctrl-0 = <&pinctrl_tda1997x>;
		reg = <0x48>;
		interrupt-parent = <&gpio1>;
		interrupts = <7 IRQ_TYPE_LEVEL_LOW>;
		DOVDD-supply = <&reg_3p3v>;
		AVDD-supply = <&reg_1p8v>;
		DVDD-supply = <&reg_1p8v>;
		/* audio */
		#sound-dai-cells = <0>;
		nxp,audout-format = "i2s";
		nxp,audout-layout = <0>;
		nxp,audout-width = <16>;
		nxp,audout-mclk-fs = <128>;
		/*
		 * The 8bpp YUV422 semi-planar mode outputs CbCr[11:4]
		 * and Y[11:4] across 16bits in the same pixclk cycle.
		 */
		nxp,vidout-portcfg =
			/* Y[11:8]<->VP[15:12]<->CSI_DATA[19:16] */
			< TDA1997X_VP24_V15_12 TDA1997X_G_Y_11_8 >,
			/* Y[7:4]<->VP[11:08]<->CSI_DATA[15:12] */
			< TDA1997X_VP24_V11_08 TDA1997X_G_Y_7_4 >,
			/* CbCc[11:8]<->VP[07:04]<->CSI_DATA[11:8] */
			< TDA1997X_VP24_V07_04 TDA1997X_R_CR_CBCR_11_8 >,
			/* CbCr[7:4]<->VP[03:00]<->CSI_DATA[7:4] */
			< TDA1997X_VP24_V03_00 TDA1997X_R_CR_CBCR_7_4 >;

		port {
			tda1997x_to_ipu1_csi0_mux: endpoint {
				remote-endpoint = <&ipu1_csi0_mux_from_parallel_sensor>;
				bus-width = <16>;
				hsync-active = <1>;
				vsync-active = <1>;
				data-active = <1>;
			};
		};
	};
 - VP[15:8] connected to IMX6 CSI_DATA[19:12] for 8bit BT656
   16bit I2S layout0 with a 128*fs clock (A_WS, AP0, A_CLK pins)
	hdmi-receiver@48 {
		compatible = "nxp,tda19971";
		pinctrl-names = "default";
		pinctrl-0 = <&pinctrl_tda1997x>;
		reg = <0x48>;
		interrupt-parent = <&gpio1>;
		interrupts = <7 IRQ_TYPE_LEVEL_LOW>;
		DOVDD-supply = <&reg_3p3v>;
		AVDD-supply = <&reg_1p8v>;
		DVDD-supply = <&reg_1p8v>;
		/* audio */
		#sound-dai-cells = <0>;
		nxp,audout-format = "i2s";
		nxp,audout-layout = <0>;
		nxp,audout-width = <16>;
		nxp,audout-mclk-fs = <128>;
		/*
		 * The 8bpp YUV422 semi-planar mode outputs CbCr[11:4]
		 * and Y[11:4] across 16bits in the same pixclk cycle.
		 */
		nxp,vidout-portcfg =
			/* Y[11:8]<->VP[15:12]<->CSI_DATA[19:16] */
			< TDA1997X_VP24_V15_12 TDA1997X_G_Y_11_8 >,
			/* Y[7:4]<->VP[11:08]<->CSI_DATA[15:12] */
			< TDA1997X_VP24_V11_08 TDA1997X_G_Y_7_4 >,
			/* CbCc[11:8]<->VP[07:04]<->CSI_DATA[11:8] */
			< TDA1997X_VP24_V07_04 TDA1997X_R_CR_CBCR_11_8 >,
			/* CbCr[7:4]<->VP[03:00]<->CSI_DATA[7:4] */
			< TDA1997X_VP24_V03_00 TDA1997X_R_CR_CBCR_7_4 >;

		port {
			tda1997x_to_ipu1_csi0_mux: endpoint {
				remote-endpoint = <&ipu1_csi0_mux_from_parallel_sensor>;
				bus-width = <16>;
				hsync-active = <1>;
				vsync-active = <1>;
				data-active = <1>;
			};
		};
	};
 - VP[15:8] connected to IMX6 CSI_DATA[19:12] for 8bit BT656
   16bit I2S layout0 with a 128*fs clock (A_WS, AP0, A_CLK pins)
	hdmi-receiver@48 {
		compatible = "nxp,tda19971";
		pinctrl-names = "default";
		pinctrl-0 = <&pinctrl_tda1997x>;
		reg = <0x48>;
		interrupt-parent = <&gpio1>;
		interrupts = <7 IRQ_TYPE_LEVEL_LOW>;
		DOVDD-supply = <&reg_3p3v>;
		AVDD-supply = <&reg_1p8v>;
		DVDD-supply = <&reg_1p8v>;
		/* audio */
		#sound-dai-cells = <0>;
		nxp,audout-format = "i2s";
		nxp,audout-layout = <0>;
		nxp,audout-width = <16>;
		nxp,audout-mclk-fs = <128>;
		/*
		 * The 8bpp BT656 mode outputs YCbCr[11:4] across 8bits over
		 * 2 pixclk cycles.
		 */
		nxp,vidout-portcfg =
			/* YCbCr[11:8]<->VP[15:12]<->CSI_DATA[19:16] */
			< TDA1997X_VP24_V15_12 TDA1997X_R_CR_CBCR_11_8 >,
			/* YCbCr[7:4]<->VP[11:08]<->CSI_DATA[15:12] */
			< TDA1997X_VP24_V11_08 TDA1997X_R_CR_CBCR_7_4 >,

		port {
			tda1997x_to_ipu1_csi0_mux: endpoint {
				remote-endpoint = <&ipu1_csi0_mux_from_parallel_sensor>;
				bus-width = <16>;
				hsync-active = <1>;
				vsync-active = <1>;
				data-active = <1>;
			};
		};
	};
```

## Documentation/devicetree/bindings/media/i2c/techwell,tw9900.yaml
```yaml
# SPDX-License-Identifier: (GPL-2.0-only OR BSD-2-Clause)
%YAML 1.2
---
$id: http://devicetree.org/schemas/media/i2c/techwell,tw9900.yaml#
$schema: http://devicetree.org/meta-schemas/core.yaml#

title: Techwell TW9900 NTSC/PAL video decoder

maintainers:
  - Mehdi Djait <mehdi.djait@bootlin.com>

description:
  The tw9900 is a multi-standard video decoder, supporting NTSC, PAL standards
  with auto-detection features.

properties:
  compatible:
    const: techwell,tw9900

  reg:
    maxItems: 1

  vdd-supply:
    description: VDD power supply

  reset-gpios:
    description: GPIO descriptor for the RESET input pin
    maxItems: 1

  powerdown-gpios:
    description: GPIO descriptor for the POWERDOWN input pin
    maxItems: 1

  ports:
    $ref: /schemas/graph.yaml#/properties/ports

    properties:
      port@0:
        $ref: /schemas/graph.yaml#/properties/port
        description: Analog input port

        properties:
          endpoint@0:
            $ref: /schemas/graph.yaml#/properties/endpoint
            description: CVBS over MUX0

          endpoint@1:
            $ref: /schemas/graph.yaml#/properties/endpoint
            description: CVBS over MUX1

          endpoint@2:
            $ref: /schemas/graph.yaml#/properties/endpoint
            description: Chroma over CIN0 and Y over MUX0

          endpoint@3:
            $ref: /schemas/graph.yaml#/properties/endpoint
            description: Chroma over CIN0 and Y over MUX1

        oneOf:
          - required:
              - endpoint@0
          - required:
              - endpoint@1
          - required:
              - endpoint@2
          - required:
              - endpoint@3

      port@1:
        $ref: /schemas/graph.yaml#/properties/port
        description: Video port for the decoder output.


    required:
      - port@0
      - port@1

required:
  - compatible
  - ports
  - reg
  - vdd-supply

additionalProperties: false

examples:
  - |
    #include <dt-bindings/display/sdtv-standards.h>
    #include <dt-bindings/gpio/gpio.h>

    composite_connector {
        compatible = "composite-video-connector";
        label = "tv";
        sdtv-standards = <(SDTV_STD_PAL | SDTV_STD_NTSC)>;

        port {
            composite_to_tw9900: endpoint {
                remote-endpoint = <&tw9900_to_composite>;
            };
        };
    };

    i2c {
        #address-cells = <1>;
        #size-cells = <0>;

        video-decoder@44 {
            compatible = "techwell,tw9900";
            reg = <0x44>;

            vdd-supply = <&tw9900_supply>;
            reset-gpios = <&gpio2 5 GPIO_ACTIVE_LOW>;

            ports {
                #address-cells = <1>;
                #size-cells = <0>;

                port@0 {
                    #address-cells = <1>;
                    #size-cells = <0>;

                    reg = <0>;
                    tw9900_to_composite: endpoint@0 {
                        reg = <0>;
                        remote-endpoint = <&composite_to_tw9900>;
                    };
                };

                port@1 {
                    reg = <1>;
                    endpoint {
                        remote-endpoint = <&cif_in>;
                    };
                };
            };
        };
    };
```
