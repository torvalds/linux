## Documentation/devicetree/bindings/media/i2c/sony,imx258.yaml
```yaml
# SPDX-License-Identifier: (GPL-2.0-only OR BSD-2-Clause)
%YAML 1.2
---
$id: http://devicetree.org/schemas/media/i2c/sony,imx258.yaml#
$schema: http://devicetree.org/meta-schemas/core.yaml#

title: Sony IMX258 13 Mpixel CMOS Digital Image Sensor

maintainers:
  - Krzysztof Kozlowski <krzk@kernel.org>

description: |-
  IMX258 is a diagonal 5.867mm (Type 1/3.06) 13 Mega-pixel CMOS active pixel
  type stacked image sensor with a square pixel array of size 4208 x 3120. It
  is programmable through I2C interface.  Image data is sent through MIPI
  CSI-2. The sensor exists in two different models, a standard variant
  (IMX258) and a variant with phase detection autofocus (IMX258-PDAF).
  The camera module does not expose the model through registers, so the
  exact model needs to be specified.

$ref: /schemas/media/video-interface-devices.yaml#

properties:
  compatible:
    enum:
      - sony,imx258
      - sony,imx258-pdaf

  clocks:
    description:
      Clock frequency from 6 to 27 MHz.
    maxItems: 1

  reg:
    maxItems: 1

  reset-gpios:
    description: |-
      Reference to the GPIO connected to the XCLR pin, if any.

  vana-supply:
    description:
      Analog voltage (VANA) supply, 2.7 V

  vdig-supply:
    description:
      Digital I/O voltage (VDIG) supply, 1.2 V

  vif-supply:
    description:
      Interface voltage (VIF) supply, 1.8 V

  # See ../video-interfaces.txt for more details
  port:
    $ref: /schemas/graph.yaml#/$defs/port-base
    additionalProperties: false

    properties:
      endpoint:
        $ref: /schemas/media/video-interfaces.yaml#
        unevaluatedProperties: false

        properties:
          data-lanes:
            oneOf:
              - items:
                  - const: 1
                  - const: 2
                  - const: 3
                  - const: 4
              - items:
                  - const: 1
                  - const: 2

          link-frequencies: true

        required:
          - data-lanes
          - link-frequencies

required:
  - compatible
  - reg
  - clocks
  - port

unevaluatedProperties: false

examples:
  - |
    i2c {
        #address-cells = <1>;
        #size-cells = <0>;

        sensor@6c {
            compatible = "sony,imx258";
            reg = <0x6c>;
            clocks = <&imx258_clk>;

            port {
                endpoint {
                    remote-endpoint = <&csi1_ep>;
                    data-lanes = <1 2 3 4>;
                    link-frequencies = /bits/ 64 <320000000>;
                };
            };
        };
    };

    /* Oscillator on the camera board */
    imx258_clk: clk {
        compatible = "fixed-clock";
        #clock-cells = <0>;
        clock-frequency = <19200000>;
    };

  - |
    i2c {
        #address-cells = <1>;
        #size-cells = <0>;

        sensor@6c {
            compatible = "sony,imx258";
            reg = <0x6c>;
            clocks = <&imx258_clk>;

            port {
                endpoint {
                    remote-endpoint = <&csi1_ep>;
                    data-lanes = <1 2 3 4>;
                    link-frequencies = /bits/ 64 <633600000>;
                };
            };
        };
    };
```

## Documentation/devicetree/bindings/media/i2c/sony,imx274.yaml
```yaml
# SPDX-License-Identifier: (GPL-2.0-only OR BSD-2-Clause)
%YAML 1.2
---
$id: http://devicetree.org/schemas/media/i2c/sony,imx274.yaml#
$schema: http://devicetree.org/meta-schemas/core.yaml#

title: Sony 1/2.5-Inch 8.51MP CMOS Digital Image Sensor

maintainers:
  - Leon Luo <leonl@leopardimaging.com>

description: |
  The Sony IMX274 is a 1/2.5-inch CMOS active pixel digital image sensor with an
  active array size of 3864H x 2202V. It is programmable through I2C interface.
  Image data is sent through MIPI CSI-2, which is configured as 4 lanes at 1440
  Mbps.

properties:
  compatible:
    const: sony,imx274

  reg:
    const: 0x1a

  reset-gpios:
    maxItems: 1

  clocks:
    maxItems: 1

  clock-names:
    const: inck

  vana-supply:
    description: Sensor 2.8 V analog supply.

  vdig-supply:
    description: Sensor 1.8 V digital core supply.

  vddl-supply:
    description: Sensor digital IO 1.2 V supply.

  port:
    $ref: /schemas/graph.yaml#/properties/port

required:
  - compatible
  - reg
  - port

additionalProperties: false

examples:
  - |
    i2c0 {
        #address-cells = <1>;
        #size-cells = <0>;

        imx274: camera-sensor@1a {
            compatible = "sony,imx274";
            reg = <0x1a>;
            reset-gpios = <&gpio_sensor 0 0>;

            port {
                sensor_out: endpoint {
                    remote-endpoint = <&csiss_in>;
                };
            };
        };
    };

...
```

## Documentation/devicetree/bindings/media/i2c/sony,imx283.yaml
```yaml
# SPDX-License-Identifier: (GPL-2.0-only OR BSD-2-Clause)
# Copyright (C) 2024 Ideas on Board Oy
%YAML 1.2
---
$id: http://devicetree.org/schemas/media/i2c/sony,imx283.yaml#
$schema: http://devicetree.org/meta-schemas/core.yaml#

title: Sony IMX283 Sensor

maintainers:
  - Kieran Bingham <kieran.bingham@ideasonboard.com>
  - Umang Jain <umang.jain@ideasonboard.com>

description:
  IMX283 sensor is a Sony CMOS active pixel digital image sensor with an active
  array size of 5472H x 3648V. It is programmable through I2C interface. The
  I2C client address is fixed to 0x1a as per sensor data sheet. Image data is
  sent through MIPI CSI-2.

properties:
  compatible:
    const: sony,imx283

  reg:
    maxItems: 1

  clocks:
    description: Clock frequency from 6 to 24 MHz.
    maxItems: 1

  vadd-supply:
    description: Analog power supply (2.9V)

  vdd1-supply:
    description: Interface power supply (1.8V)

  vdd2-supply:
    description: Digital power supply (1.2V)

  reset-gpios:
    description: Sensor reset (XCLR) GPIO
    maxItems: 1

  port:
    $ref: /schemas/graph.yaml#/$defs/port-base
    additionalProperties: false

    properties:
      endpoint:
        $ref: /schemas/media/video-interfaces.yaml#
        unevaluatedProperties: false

        properties:
          data-lanes:
            anyOf:
              - items:
                  - const: 1
                  - const: 2
                  - const: 3
                  - const: 4

          link-frequencies: true

        required:
          - data-lanes
          - link-frequencies

    required:
      - endpoint

required:
  - compatible
  - reg
  - clocks
  - port

additionalProperties: false

examples:
  - |
    i2c {
        #address-cells = <1>;
        #size-cells = <0>;

        camera@1a {
            compatible = "sony,imx283";
            reg = <0x1a>;
            clocks = <&imx283_clk>;

            assigned-clocks = <&imx283_clk>;
            assigned-clock-parents = <&imx283_clk_parent>;
            assigned-clock-rates = <12000000>;

            vadd-supply = <&camera_vadd_2v9>;
            vdd1-supply = <&camera_vdd1_1v8>;
            vdd2-supply = <&camera_vdd2_1v2>;

            port {
                imx283: endpoint {
                    remote-endpoint = <&cam>;
                    data-lanes = <1 2 3 4>;
                    link-frequencies = /bits/ 64 <360000000>;
                };
            };
        };
    };
...
```

## Documentation/devicetree/bindings/media/i2c/sony,imx290.yaml
```yaml
# SPDX-License-Identifier: (GPL-2.0 OR BSD-2-Clause)
%YAML 1.2
---
$id: http://devicetree.org/schemas/media/i2c/sony,imx290.yaml#
$schema: http://devicetree.org/meta-schemas/core.yaml#

title: Sony IMX290 1/2.8-Inch CMOS Image Sensor

maintainers:
  - Manivannan Sadhasivam <manivannan.sadhasivam@linaro.org>
  - Laurent Pinchart <laurent.pinchart@ideasonboard.com>

description: |-
  The Sony IMX290 is a 1/2.8-Inch CMOS Solid-state image sensor with Square
  Pixel, available in either mono or colour variants. It is programmable
  through I2C and 4-wire interfaces.

  The sensor output is available via CMOS logic parallel SDR output, Low voltage
  LVDS DDR output and CSI-2 serial data output. The CSI-2 bus is the default.
  No bindings have been defined for the other busses.

  imx290lqr is the full model identifier for the colour variant. "sony,imx290"
  is treated the same as this as it was the original compatible string.
  imx290llr is the mono version of the sensor.

properties:
  compatible:
    oneOf:
      - enum:
          - sony,imx290lqr # Colour
          - sony,imx290llr # Monochrome
          - sony,imx327lqr # Colour
      - const: sony,imx290
        deprecated: true

  reg:
    maxItems: 1

  clocks:
    maxItems: 1

  clock-names:
    description: Input clock (37.125 MHz or 74.25 MHz)
    items:
      - const: xclk

  clock-frequency:
    description: Frequency of the xclk clock in Hz

  vdda-supply:
    description: Analog power supply (2.9V)

  vddd-supply:
    description: Digital core power supply (1.2V)

  vdddo-supply:
    description: Digital I/O power supply (1.8V)

  reset-gpios:
    description: Sensor reset (XCLR) GPIO
    maxItems: 1

  port:
    $ref: /schemas/graph.yaml#/$defs/port-base
    description: |
      Video output port

    properties:
      endpoint:
        $ref: /schemas/media/video-interfaces.yaml#
        unevaluatedProperties: false

        properties:
          data-lanes:
            anyOf:
              - items:
                  - const: 1
                  - const: 2
              - items:
                  - const: 1
                  - const: 2
                  - const: 3
                  - const: 4

          link-frequencies: true

        required:
          - data-lanes
          - link-frequencies

    additionalProperties: false

required:
  - compatible
  - reg
  - clocks
  - clock-names
  - clock-frequency
  - vdda-supply
  - vddd-supply
  - vdddo-supply
  - port

additionalProperties: false

examples:
  - |
    #include <dt-bindings/gpio/gpio.h>

    i2c {
        #address-cells = <1>;
        #size-cells = <0>;

        imx290: camera-sensor@1a {
            compatible = "sony,imx290lqr";
            reg = <0x1a>;

            pinctrl-names = "default";
            pinctrl-0 = <&camera_rear_default>;

            clocks = <&gcc 90>;
            clock-names = "xclk";
            clock-frequency = <37125000>;

            vdddo-supply = <&camera_vdddo_1v8>;
            vdda-supply = <&camera_vdda_2v8>;
            vddd-supply = <&camera_vddd_1v5>;

            reset-gpios = <&msmgpio 35 GPIO_ACTIVE_LOW>;

            port {
                imx290_ep: endpoint {
                    data-lanes = <1 2 3 4>;
                    link-frequencies = /bits/ 64 <445500000>;
                    remote-endpoint = <&csiphy0_ep>;
                };
            };
        };
    };
...
```

## Documentation/devicetree/bindings/media/i2c/sony,imx296.yaml
```yaml
# SPDX-License-Identifier: (GPL-2.0 OR BSD-2-Clause)
%YAML 1.2
---
$id: http://devicetree.org/schemas/media/i2c/sony,imx296.yaml#
$schema: http://devicetree.org/meta-schemas/core.yaml#

title: Sony IMX296 1/2.8-Inch CMOS Image Sensor

maintainers:
  - Manivannan Sadhasivam <manivannan.sadhasivam@linaro.org>
  - Laurent Pinchart <laurent.pinchart@ideasonboard.com>

description: |-
  The Sony IMX296 is a 1/2.9-Inch active pixel type CMOS Solid-state image
  sensor with square pixel array and 1.58 M effective pixels. This chip
  features a global shutter with variable charge-integration time. It is
  programmable through I2C and 4-wire interfaces. The sensor output is
  available via CSI-2 serial data output (1 Lane).

properties:
  compatible:
    enum:
      - sony,imx296
      - sony,imx296ll
      - sony,imx296lq
    description:
      The IMX296 sensor exists in two different models, a colour variant
      (IMX296LQ) and a monochrome variant (IMX296LL). The device exposes the
      model through registers, allowing for auto-detection with a common
      "sony,imx296" compatible string. However, some camera modules disable the
      ability to read the sensor model register, which disables this feature.
      In those cases, the exact model needs to be specified as "sony,imx296ll"
      or "sony,imx296lq".

  reg:
    maxItems: 1

  clocks:
    maxItems: 1

  clock-names:
    description: Input clock (37.125 MHz, 54 MHz or 74.25 MHz)
    items:
      - const: inck

  avdd-supply:
    description: Analog power supply (3.3V)

  dvdd-supply:
    description: Digital power supply (1.2V)

  ovdd-supply:
    description: Interface power supply (1.8V)

  reset-gpios:
    description: Sensor reset (XCLR) GPIO
    maxItems: 1

  port:
    $ref: /schemas/graph.yaml#/properties/port

required:
  - compatible
  - reg
  - clocks
  - clock-names
  - avdd-supply
  - dvdd-supply
  - ovdd-supply
  - port

additionalProperties: false

examples:
  - |
    #include <dt-bindings/gpio/gpio.h>

    i2c {
        #address-cells = <1>;
        #size-cells = <0>;

        imx296: camera-sensor@1a {
            compatible = "sony,imx296";
            reg = <0x1a>;

            pinctrl-names = "default";
            pinctrl-0 = <&camera_rear_default>;

            clocks = <&gcc 90>;
            clock-names = "inck";

            avdd-supply = <&camera_vdda_3v3>;
            dvdd-supply = <&camera_vddd_1v2>;
            ovdd-supply = <&camera_vddo_1v8>;

            reset-gpios = <&msmgpio 35 GPIO_ACTIVE_LOW>;

            port {
                imx296_ep: endpoint {
                    remote-endpoint = <&csiphy0_ep>;
                };
            };
        };
    };

...
```

## Documentation/devicetree/bindings/media/i2c/sony,imx334.yaml
```yaml
# SPDX-License-Identifier: (GPL-2.0-only OR BSD-2-Clause)
# Copyright (C) 2021 Intel Corporation
%YAML 1.2
---
$id: http://devicetree.org/schemas/media/i2c/sony,imx334.yaml#
$schema: http://devicetree.org/meta-schemas/core.yaml#

title: Sony IMX334 Sensor

maintainers:
  - Paul J. Murphy <paul.j.murphy@intel.com>
  - Daniele Alessandrelli <daniele.alessandrelli@intel.com>

description:
  IMX334 sensor is a Sony CMOS active pixel digital image sensor with an active
  array size of 3864H x 2202V. It is programmable through I2C interface. The
  I2C client address is fixed to 0x1a as per sensor data sheet. Image data is
  sent through MIPI CSI-2.

properties:
  compatible:
    const: sony,imx334
  reg:
    description: I2C address
    maxItems: 1

  clocks:
    description: Clock frequency from 6 to 27 MHz, 37.125MHz, 74.25MHz
    maxItems: 1

  reset-gpios:
    description: Reference to the GPIO connected to the XCLR pin, if any.

  port:
    additionalProperties: false
    $ref: /schemas/graph.yaml#/$defs/port-base

    properties:
      endpoint:
        $ref: /schemas/media/video-interfaces.yaml#
        unevaluatedProperties: false

        properties:
          data-lanes: true
          link-frequencies: true

        required:
          - data-lanes
          - link-frequencies

    required:
      - endpoint

required:
  - compatible
  - reg
  - clocks
  - port

additionalProperties: false

examples:
  - |
    i2c {
        #address-cells = <1>;
        #size-cells = <0>;

        camera@1a {
            compatible = "sony,imx334";
            reg = <0x1a>;
            clocks = <&imx334_clk>;

            port {
                imx334: endpoint {
                    remote-endpoint = <&cam>;
                    data-lanes = <1 2 3 4>;
                    link-frequencies = /bits/ 64 <891000000 445500000>;
                };
            };
        };
    };
...
```
