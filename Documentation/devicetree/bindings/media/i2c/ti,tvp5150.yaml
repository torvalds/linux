## Documentation/devicetree/bindings/media/mediatek,mdp3-tdshp.yaml
```yaml
# SPDX-License-Identifier: (GPL-2.0-only OR BSD-2-Clause)
%YAML 1.2
---
$id: http://devicetree.org/schemas/media/mediatek,mdp3-tdshp.yaml#
$schema: http://devicetree.org/meta-schemas/core.yaml#

title: MediaTek Media Data Path 3 Two-Dimensional Sharpness

maintainers:
  - Matthias Brugger <matthias.bgg@gmail.com>
  - Moudy Ho <moudy.ho@mediatek.com>

description:
  Two-Dimensional Sharpness (TDSHP) is a Media Profile Path 3 (MDP3) component
  used to perform image edge sharpening and enhance vividness and contrast.

properties:
  compatible:
    oneOf:
      - enum:
          - mediatek,mt8195-mdp3-tdshp
      - items:
          - const: mediatek,mt8188-mdp3-tdshp
          - const: mediatek,mt8195-mdp3-tdshp

  reg:
    maxItems: 1

  mediatek,gce-client-reg:
    description:
      The register of display function block to be set by gce. There are 4 arguments,
      such as gce node, subsys id, offset and register size. The subsys id that is
      mapping to the register of display function blocks is defined in the gce header
      include/dt-bindings/gce/<chip>-gce.h of each chips.
    $ref: /schemas/types.yaml#/definitions/phandle-array
    items:
      items:
        - description: phandle of GCE
        - description: GCE subsys id
        - description: register offset
        - description: register size
    maxItems: 1

  clocks:
    maxItems: 1

required:
  - compatible
  - reg
  - mediatek,gce-client-reg
  - clocks

additionalProperties: false

examples:
  - |
    #include <dt-bindings/clock/mt8195-clk.h>
    #include <dt-bindings/gce/mt8195-gce.h>

    display@14007000 {
        compatible = "mediatek,mt8195-mdp3-tdshp";
        reg = <0x14007000 0x1000>;
        mediatek,gce-client-reg = <&gce1 SUBSYS_1400XXXX 0x7000 0x1000>;
        clocks = <&vppsys0 CLK_VPP0_MDP_TDSHP>;
    };
```

## Documentation/devicetree/bindings/media/mediatek,mdp3-wrot.yaml
```yaml
# SPDX-License-Identifier: (GPL-2.0-only OR BSD-2-Clause)
%YAML 1.2
---
$id: http://devicetree.org/schemas/media/mediatek,mdp3-wrot.yaml#
$schema: http://devicetree.org/meta-schemas/core.yaml#

title: MediaTek Write DMA with Rotation

maintainers:
  - Matthias Brugger <matthias.bgg@gmail.com>
  - Moudy Ho <moudy.ho@mediatek.com>

description: |
  One of Media Data Path 3 (MDP3) components used to write DMA with frame rotation.

properties:
  compatible:
    items:
      - enum:
          - mediatek,mt8183-mdp3-wrot

  reg:
    maxItems: 1

  mediatek,gce-client-reg:
    $ref: /schemas/types.yaml#/definitions/phandle-array
    items:
      items:
        - description: phandle of GCE
        - description: GCE subsys id
        - description: register offset
        - description: register size
    description: The register of client driver can be configured by gce with
      4 arguments defined in this property. Each GCE subsys id is mapping to
      a client defined in the header include/dt-bindings/gce/<chip>-gce.h.

  mediatek,gce-events:
    description:
      The event id which is mapping to the specific hardware event signal
      to gce. The event id is defined in the gce header
      include/dt-bindings/gce/<chip>-gce.h of each chips.
    $ref: /schemas/types.yaml#/definitions/uint32-array

  power-domains:
    maxItems: 1

  clocks:
    minItems: 1

  iommus:
    maxItems: 1

  '#dma-cells':
    const: 1

required:
  - compatible
  - reg
  - mediatek,gce-client-reg
  - mediatek,gce-events
  - power-domains
  - clocks
  - iommus
  - '#dma-cells'

additionalProperties: false

examples:
  - |
    #include <dt-bindings/clock/mt8183-clk.h>
    #include <dt-bindings/gce/mt8183-gce.h>
    #include <dt-bindings/power/mt8183-power.h>
    #include <dt-bindings/memory/mt8183-larb-port.h>

    dma-controller@14005000 {
        compatible = "mediatek,mt8183-mdp3-wrot";
        reg = <0x14005000 0x1000>;
        mediatek,gce-client-reg = <&gce SUBSYS_1400XXXX 0x5000 0x1000>;
        mediatek,gce-events = <CMDQ_EVENT_MDP_WROT0_SOF>,
                              <CMDQ_EVENT_MDP_WROT0_EOF>;
        power-domains = <&spm MT8183_POWER_DOMAIN_DISP>;
        clocks = <&mmsys CLK_MM_MDP_WROT0>;
        iommus = <&iommu>;
        #dma-cells = <1>;
    };
```

## Documentation/devicetree/bindings/media/mediatek,mt7622-cir.yaml
```yaml
# SPDX-License-Identifier: GPL-2.0-only OR BSD-2-Clause
%YAML 1.2
---
$id: http://devicetree.org/schemas/media/mediatek,mt7622-cir.yaml#
$schema: http://devicetree.org/meta-schemas/core.yaml#

title: MediaTek Consumer Infrared Receiver on-SoC Controller

maintainers:
  - Sean Wang <sean.wang@mediatek.com>

allOf:
  - $ref: rc.yaml#

properties:
  compatible:
    enum:
      - mediatek,mt7622-cir
      - mediatek,mt7623-cir

  reg:
    maxItems: 1

  interrupts:
    maxItems: 1

  clocks:
    maxItems: 2

  clock-names:
    items:
      - const: clk
      - const: bus

required:
  - reg
  - interrupts
  - clocks
  - clock-names

unevaluatedProperties: false

examples:
  - |
    #include <dt-bindings/clock/mt2701-clk.h>
    #include <dt-bindings/interrupt-controller/arm-gic.h>

    ir@10013000 {
        compatible = "mediatek,mt7623-cir";
        reg = <0x10013000 0x1000>;
        interrupts = <GIC_SPI 87 IRQ_TYPE_LEVEL_LOW>;
        clocks = <&infracfg CLK_INFRA_IRRX>, <&topckgen CLK_TOP_AXI_SEL>;
        clock-names = "clk", "bus";
        linux,rc-map-name = "rc-rc6-mce";
    };
```

## Documentation/devicetree/bindings/media/mediatek,mt8173-mdp.yaml
```yaml
# SPDX-License-Identifier: (GPL-2.0 OR BSD-2-Clause)
%YAML 1.2
---
$id: http://devicetree.org/schemas/media/mediatek,mt8173-mdp.yaml#
$schema: http://devicetree.org/meta-schemas/core.yaml#

title: MediaTek MT8173 Media Data Path

maintainers:
  - Ariel D'Alessandro <ariel.dalessandro@collabora.com>

description:
  Media Data Path is used for scaling and color space conversion.

properties:
  compatible:
    oneOf:
      - enum:
          - mediatek,mt8173-mdp-rdma
          - mediatek,mt8173-mdp-rsz
          - mediatek,mt8173-mdp-wdma
          - mediatek,mt8173-mdp-wrot
      - items:
          - const: mediatek,mt8173-mdp-rdma
          - const: mediatek,mt8173-mdp

  reg:
    maxItems: 1

  clocks:
    minItems: 1
    maxItems: 2

  power-domains:
    maxItems: 1

  iommus:
    maxItems: 1

  mediatek,vpu:
    $ref: /schemas/types.yaml#/definitions/phandle
    description:
      phandle to Mediatek Video Processor Unit for HW Codec encode/decode and
      image processing.

required:
  - compatible
  - reg
  - clocks
  - power-domains

allOf:
  - if:
      properties:
        compatible:
          contains:
            const: mediatek,mt8173-mdp-rdma
    then:
      properties:
        clocks:
          items:
            - description: Main clock
            - description: Mutex clock
    else:
      properties:
        clocks:
          items:
            - description: Main clock

  - if:
      properties:
        compatible:
          contains:
            enum:
              - mediatek,mt8173-mdp-rdma
              - mediatek,mt8173-mdp-wdma
              - mediatek,mt8173-mdp-wrot
    then:
      required:
        - iommus

  - if:
      properties:
        compatible:
          contains:
            const: mediatek,mt8173-mdp
    then:
      required:
        - mediatek,vpu

additionalProperties: false

examples:
  - |
    #include <dt-bindings/clock/mt8173-clk.h>
    #include <dt-bindings/memory/mt8173-larb-port.h>
    #include <dt-bindings/power/mt8173-power.h>

    soc {
        #address-cells = <2>;
        #size-cells = <2>;

        mdp_rdma0: rdma@14001000 {
            compatible = "mediatek,mt8173-mdp-rdma",
                         "mediatek,mt8173-mdp";
            reg = <0 0x14001000 0 0x1000>;
            clocks = <&mmsys CLK_MM_MDP_RDMA0>,
                     <&mmsys CLK_MM_MUTEX_32K>;
            power-domains = <&spm MT8173_POWER_DOMAIN_MM>;
            iommus = <&iommu M4U_PORT_MDP_RDMA0>;
            mediatek,vpu = <&vpu>;
        };

        mdp_rdma1: rdma@14002000 {
            compatible = "mediatek,mt8173-mdp-rdma";
            reg = <0 0x14002000 0 0x1000>;
            clocks = <&mmsys CLK_MM_MDP_RDMA1>,
                     <&mmsys CLK_MM_MUTEX_32K>;
            power-domains = <&spm MT8173_POWER_DOMAIN_MM>;
            iommus = <&iommu M4U_PORT_MDP_RDMA1>;
        };

        mdp_rsz0: rsz@14003000 {
            compatible = "mediatek,mt8173-mdp-rsz";
            reg = <0 0x14003000 0 0x1000>;
            clocks = <&mmsys CLK_MM_MDP_RSZ0>;
            power-domains = <&spm MT8173_POWER_DOMAIN_MM>;
        };

        mdp_rsz1: rsz@14004000 {
            compatible = "mediatek,mt8173-mdp-rsz";
            reg = <0 0x14004000 0 0x1000>;
            clocks = <&mmsys CLK_MM_MDP_RSZ1>;
            power-domains = <&spm MT8173_POWER_DOMAIN_MM>;
        };

        mdp_rsz2: rsz@14005000 {
            compatible = "mediatek,mt8173-mdp-rsz";
            reg = <0 0x14005000 0 0x1000>;
            clocks = <&mmsys CLK_MM_MDP_RSZ2>;
            power-domains = <&spm MT8173_POWER_DOMAIN_MM>;
        };

        mdp_wdma0: wdma@14006000 {
            compatible = "mediatek,mt8173-mdp-wdma";
            reg = <0 0x14006000 0 0x1000>;
            clocks = <&mmsys CLK_MM_MDP_WDMA>;
            power-domains = <&spm MT8173_POWER_DOMAIN_MM>;
            iommus = <&iommu M4U_PORT_MDP_WDMA>;
        };

        mdp_wrot0: wrot@14007000 {
            compatible = "mediatek,mt8173-mdp-wrot";
            reg = <0 0x14007000 0 0x1000>;
            clocks = <&mmsys CLK_MM_MDP_WROT0>;
            power-domains = <&spm MT8173_POWER_DOMAIN_MM>;
            iommus = <&iommu M4U_PORT_MDP_WROT0>;
        };

        mdp_wrot1: wrot@14008000 {
            compatible = "mediatek,mt8173-mdp-wrot";
            reg = <0 0x14008000 0 0x1000>;
            clocks = <&mmsys CLK_MM_MDP_WROT1>;
            power-domains = <&spm MT8173_POWER_DOMAIN_MM>;
            iommus = <&iommu M4U_PORT_MDP_WROT1>;
        };
    };

...
```

## Documentation/devicetree/bindings/media/mediatek,mt8173-vpu.yaml
```yaml
# SPDX-License-Identifier: (GPL-2.0 OR BSD-2-Clause)
%YAML 1.2
---
$id: http://devicetree.org/schemas/media/mediatek,mt8173-vpu.yaml#
$schema: http://devicetree.org/meta-schemas/core.yaml#

title: Mediatek MT8173 Video Processor Unit

maintainers:
  - Ariel D'Alessandro <ariel.dalessandro@collabora.com>

description:
  Video Processor Unit is a HW video controller. It controls HW Codec including
  H.264/VP8/VP9 Decode, H.264/VP8 Encode and Image Processor (scale/rotate/color
  convert).

properties:
  compatible:
    const: mediatek,mt8173-vpu

  reg:
    maxItems: 2

  reg-names:
    items:
      - const: tcm
      - const: cfg_reg

  interrupts:
    maxItems: 1

  clocks:
    maxItems: 1

  clock-names:
    items:
      - const: main

  memory-region:
    maxItems: 1

required:
  - compatible
  - reg
  - reg-names
  - interrupts
  - clocks
  - clock-names
  - memory-region

additionalProperties: false

examples:
  - |
    #include <dt-bindings/clock/mt8173-clk.h>
    #include <dt-bindings/interrupt-controller/arm-gic.h>

    soc {
        #address-cells = <2>;
        #size-cells = <2>;

        vpu: vpu@10020000 {
            compatible = "mediatek,mt8173-vpu";
            reg = <0 0x10020000 0 0x30000>,
                  <0 0x10050000 0 0x100>;
            reg-names = "tcm", "cfg_reg";
            interrupts = <GIC_SPI 166 IRQ_TYPE_LEVEL_HIGH>;
            clocks = <&topckgen CLK_TOP_SCP_SEL>;
            clock-names = "main";
            memory-region = <&vpu_dma_reserved>;
        };
    };

...
```
