## Documentation/devicetree/bindings/media/marvell,mmp2-ccic.yaml
```yaml
# SPDX-License-Identifier: (GPL-2.0-only OR BSD-2-Clause)
# Copyright 2019,2020 Lubomir Rintel <lkundrak@v3.sk>
%YAML 1.2
---
$id: http://devicetree.org/schemas/media/marvell,mmp2-ccic.yaml#
$schema: http://devicetree.org/meta-schemas/core.yaml#

title: Marvell MMP2 camera host interface bindings

maintainers:
  - Lubomir Rintel <lkundrak@v3.sk>

properties:
  $nodename:
    pattern: '^camera@[a-f0-9]+$'

  compatible:
    const: marvell,mmp2-ccic

  reg:
    maxItems: 1

  interrupts:
    maxItems: 1

  power-domains:
    maxItems: 1

  port:
    $ref: /schemas/graph.yaml#/$defs/port-base
    additionalProperties: false

    properties:
      endpoint:
        $ref: video-interfaces.yaml#
        unevaluatedProperties: false

        properties:
          hsync-active: true
          vsync-active: true
          pclk-sample: true
          bus-type: true

  clocks:
    minItems: 1
    items:
      - description: AXI bus interface clock
      - description: Peripheral clock
      - description: Parallel video bus interface clock

  clock-names:
    const: axi

  '#clock-cells':
    const: 0

  clock-output-names:
    const: mclk

required:
  - compatible
  - reg
  - interrupts
  - port

additionalProperties: false

examples:
  - |
    #include <dt-bindings/clock/marvell,mmp2.h>
    #include <dt-bindings/power/marvell,mmp2.h>

    camera@d420a000 {
      compatible = "marvell,mmp2-ccic";
      reg = <0xd420a000 0x800>;
      interrupts = <42>;
      clocks = <&soc_clocks MMP2_CLK_CCIC0>;
      clock-names = "axi";
      #clock-cells = <0>;
      clock-output-names = "mclk";
      power-domains = <&soc_clocks MMP3_POWER_DOMAIN_CAMERA>;

      port {
        camera0_0: endpoint {
          remote-endpoint = <&ov7670_0>;
          bus-type = <5>;      /* Parallel */
          hsync-active = <1>;  /* Active high */
          vsync-active = <1>;  /* Active high */
          pclk-sample = <0>;   /* Falling */
        };
      };
    };

...
```

## Documentation/devicetree/bindings/media/mediatek,mdp3-fg.yaml
```yaml
# SPDX-License-Identifier: (GPL-2.0-only OR BSD-2-Clause)
%YAML 1.2
---
$id: http://devicetree.org/schemas/media/mediatek,mdp3-fg.yaml#
$schema: http://devicetree.org/meta-schemas/core.yaml#

title: MediaTek Media Data Path 3 Film Grain

maintainers:
  - Matthias Brugger <matthias.bgg@gmail.com>
  - Moudy Ho <moudy.ho@mediatek.com>

description:
  Film Grain (FG) is a Media Data Path 3 (MDP3) component used to add
  the film grain according to the AOMedia Video 1 (AV1) standard.

properties:
  compatible:
    enum:
      - mediatek,mt8195-mdp3-fg

  reg:
    maxItems: 1

  mediatek,gce-client-reg:
    description:
      The register of display function block to be set by gce. There are 4 arguments,
      such as gce node, subsys id, offset and register size. The subsys id that is
      mapping to the register of display function blocks is defined in the gce header
      include/dt-bindings/gce/<chip>-gce.h of each chips.
    $ref: /schemas/types.yaml#/definitions/phandle-array
    items:
      items:
        - description: phandle of GCE
        - description: GCE subsys id
        - description: register offset
        - description: register size
    maxItems: 1

  clocks:
    maxItems: 1

required:
  - compatible
  - reg
  - mediatek,gce-client-reg
  - clocks

additionalProperties: false

examples:
  - |
    #include <dt-bindings/clock/mt8195-clk.h>
    #include <dt-bindings/gce/mt8195-gce.h>

    display@14002000 {
        compatible = "mediatek,mt8195-mdp3-fg";
        reg = <0x14002000 0x1000>;
        mediatek,gce-client-reg = <&gce1 SUBSYS_1400XXXX 0x2000 0x1000>;
        clocks = <&vppsys0 CLK_VPP0_MDP_FG>;
    };
```

## Documentation/devicetree/bindings/media/mediatek,mdp3-rdma.yaml
```yaml
# SPDX-License-Identifier: (GPL-2.0-only OR BSD-2-Clause)
%YAML 1.2
---
$id: http://devicetree.org/schemas/media/mediatek,mdp3-rdma.yaml#
$schema: http://devicetree.org/meta-schemas/core.yaml#

title: MediaTek Read Direct Memory Access

maintainers:
  - Matthias Brugger <matthias.bgg@gmail.com>
  - Moudy Ho <moudy.ho@mediatek.com>

description: |
  MediaTek Read Direct Memory Access(RDMA) component used to do read DMA.
  It contains one line buffer to store the sufficient pixel data, and
  must be siblings to the central MMSYS_CONFIG node.
  For a description of the MMSYS_CONFIG binding, see
  Documentation/devicetree/bindings/arm/mediatek/mediatek,mmsys.yaml
  for details.

properties:
  compatible:
    oneOf:
      - enum:
          - mediatek,mt8183-mdp3-rdma
          - mediatek,mt8188-mdp3-rdma
          - mediatek,mt8195-mdp3-rdma
          - mediatek,mt8195-vdo1-rdma
      - items:
          - const: mediatek,mt8188-vdo1-rdma
          - const: mediatek,mt8195-vdo1-rdma

  reg:
    maxItems: 1

  mediatek,gce-client-reg:
    $ref: /schemas/types.yaml#/definitions/phandle-array
    items:
      items:
        - description: phandle of GCE
        - description: GCE subsys id
        - description: register offset
        - description: register size
    description: The register of client driver can be configured by gce with
      4 arguments defined in this property. Each GCE subsys id is mapping to
      a client defined in the header include/dt-bindings/gce/<chip>-gce.h.

  mediatek,gce-events:
    description:
      The event id which is mapping to the specific hardware event signal
      to gce. The event id is defined in the gce header
      include/dt-bindings/gce/<chip>-gce.h of each chips.
    $ref: /schemas/types.yaml#/definitions/uint32-array

  mediatek,scp:
    $ref: /schemas/types.yaml#/definitions/phandle
    description:
      Phandle to the System Control Processor (SCP) used for initializing
      and stopping the MDP3, for sending frame data locations to the MDP3's
      VPU and to install Inter-Processor Interrupt handlers to control
      processing states.

  power-domains:
    maxItems: 1

  clocks:
    items:
      - description: RDMA clock
      - description: RSZ clock
    minItems: 1

  iommus:
    maxItems: 1

  mboxes:
    items:
      - description: used for 1st data pipe from RDMA
      - description: used for 2nd data pipe from RDMA
      - description: used for 3rd data pipe from RDMA
      - description: used for 4th data pipe from RDMA
      - description: used for the data pipe from SPLIT
    minItems: 1

  interrupts:
    maxItems: 1

  '#dma-cells':
    const: 1

required:
  - compatible
  - reg
  - mediatek,gce-client-reg
  - power-domains
  - clocks
  - iommus
  - '#dma-cells'

allOf:
  - if:
      properties:
        compatible:
          contains:
            const: mediatek,mt8183-mdp3-rdma

    then:
      properties:
        clocks:
          minItems: 2

        mboxes:
          minItems: 2

      required:
        - mboxes
        - mediatek,gce-events

  - if:
      properties:
        compatible:
          contains:
            const: mediatek,mt8195-mdp3-rdma

    then:
      properties:
        clocks:
          maxItems: 1

        mboxes:
          minItems: 5

      required:
        - mediatek,gce-events

  - if:
      properties:
        compatible:
          contains:
            const: mediatek,mt8195-vdo1-rdma

    then:
      properties:
        clocks:
          maxItems: 1

additionalProperties: false

examples:
  - |
    #include <dt-bindings/clock/mt8183-clk.h>
    #include <dt-bindings/gce/mt8183-gce.h>
    #include <dt-bindings/power/mt8183-power.h>
    #include <dt-bindings/memory/mt8183-larb-port.h>

    dma-controller@14001000 {
        compatible = "mediatek,mt8183-mdp3-rdma";
        reg = <0x14001000 0x1000>;
        mediatek,gce-client-reg = <&gce SUBSYS_1400XXXX 0x1000 0x1000>;
        mediatek,gce-events = <CMDQ_EVENT_MDP_RDMA0_SOF>,
                              <CMDQ_EVENT_MDP_RDMA0_EOF>;
        power-domains = <&spm MT8183_POWER_DOMAIN_DISP>;
        clocks = <&mmsys CLK_MM_MDP_RDMA0>,
                 <&mmsys CLK_MM_MDP_RSZ1>;
        iommus = <&iommu>;
        mboxes = <&gce 20 CMDQ_THR_PRIO_LOWEST>,
                 <&gce 21 CMDQ_THR_PRIO_LOWEST>;
        #dma-cells = <1>;
    };
```

## Documentation/devicetree/bindings/media/mediatek,mdp3-rsz.yaml
```yaml
# SPDX-License-Identifier: (GPL-2.0-only OR BSD-2-Clause)
%YAML 1.2
---
$id: http://devicetree.org/schemas/media/mediatek,mdp3-rsz.yaml#
$schema: http://devicetree.org/meta-schemas/core.yaml#

title: MediaTek Resizer

maintainers:
  - Matthias Brugger <matthias.bgg@gmail.com>
  - Moudy Ho <moudy.ho@mediatek.com>

description: |
  One of Media Data Path 3 (MDP3) components used to do frame resizing.

properties:
  compatible:
    oneOf:
      - enum:
          - mediatek,mt8183-mdp3-rsz
      - items:
          - enum:
              - mediatek,mt8195-mdp3-rsz
          - const: mediatek,mt8183-mdp3-rsz

  reg:
    maxItems: 1

  mediatek,gce-client-reg:
    $ref: /schemas/types.yaml#/definitions/phandle-array
    items:
      items:
        - description: phandle of GCE
        - description: GCE subsys id
        - description: register offset
        - description: register size
    description: The register of client driver can be configured by gce with
      4 arguments defined in this property. Each GCE subsys id is mapping to
      a client defined in the header include/dt-bindings/gce/<chip>-gce.h.

  mediatek,gce-events:
    description:
      The event id which is mapping to the specific hardware event signal
      to gce. The event id is defined in the gce header
      include/dt-bindings/gce/<chip>-gce.h of each chips.
    $ref: /schemas/types.yaml#/definitions/uint32-array

  clocks:
    minItems: 1

required:
  - compatible
  - reg
  - mediatek,gce-client-reg
  - mediatek,gce-events
  - clocks

additionalProperties: false

examples:
  - |
    #include <dt-bindings/clock/mt8183-clk.h>
    #include <dt-bindings/gce/mt8183-gce.h>

    mdp3_rsz0: mdp3-rsz0@14003000 {
      compatible = "mediatek,mt8183-mdp3-rsz";
      reg = <0x14003000 0x1000>;
      mediatek,gce-client-reg = <&gce SUBSYS_1400XXXX 0x3000 0x1000>;
      mediatek,gce-events = <CMDQ_EVENT_MDP_RSZ0_SOF>,
                            <CMDQ_EVENT_MDP_RSZ0_EOF>;
      clocks = <&mmsys CLK_MM_MDP_RSZ0>;
    };

    mdp3_rsz1: mdp3-rsz1@14004000 {
      compatible = "mediatek,mt8183-mdp3-rsz";
      reg = <0x14004000 0x1000>;
      mediatek,gce-client-reg = <&gce SUBSYS_1400XXXX 0x4000 0x1000>;
      mediatek,gce-events = <CMDQ_EVENT_MDP_RSZ1_SOF>,
                            <CMDQ_EVENT_MDP_RSZ1_EOF>;
      clocks = <&mmsys CLK_MM_MDP_RSZ1>;
    };
```

## Documentation/devicetree/bindings/media/mediatek,mdp3-stitch.yaml
```yaml
# SPDX-License-Identifier: (GPL-2.0-only OR BSD-2-Clause)
%YAML 1.2
---
$id: http://devicetree.org/schemas/media/mediatek,mdp3-stitch.yaml#
$schema: http://devicetree.org/meta-schemas/core.yaml#

title: MediaTek Media Data Path 3 STITCH

maintainers:
  - Matthias Brugger <matthias.bgg@gmail.com>
  - Moudy Ho <moudy.ho@mediatek.com>

description:
  One of Media Data Path 3 (MDP3) components used to combine multiple video frame
  with overlapping fields of view to produce a segmented panorame.

properties:
  compatible:
    enum:
      - mediatek,mt8195-mdp3-stitch

  reg:
    maxItems: 1

  mediatek,gce-client-reg:
    description:
      The register of display function block to be set by gce. There are 4 arguments,
      such as gce node, subsys id, offset and register size. The subsys id that is
      mapping to the register of display function blocks is defined in the gce header
      include/dt-bindings/gce/<chip>-gce.h of each chips.
    $ref: /schemas/types.yaml#/definitions/phandle-array
    items:
      items:
        - description: phandle of GCE
        - description: GCE subsys id
        - description: register offset
        - description: register size
    maxItems: 1

  clocks:
    maxItems: 1

required:
  - compatible
  - reg
  - mediatek,gce-client-reg
  - clocks

additionalProperties: false

examples:
  - |
    #include <dt-bindings/clock/mt8195-clk.h>
    #include <dt-bindings/gce/mt8195-gce.h>

    display@14003000 {
        compatible = "mediatek,mt8195-mdp3-stitch";
        reg = <0x14003000 0x1000>;
        mediatek,gce-client-reg = <&gce1 SUBSYS_1400XXXX 0x3000 0x1000>;
        clocks = <&vppsys0 CLK_VPP0_STITCH>;
    };
```

## Documentation/devicetree/bindings/media/mediatek,mdp3-tcc.yaml
```yaml
# SPDX-License-Identifier: (GPL-2.0-only OR BSD-2-Clause)
%YAML 1.2
---
$id: http://devicetree.org/schemas/media/mediatek,mdp3-tcc.yaml#
$schema: http://devicetree.org/meta-schemas/core.yaml#

title: MediaTek Media Data Path 3 Tone Curve Conversion

maintainers:
  - Matthias Brugger <matthias.bgg@gmail.com>

description:
  Tone Curve Conversion (TCC) is one of Media Profile Path 3 (MDP3) components.
  It is used to handle the tone mapping of various gamma curves in order to
  achieve HDR10 effects. This helps adapt the content to the color and
  brightness range that standard display devices typically support.

properties:
  compatible:
    enum:
      - mediatek,mt8195-mdp3-tcc

  reg:
    maxItems: 1

  mediatek,gce-client-reg:
    description:
      The register of display function block to be set by gce. There are 4 arguments,
      such as gce node, subsys id, offset and register size. The subsys id that is
      mapping to the register of display function blocks is defined in the gce header
      include/dt-bindings/gce/<chip>-gce.h of each chips.
    $ref: /schemas/types.yaml#/definitions/phandle-array
    items:
      items:
        - description: phandle of GCE
        - description: GCE subsys id
        - description: register offset
        - description: register size
    maxItems: 1

  clocks:
    maxItems: 1

required:
  - compatible
  - reg
  - mediatek,gce-client-reg
  - clocks

additionalProperties: false

examples:
  - |
    #include <dt-bindings/clock/mt8195-clk.h>
    #include <dt-bindings/gce/mt8195-gce.h>

    display@1400b000 {
        compatible = "mediatek,mt8195-mdp3-tcc";
        reg = <0x1400b000 0x1000>;
        mediatek,gce-client-reg = <&gce1 SUBSYS_1400XXXX 0xb000 0x1000>;
        clocks = <&vppsys0 CLK_VPP0_MDP_TCC>;
    };
```
