## Documentation/devicetree/bindings/media/i2c/tvp7002.txt
```
* Texas Instruments TV7002 video decoder

The TVP7002 device supports digitizing of video and graphics signal in RGB and
YPbPr color space.

Required Properties :
- compatible : Must be "ti,tvp7002"

Optional Properties:
- hsync-active: HSYNC Polarity configuration for the bus. Default value when
  this property is not specified is <0>.

- vsync-active: VSYNC Polarity configuration for the bus. Default value when
  this property is not specified is <0>.

- pclk-sample: Clock polarity of the bus. Default value when this property is
  not specified is <0>.

- sync-on-green-active: Active state of Sync-on-green signal property of the
  endpoint.
  0 = Normal Operation (Active Low, Default)
  1 = Inverted operation

- field-even-active: Active-high Field ID output polarity control of the bus.
  Under normal operation, the field ID output is set to logic 1 for an odd field
  (field 1) and set to logic 0 for an even field (field 0).
  0 = Normal Operation (Active Low, Default)
  1 = FID output polarity inverted

For further reading of port node refer Documentation/devicetree/bindings/media/
video-interfaces.txt.

Example:

	i2c0@1c22000 {
		...
		...
		tvp7002@5c {
			compatible = "ti,tvp7002";
			reg = <0x5c>;

			port {
				tvp7002_1: endpoint {
					hsync-active = <1>;
					vsync-active = <1>;
					pclk-sample = <0>;
					sync-on-green-active = <1>;
					field-even-active = <0>;
				};
			};
		};
		...
	};
```

## Documentation/devicetree/bindings/media/i2c/virtual-camera.txt
```
* Rockchip Virtual Camera

The virtual sensor supports multiple resolutions output,
such as 1280x720,1920x1080,3840x720,3840x2160,5120x2880.
It also can support RGB24 or raw output formats.

Required Properties:
- compatible: Must be "rockchip,virtual-camera"
- reg: I2C slave address, this value is useless.
- link-frequencies: target mipi clock frequency, half of mipi data rate.

Optional Properties:
- width: output pixel width.
- height: output pixel height.
- bus-format: output bus format, it is a media bus format code.

The device node must contain one 'port' child node for its digital output
video port, in accordance with the video interface bindings defined in
Documentation/devicetree/bindings/media/video-interfaces.txt.

Example:

	&i2c0 {
		...
		...
		 vcamera@30 {
			compatible = "rockchip,virtual-camera";
			reg = <0x30>;
			width = <1920>;
			height = <1080>;
			bus-format = <MEDIA_BUS_FMT_BGGR8_1X8>;

			port {
				vcamera_out: endpoint {
					remote-endpoint = <&dphy_rx_in>;
					link-frequencies = /bits/ 64 <500000000>;
				};
			};
		};
		...
	};
```

## Documentation/devicetree/bindings/media/img,e5010-jpeg-enc.yaml
```yaml
# SPDX-License-Identifier: (GPL-2.0-only OR BSD-2-Clause)
%YAML 1.2
---
$id: http://devicetree.org/schemas/media/img,e5010-jpeg-enc.yaml#
$schema: http://devicetree.org/meta-schemas/core.yaml#

title: Imagination E5010 JPEG Encoder

maintainers:
  - Devarsh Thakkar <devarsht@ti.com>

description: |
  The E5010 is a JPEG encoder from Imagination Technologies implemented on
  TI's AM62A SoC. It is capable of real time encoding of YUV420 and YUV422
  inputs to JPEG and M-JPEG. It supports baseline JPEG Encoding up to
  8Kx8K resolution.

properties:
  compatible:
    oneOf:
      - items:
          - const: ti,am62a-jpeg-enc
          - const: img,e5010-jpeg-enc
      - const: img,e5010-jpeg-enc

  reg:
    items:
      - description: The E5010 core register region
      - description: The E5010 mmu register region

  reg-names:
    items:
      - const: core
      - const: mmu

  power-domains:
    maxItems: 1

  resets:
    maxItems: 1

  clocks:
    maxItems: 1

  interrupts:
    maxItems: 1

required:
  - compatible
  - reg
  - reg-names
  - interrupts
  - clocks

additionalProperties: false

examples:
  - |
    #include <dt-bindings/soc/ti,sci_pm_domain.h>
    #include <dt-bindings/interrupt-controller/arm-gic.h>
    #include <dt-bindings/interrupt-controller/irq.h>

    soc {
      #address-cells = <2>;
      #size-cells = <2>;
      jpeg-encoder@fd20000 {
          compatible = "img,e5010-jpeg-enc";
          reg = <0x00 0xfd20000 0x00 0x100>,
                <0x00 0xfd20200 0x00 0x200>;
          reg-names = "core", "mmu";
          clocks = <&k3_clks 201 0>;
          power-domains = <&k3_pds 201 TI_SCI_PD_EXCLUSIVE>;
          interrupts = <GIC_SPI 98 IRQ_TYPE_LEVEL_HIGH>;
      };
    };
```

## Documentation/devicetree/bindings/media/img-ir-rev1.txt
```
* ImgTec Infrared (IR) decoder version 1

This binding is for Imagination Technologies' Infrared decoder block,
specifically major revision 1.

Required properties:
- compatible:		Should be "img,ir-rev1"
- reg:			Physical base address of the controller and length of
			memory mapped region.
- interrupts:		The interrupt specifier to the cpu.

Optional properties:
- clocks:		List of clock specifiers as described in standard
			clock bindings.
			Up to 3 clocks may be specified in the following order:
			1st:	Core clock (defaults to 32.768KHz if omitted).
			2nd:	System side (fast) clock.
			3rd:	Power modulation clock.
- clock-names:		List of clock names corresponding to the clocks
			specified in the clocks property.
			Accepted clock names are:
			"core":	Core clock.
			"sys":	System clock.
			"mod":	Power modulation clock.

Example:

	ir@02006200 {
		compatible = "img,ir-rev1";
		reg = <0x02006200 0x100>;
		interrupts = <29 4>;
		clocks = <&clk_32khz>;
		clock-names =  "core";
	};
```

## Documentation/devicetree/bindings/media/imx.txt
```
Freescale i.MX Media Video Device
=================================

Video Media Controller node
---------------------------

This is the media controller node for video capture support. It is a
virtual device that lists the camera serial interface nodes that the
media device will control.

Required properties:
- compatible : "fsl,imx-capture-subsystem";
- ports      : Should contain a list of phandles pointing to camera
		sensor interface ports of IPU devices

example:

capture-subsystem {
	compatible = "fsl,imx-capture-subsystem";
	ports = <&ipu1_csi0>, <&ipu1_csi1>;
};


mipi_csi2 node
--------------

This is the device node for the MIPI CSI-2 Receiver core in the i.MX
SoC. This is a Synopsys Designware MIPI CSI-2 host controller core
combined with a D-PHY core mixed into the same register block. In
addition this device consists of an i.MX-specific "CSI2IPU gasket"
glue logic, also controlled from the same register block. The CSI2IPU
gasket demultiplexes the four virtual channel streams from the host
controller's 32-bit output image bus onto four 16-bit parallel busses
to the i.MX IPU CSIs.

Required properties:
- compatible	: "fsl,imx6-mipi-csi2";
- reg           : physical base address and length of the register set;
- clocks	: the MIPI CSI-2 receiver requires three clocks: hsi_tx
		  (the D-PHY clock), video_27m (D-PHY PLL reference
		  clock), and eim_podf;
- clock-names	: must contain "dphy", "ref", "pix";
- port@*        : five port nodes must exist, containing endpoints
		  connecting to the source and sink devices according to
		  of_graph bindings. The first port is an input port,
		  connecting with a MIPI CSI-2 source, and ports 1
		  through 4 are output ports connecting with parallel
		  bus sink endpoint nodes and correspond to the four
		  MIPI CSI-2 virtual channel outputs.

Optional properties:
- interrupts	: must contain two level-triggered interrupts,
		  in order: 100 and 101;
```

## Documentation/devicetree/bindings/media/imx7-csi.txt
```
Freescale i.MX7 CMOS Sensor Interface
=====================================

csi yesde
--------

This is device yesde for the CMOS Sensor Interface (CSI) which enables the chip
to connect directly to external CMOS image sensors.

Required properties:

- compatible    : "fsl,imx7-csi" or "fsl,imx6ul-csi";
- reg           : base address and length of the register set for the device;
- interrupts    : should contain CSI interrupt;
- clocks        : list of clock specifiers, see
        Documentation/devicetree/bindings/clock/clock-bindings.txt for details;
- clock-names   : must contain "mclk";

The device yesde shall contain one 'port' child yesde with one child 'endpoint'
yesde, according to the bindings defined in:
Documentation/devicetree/bindings/media/video-interfaces.txt.

In the following example a remote endpoint is a video multiplexer.

example:

                csi: csi@30710000 {
                        #address-cells = <1>;
                        #size-cells = <0>;

                        compatible = "fsl,imx7-csi";
                        reg = <0x30710000 0x10000>;
                        interrupts = <GIC_SPI 7 IRQ_TYPE_LEVEL_HIGH>;
                        clocks = <&clks IMX7D_CSI_MCLK_ROOT_CLK>;
                        clock-names = "mclk";

                        port {
                                csi_from_csi_mux: endpoint {
                                        remote-endpoint = <&csi_mux_to_csi>;
                                };
                        };
                };
```

## Documentation/devicetree/bindings/media/imx7-mipi-csi2.txt
```
Freescale i.MX7 Mipi CSI2
=========================

mipi_csi2 node
--------------

This is the device node for the MIPI CSI-2 receiver core in i.MX7 SoC. It is
compatible with previous version of Samsung D-phy.

Required properties:

- compatible    : "fsl,imx7-mipi-csi2";
- reg           : base address and length of the register set for the device;
- interrupts    : should contain MIPI CSIS interrupt;
- clocks        : list of clock specifiers, see
        Documentation/devicetree/bindings/clock/clock-bindings.txt for details;
- clock-names   : must contain "pclk", "wrap" and "phy" entries, matching
                  entries in the clock property;
- power-domains : a phandle to the power domain, see
          Documentation/devicetree/bindings/power/power_domain.txt for details.
- reset-names   : should include following entry "mrst";
- resets        : a list of phandle, should contain reset entry of
                  reset-names;
- phy-supply    : from the generic phy bindings, a phandle to a regulator that
	          provides power to MIPI CSIS core;

Optional properties:

- clock-frequency : The IP's main (system bus) clock frequency in Hz, default
		    value when this property is not specified is 166 MHz;
- fsl,csis-hs-settle : differential receiver (HS-RX) settle time;

The device node should contain two 'port' child nodes with one child 'endpoint'
node, according to the bindings defined in:
 Documentation/devicetree/bindings/ media/video-interfaces.txt.
 The following are properties specific to those nodes.

port node
---------

- reg		  : (required) can take the values 0 or 1, where 0 shall be
                     related to the sink port and port 1 shall be the source
                     one;

endpoint node
-------------

- data-lanes    : (required) an array specifying active physical MIPI-CSI2
		    data input lanes and their mapping to logical lanes; this
                    shall only be applied to port 0 (sink port), the array's
                    content is unused only its length is meaningful,
                    in this case the maximum length supported is 2;

example:

        mipi_csi: mipi-csi@30750000 {
                #address-cells = <1>;
                #size-cells = <0>;

                compatible = "fsl,imx7-mipi-csi2";
                reg = <0x30750000 0x10000>;
                interrupts = <GIC_SPI 25 IRQ_TYPE_LEVEL_HIGH>;
                clocks = <&clks IMX7D_IPG_ROOT_CLK>,
                                <&clks IMX7D_MIPI_CSI_ROOT_CLK>,
                                <&clks IMX7D_MIPI_DPHY_ROOT_CLK>;
                clock-names = "pclk", "wrap", "phy";
                clock-frequency = <166000000>;
                power-domains = <&pgc_mipi_phy>;
                phy-supply = <&reg_1p0d>;
                resets = <&src IMX7_RESET_MIPI_PHY_MRST>;
                reset-names = "mrst";
                fsl,csis-hs-settle = <3>;

                port@0 {
                        reg = <0>;

                        mipi_from_sensor: endpoint {
                                remote-endpoint = <&ov2680_to_mipi>;
                                data-lanes = <1>;
                        };
                };

                port@1 {
                        reg = <1>;

                        mipi_vc0_to_csi_mux: endpoint {
                                remote-endpoint = <&csi_mux_from_mipi_vc0>;
                        };
                };
        };
```

## Documentation/devicetree/bindings/media/marvell,mmp2-ccic.txt
```
Marvell MMP2 camera host interface

Required properties:
 - compatible: Should be "marvell,mmp2-ccic".
 - reg: Register base and size.
 - interrupts: The interrupt number.
 - #clock-cells: Must be 0.

Optional properties:
 - clocks: Reference to the input clock as specified by
           Documentation/devicetree/bindings/clock/clock-bindings.txt.
 - clock-names: Names of the clocks used; "axi" for the AXI bus interface,
                "func" for the peripheral clock and "phy" for the parallel
                video bus interface.
 - clock-output-names: Optional clock source for sensors. Shall be "mclk".

Required subnodes:
 - port: The parallel bus interface port with a single endpoint linked to
         the sensor's endpoint as described in
         Documentation/devicetree/bindings/media/video-interfaces.txt.

Required endpoint properties:
 - bus-type: data bus type, <5> or <6> for Parallel or Bt.656 respectively
 - pclk-sample: pixel clock polarity
 - hsync-active: horizontal synchronization polarity (only required for
   parallel bus)
 - vsync-active: vertical synchronization polarity (only required for
   parallel bus)

Example:

	camera0: camera@d420a000 {
		compatible = "marvell,mmp2-ccic";
		reg = <0xd420a000 0x800>;
		interrupts = <42>;
		clocks = <&soc_clocks MMP2_CLK_CCIC0>;
		clock-names = "axi";
		#clock-cells = <0>;
		clock-output-names = "mclk";

		port {
			camera0_0: endpoint {
				remote-endpoint = <&ov7670_0>;
                                bus-type = <5>;      /* Parallel */
                                hsync-active = <1>;  /* Active high */
                                vsync-active = <1>;  /* Active high */
                                pclk-sample = <0>;   /* Falling */
			};
		};
	};
```
