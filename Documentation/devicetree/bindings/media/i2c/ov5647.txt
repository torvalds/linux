## Documentation/devicetree/bindings/media/i2c/ovti,ov08d10.yaml
```yaml
# SPDX-License-Identifier: (GPL-2.0-only OR BSD-2-Clause)
%YAML 1.2
---
$id: http://devicetree.org/schemas/media/i2c/ovti,ov08d10.yaml#
$schema: http://devicetree.org/meta-schemas/core.yaml#

title: Omnivision OV08D10 1/4-Inch 8MP CMOS color image sensor

maintainers:
  - Matthias Fend <matthias.fend@emfend.at>

description:
  The Omnivision OV08D10 is a 1/4-Inch 8MP CMOS color image sensor with an
  active array size of 3280 x 2464. It is programmable through I2C
  interface. Image data is transmitted via MIPI CSI-2 using 2 lanes.

allOf:
  - $ref: /schemas/media/video-interface-devices.yaml#

properties:
  compatible:
    const: ovti,ov08d10

  reg:
    maxItems: 1

  clocks:
    description: MCLK input clock (6 - 27 MHz)
    maxItems: 1

  reset-gpios:
    description: Active low XSHUTDN pin
    maxItems: 1

  dovdd-supply:
    description: IO power supply (1.8V)

  avdd-supply:
    description: Analog power supply (2.8V)

  dvdd-supply:
    description: Core power supply (1.2V)

  port:
    $ref: /schemas/graph.yaml#/$defs/port-base
    additionalProperties: false

    properties:
      endpoint:
        $ref: /schemas/media/video-interfaces.yaml#
        unevaluatedProperties: false

        required:
          - data-lanes
          - link-frequencies

    required:
      - endpoint

required:
  - compatible
  - reg
  - clocks
  - port

unevaluatedProperties: false

examples:
  - |
    #include <dt-bindings/gpio/gpio.h>
    #include <dt-bindings/media/video-interfaces.h>

    i2c {
        #address-cells = <1>;
        #size-cells = <0>;

        sensor@36 {
            compatible = "ovti,ov08d10";
            reg = <0x36>;

            clocks = <&ov08d10_clk>;

            dovdd-supply = <&ov08d10_vdddo_1v8>;
            avdd-supply = <&ov08d10_vdda_2v8>;
            dvdd-supply = <&ov08d10_vddd_1v2>;

            orientation = <2>;
            rotation = <0>;

            reset-gpios = <&gpio 1 GPIO_ACTIVE_LOW>;

            port {
                ov08d10_output: endpoint {
                    data-lanes = <1 2>;
                    link-frequencies = /bits/ 64 <360000000 720000000>;
                    remote-endpoint = <&csi_input>;
                };
            };
        };
    };
...
```

## Documentation/devicetree/bindings/media/i2c/ovti,ov08x40.yaml
```yaml
# SPDX-License-Identifier: (GPL-2.0 OR BSD-2-Clause)
# Copyright (c) 2024 Linaro Ltd.
%YAML 1.2
---
$id: http://devicetree.org/schemas/media/i2c/ovti,ov08x40.yaml#
$schema: http://devicetree.org/meta-schemas/core.yaml#

title: Omnivision OV08X40 CMOS Sensor

maintainers:
  - Bryan O'Donoghue <bryan.odonoghue@linaro.org>

description: |
  The Omnivision OV08X40 is a 9.2 megapixel, CMOS image sensor which supports:
  - Automatic black level calibration (ABLC)
  - Programmable controls for frame rate, mirror and flip, binning, cropping
    and windowing
  - Output formats 10-bit 4C RGB RAW, 10-bit Bayer RAW
  - 4-lane MIPI D-PHY TX @ 1 Gbps per lane
  - 2-lane MPIP D-PHY TX @ 2 Gbps per lane
  - Dynamic defect pixel cancellation
  - Standard SCCB command interface

allOf:
  - $ref: /schemas/media/video-interface-devices.yaml#

properties:
  compatible:
    const: ovti,ov08x40

  reg:
    maxItems: 1

  clocks:
    maxItems: 1

  avdd-supply:
    description: Analogue circuit voltage supply.

  dovdd-supply:
    description: I/O circuit voltage supply.

  dvdd-supply:
    description: Digital circuit voltage supply.

  reset-gpios:
    description: Active low GPIO connected to XSHUTDOWN pad of the sensor.

  port:
    $ref: /schemas/graph.yaml#/$defs/port-base
    additionalProperties: false

    properties:
      endpoint:
        $ref: /schemas/media/video-interfaces.yaml#
        additionalProperties: false

        properties:
          data-lanes:
            oneOf:
              - items:
                  - const: 1
                  - const: 2
              - items:
                  - const: 1
                  - const: 2
                  - const: 3
                  - const: 4
          link-frequencies: true
          remote-endpoint: true

        required:
          - data-lanes
          - link-frequencies
          - remote-endpoint

required:
  - compatible
  - reg
  - clocks
  - port

unevaluatedProperties: false

examples:
  - |
    #include <dt-bindings/gpio/gpio.h>

    i2c {
        #address-cells = <1>;
        #size-cells = <0>;

        ov08x40: camera@36 {
            compatible = "ovti,ov08x40";
            reg = <0x36>;

            reset-gpios = <&tlmm 111 GPIO_ACTIVE_LOW>;
            pinctrl-names = "default";
            pinctrl-0 = <&cam_rgb_defaultt>;

            clocks = <&ov08x40_clk>;

            assigned-clocks = <&ov08x40_clk>;
            assigned-clock-parents = <&ov08x40_clk_parent>;
            assigned-clock-rates = <19200000>;

            avdd-supply = <&vreg_l7b_2p8>;
            dvdd-supply = <&vreg_l7b_1p8>;
            dovdd-supply = <&vreg_l3m_1p8>;

            port {
                ov08x40_ep: endpoint {
                    remote-endpoint = <&csiphy4_ep>;
                    data-lanes = <1 2 3 4>;
                    link-frequencies = /bits/ 64 <400000000>;
                };
            };
        };
    };
...
```

## Documentation/devicetree/bindings/media/i2c/ovti,ov2680.yaml
```yaml
# SPDX-License-Identifier: (GPL-2.0-only OR BSD-2-Clause)
%YAML 1.2
---
$id: http://devicetree.org/schemas/media/i2c/ovti,ov2680.yaml#
$schema: http://devicetree.org/meta-schemas/core.yaml#

title: Omnivision OV2680 CMOS Sensor

maintainers:
  - Rui Miguel Silva <rmfrfs@gmail.com>

description: |-
  The OV2680 color sensor is a low voltage, high performance 1/5 inch UXGA (2
  megapixel) CMOS image sensor that provides a single-chip UXGA (1600 x 1200)
  camera. It provides full-frame, sub-sampled, or windowed 10-bit images in
  various formats via the control of the Serial Camera Control Bus (SCCB)
  interface. The OV2680 has an image array capable of operating at up to 30
  frames per second (fps) in UXGA resolution.

properties:
  compatible:
    const: ovti,ov2680

  reg:
    maxItems: 1

  clocks:
    maxItems: 1

  clock-names:
    const: xvclk

  reset-gpios:
    description:
      The phandle and specifier for the GPIO that controls sensor reset.
      This corresponds to the hardware pin XSHUTDOWN which is physically
      active low.
    maxItems: 1

  DOVDD-supply:
    description:
      Definition of the regulator used as interface power supply.

  AVDD-supply:
    description:
      Definition of the regulator used as analog power supply.

  DVDD-supply:
    description:
      Definition of the regulator used as digital power supply.

  port:
    description:
      A node containing an output port node.
    $ref: /schemas/graph.yaml#/$defs/port-base
    additionalProperties: false

    properties:
      endpoint:
        $ref: /schemas/media/video-interfaces.yaml#
        additionalProperties: false

        properties:
          link-frequencies: true

          remote-endpoint: true

        required:
          - link-frequencies

required:
  - compatible
  - reg
  - clocks
  - clock-names
  - DOVDD-supply
  - AVDD-supply
  - DVDD-supply
  - reset-gpios
  - port

additionalProperties: false

examples:
  - |
    #include <dt-bindings/gpio/gpio.h>

    i2c {
        #address-cells = <1>;
        #size-cells = <0>;

        ov2680: camera-sensor@36 {
                compatible = "ovti,ov2680";
                reg = <0x36>;
                clocks = <&osc>;
                clock-names = "xvclk";
                reset-gpios = <&gpio1 3 GPIO_ACTIVE_LOW>;

                DOVDD-supply = <&sw2_reg>;
                DVDD-supply = <&sw2_reg>;
                AVDD-supply = <&reg_peri_3p15v>;

                port {
                        ov2680_to_mipi: endpoint {
                                remote-endpoint = <&mipi_from_sensor>;
                                link-frequencies = /bits/ 64 <330000000>;
                        };
                };
        };
    };

...
```

## Documentation/devicetree/bindings/media/i2c/ovti,ov2685.yaml
```yaml
# SPDX-License-Identifier: (GPL-2.0 OR BSD-2-Clause)
%YAML 1.2
---
$id: http://devicetree.org/schemas/media/i2c/ovti,ov2685.yaml#
$schema: http://devicetree.org/meta-schemas/core.yaml#

title: OmniVision OV2685 Image Sensor

maintainers:
  - Shunqian Zheng <zhengsq@rock-chips.com>

properties:
  compatible:
    const: ovti,ov2685

  reg:
    maxItems: 1

  clocks:
    items:
      - description: XVCLK clock

  clock-names:
    items:
      - const: xvclk

  dvdd-supply:
    description: Digital Domain Power Supply

  avdd-supply:
    description: Analog Domain Power Supply

  dovdd-supply:
    description: I/O Domain Power Supply

  reset-gpios:
    maxItems: 1
    description: Reset Pin GPIO Control (active low)

  port:
    description: MIPI CSI-2 transmitter port
    $ref: /schemas/graph.yaml#/$defs/port-base
    additionalProperties: false

    properties:
      endpoint:
        $ref: /schemas/media/video-interfaces.yaml#
        unevaluatedProperties: false

        properties:
          data-lanes:
            maxItems: 2

        required:
          - data-lanes

required:
  - compatible
  - reg
  - clocks
  - clock-names
  - dvdd-supply
  - avdd-supply
  - dovdd-supply
  - port

additionalProperties: false

examples:
  - |
    #include <dt-bindings/clock/rk3399-cru.h>
    #include <dt-bindings/gpio/gpio.h>

    i2c {
        #address-cells = <1>;
        #size-cells = <0>;

        ov2685: camera-sensor@3c {
            compatible = "ovti,ov2685";
            reg = <0x3c>;
            pinctrl-names = "default";
            pinctrl-0 = <&clk_24m_cam>;

            clocks = <&cru SCLK_TESTCLKOUT1>;
            clock-names = "xvclk";

            avdd-supply = <&pp2800_cam>;
            dovdd-supply = <&pp1800>;
            dvdd-supply = <&pp1800>;
            reset-gpios = <&gpio2 3 GPIO_ACTIVE_LOW>;

            port {
                ucam_out: endpoint {
                    remote-endpoint = <&mipi_in_ucam>;
                    data-lanes = <1>;
                };
            };
        };
    };

...
```

## Documentation/devicetree/bindings/media/i2c/ovti,ov2732.yaml
```yaml
# SPDX-License-Identifier: (GPL-2.0 OR BSD-2-Clause)
%YAML 1.2
---
$id: http://devicetree.org/schemas/media/i2c/ovti,ov2732.yaml#
$schema: http://devicetree.org/meta-schemas/core.yaml#

title: OmniVision OV2732 Image Sensor

maintainers:
  - Walter Werner Schneider <contact@schnwalter.eu>

description:
  The OmniVision OV2732 is a 2MP (1920x1080) color CMOS image sensor controlled
  through an I2C-compatible SCCB bus.

properties:
  compatible:
    const: ovti,ov2732

  reg:
    maxItems: 1

  clocks:
    items:
      - description: XVCLK clock

  avdd-supply:
    description: Analog Domain Power Supply

  dovdd-supply:
    description: I/O Domain Power Supply

  dvdd-supply:
    description: Digital Domain Power Supply

  powerdown-gpios:
    maxItems: 1
    description: Reference to the GPIO connected to the pwdn pin. Active low.

  reset-gpios:
    maxItems: 1
    description: Reference to the GPIO connected to the reset pin. Active low.

  port:
    description: MIPI CSI-2 transmitter port
    $ref: /schemas/graph.yaml#/$defs/port-base
    additionalProperties: false

    properties:
      endpoint:
        $ref: /schemas/media/video-interfaces.yaml#
        unevaluatedProperties: false

        properties:
          data-lanes:
            items:
              - const: 1
              - const: 2

        required:
          - data-lanes
          - link-frequencies

required:
  - compatible
  - reg
  - clocks
  - avdd-supply
  - dovdd-supply
  - dvdd-supply
  - port

additionalProperties: false

examples:
  - |
    #include <dt-bindings/gpio/gpio.h>

    i2c {
        #address-cells = <1>;
        #size-cells = <0>;

        ov2732: camera@36 {
            compatible = "ovti,ov2732";
            reg = <0x36>;
            clocks = <&ov2732_clk>;

            avdd-supply = <&ov2732_avdd>;
            dovdd-supply = <&ov2732_dovdd>;
            dvdd-supply = <&ov2732_dvdd>;

            powerdown-gpios = <&gpio0 13 GPIO_ACTIVE_LOW>;
            reset-gpios = <&gpio0 8 GPIO_ACTIVE_LOW>;

            port {
                camera_out: endpoint {
                  data-lanes = <1 2>;
                  link-frequencies = /bits/ 64 <360000000>;
                  remote-endpoint = <&mipi_in_camera>;
                };
            };
        };
    };
```

## Documentation/devicetree/bindings/media/i2c/ovti,ov2735.yaml
```yaml
# SPDX-License-Identifier: (GPL-2.0 OR BSD-2-Clause)
%YAML 1.2
---
$id: http://devicetree.org/schemas/media/i2c/ovti,ov2735.yaml#
$schema: http://devicetree.org/meta-schemas/core.yaml#

title: OmniVision OV2735 Image Sensor

maintainers:
  - Himanshu Bhavani <himanshu.bhavani@siliconsignals.io>

description:
  The OmniVision OV2735 is a 2MP (1920x1080) color CMOS image sensor controlled
  through an I2C-compatible SCCB bus. it outputs RAW10 format and uses a 1/2.7"
  optical format.

properties:
  compatible:
    const: ovti,ov2735

  reg:
    maxItems: 1

  clocks:
    items:
      - description: XVCLK clock

  avdd-supply:
    description: Analog Domain Power Supply

  dovdd-supply:
    description: I/O Domain Power Supply

  dvdd-supply:
    description: Digital Domain Power Supply

  reset-gpios:
    maxItems: 1
    description: Reset Pin GPIO Control (active low)

  enable-gpios:
    maxItems: 1
    description:
      Active-low enable pin. Labeled as 'PWDN' in the datasheet, but acts as
      an enable signal. During power rail ramp-up, the device remains powered
      down. Once power rails are stable, pulling this pin low powers on the
      device.

  port:
    description: MIPI CSI-2 transmitter port
    $ref: /schemas/graph.yaml#/$defs/port-base
    additionalProperties: false

    properties:
      endpoint:
        $ref: /schemas/media/video-interfaces.yaml#
        unevaluatedProperties: false

        properties:
          data-lanes:
            items:
              - const: 1
              - const: 2

        required:
          - data-lanes
          - link-frequencies

required:
  - compatible
  - reg
  - clocks
  - avdd-supply
  - dovdd-supply
  - dvdd-supply
  - port

additionalProperties: false

examples:
  - |
    #include <dt-bindings/gpio/gpio.h>

    i2c {
        #address-cells = <1>;
        #size-cells = <0>;

        camera-sensor@3c {
            compatible = "ovti,ov2735";
            reg = <0x3c>;
            clocks = <&ov2735_clk>;

            avdd-supply = <&ov2735_avdd>;
            dovdd-supply = <&ov2735_dovdd>;
            dvdd-supply = <&ov2735_dvdd>;

            reset-gpios = <&gpio1 6 GPIO_ACTIVE_LOW>;
            enable-gpios = <&gpio2 11 GPIO_ACTIVE_LOW>;

            port {
                cam_out: endpoint {
                    remote-endpoint = <&mipi_in_cam>;
                    data-lanes = <1 2>;
                    link-frequencies = /bits/ 64 <420000000>;
                };
            };
        };
    };
```
