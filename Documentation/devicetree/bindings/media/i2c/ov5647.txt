## Documentation/devicetree/bindings/media/i2c/ovti,og01a1b.yaml
```yaml
# SPDX-License-Identifier: (GPL-2.0-only OR BSD-2-Clause)
# Copyright (c) 2023-2024 Linaro Ltd.
%YAML 1.2
---
$id: http://devicetree.org/schemas/media/i2c/ovti,og01a1b.yaml#
$schema: http://devicetree.org/meta-schemas/core.yaml#

title: OmniVision OG01A1B Image Sensor

maintainers:
  - Vladimir Zapolskiy <vladimir.zapolskiy@linaro.org>

description:
  The OmniVision OG01A1B is black and white CMOS 1.3 Megapixel (1280x1024)
  image sensor controlled over an I2C-compatible SCCB bus.
  The sensor transmits images on a MIPI CSI-2 output interface with one or
  two data lanes.

allOf:
  - $ref: /schemas/media/video-interface-devices.yaml#

properties:
  compatible:
    const: ovti,og01a1b

  reg:
    maxItems: 1

  clocks:
    maxItems: 1

  reset-gpios:
    description: Active low GPIO connected to XSHUTDOWN pad of the sensor.
    maxItems: 1

  strobe-gpios:
    description: Input GPIO connected to strobe pad of the sensor.
    maxItems: 1

  avdd-supply:
    description: Analogue circuit voltage supply.

  dovdd-supply:
    description: I/O circuit voltage supply.

  dvdd-supply:
    description: Digital circuit voltage supply.

  port:
    $ref: /schemas/graph.yaml#/$defs/port-base
    additionalProperties: false
    description:
      Output port node, single endpoint describing the CSI-2 transmitter.

    properties:
      endpoint:
        $ref: /schemas/media/video-interfaces.yaml#
        unevaluatedProperties: false

        properties:
          data-lanes:
            minItems: 1
            maxItems: 2
            items:
              enum: [1, 2]

          link-frequencies: true

        required:
          - data-lanes
          - link-frequencies

required:
  - compatible
  - reg
  - clocks
  - port

unevaluatedProperties: false

examples:
  - |
    #include <dt-bindings/gpio/gpio.h>

    i2c {
        #address-cells = <1>;
        #size-cells = <0>;

        sensor@60 {
            compatible = "ovti,og01a1b";
            reg = <0x60>;
            clocks = <&clk 0>;
            reset-gpios = <&gpio 117 GPIO_ACTIVE_LOW>;
            avdd-supply = <&vreg_3v3>;
            dovdd-supply = <&vreg_1p8>;
            dvdd-supply = <&vreg_1p2>;

            port {
                og01a1b_ep: endpoint {
                    remote-endpoint = <&csiphy_ep>;
                    data-lanes = <1 2>;
                    link-frequencies = /bits/ 64 <500000000>;
                };
            };
        };
    };
...
```

## Documentation/devicetree/bindings/media/i2c/ovti,og0ve1b.yaml
```yaml
# SPDX-License-Identifier: (GPL-2.0-only OR BSD-2-Clause)
%YAML 1.2
---
$id: http://devicetree.org/schemas/media/i2c/ovti,og0ve1b.yaml#
$schema: http://devicetree.org/meta-schemas/core.yaml#

title: OmniVision OG0VE1B Image Sensor

description:
  OmniVision OG0VE1B image sensor is a low power consuming monochrome
  image sensor. The sensor is controlled over a serial camera control
  bus protocol (SCCB), the widest supported image size is 640x480 at
  120 frames per second rate, data output format is 8/10-bit RAW
  transferred over one-lane MIPI D-PHY at up to 800 Mbps.

maintainers:
  - Vladimir Zapolskiy <vladimir.zapolskiy@linaro.org>

allOf:
  - $ref: /schemas/media/video-interface-devices.yaml#

properties:
  compatible:
    const: ovti,og0ve1b

  reg:
    maxItems: 1

  clocks:
    description: XVCLK supply clock, 6MHz to 27MHz frequency.
    maxItems: 1

  reset-gpios:
    description: Active low GPIO connected to XSHUTDOWN pad of the sensor.
    maxItems: 1

  strobe-gpios:
    description: Input GPIO connected to strobe pad of the sensor.
    maxItems: 1

  avdd-supply:
    description: Analog voltage supply, 2.6 to 3.0 volts.

  dovdd-supply:
    description: Digital I/O voltage supply, 1.7 to 3.0 volts.

  dvdd-supply:
    description: Digital core voltage supply.

  port:
    $ref: /schemas/graph.yaml#/$defs/port-base
    additionalProperties: false

    properties:
      endpoint:
        $ref: /schemas/media/video-interfaces.yaml#
        unevaluatedProperties: false

        required:
          - link-frequencies

required:
  - compatible
  - reg
  - port

unevaluatedProperties: false

examples:
  - |
      #include <dt-bindings/gpio/gpio.h>

      i2c {
          #address-cells = <1>;
          #size-cells = <0>;

          camera@3e {
              compatible = "ovti,og0ve1b";
              reg = <0x3e>;
              clocks = <&camera_clk 0>;
              assigned-clocks = <&camera_clk 0>;
              assigned-clock-rates = <24000000>;
              reset-gpios = <&gpio1 10 GPIO_ACTIVE_LOW>;
              avdd-supply = <&vreg_2p8>;
              dovdd-supply = <&vreg_1p8>;
              dvdd-supply = <&vreg_1p2>;

              port {
                  endpoint {
                      link-frequencies = /bits/ 64 <500000000>;
                      remote-endpoint = <&mipi_csi2_ep>;
                  };
              };
          };
      };

...
```

## Documentation/devicetree/bindings/media/i2c/ovti,os05b10.yaml
```yaml
# SPDX-License-Identifier: (GPL-2.0 OR BSD-2-Clause)
%YAML 1.2
---
$id: http://devicetree.org/schemas/media/i2c/ovti,os05b10.yaml#
$schema: http://devicetree.org/meta-schemas/core.yaml#

title: OmniVision OS05B10 Image Sensor

maintainers:
  - Elgin Perumbilly <elgin.perumbilly@siliconsignals.io>

description:
  The OmniVision OS05B10 is a 5MP (2592x1944) color CMOS image sensor controlled
  through an I2C-compatible SCCB bus. it outputs RAW10/RAW12 format and uses a
  1/2.78" optical format.

properties:
  compatible:
    const: ovti,os05b10

  reg:
    maxItems: 1

  clocks:
    items:
      - description: XCLK clock

  avdd-supply:
    description: Analog Domain Power Supply (2.8v)

  dovdd-supply:
    description: I/O Domain Power Supply (1.8v)

  dvdd-supply:
    description: Digital Domain Power Supply (1.2v)

  reset-gpios:
    maxItems: 1
    description: Reset Pin GPIO Control (active low)

  port:
    description: MIPI CSI-2 transmitter port
    $ref: /schemas/graph.yaml#/$defs/port-base
    additionalProperties: false

    properties:
      endpoint:
        $ref: /schemas/media/video-interfaces.yaml#
        unevaluatedProperties: false

        properties:
          data-lanes:
            oneOf:
              - items:
                  - const: 1
                  - const: 2
                  - const: 3
                  - const: 4
              - items:
                  - const: 1
                  - const: 2
        required:
          - data-lanes
          - link-frequencies

required:
  - compatible
  - reg
  - clocks
  - avdd-supply
  - dovdd-supply
  - dvdd-supply
  - port

additionalProperties: false

examples:
  - |
    #include <dt-bindings/gpio/gpio.h>

    i2c {
        #address-cells = <1>;
        #size-cells = <0>;

        camera-sensor@36 {
            compatible = "ovti,os05b10";
            reg = <0x36>;
            clocks = <&os05b10_clk>;
            reset-gpios = <&gpio1 7 GPIO_ACTIVE_LOW>;

            avdd-supply = <&os05b10_avdd_2v8>;
            dvdd-supply = <&os05b10_dvdd_1v2>;
            dovdd-supply = <&os05b10_dovdd_1v8>;

            port {
                cam_out: endpoint {
                    remote-endpoint = <&mipi_in_cam>;
                    data-lanes = <1 2 3 4>;
                    link-frequencies = /bits/ 64 <600000000>;
                };
            };
        };
    };
```

## Documentation/devicetree/bindings/media/i2c/ovti,ov02a10.yaml
```yaml
# SPDX-License-Identifier: (GPL-2.0 OR BSD-2-Clause)
# Copyright (c) 2020 MediaTek Inc.
%YAML 1.2
---
$id: http://devicetree.org/schemas/media/i2c/ovti,ov02a10.yaml#
$schema: http://devicetree.org/meta-schemas/core.yaml#

title: Omnivision OV02A10 CMOS Sensor

maintainers:
  - Dongchun Zhu <dongchun.zhu@mediatek.com>

description: |-
  The Omnivision OV02A10 is a low-cost, high performance, 1/5-inch, 2 megapixel
  image sensor, which is the latest production derived from Omnivision's CMOS
  image sensor technology. Ihis chip supports high frame rate speeds up to 30fps
  @ 1600x1200 (UXGA) resolution transferred over a 1-lane MIPI interface. The
  sensor output is available via CSI-2 serial data output.

allOf:
  - $ref: /schemas/media/video-interface-devices.yaml#

properties:
  compatible:
    const: ovti,ov02a10

  reg:
    maxItems: 1

  clocks:
    maxItems: 1

  clock-names:
    description:
      External clock for the sensor.
    items:
      - const: eclk

  clock-frequency:
    description:
      Frequency of the eclk clock in Hz.

  dovdd-supply:
    description:
      Definition of the regulator used as Digital I/O voltage supply.

  avdd-supply:
    description:
      Definition of the regulator used as Analog voltage supply.

  dvdd-supply:
    description:
      Definition of the regulator used as Digital core voltage supply.

  powerdown-gpios:
    description:
      Must be the device tree identifier of the GPIO connected to the
      PD_PAD pin. This pin is used to place the OV02A10 into standby mode
      or shutdown mode. As the line needs to be high for the powerdown mode
      to be active, it should be marked GPIO_ACTIVE_HIGH.
    maxItems: 1

  reset-gpios:
    description:
      Must be the device tree identifier of the GPIO connected to the
      RST_PD pin. If specified, it will be asserted during driver probe.
      As the line needs to be low for the reset to be active, it should be
      marked GPIO_ACTIVE_LOW.
    maxItems: 1

  port:
    $ref: /schemas/graph.yaml#/$defs/port-base
    additionalProperties: false
    description:
      Output port node, single endpoint describing the CSI-2 transmitter.

    properties:
      endpoint:
        $ref: /schemas/media/video-interfaces.yaml#
        unevaluatedProperties: false

        properties:
          link-frequencies: true
          ovti,mipi-clock-voltage:
            $ref: /schemas/types.yaml#/definitions/uint32
            description:
              Definition of MIPI clock voltage unit. This entry corresponds to
              the link speed defined by the 'link-frequencies' property.
              If present, the value shall be in the range of 0-4.
            default: 4

        required:
          - link-frequencies

    required:
      - endpoint

required:
  - compatible
  - reg
  - clocks
  - clock-names
  - clock-frequency
  - dovdd-supply
  - avdd-supply
  - dvdd-supply
  - powerdown-gpios
  - reset-gpios
  - port

unevaluatedProperties: false

examples:
  - |
    #include <dt-bindings/gpio/gpio.h>

    i2c {
        #address-cells = <1>;
        #size-cells = <0>;

        ov02a10: camera-sensor@3d {
            compatible = "ovti,ov02a10";
            reg = <0x3d>;

            powerdown-gpios = <&pio 107 GPIO_ACTIVE_HIGH>;
            reset-gpios = <&pio 109 GPIO_ACTIVE_LOW>;

            clocks = <&ov02a10_clk>;
            clock-names = "eclk";
            clock-frequency = <24000000>;

            rotation = <180>;

            dovdd-supply = <&ov02a10_dovdd>;
            avdd-supply = <&ov02a10_avdd>;
            dvdd-supply = <&ov02a10_dvdd>;

            port {
                wcam_out: endpoint {
                    link-frequencies = /bits/ 64 <390000000>;
                    ovti,mipi-clock-voltage = <3>;
                    remote-endpoint = <&mipi_in_wcam>;
                };
            };
        };
    };

...
```

## Documentation/devicetree/bindings/media/i2c/ovti,ov02e10.yaml
```yaml
# SPDX-License-Identifier: (GPL-2.0 OR BSD-2-Clause)
# Copyright (c) 2025 Linaro Ltd.
%YAML 1.2
---
$id: http://devicetree.org/schemas/media/i2c/ovti,ov02e10.yaml#
$schema: http://devicetree.org/meta-schemas/core.yaml#

title: Omnivision OV02E10 CMOS Sensor

maintainers:
  - Bryan O'Donoghue <bryan.odonoghue@linaro.org>

description: |
  The Omnivision OV02E10 and OV02C10 sensors are 2 megapixel, CMOS image sensors which support:
  - Automatic black level calibration (ABLC)
  - Programmable controls for frame rate, mirror and flip, binning, cropping
    and windowing
  - OVO2C10
    - 10 bit RAW Bayer 1920x1080 60 fps 2-lane @ 800 Mbps/lane
    - 10 bit RAW Bayer 1920x1080 60 fps 1-lane @ 1500 Mbps/lane
    - 10 bit RAW Bayer 1280x720 60 fps cropped 1-lane @ 960 Mbps/lane
    - 10 bit RGB/BW 640x480 60 fps bin2 or skip2 1-lane @ 800 Mbps/lane
    - 10 bit RGB/BW 480x270 60 fps bin4 or skip4 1-lane @ 800 Mbps/lane
  - OV02E10
    - 10 bit RAW Bayer 1920x1088 60 fps 2-lane @ 720 Mbps/lane
    - 10 bit RAW Bayer 1280x1080 60 fps 2-lane @ 720 Mbps/lane
    - 10 bit Quad Bayer 960x540 60 fps 2-lane 360 Mbps/lane
    - 8 bit Quad Bayer 480x270 1/3/5/10 fps sub2 288 Mbps/lane
    - 8 bit Quad Bayer 232x132 1/3/5/10 fps sub4 144 Mbps/lane
  - Dynamic defect pixel cancellation
  - Standard SCCB command interface

allOf:
  - $ref: /schemas/media/video-interface-devices.yaml#

properties:
  compatible:
    enum:
      - ovti,ov02c10
      - ovti,ov02e10

  reg:
    maxItems: 1

  clocks:
    maxItems: 1

  avdd-supply:
    description: Analogue circuit voltage supply.

  dovdd-supply:
    description: I/O circuit voltage supply.

  dvdd-supply:
    description: Digital circuit voltage supply.

  reset-gpios:
    description: Active low GPIO connected to XSHUTDOWN pad of the sensor.

  port:
    $ref: /schemas/graph.yaml#/$defs/port-base
    additionalProperties: false

    properties:
      endpoint:
        $ref: /schemas/media/video-interfaces.yaml#
        additionalProperties: false

        properties:
          data-lanes:
            items:
              - const: 1
              - const: 2
          link-frequencies: true
          remote-endpoint: true

        required:
          - data-lanes
          - link-frequencies
          - remote-endpoint

required:
  - compatible
  - reg
  - clocks
  - port

unevaluatedProperties: false

examples:
  - |
    #include <dt-bindings/gpio/gpio.h>

    i2c {
        #address-cells = <1>;
        #size-cells = <0>;

        ov02e10: camera@10 {
            compatible = "ovti,ov02e10";
            reg = <0x10>;

            reset-gpios = <&tlmm 237 GPIO_ACTIVE_LOW>;
            pinctrl-names = "default";
            pinctrl-0 = <&cam_rgb_defaultt>;

            clocks = <&ov02e10_clk>;

            assigned-clocks = <&ov02e10_clk>;
            assigned-clock-parents = <&ov02e10_clk_parent>;
            assigned-clock-rates = <19200000>;

            avdd-supply = <&vreg_l7b_2p8>;
            dvdd-supply = <&vreg_l7b_1p8>;
            dovdd-supply = <&vreg_l3m_1p8>;

            port {
                ov02e10_ep: endpoint {
                    remote-endpoint = <&csiphy4_ep>;
                    data-lanes = <1 2>;
                    link-frequencies = /bits/ 64 <400000000>;
                };
            };
        };

        ov02c10: camera@36 {
            compatible = "ovti,ov02c10";
            reg = <0x36>;

            reset-gpios = <&tlmm 237 GPIO_ACTIVE_LOW>;
            pinctrl-names = "default";
            pinctrl-0 = <&cam_rgb_defaultt>;

            clocks = <&ov02c10_clk>;

            assigned-clocks = <&ov02c10_clk>;
            assigned-clock-parents = <&ov02c10_clk_parent>;
            assigned-clock-rates = <19200000>;

            avdd-supply = <&vreg_l7b_2p8>;
            dvdd-supply = <&vreg_l7b_1p8>;
            dovdd-supply = <&vreg_l3m_1p8>;

            port {
                ov02c10_ep: endpoint {
                    remote-endpoint = <&csiphy4_ep>;
                    data-lanes = <1 2>;
                    link-frequencies = /bits/ 64 <400000000>;
                };
            };
        };
    };
...
```
