## Documentation/devicetree/bindings/media/i2c/ov5647.txt
```
Omnivision OV5647 raw image sensor
---------------------------------

OV5647 is a raw image sensor with MIPI CSI-2 and CCP2 image data interfaces
and CCI (I2C compatible) control bus.

Required properties:

- compatible		: "ovti,ov5647".
- reg			: I2C slave address of the sensor.
- clocks		: Reference to the xclk clock.

The common video interfaces bindings (see video-interfaces.txt) should be
used to specify link to the image data receiver. The OV5647 device
node should contain one 'port' child node with an 'endpoint' subnode.

Endpoint node mandatory properties:

- remote-endpoint: A phandle to the bus receiver's endpoint node.

Example:

	i2c@2000 {
		...
		ov: camera@36 {
			compatible = "ovti,ov5647";
			reg = <0x36>;
			clocks = <&camera_clk>;
			port {
				camera_1: endpoint {
					remote-endpoint = <&csi1_ep1>;
				};
			};
		};
	};
```

## Documentation/devicetree/bindings/media/i2c/ov5647.yaml
```yaml
# SPDX-License-Identifier: (GPL-2.0-only OR BSD-2-Clause)
%YAML 1.2
---
$id: http://devicetree.org/schemas/media/i2c/ov5647.yaml#
$schema: http://devicetree.org/meta-schemas/core.yaml#

title: Omnivision OV5647 raw image sensor

maintainers:
  - Dave Stevenson <dave.stevenson@raspberrypi.com>
  - Jacopo Mondi <jacopo@jmondi.org>

description: |-
  The OV5647 is a raw image sensor with MIPI CSI-2 and CCP2 image data
  interfaces and CCI (I2C compatible) control bus.

properties:
  compatible:
    const: ovti,ov5647

  reg:
    description: I2C device address.
    maxItems: 1

  clocks:
    description: Reference to the xclk clock.
    maxItems: 1

  pwdn-gpios:
    description: Reference to the GPIO connected to the pwdn pin. Active high.
    maxItems: 1

  port:
    type: object
    description: |-
      Should contain one endpoint sub-node used to model connection to the
      video receiver according to the specification defined in
      Documentation/devicetree/bindings/media/video-interfaces.txt.

    properties:
      endpoint:
        type: object

        properties:
          remote-endpoint:
            description: |-
              phandle to the video receiver input port.

          clock-noncontinuous:
            type: boolean
            description: |-
              Set to true to allow MIPI CSI-2 non-continuous clock operations.

        additionalProperties: false

    additionalProperties: false

required:
  - compatible
  - reg
  - clocks
  - port

additionalProperties: false

examples:
  - |
    #include <dt-bindings/gpio/gpio.h>

    i2c {
        #address-cells = <1>;
        #size-cells = <0>;

        ov5647: camera@36 {
            compatible = "ovti,ov5647";
            reg = <0x36>;
            clocks = <&camera_clk>;
            pwdn-gpios = <&pioE 29 GPIO_ACTIVE_HIGH>;

            port {
                camera_out: endpoint {
                    remote-endpoint = <&csi1_ep1>;
                };
            };
        };
    };

...
```

## Documentation/devicetree/bindings/media/i2c/ov5695.txt
```
* Omnivision OV5695 MIPI CSI-2 sensor

Required Properties:
- compatible: shall be "ovti,ov5695"
- clocks: reference to the xvclk input clock
- clock-names: shall be "xvclk"
- avdd-supply: Analog voltage supply, 2.8 volts
- dovdd-supply: Digital I/O voltage supply, 1.8 volts
- dvdd-supply: Digital core voltage supply, 1.2 volts
- reset-gpios: Low active reset gpio

The device node shall contain one 'port' child node with an
'endpoint' subnode for its digital output video port,
in accordance with the video interface bindings defined in
Documentation/devicetree/bindings/media/video-interfaces.txt.
The endpoint optional property 'data-lanes' shall be "<1 2>".

Example:
&i2c7 {
	ov5695: camera-sensor@36 {
		compatible = "ovti,ov5695";
		reg = <0x36>;
		pinctrl-names = "default";
		pinctrl-0 = <&clk_24m_cam>;

		clocks = <&cru SCLK_TESTCLKOUT1>;
		clock-names = "xvclk";

		avdd-supply = <&pp2800_cam>;
		dovdd-supply = <&pp1800>;
		dvdd-supply = <&pp1250_cam>;
		reset-gpios = <&gpio2 5 GPIO_ACTIVE_LOW>;

		port {
			wcam_out: endpoint {
				remote-endpoint = <&mipi_in_wcam>;
				data-lanes = <1 2>;
			};
		};
	};
};
```

## Documentation/devicetree/bindings/media/i2c/ov7251.txt
```
* Omnivision 1/7.5-Inch B&W VGA CMOS Digital Image Sensor

The Omnivision OV7251 is a 1/7.5-Inch CMOS active pixel digital image sensor
with an active array size of 640H x 480V. It is programmable through a serial
I2C interface.

Required Properties:
- compatible: Value should be "ovti,ov7251".
- clocks: Reference to the xclk clock.
- clock-names: Should be "xclk".
- clock-frequency: Frequency of the xclk clock.
- enable-gpios: Chip enable GPIO. Polarity is GPIO_ACTIVE_HIGH. This corresponds
  to the hardware pin XSHUTDOWN which is physically active low.
- vdddo-supply: Chip digital IO regulator.
- vdda-supply: Chip analog regulator.
- vddd-supply: Chip digital core regulator.

The device node shall contain one 'port' child node with a single 'endpoint'
subnode for its digital output video port, in accordance with the video
interface bindings defined in
Documentation/devicetree/bindings/media/video-interfaces.txt.

Example:

	&i2c1 {
		...

		ov7251: camera-sensor@60 {
			compatible = "ovti,ov7251";
			reg = <0x60>;

			enable-gpios = <&gpio1 6 GPIO_ACTIVE_HIGH>;
			pinctrl-names = "default";
			pinctrl-0 = <&camera_bw_default>;

			clocks = <&clks 200>;
			clock-names = "xclk";
			clock-frequency = <24000000>;

			vdddo-supply = <&camera_dovdd_1v8>;
			vdda-supply = <&camera_avdd_2v8>;
			vddd-supply = <&camera_dvdd_1v2>;

			port {
				ov7251_ep: endpoint {
					clock-lanes = <1>;
					data-lanes = <0>;
					remote-endpoint = <&csi0_ep>;
				};
			};
		};
	};
```

## Documentation/devicetree/bindings/media/i2c/ov7670.txt
```
* Omnivision OV7670 CMOS sensor

The Omnivision OV7670 sensor supports multiple resolutions output, such as
CIF, SVGA, UXGA. It also can support the YUV422/420, RGB565/555 or raw RGB
output formats.

Required Properties:
- compatible: should be "ovti,ov7670"
- clocks: reference to the xclk input clock.
- clock-names: should be "xclk".

Required Endpoint Properties:
- hsync-active: active state of the HSYNC signal, 0/1 for LOW/HIGH respectively.
- vsync-active: active state of the VSYNC signal, 0/1 for LOW/HIGH respectively.

Optional Properties:
- reset-gpios: reference to the GPIO connected to the resetb pin, if any.
  Active is low.
- powerdown-gpios: reference to the GPIO connected to the pwdn pin, if any.
  Active is high.
- ov7670,pclk-hb-disable: a boolean property to suppress pixel clock output
  signal during horizontal blankings.

The device node must contain one 'port' child node with one 'endpoint' child
sub-node for its digital output video port, in accordance with the video
interface bindings defined in:
Documentation/devicetree/bindings/media/video-interfaces.txt.

Example:

	i2c1: i2c@f0018000 {
		ov7670: camera@21 {
			compatible = "ovti,ov7670";
			reg = <0x21>;
			pinctrl-names = "default";
			pinctrl-0 = <&pinctrl_pck0_as_isi_mck &pinctrl_sensor_power &pinctrl_sensor_reset>;
			reset-gpios = <&pioE 11 GPIO_ACTIVE_LOW>;
			powerdown-gpios = <&pioE 13 GPIO_ACTIVE_HIGH>;
			clocks = <&pck0>;
			clock-names = "xclk";
			assigned-clocks = <&pck0>;
			assigned-clock-rates = <25000000>;

			ov7670,pclk-hb-disable;

			port {
				ov7670_0: endpoint {
					hsync-active = <0>;
					vsync-active = <0>;

					remote-endpoint = <&isi_0>;
				};
			};
		};
	};
```

## Documentation/devicetree/bindings/media/i2c/ov772x.txt
```
* Omnivision OV7720/OV7725 CMOS sensor

The Omnivision OV7720/OV7725 sensor supports multiple resolutions output,
such as VGA, QVGA, and any size scaling down from CIF to 40x30. It also can
support the YUV422, RGB565/555/444, GRB422 or raw RGB output formats.

Required Properties:
- compatible: shall be one of
	"ovti,ov7720"
	"ovti,ov7725"
- clocks: reference to the xclk input clock.

Optional Properties:
- reset-gpios: reference to the GPIO connected to the RSTB pin which is
  active low, if any.
- powerdown-gpios: reference to the GPIO connected to the PWDN pin which is
  active high, if any.

The device node shall contain one 'port' child node with one child 'endpoint'
subnode for its digital output video port, in accordance with the video
interface bindings defined in Documentation/devicetree/bindings/media/
video-interfaces.txt.

Example:

&i2c0 {
	ov772x: camera@21 {
		compatible = "ovti,ov7725";
		reg = <0x21>;
		reset-gpios = <&axi_gpio_0 0 GPIO_ACTIVE_LOW>;
		powerdown-gpios = <&axi_gpio_0 1 GPIO_ACTIVE_LOW>;
		clocks = <&xclk>;

		port {
			ov772x_0: endpoint {
				remote-endpoint = <&vcap1_in0>;
			};
		};
	};
};
```

## Documentation/devicetree/bindings/media/i2c/ov7740.txt
```
* Omnivision OV7740 CMOS image sensor

The Omnivision OV7740 image sensor supports multiple output image
size, such as VGA, and QVGA, CIF and any size smaller. It also
supports the RAW RGB and YUV output formats.

The common video interfaces bindings (see video-interfaces.txt) should
be used to specify link to the image data receiver. The OV7740 device
node should contain one 'port' child node with an 'endpoint' subnode.

Required Properties:
- compatible:	"ovti,ov7740".
- reg:		I2C slave address of the sensor.
- clocks:	Reference to the xvclk input clock.
- clock-names:	"xvclk".

Optional Properties:
- reset-gpios: Rreference to the GPIO connected to the reset_b pin,
  if any. Active low with pull-ip resistor.
- powerdown-gpios: Reference to the GPIO connected to the pwdn pin,
  if any. Active high with pull-down resistor.

Endpoint node mandatory properties:
- remote-endpoint: A phandle to the bus receiver's endpoint node.

Example:

	i2c1: i2c@fc028000 {
		ov7740: camera@21 {
			compatible = "ovti,ov7740";
			reg = <0x21>;
			pinctrl-names = "default";
			pinctrl-0 = <&pinctrl_sensor_power &pinctrl_sensor_reset>;
			clocks = <&isc>;
			clock-names = "xvclk";
			assigned-clocks = <&isc>;
			assigned-clock-rates = <24000000>;
			reset-gpios = <&pioA 43 GPIO_ACTIVE_LOW>;
			powerdown-gpios = <&pioA 44 GPIO_ACTIVE_HIGH>;

			port {
				ov7740_0: endpoint {
					remote-endpoint = <&isc_0>;
				};
			};
		};
	};
```

## Documentation/devicetree/bindings/media/i2c/ov7750.txt
```
* Omnivision OV7750 MIPI CSI-2 sensor

Required Properties:
- compatible: should be "ovti,ov7750"
- clocks: reference to the 24M xvclk input clock.
- clock-names: should be "xvclk".
- dovdd-supply: Digital I/O voltage supply, 1.8 volts
- avdd-supply: Analog voltage supply, 2.8 volts
- dvdd-supply: Digital core voltage supply, 1.2 volts
- reset-gpios: Low active reset gpio

The device node must contain one 'port' child node for its digital output
video port, in accordance with the video interface bindings defined in
Documentation/devicetree/bindings/media/video-interfaces.txt.

Example:

	i2c0@1c22000 {
		...
		...
		ov7750: ov7750@60 {
			compatible = "ovti,ov7750";
			reg = <0x60>;

			clocks = <&cru SCLK_CIF_OUT>;
			clock-names = "xvclk";

			avdd-supply = <&vcc2v8_dvp>;
			dovdd-supply = <&vcc1v8_dvp>;
			dvdd-supply = <&vcc1v8_dvp>;

			pwdn-gpios = <&gpio2 14 GPIO_ACTIVE_HIGH>;

			port {
				ucam_out: endpoint {
					remote-endpoint = <&mipi_in_ucam>;
					data-lanes = <1>;
				};
			};
		};
		...
	};
```

## Documentation/devicetree/bindings/media/i2c/ov8856.yaml
```yaml
# SPDX-License-Identifier: (GPL-2.0 OR BSD-2-Clause)
# Copyright (c) 2019 MediaTek Inc.
%YAML 1.2
---
$id: http://devicetree.org/schemas/media/i2c/ov8856.yaml#
$schema: http://devicetree.org/meta-schemas/core.yaml#

title: Omnivision OV8856 CMOS Sensor

maintainers:
  - Sakari Ailus <sakari.ailus@linux.intel.com>

description: |-
  The Omnivision OV8856 is a high performance, 1/4-inch, 8 megapixel, CMOS
  image sensor that delivers 3264x2448 at 30fps. It provides full-frame,
  sub-sampled, and windowed 10-bit MIPI images in various formats via the
  Serial Camera Control Bus (SCCB) interface. This chip is programmable
  through I2C and two-wire SCCB. The sensor output is available via CSI-2
  serial data output (up to 4-lane).

properties:
  compatible:
    const: ovti,ov8856

  reg:
    maxItems: 1

  clocks:
    maxItems: 1

  clock-names:
    description:
      Input clock for the sensor.
    items:
      - const: xvclk

  clock-frequency:
    description:
      Frequency of the xvclk clock in Hertz.

  dovdd-supply:
    description:
      Definition of the regulator used as interface power supply.

  avdd-supply:
    description:
      Definition of the regulator used as analog power supply.

  dvdd-supply:
    description:
      Definition of the regulator used as digital power supply.

  reset-gpios:
    description:
      The phandle and specifier for the GPIO that controls sensor reset.
      This corresponds to the hardware pin XSHUTDOWN which is physically
      active low.

  port:
    $ref: /schemas/graph.yaml#/$defs/port-base
    additionalProperties: false

    properties:
      endpoint:
        $ref: /schemas/media/video-interfaces.yaml#
        unevaluatedProperties: false

        properties:
          data-lanes:
            oneOf:
              - items:
                  - const: 1
              - items:
                  - const: 1
                  - const: 2
              - items:
                  - const: 1
                  - const: 2
                  - const: 3
                  - const: 4

        required:
          - link-frequencies

required:
  - compatible
  - reg
  - clocks
  - clock-names
  - clock-frequency
  - dovdd-supply
  - avdd-supply
  - dvdd-supply
  - reset-gpios
  - port

additionalProperties: false

examples:
  - |
    #include <dt-bindings/gpio/gpio.h>

    i2c {
        #address-cells = <1>;
        #size-cells = <0>;

        ov8856: camera@10 {
            compatible = "ovti,ov8856";
            reg = <0x10>;

            reset-gpios = <&pio 111 GPIO_ACTIVE_LOW>;
            pinctrl-names = "default";
            pinctrl-0 = <&clk_24m_cam>;

            clocks = <&cam_osc>;
            clock-names = "xvclk";
            clock-frequency = <19200000>;

            avdd-supply = <&mt6358_vcama2_reg>;
            dvdd-supply = <&mt6358_vcamd_reg>;
            dovdd-supply = <&mt6358_vcamio_reg>;

            port {
                wcam_out: endpoint {
                    remote-endpoint = <&mipi_in_wcam>;
                    data-lanes = <1 2 3 4>;
                    link-frequencies = /bits/ 64 <360000000>;
                };
            };
        };
    };
...
```

## Documentation/devicetree/bindings/media/i2c/ov9650.txt
```
* Omnivision OV9650/OV9652 CMOS sensor

Required Properties:
- compatible: shall be one of
	"ovti,ov9650"
	"ovti,ov9652"
- clocks: reference to the xvclk input clock.

Optional Properties:
- reset-gpios: reference to the GPIO connected to the resetb pin, if any.
  Active is high.
- powerdown-gpios: reference to the GPIO connected to the pwdn pin, if any.
  Active is high.

The device node shall contain one 'port' child node with one child 'endpoint'
subnode for its digital output video port, in accordance with the video
interface bindings defined in Documentation/devicetree/bindings/media/
video-interfaces.txt.

Example:

&i2c0 {
	ov9650: camera@30 {
		compatible = "ovti,ov9650";
		reg = <0x30>;
		reset-gpios = <&axi_gpio_0 0 GPIO_ACTIVE_HIGH>;
		powerdown-gpios = <&axi_gpio_0 1 GPIO_ACTIVE_HIGH>;
		clocks = <&xclk>;

		port {
			ov9650_0: endpoint {
				remote-endpoint = <&vcap1_in0>;
			};
		};
	};
};
```
