## Documentation/devicetree/bindings/media/i2c/ovti,ov4689.yaml
```yaml
# SPDX-License-Identifier: (GPL-2.0 OR BSD-2-Clause)
%YAML 1.2
---
$id: http://devicetree.org/schemas/media/i2c/ovti,ov4689.yaml#
$schema: http://devicetree.org/meta-schemas/core.yaml#

title: Omnivision OV4689 CMOS

maintainers:
  - Mikhail Rudenko <mike.rudenko@gmail.com>

description: |
  The Omnivision OV4689 is a high performance, 1/3-inch, 4 megapixel
  image sensor. Ihis chip supports high frame rate speeds up to 90 fps
  at 2688x1520 resolution. It is programmable through an I2C
  interface, and sensor output is sent via 1/2/4 lane MIPI CSI-2
  connection.

allOf:
  - $ref: /schemas/media/video-interface-devices.yaml#

properties:
  compatible:
    const: ovti,ov4689

  reg:
    maxItems: 1

  clocks:
    description:
      External clock (XVCLK) for the sensor, 6-64 MHz
    maxItems: 1

  dovdd-supply:
    description:
      Digital I/O voltage supply, 1.7-3.0 V

  avdd-supply:
    description:
      Analog voltage supply, 2.6-3.0 V

  dvdd-supply:
    description:
      Digital core voltage supply, 1.1-1.3 V

  powerdown-gpios:
    description:
      GPIO connected to the powerdown pin (active low)

  reset-gpios:
    maxItems: 1
    description:
      GPIO connected to the reset pin (active low)

  orientation: true

  rotation: true

  port:
    $ref: /schemas/graph.yaml#/$defs/port-base
    additionalProperties: false
    description:
      Output port node, single endpoint describing the CSI-2 transmitter

    properties:
      endpoint:
        $ref: /schemas/media/video-interfaces.yaml#
        unevaluatedProperties: false

        properties:
          data-lanes:
            oneOf:
              - items:
                  - const: 1
                  - const: 2
                  - const: 3
                  - const: 4
              - items:
                  - const: 1
                  - const: 2
              - items:
                  - const: 1
          link-frequencies: true

        required:
          - data-lanes
          - link-frequencies

required:
  - compatible
  - reg
  - clocks
  - dovdd-supply
  - avdd-supply
  - dvdd-supply
  - port

additionalProperties: false

examples:
  - |
    #include <dt-bindings/gpio/gpio.h>

    i2c {
        #address-cells = <1>;
        #size-cells = <0>;

        ov4689: camera@36 {
            compatible = "ovti,ov4689";
            reg = <0x36>;

            clocks = <&ov4689_clk>;

            avdd-supply = <&ov4689_avdd>;
            dovdd-supply = <&ov4689_dovdd>;
            dvdd-supply = <&ov4689_dvdd>;

            powerdown-gpios = <&pio 107 GPIO_ACTIVE_LOW>;
            reset-gpios = <&pio 109 GPIO_ACTIVE_LOW>;

            orientation = <2>;
            rotation = <0>;

            port {
                wcam_out: endpoint {
                    remote-endpoint = <&mipi_in_wcam>;
                    data-lanes = <1 2 3 4>;
                    link-frequencies = /bits/ 64 <504000000>;
                };
            };
        };
    };

...
```

## Documentation/devicetree/bindings/media/i2c/ovti,ov5640.yaml
```yaml
# SPDX-License-Identifier: GPL-2.0
%YAML 1.2
---
$id: http://devicetree.org/schemas/media/i2c/ovti,ov5640.yaml#
$schema: http://devicetree.org/meta-schemas/core.yaml#

title: OmniVision OV5640 Image Sensor

maintainers:
  - Steve Longerbeam <slongerbeam@gmail.com>

allOf:
  - $ref: /schemas/media/video-interface-devices.yaml#

properties:
  compatible:
    const: ovti,ov5640

  reg:
    maxItems: 1

  clocks:
    description: XCLK Input Clock

  clock-names:
    const: xclk

  AVDD-supply:
    description: Analog voltage supply, 2.8 volts

  DVDD-supply:
    description: Digital core voltage supply, 1.5 volts

  DOVDD-supply:
    description: Digital I/O voltage supply, 1.8 volts

  powerdown-gpios:
    maxItems: 1
    description: >
      Reference to the GPIO connected to the powerdown pin, if any.

  reset-gpios:
    maxItems: 1
    description: >
      Reference to the GPIO connected to the reset pin, if any.

  port:
    description: Digital Output Port
    $ref: /schemas/graph.yaml#/$defs/port-base
    additionalProperties: false

    properties:
      endpoint:
        $ref: /schemas/media/video-interfaces.yaml#
        unevaluatedProperties: false

        properties:
          clock-lanes:
            const: 0

          data-lanes:
            minItems: 1
            maxItems: 2
            items:
              enum: [1, 2]

          bus-width:
            enum: [8, 10]

          data-shift:
            enum: [0, 2]

required:
  - compatible
  - reg
  - clocks
  - clock-names
  - AVDD-supply
  - DVDD-supply
  - DOVDD-supply
  - port

unevaluatedProperties: false

examples:
  - |
      #include <dt-bindings/clock/imx6qdl-clock.h>
      #include <dt-bindings/gpio/gpio.h>

      i2c {
          #address-cells = <1>;
          #size-cells = <0>;

          camera@3c {
              compatible = "ovti,ov5640";
              pinctrl-names = "default";
              pinctrl-0 = <&pinctrl_ov5640>;
              reg = <0x3c>;
              clocks = <&clks IMX6QDL_CLK_CKO>;
              clock-names = "xclk";
              DOVDD-supply = <&vgen4_reg>; /* 1.8v */
              AVDD-supply = <&vgen3_reg>;  /* 2.8v */
              DVDD-supply = <&vgen2_reg>;  /* 1.5v */
              powerdown-gpios = <&gpio1 19 GPIO_ACTIVE_HIGH>;
              reset-gpios = <&gpio1 20 GPIO_ACTIVE_LOW>;
              rotation = <180>;

              port {
                  /* MIPI CSI-2 bus endpoint */
                  ov5640_to_mipi_csi2: endpoint {
                      remote-endpoint = <&mipi_csi2_from_ov5640>;
                      clock-lanes = <0>;
                      data-lanes = <1 2>;
                  };
              };
          };
      };

  - |
      i2c {
          #address-cells = <1>;
          #size-cells = <0>;

          camera@3c {
              compatible = "ovti,ov5640";
              pinctrl-names = "default";
              pinctrl-0 = <&pinctrl_ov5640>;
              reg = <0x3c>;
              clocks = <&clk_ext_camera>;
              clock-names = "xclk";
              DOVDD-supply = <&vgen4_reg>; /* 1.8v */
              AVDD-supply = <&vgen3_reg>;  /* 2.8v */
              DVDD-supply = <&vgen2_reg>;  /* 1.5v */

              port {
                  /* Parallel bus endpoint */
                  ov5640_to_parallel: endpoint {
                      remote-endpoint = <&parallel_from_ov5640>;
                      bus-width = <8>;
                      data-shift = <2>; /* lines 9:2 are used */
                      hsync-active = <0>;
                      vsync-active = <0>;
                      pclk-sample = <1>;
                  };
              };
          };
      };

...
```

## Documentation/devicetree/bindings/media/i2c/ovti,ov5642.yaml
```yaml
# SPDX-License-Identifier: GPL-2.0-only OR BSD-2-Clause
%YAML 1.2
---
$id: http://devicetree.org/schemas/media/i2c/ovti,ov5642.yaml#
$schema: http://devicetree.org/meta-schemas/core.yaml#

title: OmniVision OV5642 Image Sensor

maintainers:
  - Fabio Estevam <festevam@gmail.com>

allOf:
  - $ref: /schemas/media/video-interface-devices.yaml#

properties:
  compatible:
    const: ovti,ov5642

  reg:
    maxItems: 1

  clocks:
    description: XCLK Input Clock

  AVDD-supply:
    description: Analog voltage supply, 2.8V.

  DVDD-supply:
    description: Digital core voltage supply, 1.5V.

  DOVDD-supply:
    description: Digital I/O voltage supply, 1.8V.

  powerdown-gpios:
    maxItems: 1
    description: Reference to the GPIO connected to the powerdown pin, if any.

  reset-gpios:
    maxItems: 1
    description: Reference to the GPIO connected to the reset pin, if any.

  port:
    $ref: /schemas/graph.yaml#/$defs/port-base
    description: |
      Video output port.

    properties:
      endpoint:
        $ref: /schemas/media/video-interfaces.yaml#
        unevaluatedProperties: false

        properties:
          bus-type:
            enum: [5, 6]

          bus-width:
            enum: [8, 10]
            default: 10

          data-shift:
            enum: [0, 2]
            default: 0

          hsync-active:
            enum: [0, 1]
            default: 1

          vsync-active:
            enum: [0, 1]
            default: 1

          pclk-sample:
            enum: [0, 1]
            default: 1

        allOf:
          - if:
              properties:
                bus-type:
                  const: 6
            then:
              properties:
                hsync-active: false
                vsync-active: false

          - if:
              properties:
                bus-width:
                  const: 10
            then:
              properties:
                data-shift:
                  const: 0

        required:
          - bus-type

    additionalProperties: false

required:
  - compatible
  - reg
  - clocks
  - port

additionalProperties: false

examples:
  - |
      #include <dt-bindings/gpio/gpio.h>
      #include <dt-bindings/media/video-interfaces.h>

      i2c {
          #address-cells = <1>;
          #size-cells = <0>;

          camera@3c {
              compatible = "ovti,ov5642";
              reg = <0x3c>;
              pinctrl-names = "default";
              pinctrl-0 = <&pinctrl_ov5642>;
              clocks = <&clk_ext_camera>;
              DOVDD-supply = <&vgen4_reg>;
              AVDD-supply = <&vgen3_reg>;
              DVDD-supply = <&vgen2_reg>;
              powerdown-gpios = <&gpio1 19 GPIO_ACTIVE_HIGH>;
              reset-gpios = <&gpio1 20 GPIO_ACTIVE_LOW>;

              port {
                  ov5642_to_parallel: endpoint {
                      bus-type = <MEDIA_BUS_TYPE_PARALLEL>;
                      remote-endpoint = <&parallel_from_ov5642>;
                      bus-width = <8>;
                      data-shift = <2>; /* lines 9:2 are used */
                      hsync-active = <0>;
                      vsync-active = <0>;
                      pclk-sample = <1>;
                  };
              };
          };
      };
```

## Documentation/devicetree/bindings/media/i2c/ovti,ov5645.yaml
```yaml
# SPDX-License-Identifier: (GPL-2.0-only OR BSD-2-Clause)
%YAML 1.2
---
$id: http://devicetree.org/schemas/media/i2c/ovti,ov5645.yaml#
$schema: http://devicetree.org/meta-schemas/core.yaml#

title: OmniVision OV5645 Image Sensor

maintainers:
  - Lad Prabhakar <prabhakar.mahadev-lad.rj@bp.renesas.com>

properties:
  compatible:
    const: ovti,ov5645

  reg:
    maxItems: 1

  clocks:
    description: XCLK Input Clock

  clock-frequency:
    description: Frequency of the xclk clock in Hz.

  vdda-supply:
    description: Analog voltage supply, 2.8 volts

  vddd-supply:
    description: Digital core voltage supply, 1.5 volts

  vdddo-supply:
    description: Digital I/O voltage supply, 1.8 volts

  enable-gpios:
    maxItems: 1
    description:
      Reference to the GPIO connected to the PWDNB pin, if any.

  reset-gpios:
    maxItems: 1
    description:
      Reference to the GPIO connected to the RESETB pin, if any.

  port:
    description: Digital Output Port
    $ref: /schemas/graph.yaml#/$defs/port-base
    additionalProperties: false

    properties:
      endpoint:
        $ref: /schemas/media/video-interfaces.yaml#
        unevaluatedProperties: false

        properties:
          data-lanes:
            minItems: 1
            maxItems: 2
            items:
              enum: [1, 2]

        required:
          - data-lanes

required:
  - compatible
  - reg
  - clocks
  - vdddo-supply
  - vdda-supply
  - vddd-supply
  - port

additionalProperties: false

examples:
  - |
    #include <dt-bindings/gpio/gpio.h>

    i2c {
        #address-cells = <1>;
        #size-cells = <0>;

        camera@3c {
            compatible = "ovti,ov5645";
            reg = <0x3c>;
            clocks = <&clks 1>;
            clock-frequency = <24000000>;
            vdddo-supply = <&ov5645_vdddo_1v8>;
            vdda-supply = <&ov5645_vdda_2v8>;
            vddd-supply = <&ov5645_vddd_1v5>;
            enable-gpios = <&gpio1 19 GPIO_ACTIVE_HIGH>;
            reset-gpios = <&gpio1 20 GPIO_ACTIVE_LOW>;
            pinctrl-names = "default";
            pinctrl-0 = <&pinctrl_ov5645>;

            port {
                ov5645_ep: endpoint {
                    remote-endpoint = <&csi0_ep>;
                    data-lanes = <1 2>;
                };
            };
        };
    };
...
```
