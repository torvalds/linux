## Documentation/devicetree/bindings/media/i2c/imx290.txt
```
* Sony IMX290 1/2.8-Inch CMOS Image Sensor

The Sony IMX290 is a 1/2.8-Inch CMOS Solid-state image sensor with
Square Pixel for Color Cameras. It is programmable through I2C and 4-wire
interfaces. The sensor output is available via CMOS logic parallel SDR output,
Low voltage LVDS DDR output and CSI-2 serial data output. The CSI-2 bus is the
default. No bindings have been defined for the other busses.

Required Properties:
- compatible: Should be "sony,imx290"
- reg: I2C bus address of the device
- clocks: Reference to the xclk clock.
- clock-names: Should be "xclk".
- clock-frequency: Frequency of the xclk clock in Hz.
- vdddo-supply: Sensor digital IO regulator.
- vdda-supply: Sensor analog regulator.
- vddd-supply: Sensor digital core regulator.

Optional Properties:
- reset-gpios: Sensor reset GPIO

The imx290 device node should contain one 'port' child node with
an 'endpoint' subnode. For further reading on port node refer to
Documentation/devicetree/bindings/media/video-interfaces.txt.

Required Properties on endpoint:
- data-lanes: check ../video-interfaces.txt
- link-frequencies: check ../video-interfaces.txt
- remote-endpoint: check ../video-interfaces.txt

Example:
	&i2c1 {
		...
		imx290: camera-sensor@1a {
			compatible = "sony,imx290";
			reg = <0x1a>;

			reset-gpios = <&msmgpio 35 GPIO_ACTIVE_LOW>;
			pinctrl-names = "default";
			pinctrl-0 = <&camera_rear_default>;

			clocks = <&gcc GCC_CAMSS_MCLK0_CLK>;
			clock-names = "xclk";
			clock-frequency = <37125000>;

			vdddo-supply = <&camera_vdddo_1v8>;
			vdda-supply = <&camera_vdda_2v8>;
			vddd-supply = <&camera_vddd_1v5>;

			port {
				imx290_ep: endpoint {
					data-lanes = <1 2 3 4>;
					link-frequencies = /bits/ 64 <445500000>;
					remote-endpoint = <&csiphy0_ep>;
				};
			};
		};
```

## Documentation/devicetree/bindings/media/i2c/imx323.txt
```
* Sony IMX323 DVP sensor

Required Properties:
- compatible: should be "sony,imx323"
- clocks: reference to the 37.125M xvclk input clock.
- clock-names: should be "xvclk".
- dovdd-supply: Digital I/O voltage supply, 1.8 volts
- avdd-supply: Analog voltage supply, 2.8 volts
- dvdd-supply: Digital core voltage supply, 1.2 volts
- reset-gpios: Low active reset gpio

The device node must contain one 'port' child node for its digital output
video port, in accordance with the video interface bindings defined in
Documentation/devicetree/bindings/media/video-interfaces.txt.

Example:
&i2c3: imx323@1a {
	compatible = "sony,imx323";
	reg = <0x1a>;
	clocks = <&cru SCLK_CIF_OUT>;
	clock-names = "xvclk";
	avdd-supply = <&vcc2v8_dvp>;
	dovdd-supply = <&vcc1v8_dvp>;
	dvdd-supply = <&vdd1v5_dvp>;
	pwdn-gpios = <&gpio2 RK_PC4 GPIO_ACTIVE_HIGH>;
	reset-gpios = <&gpio2 RK_PC5 GPIO_ACTIVE_HIGH>;
	pinctrl-names = "default";
	pinctrl-0 = <&dvp_d0d1_m0 &dvp_d2d9_m0
		&dvp_d10d11_m0 &cif_clkout_m0>;
	port {
		imx323_out: endpoint {
			remote-endpoint = <&isp0_dvp_in>;
		};
	};
};
```

## Documentation/devicetree/bindings/media/i2c/imx378.txt
```
* Sony IMX378 MIPI sensor

Required Properties:
- compatible: should be "sony,imx378"
- clocks: reference to the 24M xvclk input clock.
- clock-names: should be "xvclk".
- dovdd-supply: Digital I/O voltage supply, 1.8 volts
- avdd-supply: Analog voltage supply, 2.8 volts
- dvdd-supply: Digital core voltage supply, 1.2 volts
- reset-gpios: High active reset gpio

Attention:
IMX378 device address 0x1a(7bit);

The device node must contain one 'port' child node for its digital output
video port, in accordance with the video interface bindings defined in
Documentation/devicetree/bindings/media/video-interfaces.txt.

Example:

&i2c1 {
	status = "okay";
	imx378: imx378@1a {
		compatible = "sony,imx378";
		reg = <0x1a>;
		clocks = <&cru CLK_MIPICSI_OUT>;
		clock-names = "xvclk";
		power-domains = <&power RV1126_PD_VI>;
		pinctrl-names = "default";
		pinctrl-0 = <&mipicsi_clk0>;
		avdd-supply = <&vcc_avdd>;
		dovdd-supply = <&vcc_dovdd>;
		dvdd-supply = <&vcc_dvdd>;
		pwdn-gpios = <&gpio1 RK_PD4 GPIO_ACTIVE_HIGH>;
		reset-gpios = <&gpio1 RK_PD5 GPIO_ACTIVE_HIGH>;
		rockchip,camera-module-index = <1>;
		rockchip,camera-module-facing = "front";
		rockchip,camera-module-name = "A12N01B";
		rockchip,camera-module-lens-name = "48IRC-12M-F18";
		/* NO_HDR:0 HDR_X2:5 HDR_X3:6 */
		rockchip,camera-hdr-mode = <0>;
		port {
			sc4238_out: endpoint {
				remote-endpoint = <&mipi_in_ucam1>;
				data-lanes = <1 2 3 4>;
			};
		};
	};
};
```
