## Documentation/devicetree/bindings/media/i2c/chrontel,ch7322.yaml
```yaml
# SPDX-License-Identifier: (GPL-2.0-only OR BSD-2-Clause)
%YAML 1.2
---
$id: "http://devicetree.org/schemas/media/i2c/chrontel,ch7322.yaml#"
$schema: "http://devicetree.org/meta-schemas/core.yaml#"

title: Chrontel HDMI-CEC Controller

maintainers:
  - Jeff Chase <jnchase@google.com>

description:
  The Chrontel CH7322 is a discrete HDMI-CEC controller. It is
  programmable through I2C and drives a single CEC line.

properties:
  compatible:
    const: chrontel,ch7322

  reg:
    description: I2C device address
    maxItems: 1

  clocks:
    maxItems: 1

  interrupts:
    maxItems: 1

  reset-gpios:
    description:
      Reference to the GPIO connected to the RESET pin, if any. This
      pin is active-low.
    maxItems: 1

  standby-gpios:
    description:
      Reference to the GPIO connected to the OE pin, if any. When low
      the device will respond to power status requests with "standby"
      if in auto mode.
    maxItems: 1

  # see ../cec.txt
  hdmi-phandle:
    description: phandle to the HDMI controller

required:
  - compatible
  - reg
  - interrupts

examples:
  - |
    #include <dt-bindings/gpio/gpio.h>
    #include <dt-bindings/interrupt-controller/irq.h>
    i2c {
      #address-cells = <1>;
      #size-cells = <0>;
      ch7322@75 {
        compatible = "chrontel,ch7322";
        reg = <0x75>;
        interrupts = <47 IRQ_TYPE_EDGE_RISING>;
        standby-gpios = <&gpio 16 GPIO_ACTIVE_LOW>;
        reset-gpios = <&gpio 15 GPIO_ACTIVE_LOW>;
        hdmi-phandle = <&hdmi>;
      };
    };
```

## Documentation/devicetree/bindings/media/i2c/cn3927v.txt
```
* CN3927V vcm driver support

Required Properties:
- compatible: Must contain "chipnext,cn3927v"
- reg: I2C slave address

Common Optional Properties:
- rockchip,vcm-max-current: max output current, default 120, unit: mA.
- rockchip,vcm-start-current: starting current.
- rockchip,vcm-rated-current: rate current.

Normal Mode Optional Properties:
- rockchip,vcm-step-mode: S[3:2]: Codes per step, S[1:0]: Step period, default 0xd.
- rockchip,vcm-edlc-enable: Enhanced Dual Level Control Mode enable, default 0.
- rockchip,vcm-dlc-enable: Dual level control enable, default 0.
- rockchip,vcm-mclk: MCLK[1:0], default 0.
- rockchip,vcm-t-src: T_SRC[4:0], default 0.

Advanced Mode Optional Properties:
- rockchip,vcm-adcanced-mode: Enable Advanced mode, 0: Normal mode; 1: Advanced mode.
- rockchip,vcm-sac-mode: SAC_MODE[3:0]: 0x0~0xe, other reserved.
- rockchip,vcm-sac-time: SACT[6:0]: SAC time selection.
- rockchip,vcm-prescl: PRESC[1:0]: Prescaler (SAC Period Divider).
  : SAC setting time = tVIB = (3.81ms+(SACT [6:0]) x 0.03ms)) x (PRESC[1:0]).

NRC(Noise Reduction Control) mode Properties:
Current not used, for future use
- rockchip,vcm-nrc-en: NRC EN: 0:Direct mode, 1:NRC mode.
- rockchip,vcm-nrc-mode: NRC_MODE: 0: NRC start, 1: NRC landing.
- rockchip,vcm-nrc-preset: PRESET[7:0]: NRC Current Setting.
- rockchip,vcm-nrc-infl: NRC_INF[1:0]: NRC inflection point.
- rockchip,vcm-nrc-time: NRC Operation Time: 0: 32ms, 1: 64ms.

Required Special properties:
- rockchip,camera-module-index : indicate which camera the vcm belongs to.
- rockchip,camera-module-facing : indicate the camera facing.

Example:

&i2c1 {
	...
	cn3927v: cn3927v@c {
		compatible = "chipnext,cn3927v";
		status = "okay";
		reg = <0x0c>;
		rockchip,vcm-max-current = <120>;
		rockchip,vcm-start-current = <30>;
		rockchip,vcm-rated-current = <80>;
		rockchip,vcm-step-mode = <0x8>;
		rockchip,vcm-edlc-enable = <0>;
		rockchip,vcm-dlc-enable = <0>;
		rockchip,vcm-mclk = <1>;
		rockchip,vcm-t-src = <0>;
		rockchip,vcm-adcanced-mode = <1>;
		rockchip,vcm-sac-mode = <0x03>;
		rockchip,vcm-sac-time = <0x28>;
		rockchip,vcm-prescl = <0x02>;
		rockchip,vcm-nrc-en = <0>;
		rockchip,vcm-nrc-mode = <1>;
		rockchip,vcm-nrc-preset = <0x11110000>;
		rockchip,vcm-nrc-infl = <0x01>;
		rockchip,vcm-nrc-time = <0>;
		rockchip,camera-module-index = <0>;
		rockchip,camera-module-facing = "back";
	};

	...
	s5kjn1: s5kjn1@10 {
		...
		lens-focus = <&cn3927v>;
		...
	};
	...
}
```

## Documentation/devicetree/bindings/media/i2c/dongwoon,dw9714.txt
```
Dongwoon Anatech DW9714 camera voice coil lens driver

DW9174 is a 10-bit DAC with current sink capability. It is intended
for driving voice coil lenses in camera modules.

Mandatory properties:

- compatible: "dongwoon,dw9714"
- reg: I²C slave address
```

## Documentation/devicetree/bindings/media/i2c/dongwoon,dw9714.yaml
```yaml
# SPDX-License-Identifier: GPL-2.0-only OR BSD-2-Clause
%YAML 1.2
---
$id: http://devicetree.org/schemas/media/i2c/dongwoon,dw9714.yaml#
$schema: http://devicetree.org/meta-schemas/core.yaml#

title: Dongwoon Anatech DW9714 camera voice coil lens driver

maintainers:
  - Krzysztof Kozlowski <krzk@kernel.org>

description:
  DW9174 is a 10-bit DAC with current sink capability. It is intended for
  driving voice coil lenses in camera modules.

properties:
  compatible:
    const: dongwoon,dw9714

  reg:
    maxItems: 1

  powerdown-gpios:
    description:
      XSD pin for shutdown (active low)

  vcc-supply:
    description: VDD power supply

required:
  - compatible
  - reg

additionalProperties: false

examples:
  - |
    i2c {
        #address-cells = <1>;
        #size-cells = <0>;

        camera-lens@c {
            compatible = "dongwoon,dw9714";
            reg = <0x0c>;
            vcc-supply = <&reg_csi_1v8>;
        };
    };
```

## Documentation/devicetree/bindings/media/i2c/dongwoon,dw9719.yaml
```yaml
# SPDX-License-Identifier: (GPL-2.0-only OR BSD-2-Clause)
%YAML 1.2
---
$id: http://devicetree.org/schemas/media/i2c/dongwoon,dw9719.yaml#
$schema: http://devicetree.org/meta-schemas/core.yaml#

title: Dongwoon Anatech DW9719 Voice Coil Motor (VCM) Controller

maintainers:
  - André Apitzsch <git@apitzsch.eu>

description:
  The Dongwoon DW9718S/9719/9761 is a single 10-bit digital-to-analog converter
  with 100 mA output current sink capability, designed for linear control of
  voice coil motors (VCM) in camera lenses. This chip provides a Smart Actuator
  Control (SAC) mode intended for driving voice coil lenses in camera modules.

properties:
  compatible:
    enum:
      - dongwoon,dw9718s
      - dongwoon,dw9719
      - dongwoon,dw9761
      - dongwoon,dw9800k

  reg:
    maxItems: 1

  vdd-supply:
    description: VDD power supply

  dongwoon,sac-mode:
    description: |
      Slew Rate Control mode to use: direct, LSC (Linear Slope Control) or
      SAC1-SAC6 (Smart Actuator Control).
    $ref: /schemas/types.yaml#/definitions/uint32
    enum:
      - 0   # Direct mode
      - 1   # LSC mode
      - 2   # SAC1 mode (operation time# 0.32 x Tvib)
      - 3   # SAC2 mode (operation time# 0.48 x Tvib)
      - 4   # SAC3 mode (operation time# 0.72 x Tvib)
      - 5   # SAC4 mode (operation time# 1.20 x Tvib)
      - 6   # SAC5 mode (operation time# 1.64 x Tvib)
      - 7   # SAC6 mode (operation time# 1.88 x Tvib)
    default: 4

  dongwoon,vcm-prescale:
    description:
      Indication of VCM switching frequency dividing rate select.
    $ref: /schemas/types.yaml#/definitions/uint32

required:
  - compatible
  - reg
  - vdd-supply

allOf:
  - if:
      properties:
        compatible:
          contains:
            const: dongwoon,dw9718s
    then:
      properties:
        dongwoon,vcm-prescale:
          description:
            The final frequency is 10 MHz divided by (value + 2).
          maximum: 15
          default: 0

additionalProperties: false

examples:
  - |
    i2c {
        #address-cells = <1>;
        #size-cells = <0>;

        actuator@c {
            compatible = "dongwoon,dw9718s";
            reg = <0x0c>;

            vdd-supply = <&pm8937_l17>;

            dongwoon,sac-mode = <4>;
            dongwoon,vcm-prescale = <0>;
        };
    };
```

## Documentation/devicetree/bindings/media/i2c/dongwoon,dw9768.yaml
```yaml
# SPDX-License-Identifier: (GPL-2.0 OR BSD-2-Clause)
# Copyright (c) 2020 MediaTek Inc.
%YAML 1.2
---
$id: http://devicetree.org/schemas/media/i2c/dongwoon,dw9768.yaml#
$schema: http://devicetree.org/meta-schemas/core.yaml#

title: Dongwoon Anatech DW9768 Voice Coil Motor (VCM) Lens

maintainers:
  - Dongchun Zhu <dongchun.zhu@mediatek.com>

description: |-
  The Dongwoon DW9768 is a single 10-bit digital-to-analog (DAC) converter
  with 100 mA output current sink capability. VCM current is controlled with
  a linear mode driver. The DAC is controlled via a 2-wire (I2C-compatible)
  serial interface that operates at clock rates up to 1MHz. This chip
  integrates Advanced Actuator Control (AAC) technology and is intended for
  driving voice coil lenses in camera modules.

properties:
  compatible:
    enum:
      - dongwoon,dw9768 # for DW9768 VCM
      - giantec,gt9769  # for GT9769 VCM

  reg:
    maxItems: 1

  vin-supply:
    description:
      Definition of the regulator used as Digital I/O voltage supply.

  vdd-supply:
    description:
      Definition of the regulator used as Digital core voltage supply.

  dongwoon,aac-mode:
    description:
      Indication of AAC mode select.
    $ref: "/schemas/types.yaml#/definitions/uint32"
    enum:
      - 1    #  AAC2 mode(operation time# 0.48 x Tvib)
      - 2    #  AAC3 mode(operation time# 0.70 x Tvib)
      - 3    #  AAC4 mode(operation time# 0.75 x Tvib)
      - 5    #  AAC8 mode(operation time# 1.13 x Tvib)
    default: 2

  dongwoon,aac-timing:
    description:
      Number of AAC Timing count that controlled by one 6-bit period of
      vibration register AACT[5:0], the unit of which is 100 us.
    $ref: "/schemas/types.yaml#/definitions/uint32"
    default: 0x20
    minimum: 0x00
    maximum: 0x3f

  dongwoon,clock-presc:
    description:
      Indication of VCM internal clock dividing rate select, as one multiple
      factor to calculate VCM ring periodic time Tvib.
    $ref: "/schemas/types.yaml#/definitions/uint32"
    enum:
      - 0    #  Dividing Rate -  2
      - 1    #  Dividing Rate -  1
      - 2    #  Dividing Rate -  1/2
      - 3    #  Dividing Rate -  1/4
      - 4    #  Dividing Rate -  8
      - 5    #  Dividing Rate -  4
    default: 1

required:
  - compatible
  - reg
  - vin-supply
  - vdd-supply

additionalProperties: false

examples:
  - |

    i2c {
        #address-cells = <1>;
        #size-cells = <0>;

        dw9768: camera-lens@c {
            compatible = "dongwoon,dw9768";
            reg = <0x0c>;

            vin-supply = <&mt6358_vcamio_reg>;
            vdd-supply = <&mt6358_vcama2_reg>;
            dongwoon,aac-timing = <0x39>;
        };
    };

...
```

## Documentation/devicetree/bindings/media/i2c/dongwoon,dw9800.yaml
```yaml
# SPDX-License-Identifier: (GPL-2.0-only OR BSD-2-Clause)
# Copyright (C) 2018, 2021 Intel Corporation
%YAML 1.2
---
$id: http://devicetree.org/schemas/media/i2c/dongwoon,dw9800-vcm.yaml#
$schema: http://devicetree.org/meta-schemas/core.yaml#

title: Dongwoon Anatech DW9800 Voice Coil Motor (VCM) Lens

maintainers:
  - Vitalii Skorkin <nikroksm@mail.ru>

description: |
  The Dongwoon DW9800 is a 10-bit DAC with current sink capability. It is intended for
  controlling voice coil lenses in camera modules.

properties:
  compatible:
    const: dongwoon,dw9800

  reg:
    maxItems: 1

  vin-supply:
    description:
      Definition of the regulator used as Digital I/O voltage supply.

  vdd-supply:
    description:
      Definition of the regulator used as Digital core voltage supply.

  dongwoon,sac-mode:
    description:
      Indication of SAC mode select.
    $ref: /schemas/types.yaml#/definitions/uint32
    enum:
      - 0    #  SAC2 mode
      - 1    #  SAC3 mode
      - 2    #  SAC4 mode
      - 3    #  SAC5 mode
    default: 1

  dongwoon,sac-timing:
    description:
      Number of SAC Timing count that controlled by one 6-bit period of
      vibration register AACT[5:0], the unit of which is 100 us.
    $ref: /schemas/types.yaml#/definitions/uint32
    default: 0x25
    minimum: 0x00
    maximum: 0x3f

  dongwoon,clock-presc:
    description:
      Indication of VCM internal clock dividing rate select, as one multiple
      factor to calculate VCM ring periodic time Tvib.
    $ref: /schemas/types.yaml#/definitions/uint32
    enum:
      - 0    #  Dividing Rate -  2
      - 1    #  Dividing Rate -  1
      - 2    #  Dividing Rate -  1/2
      - 3    #  Dividing Rate -  1/4
      - 4    #  Dividing Rate -  8
      - 5    #  Dividing Rate -  4
    default: 1

required:
  - compatible
  - reg
  - vin-supply
  - vdd-supply

additionalProperties: false

examples:
  - |
    i2c {
        #address-cells = <1>;
        #size-cells = <0>;

        dw9800: camera-lens@c {
            compatible = "dongwoon,dw9800";
            reg = <0x0c>;

            vin-supply = <&vreg_l5c_1p8>;
            vdd-supply = <&vreg_l7c_2p85>;
        };
    };
...
```

## Documentation/devicetree/bindings/media/i2c/dongwoon,dw9807-vcm.txt
```
Dongwoon Anatech DW9807 voice coil lens driver

DW9807 is a 10-bit DAC with current sink capability. It is intended for
controlling voice coil lenses.

Mandatory properties:

- compatible: "dongwoon,dw9807-vcm"
- reg: I2C slave address
```

## Documentation/devicetree/bindings/media/i2c/dongwoon,dw9807-vcm.yaml
```yaml
# SPDX-License-Identifier: (GPL-2.0-only OR BSD-2-Clause)
# Copyright (C) 2018, 2021 Intel Corporation
%YAML 1.2
---
$id: http://devicetree.org/schemas/media/i2c/dongwoon,dw9807-vcm.yaml#
$schema: http://devicetree.org/meta-schemas/core.yaml#

title: Dongwoon Anatech DW9807 voice coil lens driver

maintainers:
  - Sakari Ailus <sakari.ailus@linux.intel.com>

description: |
  DW9807 is a 10-bit DAC with current sink capability. It is intended for
  controlling voice coil lenses.

properties:
  compatible:
    const: dongwoon,dw9807-vcm

  reg:
    maxItems: 1

required:
  - compatible
  - reg

additionalProperties: false

examples:
  - |
    i2c {
        #address-cells = <1>;
        #size-cells = <0>;

        lens@e {
            compatible = "dongwoon,dw9807-vcm";
            reg = <0x0e>;
        };
    };
...
```

## Documentation/devicetree/bindings/media/i2c/dw9800w.txt
```
* DW9800W vcm driver support

Required Properties:
- compatible: Must contain "chipnext,cn3927v"
- reg: I2C slave address

Optional Properties:
- rockchip,vcm-max-current: max output current, unit: mA.
- rockchip,vcm-start-current: starting current.
- rockchip,vcm-rated-current: rate current.
- rockchip,vcm-step-mode: 0 SAC2 mode,1 SAC3 mode,2 SAC4 mode,3 SAC5 mode,4 Direct mode,5 LSC mode.
- rockchip,vcm-t-src : SACT[5:0],  Tvib = 6.3ms + SACT[5:0]*0.1ms, recommend: 10ms.
- rockchip,vcm-t-div : 0 Tvibx2(double),1 Tvibx1(default),2 Tvibx1/2(half),3 Tvibx1/4(quarter),4 Tvibx8,5 Tvibx4,

Required Special properties:
- rockchip,camera-module-index : indicate which camera the vcm belongs to.
- rockchip,camera-module-facing : indicate the camera facing.

Example:

&i2c4 {
	...
	dw9800w: dw9800w@c {
		compatible = "dongwoon,dw9800w";
		status = "okay";
		reg = <0x0c>;
		rockchip,vcm-max-current = <100>;
		rockchip,vcm-start-current = <20>;
		rockchip,vcm-rated-current = <80>;
		rockchip,vcm-step-mode = <1>;
		rockchip,vcm-t-src = <0x25>;
		rockchip,vcm-t-div = <1>;
		rockchip,camera-module-index = <0>;
		rockchip,camera-module-facing = "back";
	};

	...
	imx586: s5kjn1@1a {
		...
		lens-focus = <&dw9800w>;
		...
	};
	...
}
```
