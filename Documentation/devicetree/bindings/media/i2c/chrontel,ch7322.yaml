## Documentation/devicetree/bindings/media/i2c/hynix,hi846.yaml
```yaml
# SPDX-License-Identifier: (GPL-2.0-only OR BSD-2-Clause)
%YAML 1.2
---
$id: http://devicetree.org/schemas/media/i2c/hynix,hi846.yaml#
$schema: http://devicetree.org/meta-schemas/core.yaml#

title: SK Hynix Hi-846 1/4" 8M Pixel MIPI CSI-2 sensor

maintainers:
  - Martin Kepplinger <martin.kepplinger@puri.sm>

description: |-
  The Hi-846 is a raw image sensor with an MIPI CSI-2 image data
  interface and CCI (I2C compatible) control bus. The output format
  is raw Bayer.

properties:
  compatible:
    const: hynix,hi846

  reg:
    maxItems: 1

  clocks:
    items:
      - description: Reference to the mclk clock.

  assigned-clocks:
    maxItems: 1

  assigned-clock-rates:
    maxItems: 1

  reset-gpios:
    description: Reference to the GPIO connected to the RESETB pin. Active low.
    maxItems: 1

  shutdown-gpios:
    description: Reference to the GPIO connected to the XSHUTDOWN pin. Active low.
    maxItems: 1

  vddio-supply:
    description: Definition of the regulator used for the VDDIO power supply.

  vdda-supply:
    description: Definition of the regulator used for the VDDA power supply.

  vddd-supply:
    description: Definition of the regulator used for the VDDD power supply.

  port:
    $ref: /schemas/graph.yaml#/properties/port

    properties:
      endpoint:
        $ref: /schemas/media/video-interfaces.yaml#
        unevaluatedProperties: false

        properties:
          data-lanes:
            oneOf:
              - items:
                  - const: 1
                  - const: 2
                  - const: 3
                  - const: 4
              - items:
                  - const: 1
                  - const: 2

        required:
          - data-lanes

required:
  - compatible
  - reg
  - clocks
  - assigned-clocks
  - assigned-clock-rates
  - vddio-supply
  - vdda-supply
  - vddd-supply
  - port

additionalProperties: false

examples:
  - |
    #include <dt-bindings/gpio/gpio.h>

    i2c {
        #address-cells = <1>;
        #size-cells = <0>;

        hi846: camera@20 {
            compatible = "hynix,hi846";
            reg = <0x20>;
            pinctrl-names = "default";
            pinctrl-0 = <&pinctrl_csi1>;
            clocks = <&clk 0>;
            assigned-clocks = <&clk 0>;
            assigned-clock-rates = <25000000>;
            vdda-supply = <&reg_camera_vdda>;
            vddd-supply = <&reg_camera_vddd>;
            vddio-supply = <&reg_camera_vddio>;
            reset-gpios = <&gpio1 25 GPIO_ACTIVE_LOW>;
            shutdown-gpios = <&gpio5 4 GPIO_ACTIVE_LOW>;

            port {
                camera_out: endpoint {
                    remote-endpoint = <&csi1_ep1>;
                    link-frequencies = /bits/ 64
                        <80000000 200000000>;
                    data-lanes = <1 2>;
                };
            };
        };
    };

...
```

## Documentation/devicetree/bindings/media/i2c/imi,rdacm2x-gmsl.yaml
```yaml
# SPDX-License-Identifier: GPL-2.0 OR BSD-2-Clause
# Copyright (C) 2019 Renesas Electronics Corp.
%YAML 1.2
---
$id: http://devicetree.org/schemas/media/i2c/imi,rdacm2x-gmsl.yaml#
$schema: http://devicetree.org/meta-schemas/core.yaml#

title: IMI D&D RDACM20 and RDACM21 Automotive Camera Platforms

maintainers:
  - Jacopo Mondi <jacopo+renesas@jmondi.org>
  - Kieran Bingham <kieran.bingham+renesas@ideasonboard.com>
  - Laurent Pinchart <laurent.pinchart+renesas@ideasonboard.com>
  - Niklas Söderlund <niklas.soderlund+renesas@ragnatech.se>

description: -|
  The IMI D&D RDACM20 and RDACM21 are GMSL-compatible camera designed for
  automotive applications.

  The RDACM20 camera module encloses a Maxim Integrated MAX9271 GMSL serializer,
  coupled with an OV10635 image sensor and an embedded MCU. Both the MCU and
  the image sensor are connected to the serializer local I2C bus and are
  accessible by the host SoC by direct addressing.

  The RDACM21 camera module encloses the same serializer, coupled with an
  OV10640 image sensor and an OV490 ISP. Only the OV490 ISP is interfaced to
  the serializer local I2C bus while the image sensor is not accessible from
  the host SoC.

  They both connect to a remote GMSL endpoint through a coaxial cable.

                                                   IMI RDACM20
  +---------------+                        +--------------------------------+
  |      GMSL     |   <- Video Stream      |       <- Video--------\        |
  |               |< === GMSL Link ====== >|MAX9271<- I2C bus-> <-->OV10635 |
  | de-serializer |   <- I2C messages ->   |                   \<-->MCU     |
  +---------------+                        +--------------------------------+

                                                   IMI RDACM21
  +---------------+                        +--------------------------------+
  |      GMSL     |   <- Video Stream      |       <- Video--------\        |
  |               |< === GMSL Link ====== >|MAX9271<- I2C bus-> <-->OV490   |
  |               |   <- I2C messages ->   |                          |     |
  | de-serializer |                        |          OV10640 <-------|     |
  +---------------+                        +--------------------------------+

  Both camera modules serialize video data generated by the embedded camera
  sensor on the GMSL serial channel to a remote GMSL de-serializer. They also
  receive and transmit I2C messages encapsulated and transmitted on the GMSL
  bidirectional control channel.

  All I2C traffic received on the GMSL link not directed to the serializer is
  propagated on the local I2C bus to the remote device there connected. All the
  I2C traffic generated on the local I2C bus not directed to the serializer is
  propagated to the remote de-serializer encapsulated in the GMSL control
  channel.

  The RDACM20 and RDACM21 DT node should be a direct child of the GMSL
  deserializer's I2C bus corresponding to the GMSL link that the camera is
  attached to.

properties:
  '#address-cells':
    const: 1

  '#size-cells':
    const: 0

  compatible:
    enum:
      - imi,rdacm20
      - imi,rdacm21

  reg:
    description: -|
      I2C device addresses, the first to be assigned to the serializer, the
      following ones to be assigned to the remote devices.

      For RDACM20 the second entry of the property is assigned to the
      OV10635 image sensor and the optional third one to the embedded MCU.

      For RDACM21 the second entry is assigned to the OV490 ISP and the optional
      third one ignored.

    minItems: 2
    maxItems: 3

  port:
    type: object
    additionalProperties: false
    description: -|
      Connection to the remote GMSL endpoint are modelled using the OF graph
      bindings in accordance with the video interface bindings defined in
      Documentation/devicetree/bindings/media/video-interfaces.txt.

      The device node contains a single "port" child node with a single
      "endpoint" sub-device.

    properties:
      endpoint:
        type: object
        additionalProperties: false

        properties:
          remote-endpoint:
            description: -|
              phandle to the remote GMSL endpoint sub-node in the remote node
              port.
            maxItems: 1

        required:
          - remote-endpoint

    required:
      - endpoint

required:
  - compatible
  - reg
  - port

additionalProperties: false

examples:
  - |
    i2c@e66d8000 {
      #address-cells = <1>;
      #size-cells = <0>;

      reg = <0 0xe66d8000>;

      camera@31 {
        compatible = "imi,rdacm20";
        reg = <0x31>, <0x41>, <0x51>;

        port {
          rdacm20_out0: endpoint {
            remote-endpoint = <&max9286_in0>;
          };
        };
      };
    };

  - |
    i2c@e66d8000 {
      #address-cells = <1>;
      #size-cells = <0>;

      reg = <0 0xe66d8000>;

      camera@31 {
        compatible = "imi,rdacm21";
        reg = <0x31>, <0x41>;

        port {
          rdacm21_out0: endpoint {
            remote-endpoint = <&max9286_in0>;
          };
        };
      };
    };
```

## Documentation/devicetree/bindings/media/i2c/imx219.yaml
```yaml
# SPDX-License-Identifier: (GPL-2.0-only OR BSD-2-Clause)
%YAML 1.2
---
$id: http://devicetree.org/schemas/media/i2c/imx219.yaml#
$schema: http://devicetree.org/meta-schemas/core.yaml#

title: Sony 1/4.0-Inch 8Mpixel CMOS Digital Image Sensor

maintainers:
  - Dave Stevenson <dave.stevenson@raspberrypi.com>

description: |-
  The Sony imx219 is a 1/4.0-inch CMOS active pixel digital image sensor
  with an active array size of 3280H x 2464V. It is programmable through
  I2C interface. The I2C address is fixed to 0x10 as per sensor data sheet.
  Image data is sent through MIPI CSI-2, which is configured as either 2 or
  4 data lanes.

properties:
  compatible:
    const: sony,imx219

  reg:
    description: I2C device address
    maxItems: 1

  clocks:
    maxItems: 1

  VDIG-supply:
    description:
      Digital I/O voltage supply, 1.8 volts

  VANA-supply:
    description:
      Analog voltage supply, 2.8 volts

  VDDL-supply:
    description:
      Digital core voltage supply, 1.2 volts

  reset-gpios:
    maxItems: 1
    description: |-
      Reference to the GPIO connected to the xclr pin, if any.
      Must be released (set high) after all supplies are applied.

  port:
    $ref: /schemas/graph.yaml#/$defs/port-base
    additionalProperties: false

    properties:
      endpoint:
        $ref: /schemas/media/video-interfaces.yaml#
        unevaluatedProperties: false

        properties:
          data-lanes:
            description: |-
              The sensor supports either two-lane, or four-lane operation.
              If this property is omitted four-lane operation is assumed.
              For two-lane operation the property must be set to <1 2>.
            items:
              - const: 1
              - const: 2

          clock-noncontinuous: true
          link-frequencies: true

        required:
          - link-frequencies

required:
  - compatible
  - reg
  - clocks
  - VANA-supply
  - VDIG-supply
  - VDDL-supply
  - port

additionalProperties: false

examples:
  - |
    i2c {
        #address-cells = <1>;
        #size-cells = <0>;

        imx219: sensor@10 {
            compatible = "sony,imx219";
            reg = <0x10>;
            clocks = <&imx219_clk>;
            VANA-supply = <&imx219_vana>;   /* 2.8v */
            VDIG-supply = <&imx219_vdig>;   /* 1.8v */
            VDDL-supply = <&imx219_vddl>;   /* 1.2v */

            port {
                imx219_0: endpoint {
                    remote-endpoint = <&csi1_ep>;
                    data-lanes = <1 2>;
                    clock-noncontinuous;
                    link-frequencies = /bits/ 64 <456000000>;
                };
            };
        };
    };

...
```

## Documentation/devicetree/bindings/media/i2c/imx258.yaml
```yaml
# SPDX-License-Identifier: (GPL-2.0-only OR BSD-2-Clause)
%YAML 1.2
---
$id: http://devicetree.org/schemas/media/i2c/imx258.yaml#
$schema: http://devicetree.org/meta-schemas/core.yaml#

title: Sony IMX258 13 Mpixel CMOS Digital Image Sensor

maintainers:
  - Krzysztof Kozlowski <krzk@kernel.org>

description: |-
  IMX258 is a diagonal 5.867mm (Type 1/3.06) 13 Mega-pixel CMOS active pixel
  type stacked image sensor with a square pixel array of size 4208 x 3120. It
  is programmable through I2C interface.  Image data is sent through MIPI
  CSI-2.

properties:
  compatible:
    const: sony,imx258

  assigned-clocks: true
  assigned-clock-parents: true
  assigned-clock-rates: true

  clocks:
    description:
      Clock frequency from 6 to 27 MHz.
    maxItems: 1

  reg:
    maxItems: 1

  reset-gpios:
    description: |-
      Reference to the GPIO connected to the XCLR pin, if any.

  vana-supply:
    description:
      Analog voltage (VANA) supply, 2.7 V

  vdig-supply:
    description:
      Digital I/O voltage (VDIG) supply, 1.2 V

  vif-supply:
    description:
      Interface voltage (VIF) supply, 1.8 V

  # See ../video-interfaces.txt for more details
  port:
    $ref: /schemas/graph.yaml#/properties/port
    additionalProperties: false

    properties:
      endpoint:
        $ref: /schemas/media/video-interfaces.yaml#
        unevaluatedProperties: false

        properties:
          data-lanes:
            oneOf:
              - items:
                  - const: 1
                  - const: 2
                  - const: 3
                  - const: 4
              - items:
                  - const: 1
                  - const: 2

          link-frequencies: true

        required:
          - data-lanes
          - link-frequencies

required:
  - compatible
  - reg
  - port

additionalProperties: false

examples:
  - |
    i2c0 {
        #address-cells = <1>;
        #size-cells = <0>;

        sensor@6c {
            compatible = "sony,imx258";
            reg = <0x6c>;
            clocks = <&imx258_clk>;

            port {
                endpoint {
                    remote-endpoint = <&csi1_ep>;
                    data-lanes = <1 2 3 4>;
                    link-frequencies = /bits/ 64 <320000000>;
                };
            };
        };
    };

    /* Oscillator on the camera board */
    imx258_clk: clk {
        compatible = "fixed-clock";
        #clock-cells = <0>;
        clock-frequency = <19200000>;
    };

  - |
    i2c0 {
        #address-cells = <1>;
        #size-cells = <0>;

        sensor@6c {
            compatible = "sony,imx258";
            reg = <0x6c>;
            clocks = <&imx258_clk>;

            assigned-clocks = <&imx258_clk>;
            assigned-clock-rates = <19200000>;

            port {
                endpoint {
                    remote-endpoint = <&csi1_ep>;
                    data-lanes = <1 2 3 4>;
                    link-frequencies = /bits/ 64 <633600000>;
                };
            };
        };
    };
```

## Documentation/devicetree/bindings/media/i2c/imx274.txt
```
* Sony 1/2.5-Inch 8.51Mp CMOS Digital Image Sensor

The Sony imx274 is a 1/2.5-inch CMOS active pixel digital image sensor with
an active array size of 3864H x 2202V. It is programmable through I2C
interface. The I2C address is fixed to 0x1a as per sensor data sheet.
Image data is sent through MIPI CSI-2, which is configured as 4 lanes
at 1440 Mbps.


Required Properties:
- compatible: value should be "sony,imx274" for imx274 sensor
- reg: I2C bus address of the device

Optional Properties:
- reset-gpios: Sensor reset GPIO
- clocks: Reference to the input clock.
- clock-names: Should be "inck".
- VANA-supply: Sensor 2.8v analog supply.
- VDIG-supply: Sensor 1.8v digital core supply.
- VDDL-supply: Sensor digital IO 1.2v supply.

The imx274 device node should contain one 'port' child node with
an 'endpoint' subnode. For further reading on port node refer to
Documentation/devicetree/bindings/media/video-interfaces.txt.

Example:
	sensor@1a {
		compatible = "sony,imx274";
		reg = <0x1a>;
		#address-cells = <1>;
		#size-cells = <0>;
		reset-gpios = <&gpio_sensor 0 0>;
		port {
			sensor_out: endpoint {
				remote-endpoint = <&csiss_in>;
			};
		};
	};
```
