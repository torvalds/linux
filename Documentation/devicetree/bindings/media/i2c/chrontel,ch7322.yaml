## Documentation/devicetree/bindings/media/i2c/galaxycore,gc0308.yaml
```yaml
# SPDX-License-Identifier: (GPL-2.0-only OR BSD-2-Clause)
%YAML 1.2
---
$id: http://devicetree.org/schemas/media/i2c/galaxycore,gc0308.yaml#
$schema: http://devicetree.org/meta-schemas/core.yaml#

title: Galaxycore GC0308 and GC0309 Image Sensors

maintainers:
  - Sebastian Reichel <sre@kernel.org>

description: |
  The GalaxyCore GC0308 (1/6.5") and GC0309 (1/9") are 640x480 VGA sensors
  programmable through an I2C interface and connected via parallel bus.
  They include an ISP capable of auto exposure and auto white balance.

allOf:
  - $ref: ../video-interface-devices.yaml#

properties:
  compatible:
    oneOf:
      - const: galaxycore,gc0308
      - items:
          - const: galaxycore,gc0309
          - const: galaxycore,gc0308

  reg:
    const: 0x21

  clocks:
    description: Reference to the xclk clock.
    maxItems: 1

  reset-gpios:
    description: GPIO descriptor for the reset pin.
    maxItems: 1

  powerdown-gpios:
    description: GPIO descriptor for the powerdown pin.
    maxItems: 1

  vdd28-supply:
    description: 2.8V supply

  port:
    $ref: /schemas/graph.yaml#/$defs/port-base
    description: |
      Video output port.

    properties:
      endpoint:
        $ref: /schemas/media/video-interfaces.yaml#
        unevaluatedProperties: false

        properties:
          bus-width: true
          data-shift: true
          hsync-active: true
          vsync-active: true
          data-active: true
          pclk-sample: true

        required:
          - bus-width

    additionalProperties: false

required:
  - compatible
  - reg
  - clocks
  - powerdown-gpios
  - port

additionalProperties: false

examples:
  - |
    #include <dt-bindings/gpio/gpio.h>

    i2c {
        #address-cells = <1>;
        #size-cells = <0>;

        camera-sensor@21 {
            compatible = "galaxycore,gc0308";
            reg = <0x21>;
            clocks = <&camera_clk>;
            powerdown-gpios = <&gpio1 5 GPIO_ACTIVE_HIGH>;
            reset-gpios = <&gpio1 6 GPIO_ACTIVE_LOW>;
            vdd28-supply = <&vdd28>;

            port {
                gc0308_ep: endpoint {
                    remote-endpoint = <&parallel_from_gc0308>;
                    bus-width = <8>;
                    data-shift = <2>; /* lines 9:2 are used */
                    hsync-active = <1>; /* active high */
                    vsync-active = <1>; /* active high */
                    data-active = <1>; /* active high */
                    pclk-sample = <1>; /* sample on rising edge */
                };
            };
        };
    };

...
```

## Documentation/devicetree/bindings/media/i2c/galaxycore,gc05a2.yaml
```yaml
# SPDX-License-Identifier: (GPL-2.0 OR BSD-2-Clause)
# Copyright (c) 2023 MediaTek Inc.
%YAML 1.2
---
$id: http://devicetree.org/schemas/media/i2c/galaxycore,gc05a2.yaml#
$schema: http://devicetree.org/meta-schemas/core.yaml#

title: GalaxyCore gc05a2 1/5" 5M Pixel MIPI CSI-2 sensor

maintainers:
  - Zhi Mao <zhi.mao@mediatek.com>

description:
  The gc05a2 is a raw image sensor with an MIPI CSI-2 image data
  interface and CCI (I2C compatible) control bus. The output format
  is raw Bayer.

properties:
  compatible:
    const: galaxycore,gc05a2

  reg:
    maxItems: 1

  clocks:
    maxItems: 1

  dovdd-supply: true

  avdd-supply: true

  dvdd-supply: true

  reset-gpios:
    description: Reference to the GPIO connected to the RESETB pin.
    maxItems: 1

  port:
    $ref: /schemas/graph.yaml#/$defs/port-base
    additionalProperties: false
    description:
      Output port node, single endpoint describing the CSI-2 transmitter.

    properties:
      endpoint:
        $ref: /schemas/media/video-interfaces.yaml#
        unevaluatedProperties: false

        properties:
          data-lanes:
            oneOf:
              - items:
                  - const: 1
                  - const: 2
                  - const: 3
                  - const: 4
              - items:
                  - const: 1
                  - const: 2

          link-frequencies: true

        required:
          - data-lanes
          - link-frequencies

    required:
      - endpoint

required:
  - compatible
  - reg
  - clocks
  - dovdd-supply
  - avdd-supply
  - dvdd-supply
  - reset-gpios
  - port

additionalProperties: false

examples:
  - |
    #include <dt-bindings/gpio/gpio.h>

    i2c {
        #address-cells = <1>;
        #size-cells = <0>;

        sensor@37 {
            compatible =  "galaxycore,gc05a2";
            reg = <0x37>;

            clocks = <&gc05a2_clk>;

            reset-gpios = <&pio 21 GPIO_ACTIVE_LOW>;

            avdd-supply = <&gc05a2_avdd>;
            dovdd-supply = <&gc05a2_dovdd>;
            dvdd-supply = <&gc05a2_dvdd>;

            port {
                sensor_out: endpoint {
                    data-lanes = <1 2>;
                    link-frequencies = /bits/ 64 <448000000 224000000>;
                    remote-endpoint = <&seninf_csi_port_1_in>;
                };
            };
        };
    };

...
```

## Documentation/devicetree/bindings/media/i2c/galaxycore,gc08a3.yaml
```yaml
# SPDX-License-Identifier: (GPL-2.0 OR BSD-2-Clause)
# Copyright (c) 2023 MediaTek Inc.
%YAML 1.2
---
$id: http://devicetree.org/schemas/media/i2c/galaxycore,gc08a3.yaml#
$schema: http://devicetree.org/meta-schemas/core.yaml#

title: GalaxyCore gc08a3 1/4" 8M Pixel MIPI CSI-2 sensor

maintainers:
  - Zhi Mao <zhi.mao@mediatek.com>

description:
  The gc08a3 is a raw image sensor with an MIPI CSI-2 image data
  interface and CCI (I2C compatible) control bus. The output format
  is raw Bayer.

properties:
  compatible:
    const: galaxycore,gc08a3

  reg:
    maxItems: 1

  clocks:
    maxItems: 1

  dovdd-supply: true

  avdd-supply: true

  dvdd-supply: true

  reset-gpios:
    description: Reference to the GPIO connected to the RESETB pin.
    maxItems: 1

  port:
    $ref: /schemas/graph.yaml#/$defs/port-base
    additionalProperties: false
    description:
      Output port node, single endpoint describing the CSI-2 transmitter.

    properties:
      endpoint:
        $ref: /schemas/media/video-interfaces.yaml#
        unevaluatedProperties: false

        properties:
          data-lanes:
            oneOf:
              - items:
                  - const: 1
                  - const: 2
                  - const: 3
                  - const: 4
              - items:
                  - const: 1
                  - const: 2

          link-frequencies: true

        required:
          - data-lanes
          - link-frequencies

    required:
      - endpoint

required:
  - compatible
  - reg
  - clocks
  - dovdd-supply
  - avdd-supply
  - dvdd-supply
  - reset-gpios
  - port

additionalProperties: false

examples:
  - |
    #include <dt-bindings/gpio/gpio.h>

    i2c {
        #address-cells = <1>;
        #size-cells = <0>;

        sensor@31 {
            compatible = "galaxycore,gc08a3";
            reg = <0x31>;

            clocks = <&gc08a3_clk>;

            reset-gpios = <&pio 19 GPIO_ACTIVE_LOW>;

            avdd-supply = <&gc08a3_avdd>;
            dovdd-supply = <&gc08a3_dovdd>;
            dvdd-supply = <&gc08a3_dvdd>;

            port {
                sensor_out: endpoint {
                    data-lanes = <1 2 3 4>;
                    link-frequencies = /bits/ 64 <336000000 207000000>;
                    remote-endpoint = <&seninf_csi_port_0_in>;
                };
            };
        };
    };

...
```

## Documentation/devicetree/bindings/media/i2c/galaxycore,gc2145.yaml
```yaml
# SPDX-License-Identifier: (GPL-2.0-only OR BSD-2-Clause)
%YAML 1.2
---
$id: http://devicetree.org/schemas/media/i2c/galaxycore,gc2145.yaml#
$schema: http://devicetree.org/meta-schemas/core.yaml#

title: Galaxy Core 1/5'' UXGA CMOS Image Sensor

maintainers:
  - Alain Volmat <alain.volmat@foss.st.com>

description:
  The Galaxy Core GC2145 is a 2 Megapixel CMOS image sensor, for mobile
  phone camera applications and digital camera products. GC2145 incorporates a
  1616V x 1232H active pixel array, on-chip 10-bit ADC, and image signal
  processor allowing AE/AWB/interpolation/de-noise/color-conversion and
  gamma correction. Bayer RGB, RGB565 and YCbCr 4:2:2 can be provided by the
  sensor. It is programmable through an I2C interface. Image data is sent
  either through a parallel interface or through MIPI CSI-2.

allOf:
  - $ref: ../video-interface-devices.yaml#

properties:
  compatible:
    const: galaxycore,gc2145

  reg:
    const: 0x3c

  clocks:
    maxItems: 1

  powerdown-gpios:
    maxItems: 1

  reset-gpios:
    maxItems: 1

  iovdd-supply:
    description: Power Supply for I/O circuits (1.7 - 3V).

  avdd-supply:
    description: Power for analog circuit/sensor array (2.7 - 3V).

  dvdd-supply:
    description: Power for digital core (1.7 - 1.9V).

  orientation: true

  rotation: true

  port:
    $ref: /schemas/graph.yaml#/$defs/port-base

    properties:
      endpoint:
        $ref: /schemas/media/video-interfaces.yaml#
        unevaluatedProperties: false

        properties:
          link-frequencies: true

        required:
          - link-frequencies

    required:
      - endpoint

    additionalProperties: false

required:
  - compatible
  - reg
  - clocks
  - powerdown-gpios
  - reset-gpios
  - iovdd-supply
  - avdd-supply
  - dvdd-supply
  - port

additionalProperties: false

examples:
  - |
    #include <dt-bindings/gpio/gpio.h>

    i2c {
        #address-cells = <1>;
        #size-cells = <0>;

        camera@3c {
            compatible = "galaxycore,gc2145";
            reg = <0x3c>;
            clocks = <&clk_ext_camera>;
            iovdd-supply = <&scmi_v3v3_sw>;
            avdd-supply = <&scmi_v3v3_sw>;
            dvdd-supply = <&scmi_v3v3_sw>;
            powerdown-gpios = <&mcp23017 3 (GPIO_ACTIVE_LOW | GPIO_PUSH_PULL)>;
            reset-gpios = <&mcp23017 4 (GPIO_ACTIVE_LOW | GPIO_PUSH_PULL)>;

            port {
                endpoint {
                    remote-endpoint = <&mipid02_0>;
                    data-lanes = <1 2>;
                    link-frequencies = /bits/ 64 <120000000 192000000 240000000>;
                };
            };
        };
    };

...
```

## Documentation/devicetree/bindings/media/i2c/gc2053.txt
```
* galaxycore,gc2053 MIPI sensor

Required Properties:
- compatible: should be "galaxycore,gc2053"
- clocks: reference to the 24M xvclk input clock.
- clock-names: should be "xvclk".
- dovdd-supply: Digital I/O voltage supply, 1.8 volts
- avdd-supply: Analog voltage supply, 2.8 volts
- dvdd-supply: Digital core voltage supply, 1.2 volts
- reset-gpios: Low active reset gpio
- pwdn-gpios: Low active power-down gpio

Attention:
GC2053 device address 0x37(7bit)

Example:
&i2c1 {
	status = "okay";
	gc2053: gc2053@37 {
		compatible = "galaxycore,gc2053";
		reg = <0x37>;
		clocks = <&cru CLK_MIPICSI_OUT>;
		clock-names = "xvclk";
		power-domains = <&power RV1126_PD_VI>;
		pinctrl-names = "rockchip,camera_default";
		pinctrl-0 = <&mipicsi_clk0>;
		power-gpios = <&gpio3 RK_PA6 GPIO_ACTIVE_HIGH>;
		pwdn-gpios = <&gpio1 RK_PD4 GPIO_ACTIVE_LOW>;
		reset-gpios = <&gpio1 RK_PD5 GPIO_ACTIVE_LOW>;
		avdd-supply = <&vcc_avdd>;
		dovdd-supply = <&vcc_dovdd>;
		dvdd-supply = <&vcc_dvdd>;
		rockchip,camera-module-index = <0>;
		rockchip,camera-module-facing = "front";
		rockchip,camera-module-name = "YT-RV1109-2-V1";
		rockchip,camera-module-lens-name = "40IR-2MP-F20";
		port {
			ucam_out0: endpoint {
				remote-endpoint = <&mipi_in_ucam0>;
				data-lanes = <1 2>;
			};
		};
	};
};
```

## Documentation/devicetree/bindings/media/i2c/gc4663.txt
```
* galaxycore,gc4663 MIPI sensor

Required Properties:
- compatible: should be "galaxycore,gc4663"
- clocks: reference to the 24M xvclk input clock.
- clock-names: should be "xvclk".
- dovdd-supply: Digital I/O voltage supply, 1.8 volts
- avdd-supply: Analog voltage supply, 2.8 volts
- dvdd-supply: Digital core voltage supply, 1.2 volts
- reset-gpios: High active reset gpio

Attention:
GC4C33 device address 0x29(7bit)

Example:
&i2c1 {
	status = "okay";
	gc4663: gc4663@29 {
		compatible = "galaxycore,gc4663";
		reg = <0x29>;
		clocks = <&cru CLK_MIPICSI_OUT>;
		clock-names = "xvclk";
		power-domains = <&power RV1126_PD_VI>;
		pinctrl-names = "rockchip,camera_default";
		pinctrl-0 = <&mipicsi_clk0>;
		avdd-supply = <&vcc_avdd>;
		dovdd-supply = <&vcc_dovdd>;
		dvdd-supply = <&vcc_dvdd>;
		pwdn-gpios = <&gpio1 RK_PD4 GPIO_ACTIVE_HIGH>;
		reset-gpios = <&gpio1 RK_PD5 GPIO_ACTIVE_HIGH>;
		rockchip,camera-module-index = <1>;
		rockchip,camera-module-facing = "front";
		rockchip,camera-module-name = "TRC-2232A6";
		rockchip,camera-module-lens-name = "28IRC-4M-F22";
		/* NO_HDR:0 HDR_X2:5 HDR_X3:6 */
		rockchip,camera-hdr-mode = <5>;
		port {
			sc4238_out: endpoint {
				remote-endpoint = <&mipi_in_ucam1>;
				data-lanes = <1 2>;
			};
		};
	};
};
```

## Documentation/devicetree/bindings/media/i2c/gc4c33.txt
```
* galaxycore,gc4c33 MIPI sensor

Required Properties:
- compatible: should be "galaxycore,gc4c33"
- clocks: reference to the 27M xvclk input clock.
- clock-names: should be "xvclk".
- dovdd-supply: Digital I/O voltage supply, 1.8 volts
- avdd-supply: Analog voltage supply, 2.8 volts
- dvdd-supply: Digital core voltage supply, 1.2 volts
- reset-gpios: High active reset gpio

Attention:
GC4C33 device address 0x29(7bit)

Example:
&i2c1 {
	status = "okay";
	gc4c33: gc4c33@29 {
		compatible = "galaxycore,gc4c33";
		reg = <0x29>;
		clocks = <&cru CLK_MIPICSI_OUT>;
		clock-names = "xvclk";
		power-domains = <&power RV1126_PD_VI>;
		pinctrl-names = "rockchip,camera_default";
		pinctrl-0 = <&mipicsi_clk0>;
		avdd-supply = <&vcc_avdd>;
		dovdd-supply = <&vcc_dovdd>;
		dvdd-supply = <&vcc_dvdd>;
		pwdn-gpios = <&gpio1 RK_PD4 GPIO_ACTIVE_HIGH>;
		reset-gpios = <&gpio1 RK_PD5 GPIO_ACTIVE_HIGH>;
		rockchip,camera-module-index = <1>;
		rockchip,camera-module-facing = "front";
		rockchip,camera-module-name = "PCORW0009A";
		rockchip,camera-module-lens-name = "40IRC-4M";
		/* NO_HDR:0 HDR_X2:5 HDR_X3:6 */
		rockchip,camera-hdr-mode = <0>;
		port {
			sc4238_out: endpoint {
				remote-endpoint = <&mipi_in_ucam1>;
				data-lanes = <1 2>;
			};
		};
	};
};
```
