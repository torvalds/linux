## Documentation/devicetree/bindings/media/i2c/panasonic,amg88xx.txt
```
* Panasonic AMG88xx

The Panasonic family of AMG88xx Grid-Eye sensors allow recording
8x8 10Hz video which consists of thermal datapoints

Required Properties:
 - compatible : Must be "panasonic,amg88xx"
 - reg : i2c address of the device

Example:

	i2c0@1c22000 {
		...
		amg88xx@69 {
			compatible = "panasonic,amg88xx";
			reg = <0x69>;
		};
		...
	};
```

## Documentation/devicetree/bindings/media/i2c/rda,rda5807.yaml
```yaml
# SPDX-License-Identifier: (GPL-2.0-only OR BSD-2-Clause)
%YAML 1.2
---
$id: http://devicetree.org/schemas/media/i2c/rda,rda5807.yaml#
$schema: http://devicetree.org/meta-schemas/core.yaml#

title: Unisoc Communications RDA5807 FM radio receiver

maintainers:
  - Paul Cercueil <paul@crapouillou.net>

properties:
  compatible:
    enum:
      - rda,rda5807

  reg:
    description: I2C address.
    maxItems: 1

  power-supply: true

  rda,lnan:
    description: Use LNAN input port.
    type: boolean

  rda,lnap:
    description: Use LNAP input port.
    type: boolean

  rda,analog-out:
    description: Enable analog audio output.
    type: boolean

  rda,i2s-out:
    description: Enable I2S digital audio output.
    type: boolean

  rda,lna-microamp:
    description: LNA working current, in micro-amperes.
    default: 2500
    enum: [1800, 2100, 2500, 3000]

required:
  - compatible
  - reg
  - power-supply

additionalProperties: false

examples:
  - |
    i2c0 {
      #address-cells = <1>;
      #size-cells = <0>;

      radio@11 {
        compatible = "rda,rda5807";
        reg = <0x11>;

        power-supply = <&ldo6>;

        rda,lnan;
        rda,lnap;
        rda,analog-out;
      };
    };
```

## Documentation/devicetree/bindings/media/i2c/rk628.txt
```
* RK628 HDMI-RX to MIPI CSI2-TX Bridge

The RK628 HDMI-RX to MIPI CSI2-TX (H2C) is a bridge that converts
a HDMI stream to MIPI CSI-2 TX. It is programmable through I2C.

Required Properties:
- compatible: value should be "rockchip,rk628-csi-v4l2"
- reg: I2C device address

Optional Properties:
- reset-gpios: gpio phandle GPIO connected to the reset pin
- enable-gpios: a GPIO spec for the enable pin
- plugin-det-gpios: HDMI 5V detect pin
- interrupts: GPIO connected to the interrupt pin
- data-lanes: should be <1 2 3 4> for four-lane operation,
	      or <1 2> for two-lane operation

For further information on the MIPI CSI-2 endpoint node properties, see
Documentation/devicetree/bindings/media/video-interfaces.txt.

Example:

	rk628_csi_v4l2: rk628_csi_v4l2@50 {
		reg = <0x50>;
		compatible = "rockchip,rk628-csi-v4l2";
		interrupt-parent = <&gpio2>;
		interrupts = <2 IRQ_TYPE_LEVEL_HIGH>;
		enable-gpios = <&gpio5 RK_PC3 GPIO_ACTIVE_HIGH>;
		reset-gpios = <&gpio2 RK_PA3 GPIO_ACTIVE_LOW>;
		plugin-det-gpios = <&gpio2 RK_PA4 GPIO_ACTIVE_LOW>;

		rockchip,camera-module-index = <0>;
		rockchip,camera-module-facing = "back";
		rockchip,camera-module-name = "RK628-CSI";
		rockchip,camera-module-lens-name = "NC";

		port {
			hdmiin_out0: endpoint {
				remote-endpoint = <&mipi_in>;
				data-lanes = <1 2 3 4>;
			};
		};
	};
```

## Documentation/devicetree/bindings/media/i2c/samsung,s5k3m5.yaml
```yaml
# SPDX-License-Identifier: (GPL-2.0-only OR BSD-2-Clause)
%YAML 1.2
---
$id: http://devicetree.org/schemas/media/i2c/samsung,s5k3m5.yaml#
$schema: http://devicetree.org/meta-schemas/core.yaml#

title: Samsung S5K3M5 Image Sensor

description:
  Samsung S5K3M5 (ISOCELL 3M5) image sensor is a 13MP image sensor.
  The sensor is controlled over a serial camera control bus protocol,
  the widest supported output image frame size is 4208x3120 at 30 frames
  per second, data output format is RAW10 transferred over 4-lane
  MIPI D-PHY interface.

maintainers:
  - Vladimir Zapolskiy <vladimir.zapolskiy@linaro.org>

allOf:
  - $ref: /schemas/media/video-interface-devices.yaml#

properties:
  compatible:
    const: samsung,s5k3m5

  reg:
    maxItems: 1

  clocks:
    description: MCLK supply clock.
    maxItems: 1

  reset-gpios:
    description: Active low GPIO connected to RESET pad of the sensor.
    maxItems: 1

  afvdd-supply:
    description: Autofocus actuator voltage supply, 2.8-3.0 volts.

  vdda-supply:
    description: Analogue voltage supply, 2.8 volts.

  vddd-supply:
    description: Digital core voltage supply, 1.05 volts.

  vddio-supply:
    description: Digital I/O voltage supply, 2.8 or 1.8 volts.

  port:
    $ref: /schemas/graph.yaml#/$defs/port-base
    additionalProperties: false

    properties:
      endpoint:
        $ref: /schemas/media/video-interfaces.yaml#
        unevaluatedProperties: false

        properties:
          data-lanes:
            items:
              - const: 1
              - const: 2
              - const: 3
              - const: 4

        required:
          - link-frequencies

required:
  - compatible
  - reg
  - port

unevaluatedProperties: false

examples:
  - |
      #include <dt-bindings/gpio/gpio.h>

      i2c {
          #address-cells = <1>;
          #size-cells = <0>;

          camera@10 {
              compatible = "samsung,s5k3m5";
              reg = <0x10>;
              clocks = <&camera_mclk 0>;
              assigned-clocks = <&camera_mclk 0>;
              assigned-clock-rates = <24000000>;
              reset-gpios = <&gpio1 10 GPIO_ACTIVE_LOW>;
              vdda-supply = <&vreg_2p8>;
              vddd-supply = <&vreg_1p05>;
              vddio-supply = <&vreg_1p8>;

              port {
                  endpoint {
                      link-frequencies = /bits/ 64 <602500000>;
                      remote-endpoint = <&mipi_csi2_ep>;
                  };
              };
          };
      };
...
```

## Documentation/devicetree/bindings/media/i2c/samsung,s5k5baf.yaml
```yaml
# SPDX-License-Identifier: GPL-2.0-only OR BSD-2-Clause
%YAML 1.2
---
$id: http://devicetree.org/schemas/media/i2c/samsung,s5k5baf.yaml#
$schema: http://devicetree.org/meta-schemas/core.yaml#

title: Samsung S5K5BAF UXGA 1/5" 2M CMOS Image Sensor with embedded SoC ISP

maintainers:
  - Krzysztof Kozlowski <krzysztof.kozlowski@linaro.org>

properties:
  compatible:
    const: samsung,s5k5baf

  reg:
    maxItems: 1

  clocks:
    maxItems: 1

  clock-names:
    items:
      - const: mclk

  clock-frequency:
    default: 24000000
    description: mclk clock frequency
    deprecated: true

  rstn-gpios:
    maxItems: 1
    description: RSTN pin

  stbyn-gpios:
    maxItems: 1
    description: STDBYN pin

  vdda-supply:
    description: Analog power supply 2.8V (2.6V to 3.0V)

  vddio-supply:
    description: I/O power supply 1.8V (1.65V to 1.95V) or 2.8V (2.5V to 3.1V)

  vddreg-supply:
    description:
      Regulator input power supply 1.8V (1.7V to 1.9V) or 2.8V (2.6V to 3.0)

  port:
    $ref: /schemas/graph.yaml#/$defs/port-base
    additionalProperties: false

    properties:
      endpoint:
        $ref: /schemas/media/video-interfaces.yaml#
        unevaluatedProperties: false

        properties:
          data-lanes:
            items:
              - const: 1

required:
  - compatible
  - clocks
  - clock-names
  - rstn-gpios
  - stbyn-gpios
  - vdda-supply
  - vddio-supply
  - vddreg-supply

additionalProperties: false

examples:
  - |
    #include <dt-bindings/gpio/gpio.h>

    i2c {
        #address-cells = <1>;
        #size-cells = <0>;

        sensor@2d {
            compatible = "samsung,s5k5baf";
            reg = <0x2d>;

            clocks = <&camera 0>;
            assigned-clocks = <&camera 0>;
            assigned-clock-rates = <24000000>;

            clock-names = "mclk";
            rstn-gpios = <&gpl2 1 GPIO_ACTIVE_LOW>;
            stbyn-gpios = <&gpl2 0 GPIO_ACTIVE_LOW>;
            vdda-supply = <&cam_io_en_reg>;
            vddio-supply = <&vtcam_reg>;
            vddreg-supply = <&vt_core_15v_reg>;

            port {
                endpoint {
                    remote-endpoint = <&csis1_ep>;
                    data-lanes = <1>;
                };
            };
        };
    };
```

## Documentation/devicetree/bindings/media/i2c/samsung,s5k6a3.yaml
```yaml
# SPDX-License-Identifier: GPL-2.0-only OR BSD-2-Clause
%YAML 1.2
---
$id: http://devicetree.org/schemas/media/i2c/samsung,s5k6a3.yaml#
$schema: http://devicetree.org/meta-schemas/core.yaml#

title: Samsung S5K6A3(YX) raw image sensor

maintainers:
  - Krzysztof Kozlowski <krzysztof.kozlowski@linaro.org>

description:
  S5K6A3(YX) is a raw image sensor with MIPI CSI-2 and CCP2 image data
  interfaces and CCI (I2C compatible) control bus.

properties:
  compatible:
    const: samsung,s5k6a3

  reg:
    maxItems: 1

  clocks:
    maxItems: 1

  clock-names:
    items:
      - const: extclk

  clock-frequency:
    default: 24000000
    description: extclk clock frequency
    deprecated: true

  gpios:
    maxItems: 1
    description: GPIO connected to the RESET pin

  afvdd-supply:
    description: AF (actuator) voltage supply

  svdda-supply:
    description: Core voltage supply

  svddio-supply:
    description: I/O voltage supply

  port:
    $ref: /schemas/graph.yaml#/$defs/port-base
    additionalProperties: false

    properties:
      endpoint:
        $ref: /schemas/media/video-interfaces.yaml#
        unevaluatedProperties: false

        properties:
          data-lanes:
            items:
              - const: 1

required:
  - compatible
  - clocks
  - clock-names
  - gpios
  - afvdd-supply
  - svdda-supply
  - svddio-supply

additionalProperties: false

examples:
  - |
    #include <dt-bindings/gpio/gpio.h>

    i2c {
        #address-cells = <1>;
        #size-cells = <0>;

        sensor@10 {
            compatible = "samsung,s5k6a3";
            reg = <0x10>;

            clocks = <&camera 1>;
            assigned-clocks = <&camera 1>;
            assigned-clock-rates = <24000000>;

            clock-names = "extclk";
            gpios = <&gpm1 6 GPIO_ACTIVE_LOW>;
            afvdd-supply = <&ldo19_reg>;
            svdda-supply = <&cam_io_reg>;
            svddio-supply = <&ldo19_reg>;

            port {
                endpoint {
                    remote-endpoint = <&csis1_ep>;
                    data-lanes = <1>;
                };
            };
        };
    };
```

## Documentation/devicetree/bindings/media/i2c/sc200ai.txt
```
* smartsens,sc200ai MIPI sensor

Required Properties:
- compatible: should be "smartsens,sc200ai"
- clocks: reference to the 27M xvclk input clock.
- clock-names: should be "xvclk".
- dovdd-supply: Digital I/O voltage supply, 1.8 volts
- avdd-supply: Analog voltage supply, 2.8 volts
- dvdd-supply: Digital core voltage supply, 1.2 volts
- reset-gpios: High active reset gpio

Attention:
SC4238 device address 0x30(7bit)；

The device node must contain one 'port' child node for its digital output
video port, in accordance with the video interface bindings defined in
Documentation/devicetree/bindings/media/video-interfaces.txt.

Example:

&i2c1 {
	status = "okay";
	sc200ai: sc200ai@30 {
		compatible = "smartsens,sc200ai";
		reg = <0x30>;
		clocks = <&cru CLK_MIPICSI_OUT>;
		clock-names = "xvclk";
		power-domains = <&power RV1126_PD_VI>;
		pinctrl-names = "rockchip,camera_default";
		pinctrl-0 = <&mipicsi_clk0>;
		avdd-supply = <&vcc_avdd>;
		dovdd-supply = <&vcc_dovdd>;
		dvdd-supply = <&vcc_dvdd>;
		pwdn-gpios = <&gpio1 RK_PD4 GPIO_ACTIVE_HIGH>;
		reset-gpios = <&gpio1 RK_PD5 GPIO_ACTIVE_HIGH>;
		rockchip,camera-module-index = <1>;
		rockchip,camera-module-facing = "front";
		rockchip,camera-module-name = "C7234A-400";
		rockchip,camera-module-lens-name = "30IRC-2MP-F20";
		/* NO_HDR:0 HDR_X2:5 HDR_X3:6 */
		rockchip,camera-hdr-mode = <5>;

		port {
			sc4238_out: endpoint {
				remote-endpoint = <&mipi_in_ucam1>;
				data-lanes = <1 2>;
			};
		};
	};
};
```

## Documentation/devicetree/bindings/media/i2c/sc2239.txt
```
* Smartsens SC2239 MIPI sensor

Required Properties:
- compatible: should be "smartsens,sc2239"
- clocks: reference to the 24M xvclk input clock.
- clock-names: should be "xvclk".
- dovdd-supply: Digital I/O voltage supply, 1.8 volts
- avdd-supply: Analog voltage supply, 2.8 volts
- dvdd-supply: Digital core voltage supply, 1.5 volts
- pwdn-gpios High active reset gpio
- reset-gpios: High active reset gpio

Attention:
SC2239 device address 0x30(7bit) or 0x32(7bit) is decided by SID pin;

The device node must contain one 'port' child node for its digital output
video port, in accordance with the video interface bindings defined in
Documentation/devicetree/bindings/media/video-interfaces.txt.

Example:
//rv1126 evb13 board
&i2c1 {
	status = "okay";
	sc2239: sc2239@30 {	// or sc2239: sc2239@32
		compatible = "smartsens,sc2239";
		reg = <0x30>;
		clocks = <&cru CLK_MIPICSI_OUT>;
		clock-names = "xvclk";
		power-domains = <&power RV1126_PD_VI>;
		pinctrl-names = "rockchip,camera_default";
		pinctrl-0 = <&mipicsi_clk0>;
		avdd-supply = <&vcc_avdd>;
		dovdd-supply = <&vcc_dovdd>;
		dvdd-supply = <&vcc_dvdd>;
		pwdn-gpios = <&gpio1 RK_PD4 GPIO_ACTIVE_HIGH>;
		reset-gpios = <&gpio1 RK_PD5 GPIO_ACTIVE_HIGH>;
		rockchip,camera-module-index = <1>;
		rockchip,camera-module-facing = "front";
		rockchip,camera-module-name = "CMK-OT1607-FV1";
		rockchip,camera-module-lens-name = "M12-40IRC-4MP-F16";
		/* NO_HDR:0 HDR_X2:5 HDR_X3:6 */
		rockchip,camera-hdr-mode = <5>;
		port {
			sc2239_out: endpoint {
				remote-endpoint = <&mipi_in_ucam>;
				data-lanes = <1>;
			};
		};
	};
};
```

## Documentation/devicetree/bindings/media/i2c/sc4238.txt
```
* Smartsens SC4238 MIPI sensor

Required Properties:
- compatible: should be "smartsens,sc4238"
- clocks: reference to the 24M xvclk input clock.
- clock-names: should be "xvclk".
- dovdd-supply: Digital I/O voltage supply, 1.8 volts
- avdd-supply: Analog voltage supply, 2.8 volts
- dvdd-supply: Digital core voltage supply, 1.5 volts
- reset-gpios: Low active reset gpio

Attention:
SC4238 device address 0x30(7bit) or 0x32(7bit) is decided by SID pin;

The device node must contain one 'port' child node for its digital output
video port, in accordance with the video interface bindings defined in
Documentation/devicetree/bindings/media/video-interfaces.txt.

Example:
//rv1126 evb13 board
&i2c1 {
	status = "okay";
	sc4238: sc4238@30 {	// or sc4238: sc4238@32
		compatible = "smartsens,sc4238";
		reg = <0x30>;
		clocks = <&cru CLK_MIPICSI_OUT>;
		clock-names = "xvclk";
		power-domains = <&power RV1126_PD_VI>;
		pinctrl-names = "rockchip,camera_default";
		pinctrl-0 = <&mipicsi_clk0>;
		avdd-supply = <&vcc_avdd>;
		dovdd-supply = <&vcc_dovdd>;
		dvdd-supply = <&vcc_dvdd>;
		pwdn-gpios = <&gpio1 RK_PD4 GPIO_ACTIVE_HIGH>;
		reset-gpios = <&gpio1 RK_PD5 GPIO_ACTIVE_LOW>;
		rockchip,camera-module-index = <1>;
		rockchip,camera-module-facing = "front";
		rockchip,camera-module-name = "CMK-OT1607-FV1";
		rockchip,camera-module-lens-name = "M12-40IRC-4MP-F16";
		/* NO_HDR:0 HDR_X2:5 HDR_X3:6 */
		rockchip,camera-hdr-mode = <5>;
		ir-cut = <&cam_ircut0>;
		port {
			sc4238_out: endpoint {
				remote-endpoint = <&mipi_in_ucam1>;
				data-lanes = <1 2 3 4>;
			};
		};
	};
};
```
