## Documentation/devicetree/bindings/media/i2c/sgm3784.txt
```
* SGM3784 dual flash driver support

Required Properties:
- compatible: Must contain "sgmicro,gsm3784"
- reg: I2C slave address
- enable-gpios: Specifier of the GPIO connected to EN pin
- strobe-gpio: Specifier of the GPIO connected to STROBE pin
- torch-gpio: Specifier of the GPIO connected to GPIO pin,
this pin is for torch mode, if not, will using assist mode.


A discrete LED element connected to the device must be represented by a child
node - see Documentation/devicetree/bindings/leds/common.txt.

Required properties of the LED child node:
- led-max-microamp : see Documentation/devicetree/bindings/leds/common.txt
- flash-max-microamp : see Documentation/devicetree/bindings/leds/common.txt
- flash-max-timeout-us : see Documentation/devicetree/bindings/leds/common.txt

Special properties:
- rockchip,camera-module-index : indicate which camera the flash belongs to.
- rockchip,camera-module-facing : indicate the camera facing.

Example:

&i2c1 {
	...
	sgm3784: sgm3784@30 {
		#address-cells = <1>;
		#size-cells = <0>;
		compatible = "sgmicro,gsm3784";
		reg = <0x30>;
		rockchip,camera-module-index = <0>;
		rockchip,camera-module-facing = "back";
		enable-gpio = <&gpio2 RK_PB4 GPIO_ACTIVE_HIGH>;
		strobe-gpio = <&gpio1 RK_PA3 GPIO_ACTIVE_HIGH>;
		status = "okay";
		sgm3784_led0: led@0 {
			reg = <0x0>;
			led-max-microamp = <299200>;
			flash-max-microamp = <1122000>;
			flash-max-timeout-us = <1600000>;
		};

		sgm3784_led1: led@1 {
			reg = <0x1>;
			led-max-microamp = <299200>;
			flash-max-microamp = <1122000>;
			flash-max-timeout-us = <1600000>;
		};
	};
	...
	ov13850: ov13850@10 {
		...
		flash-leds = <&sgm3784_led0 &sgm3784_led1>;
		...
	};
	...
}
```

## Documentation/devicetree/bindings/media/i2c/sony,imx111.yaml
```yaml
# SPDX-License-Identifier: (GPL-2.0-only OR BSD-2-Clause)
%YAML 1.2
---
$id: http://devicetree.org/schemas/media/i2c/sony,imx111.yaml#
$schema: http://devicetree.org/meta-schemas/core.yaml#

title: Sony IMX111 8MP CMOS Digital Image Sensor

maintainers:
  - Svyatoslav Ryhel <clamor95@gmail.com>

description:
  IMX111 sensor is a Sony CMOS active pixel digital image sensor with an active
  array size of 2464H x 3280V. It is programmable through I2C interface. Image
  data is sent through MIPI CSI-2, through 1 or 2 lanes.

allOf:
  - $ref: /schemas/media/video-interface-devices.yaml#
  - $ref: /schemas/nvmem/nvmem-consumer.yaml#

properties:
  compatible:
    const: sony,imx111

  reg:
    maxItems: 1

  clocks:
    description: EXTCLK with possible frequency from 6 to 54 MHz
    maxItems: 1

  reset-gpios:
    maxItems: 1

  iovdd-supply:
    description: Digital IO power supply (1.8V)

  dvdd-supply:
    description: Digital power supply (1.2V)

  avdd-supply:
    description: Analog power supply (2.7V)

  port:
    additionalProperties: false
    $ref: /schemas/graph.yaml#/$defs/port-base

    properties:
      endpoint:
        $ref: /schemas/media/video-interfaces.yaml#
        unevaluatedProperties: false

        required:
          - data-lanes
          - link-frequencies

    required:
      - endpoint

required:
  - compatible
  - reg
  - clocks
  - port

unevaluatedProperties: false

examples:
  - |
    #include <dt-bindings/gpio/gpio.h>
    #include <dt-bindings/media/video-interfaces.h>

    i2c {
        #address-cells = <1>;
        #size-cells = <0>;

        camera@10 {
            compatible = "sony,imx111";
            reg = <0x10>;

            clocks = <&imx111_clk>;

            iovdd-supply = <&camera_vddio_1v8>;
            dvdd-supply = <&camera_vddd_1v2>;
            avdd-supply = <&camera_vdda_2v7>;

            orientation = <1>;
            rotation = <90>;

            nvmem = <&eeprom>;
            flash-leds = <&led>;
            lens-focus = <&vcm>;

            reset-gpios = <&gpio 84 GPIO_ACTIVE_LOW>;

            port {
                imx111_output: endpoint {
                    data-lanes = <1 2>;
                    link-frequencies = /bits/ 64 <542400000>;
                    remote-endpoint = <&csi_input>;
                };
            };
        };
    };
...
```

## Documentation/devicetree/bindings/media/i2c/sony,imx214.txt
```
* Sony 1/3.06-Inch 13.13Mp CMOS Digital Image Sensor

The Sony imx214 is a 1/3.06-inch CMOS active pixel digital image sensor with
an active array size of 4224H x 3200V. It is programmable through an I2C
interface.
Image data is sent through MIPI CSI-2, through 2 or 4 lanes at a maximum
throughput of 1.2Gbps/lane.


Required Properties:
- compatible: Shall be "sony,imx214".
- reg: I2C bus address of the device. Depending on how the sensor is wired,
       it shall be <0x10> or <0x1a>;
- enable-gpios: GPIO descriptor for the enable pin.
- vdddo-supply: Chip digital IO regulator (1.8V).
- vdda-supply: Chip analog regulator (2.7V).
- vddd-supply: Chip digital core regulator (1.12V).
- clocks: Reference to the xclk clock.
- clock-frequency: Frequency of the xclk clock.

Optional Properties:
- flash-leds: See ../video-interfaces.txt
- lens-focus: See ../video-interfaces.txt

The imx214 device node shall contain one 'port' child node with
an 'endpoint' subnode. For further reading on port node refer to
Documentation/devicetree/bindings/media/video-interfaces.txt.

Required Properties on endpoint:
- data-lanes: check ../video-interfaces.txt
- link-frequencies: check ../video-interfaces.txt
- remote-endpoint: check ../video-interfaces.txt

Example:

	camera-sensor@1a {
		compatible = "sony,imx214";
		reg = <0x1a>;
		vdddo-supply = <&pm8994_lvs1>;
		vddd-supply = <&camera_vddd_1v12>;
		vdda-supply = <&pm8994_l17>;
		lens-focus = <&ad5820>;
		enable-gpios = <&msmgpio 25 GPIO_ACTIVE_HIGH>;
		clocks = <&mmcc CAMSS_MCLK0_CLK>;
		clock-frequency = <24000000>;
		port {
			imx214_ep: endpoint {
				data-lanes = <1 2 3 4>;
				link-frequencies = /bits/ 64 <480000000>;
				remote-endpoint = <&csiphy0_ep>;
			};
		};
	};
```

## Documentation/devicetree/bindings/media/i2c/sony,imx214.yaml
```yaml
# SPDX-License-Identifier: (GPL-2.0-only OR BSD-2-Clause)
%YAML 1.2
---
$id: http://devicetree.org/schemas/media/i2c/sony,imx214.yaml#
$schema: http://devicetree.org/meta-schemas/core.yaml#

title: Sony 1/3.06-Inch 13.13MP CMOS Digital Image Sensor

maintainers:
  - Ricardo Ribalda <ribalda@kernel.org>

description: |
  The Sony IMX214 is a 1/3.06-inch CMOS active pixel digital image sensor with
  an active array size of 4224H x 3200V. It is programmable through an I2C
  interface. Image data is sent through MIPI CSI-2, through 2 or 4 lanes at a
  maximum throughput of 1.2Gbps/lane.

allOf:
  - $ref: /schemas/media/video-interface-devices.yaml#

properties:
  compatible:
    const: sony,imx214

  reg:
    enum:
      - 0x10
      - 0x1a

  clocks:
    description: Reference to the xclk clock.
    maxItems: 1

  clock-frequency:
    description: Frequency of the xclk clock in Hz.

  enable-gpios:
    description: GPIO descriptor for the enable pin.
    maxItems: 1

  vdddo-supply:
    description: Chip digital IO regulator (1.8V).

  vdda-supply:
    description: Chip analog regulator (2.7V).

  vddd-supply:
    description: Chip digital core regulator (1.12V).

  flash-leds: true
  lens-focus: true

  port:
    $ref: /schemas/graph.yaml#/$defs/port-base
    description: |
      Video output port.

    properties:
      endpoint:
        $ref: /schemas/media/video-interfaces.yaml#
        unevaluatedProperties: false

        properties:
          data-lanes:
            anyOf:
              - items:
                  - const: 1
                  - const: 2
              - items:
                  - const: 1
                  - const: 2
                  - const: 3
                  - const: 4

          link-frequencies: true

        required:
          - data-lanes
          - link-frequencies

    additionalProperties: false

required:
  - compatible
  - reg
  - clocks
  - clock-frequency
  - enable-gpios
  - vdddo-supply
  - vdda-supply
  - vddd-supply
  - port

unevaluatedProperties: false

examples:
  - |
    #include <dt-bindings/gpio/gpio.h>

    i2c {
        #address-cells = <1>;
        #size-cells = <0>;

        camera-sensor@1a {
            compatible = "sony,imx214";
            reg = <0x1a>;
            vdddo-supply = <&pm8994_lvs1>;
            vddd-supply = <&camera_vddd_1v12>;
            vdda-supply = <&pm8994_l17>;
            lens-focus = <&ad5820>;
            enable-gpios = <&msmgpio 25 GPIO_ACTIVE_HIGH>;
            clocks = <&camera_clk>;
            clock-frequency = <24000000>;

            port {
                imx214_ep: endpoint {
                    data-lanes = <1 2 3 4>;
                    link-frequencies = /bits/ 64 <480000000>;
                    remote-endpoint = <&csiphy0_ep>;
                };
            };
        };
    };

...
```
