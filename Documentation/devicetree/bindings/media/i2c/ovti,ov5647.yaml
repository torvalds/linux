## Documentation/devicetree/bindings/media/i2c/ovti,ov5647.yaml
```yaml
# SPDX-License-Identifier: (GPL-2.0-only OR BSD-2-Clause)
%YAML 1.2
---
$id: http://devicetree.org/schemas/media/i2c/ovti,ov5647.yaml#
$schema: http://devicetree.org/meta-schemas/core.yaml#

title: Omnivision OV5647 raw image sensor

maintainers:
  - Dave Stevenson <dave.stevenson@raspberrypi.com>
  - Jacopo Mondi <jacopo@jmondi.org>

description: |-
  The OV5647 is a raw image sensor with MIPI CSI-2 and CCP2 image data
  interfaces and CCI (I2C compatible) control bus.

properties:
  compatible:
    const: ovti,ov5647

  reg:
    description: I2C device address.
    maxItems: 1

  clocks:
    description: Reference to the xclk clock.
    maxItems: 1

  pwdn-gpios:
    description: Reference to the GPIO connected to the pwdn pin. Active high.
    maxItems: 1

  port:
    $ref: /schemas/graph.yaml#/$defs/port-base

    properties:
      endpoint:
        $ref: /schemas/media/video-interfaces.yaml#
        unevaluatedProperties: false

        properties:
          clock-noncontinuous: true

    additionalProperties: false

required:
  - compatible
  - reg
  - clocks
  - port

additionalProperties: false

examples:
  - |
    #include <dt-bindings/gpio/gpio.h>

    i2c {
        #address-cells = <1>;
        #size-cells = <0>;

        ov5647: camera@36 {
            compatible = "ovti,ov5647";
            reg = <0x36>;
            clocks = <&camera_clk>;
            pwdn-gpios = <&pioE 29 GPIO_ACTIVE_HIGH>;

            port {
                camera_out: endpoint {
                    remote-endpoint = <&csi1_ep1>;
                };
            };
        };
    };

...
```

## Documentation/devicetree/bindings/media/i2c/ovti,ov5648.yaml
```yaml
# SPDX-License-Identifier: (GPL-2.0 OR BSD-2-Clause)
%YAML 1.2
---
$id: http://devicetree.org/schemas/media/i2c/ovti,ov5648.yaml#
$schema: http://devicetree.org/meta-schemas/core.yaml#

title: OmniVision OV5648 Image Sensor

maintainers:
  - Paul Kocialkowski <paul.kocialkowski@bootlin.com>

properties:
  compatible:
    const: ovti,ov5648

  reg:
    maxItems: 1

  clocks:
    items:
      - description: XVCLK Clock

  dvdd-supply:
    description: Digital Domain Power Supply

  avdd-supply:
    description: Analog Domain Power Supply (internal AVDD is used if missing)

  dovdd-supply:
    description: I/O Domain Power Supply

  powerdown-gpios:
    maxItems: 1
    description: Power Down Pin GPIO Control (active low)

  reset-gpios:
    maxItems: 1
    description: Reset Pin GPIO Control (active low)

  port:
    description: MIPI CSI-2 transmitter port
    $ref: /schemas/graph.yaml#/$defs/port-base
    additionalProperties: false

    properties:
      endpoint:
        $ref: /schemas/media/video-interfaces.yaml#
        unevaluatedProperties: false

        properties:
          link-frequencies: true

          data-lanes:
            minItems: 1
            maxItems: 2

        required:
          - data-lanes
          - link-frequencies

required:
  - compatible
  - reg
  - clocks
  - dvdd-supply
  - dovdd-supply
  - port

additionalProperties: false

examples:
  - |
    #include <dt-bindings/clock/sun8i-v3s-ccu.h>
    #include <dt-bindings/gpio/gpio.h>

    i2c {
        #address-cells = <1>;
        #size-cells = <0>;

        ov5648: camera@36 {
            compatible = "ovti,ov5648";
            reg = <0x36>;

            dvdd-supply = <&ov5648_dvdd>;
            avdd-supply = <&ov5648_avdd>;
            dovdd-supply = <&ov5648_dovdd>;
            clocks = <&ov5648_xvclk 0>;

            ov5648_out: port {
                ov5648_out_mipi_csi2: endpoint {
                    data-lanes = <1 2>;
                    link-frequencies = /bits/ 64 <210000000 168000000>;

                    remote-endpoint = <&mipi_csi2_in_ov5648>;
                };
            };
        };
    };
```

## Documentation/devicetree/bindings/media/i2c/ovti,ov5670.yaml
```yaml
# SPDX-License-Identifier: (GPL-2.0-only OR BSD-2-Clause)
%YAML 1.2
---
$id: http://devicetree.org/schemas/media/i2c/ovti,ov5670.yaml#
$schema: http://devicetree.org/meta-schemas/core.yaml#

title: Omnivision OV5670 5 Megapixels raw image sensor

maintainers:
  - Jacopo Mondi <jacopo.mondi@ideasonboard.com>

description: |-
  The OV5670 is a 5 Megapixels raw image sensor which provides images in 10-bits
  RAW BGGR Bayer format on a 2 data lanes MIPI CSI-2 serial interface and is
  controlled through an I2C compatible control bus.

properties:
  compatible:
    const: ovti,ov5670

  reg:
    maxItems: 1

  clocks:
    description: System clock. From 6 to 27 MHz.
    maxItems: 1

  powerdown-gpios:
    description: Reference to the GPIO connected to the PWDNB pin. Active low.

  reset-gpios:
    description: Reference to the GPIO connected to the XSHUTDOWN pin. Active low.
    maxItems: 1

  avdd-supply:
    description: Analog circuit power. Typically 2.8V.

  dvdd-supply:
    description: Digital circuit power. Typically 1.2V.

  dovdd-supply:
    description: Digital I/O circuit power. Typically 2.8V or 1.8V.

  port:
    $ref: /schemas/graph.yaml#/$defs/port-base
    additionalProperties: false

    properties:
      endpoint:
        $ref: /schemas/media/video-interfaces.yaml#
        additionalProperties: false

        properties:
          data-lanes:
            minItems: 1
            maxItems: 2
            items:
              enum: [1, 2]

          clock-noncontinuous: true
          remote-endpoint: true

required:
  - compatible
  - reg
  - clocks
  - port

additionalProperties: false

examples:
  - |
    i2c {
        #address-cells = <1>;
        #size-cells = <0>;

        ov5670: sensor@36 {
            compatible = "ovti,ov5670";
            reg = <0x36>;

            clocks = <&sensor_xclk>;

            port {
                ov5670_ep: endpoint {
                    remote-endpoint = <&csi_ep>;
                    data-lanes = <1 2>;
                    clock-noncontinuous;
                };
            };
        };
    };

...
```

## Documentation/devicetree/bindings/media/i2c/ovti,ov5675.yaml
```yaml
# SPDX-License-Identifier: (GPL-2.0-only OR BSD-2-Clause)
# Copyright (c) 2022 Theobroma Systems Design und Consulting GmbH
%YAML 1.2
---
$id: http://devicetree.org/schemas/media/i2c/ovti,ov5675.yaml#
$schema: http://devicetree.org/meta-schemas/core.yaml#

title: Omnivision OV5675 CMOS Sensor

maintainers:
  - Quentin Schulz <quentin.schulz@theobroma-systems.com>

allOf:
  - $ref: /schemas/media/video-interface-devices.yaml#

description: |
  The Omnivision OV5675 is a high performance, 1/5-inch, 5 megapixel, CMOS
  image sensor that delivers 2592x1944 at 30fps. It provides full-frame,
  sub-sampled, and windowed 10-bit MIPI images in various formats via the
  Serial Camera Control Bus (SCCB) interface.

  This chip is programmable through I2C and two-wire SCCB. The sensor output
  is available via CSI-2 serial data output (up to 2-lane).

properties:
  compatible:
    const: ovti,ov5675

  reg:
    maxItems: 1

  clocks:
    description:
      System input clock (aka XVCLK). From 6 to 27 MHz.
    maxItems: 1

  dovdd-supply:
    description:
      Digital I/O voltage supply, 1.8 volts.

  avdd-supply:
    description:
      Analog voltage supply, 2.8 volts.

  dvdd-supply:
    description:
      Digital core voltage supply, 1.2 volts.

  reset-gpios:
    description:
      The phandle and specifier for the GPIO that controls sensor reset.
      This corresponds to the hardware pin XSHUTDN which is physically
      active low.
    maxItems: 1

  port:
    $ref: /schemas/graph.yaml#/$defs/port-base
    additionalProperties: false

    properties:
      endpoint:
        $ref: /schemas/media/video-interfaces.yaml#
        unevaluatedProperties: false

        properties:
          data-lanes:
            minItems: 1
            maxItems: 2

          # Supports max data transfer of 900 Mbps per lane
          link-frequencies: true

required:
  - compatible
  - reg
  - clocks
  - dovdd-supply
  - avdd-supply
  - dvdd-supply
  - port

unevaluatedProperties: false

examples:
  - |
    #include <dt-bindings/clock/px30-cru.h>
    #include <dt-bindings/gpio/gpio.h>
    #include <dt-bindings/pinctrl/rockchip.h>

    i2c {
        #address-cells = <1>;
        #size-cells = <0>;

        ov5675: camera@36 {
            compatible = "ovti,ov5675";
            reg = <0x36>;

            reset-gpios = <&gpio2 RK_PB1 GPIO_ACTIVE_LOW>;
            pinctrl-names = "default";
            pinctrl-0 = <&cif_clkout_m0>;

            clocks = <&cru SCLK_CIF_OUT>;
            assigned-clocks = <&cru SCLK_CIF_OUT>;
            assigned-clock-rates = <19200000>;

            avdd-supply = <&vcc_1v8>;
            dvdd-supply = <&vcc_1v2>;
            dovdd-supply = <&vcc_2v8>;

            rotation = <90>;
            orientation = <0>;

            port {
                ucam_out: endpoint {
                    remote-endpoint = <&mipi_in_ucam>;
                    data-lanes = <1 2>;
                    link-frequencies = /bits/ 64 <450000000>;
                };
            };
        };
    };
...
```

## Documentation/devicetree/bindings/media/i2c/ovti,ov5693.yaml
```yaml
# SPDX-License-Identifier: (GPL-2.0-only OR BSD-2-Clause)
# Copyright (c) 2022 Amarulasolutions
%YAML 1.2
---
$id: http://devicetree.org/schemas/media/i2c/ovti,ov5693.yaml#
$schema: http://devicetree.org/meta-schemas/core.yaml#

title: Omnivision OV5693 CMOS Sensor

maintainers:
  - Tommaso Merciai <tommaso.merciai@amarulasolutions.com>

description: |
  The Omnivision OV5693 is a high performance, 1/4-inch, 5 megapixel, CMOS
  image sensor that delivers 2592x1944 at 30fps. It provides full-frame,
  sub-sampled, and windowed 10-bit MIPI images in various formats via the
  Serial Camera Control Bus (SCCB) interface.

  OV5693 is controlled via I2C and two-wire Serial Camera Control Bus (SCCB).
  The sensor output is available via CSI-2 serial data output (up to 2-lane).

allOf:
  - $ref: /schemas/media/video-interface-devices.yaml#

properties:
  compatible:
    const: ovti,ov5693

  reg:
    maxItems: 1

  clocks:
    description:
      System input clock (aka XVCLK). From 6 to 27 MHz.
    maxItems: 1

  dovdd-supply:
    description:
      Digital I/O voltage supply, 1.8V.

  avdd-supply:
    description:
      Analog voltage supply, 2.8V.

  dvdd-supply:
    description:
      Digital core voltage supply, 1.2V.

  reset-gpios:
    description:
      The phandle and specifier for the GPIO that controls sensor reset.
      This corresponds to the hardware pin XSHUTDN which is physically
      active low.
    maxItems: 1

  port:
    description: MIPI CSI-2 transmitter port
    $ref: /schemas/graph.yaml#/$defs/port-base
    additionalProperties: false

    properties:
      endpoint:
        $ref: /schemas/media/video-interfaces.yaml#
        unevaluatedProperties: false

        properties:
          link-frequencies: true

          data-lanes:
            minItems: 1
            maxItems: 2

        required:
          - data-lanes
          - link-frequencies

required:
  - compatible
  - reg
  - clocks
  - port

unevaluatedProperties: false

examples:
  - |
    #include <dt-bindings/clock/px30-cru.h>
    #include <dt-bindings/gpio/gpio.h>
    #include <dt-bindings/pinctrl/rockchip.h>

    i2c {
        #address-cells = <1>;
        #size-cells = <0>;

        ov5693: camera@36 {
            compatible = "ovti,ov5693";
            reg = <0x36>;

            reset-gpios = <&gpio2 RK_PB1 GPIO_ACTIVE_LOW>;
            pinctrl-names = "default";
            pinctrl-0 = <&cif_clkout_m0>;

            clocks = <&cru SCLK_CIF_OUT>;
            assigned-clocks = <&cru SCLK_CIF_OUT>;
            assigned-clock-rates = <19200000>;

            avdd-supply = <&vcc_1v8>;
            dvdd-supply = <&vcc_1v2>;
            dovdd-supply = <&vcc_2v8>;

            rotation = <90>;
            orientation = <0>;

            port {
                ucam_out: endpoint {
                    remote-endpoint = <&mipi_in_ucam>;
                    data-lanes = <1 2>;
                    link-frequencies = /bits/ 64 <450000000>;
                };
            };
        };
    };

...
```

## Documentation/devicetree/bindings/media/i2c/ovti,ov6211.yaml
```yaml
# SPDX-License-Identifier: (GPL-2.0-only OR BSD-2-Clause)
%YAML 1.2
---
$id: http://devicetree.org/schemas/media/i2c/ovti,ov6211.yaml#
$schema: http://devicetree.org/meta-schemas/core.yaml#

title: OmniVision OV6211 Image Sensor

description:
  OmniVision OV6211 image sensor is a high performance monochrome image
  sensor. The sensor is controlled over a serial camera control bus
  protocol (SCCB), the widest supported output image frame size is 400x400
  at 120 frames per second rate, data output format is 8/10-bit RAW
  transferred over one-lane MIPI D-PHY interface.

maintainers:
  - Vladimir Zapolskiy <vladimir.zapolskiy@linaro.org>

allOf:
  - $ref: /schemas/media/video-interface-devices.yaml#

properties:
  compatible:
    const: ovti,ov6211

  reg:
    maxItems: 1

  clocks:
    description: XVCLK supply clock, 6MHz to 27MHz frequency.
    maxItems: 1

  reset-gpios:
    description: Active low GPIO connected to XSHUTDOWN pad of the sensor.
    maxItems: 1

  strobe-gpios:
    description: Input GPIO connected to strobe pad of the sensor.
    maxItems: 1

  avdd-supply:
    description: Analogue voltage supply, 2.6 to 3.0 volts.

  dovdd-supply:
    description: Digital I/O voltage supply, 1.8 volts.

  dvdd-supply:
    description: Digital core voltage supply.

  port:
    $ref: /schemas/graph.yaml#/$defs/port-base
    additionalProperties: false

    properties:
      endpoint:
        $ref: /schemas/media/video-interfaces.yaml#
        unevaluatedProperties: false

        required:
          - link-frequencies

required:
  - compatible
  - reg
  - port

unevaluatedProperties: false

examples:
  - |
      #include <dt-bindings/gpio/gpio.h>

      i2c {
          #address-cells = <1>;
          #size-cells = <0>;

          camera@60 {
              compatible = "ovti,ov6211";
              reg = <0x60>;
              clocks = <&camera_clk 0>;
              assigned-clocks = <&camera_clk 0>;
              assigned-clock-rates = <24000000>;
              reset-gpios = <&gpio1 10 GPIO_ACTIVE_LOW>;
              avdd-supply = <&vreg_2p8>;
              dovdd-supply = <&vreg_1p8>;
              dvdd-supply = <&vreg_1p2>;

              port {
                  endpoint {
                      link-frequencies = /bits/ 64 <480000000>;
                      remote-endpoint = <&mipi_csi2_ep>;
                  };
              };
          };
      };
...
```
