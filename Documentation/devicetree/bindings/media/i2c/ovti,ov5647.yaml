## Documentation/devicetree/bindings/media/i2c/ovti,ov64a40.yaml
```yaml
# SPDX-License-Identifier: (GPL-2.0-only OR BSD-2-Clause)
%YAML 1.2
---
$id: http://devicetree.org/schemas/media/i2c/ovti,ov64a40.yaml#
$schema: http://devicetree.org/meta-schemas/core.yaml#

title: OmniVision OV64A40 Image Sensor

maintainers:
  - Jacopo Mondi <jacopo.mondi@ideasonboard.com>

allOf:
  - $ref: /schemas/media/video-interface-devices.yaml#

properties:
  compatible:
    const: ovti,ov64a40

  reg:
    maxItems: 1

  clocks:
    maxItems: 1

  avdd-supply:
    description: Analog voltage supply, 2.8 volts

  dvdd-supply:
    description: Digital core voltage supply, 1.1 volts

  dovdd-supply:
    description: Digital I/O voltage supply, 1.8 volts

  powerdown-gpios:
    maxItems: 1

  reset-gpios:
    maxItems: 1

  port:
    $ref: /schemas/graph.yaml#/$defs/port-base
    additionalProperties: false

    properties:
      endpoint:
        $ref: /schemas/media/video-interfaces.yaml#
        additionalProperties: false

        properties:
          bus-type:
            enum:
              - 1 # MIPI CSI-2 C-PHY
              - 4 # MIPI CSI-2 D-PHY
          data-lanes: true
          link-frequencies: true
          clock-noncontinuous: true
          remote-endpoint: true

        required:
          - bus-type
          - data-lanes
          - link-frequencies

required:
  - compatible
  - reg
  - clocks
  - port

unevaluatedProperties: false

examples:
  - |
      #include <dt-bindings/gpio/gpio.h>

      i2c {
          #address-cells = <1>;
          #size-cells = <0>;

          camera@36 {
              compatible = "ovti,ov64a40";
              reg = <0x36>;
              clocks = <&camera_clk>;
              dovdd-supply = <&vgen4_reg>;
              avdd-supply = <&vgen3_reg>;
              dvdd-supply = <&vgen2_reg>;
              powerdown-gpios = <&gpio1 9 GPIO_ACTIVE_HIGH>;
              reset-gpios = <&gpio1 10 GPIO_ACTIVE_LOW>;
              rotation = <180>;
              orientation = <2>;

              port {
                  endpoint {
                      remote-endpoint = <&mipi_csi2_in>;
                      bus-type = <4>;
                      data-lanes = <1 2 3 4>;
                      link-frequencies = /bits/ 64 <456000000>;
                  };
              };
          };
      };

...
```

## Documentation/devicetree/bindings/media/i2c/ovti,ov7251.yaml
```yaml
# SPDX-License-Identifier: (GPL-2.0-only OR BSD-2-Clause)
%YAML 1.2
---
$id: http://devicetree.org/schemas/media/i2c/ovti,ov7251.yaml#
$schema: http://devicetree.org/meta-schemas/core.yaml#

title: OmniVision OV7251 Image Sensor

description:
  The Omnivision OV7251 is a 1/7.5-Inch CMOS active pixel digital image sensor
  with an active array size of 640H x 480V. It is programmable through a serial
  I2C interface.

maintainers:
  - Todor Tomov <todor.too@gmail.com>

properties:
  compatible:
    const: ovti,ov7251

  reg:
    maxItems: 1

  clocks:
    description: XCLK Input Clock

  clock-names:
    const: xclk

  clock-frequency:
    description: Frequency of the xclk clock in Hz.
    deprecated: true

  vdda-supply:
    description: Analog voltage supply, 2.8 volts

  vddd-supply:
    description: Digital core voltage supply, 1.2 volts

  vdddo-supply:
    description: Digital I/O voltage supply, 1.8 volts

  enable-gpios:
    maxItems: 1
    description:
      Reference to the GPIO connected to the XSHUTDOWN pin, if any. Polarity
      is GPIO_ACTIVE_HIGH.

  port:
    description: Digital Output Port
    $ref: /schemas/graph.yaml#/$defs/port-base
    additionalProperties: false

    properties:
      endpoint:
        $ref: /schemas/media/video-interfaces.yaml#
        unevaluatedProperties: false

        properties:
          clock-lanes:
            maximum: 1

          data-lanes:
            maxItems: 1

          link-frequencies: true

        required:
          - data-lanes
          - link-frequencies

required:
  - compatible
  - reg
  - clocks
  - vdddo-supply
  - vdda-supply
  - port

additionalProperties: false

examples:
  - |
    #include <dt-bindings/gpio/gpio.h>

    i2c {
        #address-cells = <1>;
        #size-cells = <0>;

        camera@3c {
            compatible = "ovti,ov7251";
            reg = <0x3c>;

            clocks = <&clks 1>;
            assigned-clocks = <&clks 1>;
            assigned-clock-rates = <24000000>;

            vdddo-supply = <&ov7251_vdddo_1v8>;
            vdda-supply = <&ov7251_vdda_2v8>;
            vddd-supply = <&ov7251_vddd_1v5>;
            enable-gpios = <&gpio1 19 GPIO_ACTIVE_HIGH>;

            port {
                ov7251_ep: endpoint {
                    remote-endpoint = <&csi0_ep>;
                    clock-lanes = <1>;
                    data-lanes = <0>;
                    link-frequencies = /bits/ 64 <240000000 319200000>;
                };
            };
        };
    };
...
```

## Documentation/devicetree/bindings/media/i2c/ovti,ov772x.yaml
```yaml
# SPDX-License-Identifier: (GPL-2.0-only OR BSD-2-Clause)
%YAML 1.2
---
$id: http://devicetree.org/schemas/media/i2c/ovti,ov772x.yaml#
$schema: http://devicetree.org/meta-schemas/core.yaml#

title: Omnivision OV7720/OV7725 CMOS sensor

maintainers:
  - Jacopo Mondi <jacopo@jmondi.org>

description: |
  The Omnivision OV7720/OV7725 sensor supports multiple resolutions output,
  such as VGA, QVGA, and any size scaling down from CIF to 40x30. It also can
  support the YUV422, RGB565/555/444, GRB422 or raw RGB output formats.

properties:
  compatible:
    enum:
      - ovti,ov7720
      - ovti,ov7725

  reg:
    maxItems: 1

  clocks:
    maxItems: 1

  reset-gpios:
    description: |
      Reference to the GPIO connected to the RSTB pin which is active low.
    maxItems: 1

  powerdown-gpios:
    description: |
      Reference to the GPIO connected to the PWDN pin which is active high.
    maxItems: 1

  port:
    $ref: /schemas/graph.yaml#/$defs/port-base
    description: |
      Video output port.

    properties:
      endpoint:
        $ref: /schemas/media/video-interfaces.yaml#
        unevaluatedProperties: false

        properties:
          bus-type:
            enum: [5, 6]

          bus-width:
            enum: [8, 10]
            default: 10

          data-shift:
            enum: [0, 2]
            default: 0

          hsync-active:
            enum: [0, 1]
            default: 1

          vsync-active:
            enum: [0, 1]
            default: 1

          pclk-sample:
            enum: [0, 1]
            default: 1

        allOf:
          - if:
              properties:
                bus-type:
                  const: 6
            then:
              properties:
                hsync-active: false
                vsync-active: false

          - if:
              properties:
                bus-width:
                  const: 10
            then:
              properties:
                data-shift:
                  const: 0

        required:
          - bus-type

    additionalProperties: false

required:
  - compatible
  - reg
  - clocks
  - port

additionalProperties: false

examples:
  - |
    #include <dt-bindings/gpio/gpio.h>
    #include <dt-bindings/media/video-interfaces.h>

    i2c {
        #address-cells = <1>;
        #size-cells = <0>;
        ov772x: camera@21 {
            compatible = "ovti,ov7725";
            reg = <0x21>;
            reset-gpios = <&axi_gpio_0 0 GPIO_ACTIVE_LOW>;
            powerdown-gpios = <&axi_gpio_0 1 GPIO_ACTIVE_LOW>;
            clocks = <&xclk>;

            port {
                ov772x_0: endpoint {
                    bus-type = <MEDIA_BUS_TYPE_PARALLEL>;
                    vsync-active = <0>;
                    hsync-active = <0>;
                    pclk-sample = <0>;
                    bus-width = <8>;
                    data-shift = <0>;
                    remote-endpoint = <&vcap1_in0>;
                };
            };
        };
    };

...
```

## Documentation/devicetree/bindings/media/i2c/ovti,ov8858.yaml
```yaml
# SPDX-License-Identifier: (GPL-2.0 OR BSD-2-Clause)
%YAML 1.2
---
$id: http://devicetree.org/schemas/media/i2c/ovti,ov8858.yaml#
$schema: http://devicetree.org/meta-schemas/core.yaml#

title: OmniVision OV8858 Image Sensor

maintainers:
  - Jacopo Mondi <jacopo.mondi@ideasonboard.com>
  - Nicholas Roth <nicholas@rothemail.net>

description: |
  The OmniVision OV8858 is a color CMOS 8 Megapixels (3264x2448) image sensor
  controlled through an I2C-compatible SCCB bus. The sensor transmits images
  on a MIPI CSI-2 output interface with up to 4 data lanes.

$ref: /schemas/media/video-interface-devices.yaml#

properties:
  compatible:
    const: ovti,ov8858

  reg:
    maxItems: 1

  clocks:
    maxItems: 1
    description: XVCLK external clock

  clock-names:
    const: xvclk

  dvdd-supply:
    description: Digital Domain Power Supply

  avdd-supply:
    description: Analog Domain Power Supply

  dovdd-supply:
    description: I/O Domain Power Supply

  powerdown-gpios:
    description: PWDNB powerdown GPIO (active low)

  reset-gpios:
    maxItems: 1
    description: XSHUTDN reset GPIO (active low)

  port:
    description: MIPI CSI-2 transmitter port
    $ref: /schemas/graph.yaml#/$defs/port-base
    additionalProperties: false

    properties:
      endpoint:
        $ref: /schemas/media/video-interfaces.yaml#
        unevaluatedProperties: false

        properties:
          data-lanes:
            minItems: 1
            maxItems: 4

        required:
          - data-lanes

required:
  - compatible
  - reg
  - clocks
  - port

unevaluatedProperties: false

examples:
  - |
    #include <dt-bindings/pinctrl/rockchip.h>
    #include <dt-bindings/clock/rk3399-cru.h>
    #include <dt-bindings/gpio/gpio.h>

    i2c {
        #address-cells = <1>;
        #size-cells = <0>;

        ov8858: camera@36 {
            compatible = "ovti,ov8858";
            reg = <0x36>;

            clocks = <&cru SCLK_CIF_OUT>;
            clock-names = "xvclk";
            assigned-clocks = <&cru SCLK_CIF_OUT>;
            assigned-clock-rates = <24000000>;

            dovdd-supply = <&vcc1v8_dvp>;

            reset-gpios = <&gpio1 RK_PA4 GPIO_ACTIVE_LOW>;
            powerdown-gpios = <&gpio2 RK_PB4 GPIO_ACTIVE_LOW>;

            port {
                ucam_out: endpoint {
                    remote-endpoint = <&mipi_in_ucam>;
                    data-lanes = <1 2 3 4>;
                };
            };
        };
    };
...
```

## Documentation/devicetree/bindings/media/i2c/ovti,ov8865.yaml
```yaml
# SPDX-License-Identifier: (GPL-2.0 OR BSD-2-Clause)
%YAML 1.2
---
$id: http://devicetree.org/schemas/media/i2c/ovti,ov8865.yaml#
$schema: http://devicetree.org/meta-schemas/core.yaml#

title: OmniVision OV8865 Image Sensor Device Tree Bindings

maintainers:
  - Paul Kocialkowski <paul.kocialkowski@bootlin.com>

properties:
  compatible:
    const: ovti,ov8865

  reg:
    maxItems: 1

  clocks:
    items:
      - description: EXTCLK Clock

  assigned-clocks:
    maxItems: 1

  assigned-clock-rates:
    maxItems: 1

  dvdd-supply:
    description: Digital Domain Power Supply

  avdd-supply:
    description: Analog Domain Power Supply

  dovdd-supply:
    description: I/O Domain Power Supply

  powerdown-gpios:
    maxItems: 1
    description: Power Down Pin GPIO Control (active low)

  reset-gpios:
    maxItems: 1
    description: Reset Pin GPIO Control (active low)

  port:
    description: MIPI CSI-2 transmitter port
    $ref: /schemas/graph.yaml#/$defs/port-base
    additionalProperties: false

    properties:
      endpoint:
        $ref: /schemas/media/video-interfaces.yaml#
        unevaluatedProperties: false

        properties:
          link-frequencies: true

          data-lanes:
            minItems: 1
            maxItems: 4

        required:
          - data-lanes
          - link-frequencies

required:
  - compatible
  - reg
  - clocks
  - assigned-clocks
  - assigned-clock-rates
  - dvdd-supply
  - avdd-supply
  - dovdd-supply
  - port

additionalProperties: false

examples:
  - |
    #include <dt-bindings/clock/sun8i-a83t-ccu.h>
    #include <dt-bindings/gpio/gpio.h>

    i2c2 {
        #address-cells = <1>;
        #size-cells = <0>;

        ov8865: camera@36 {
            compatible = "ovti,ov8865";
            reg = <0x36>;

            pinctrl-names = "default";
            pinctrl-0 = <&csi_mclk_pin>;

            clocks = <&ccu CLK_CSI_MCLK>;
            assigned-clocks = <&ccu CLK_CSI_MCLK>;
            assigned-clock-rates = <24000000>;

            avdd-supply = <&reg_ov8865_avdd>;
            dovdd-supply = <&reg_ov8865_dovdd>;
            dvdd-supply = <&reg_ov8865_dvdd>;

            powerdown-gpios = <&pio 4 17 GPIO_ACTIVE_LOW>; /* PE17 */
            reset-gpios = <&pio 4 16 GPIO_ACTIVE_LOW>; /* PE16 */

            port {
                ov8865_out_mipi_csi2: endpoint {
                    data-lanes = <1 2 3 4>;
                    link-frequencies = /bits/ 64 <360000000>;

                    remote-endpoint = <&mipi_csi2_in_ov8865>;
                };
            };
        };
    };

...
```

## Documentation/devicetree/bindings/media/i2c/ovti,ov9282.yaml
```yaml
# SPDX-License-Identifier: (GPL-2.0-only OR BSD-2-Clause)
# Copyright (C) 2021 Intel Corporation
%YAML 1.2
---
$id: http://devicetree.org/schemas/media/i2c/ovti,ov9282.yaml#
$schema: http://devicetree.org/meta-schemas/core.yaml#

title: OmniVision OV9282 Sensor

maintainers:
  - Paul J. Murphy <paul.j.murphy@intel.com>
  - Daniele Alessandrelli <daniele.alessandrelli@intel.com>

description:
  OV9282 sensor is an OmniVision black & white CMOS active pixel digital image
  sensor with an active array size of 1296H x 816V. It is programmable through
  I2C interface. The I2C client address is fixed to 0x60/0x70 as per sensor data
  sheet. Image data is sent through MIPI CSI-2.
  OV9281 has a different lens chief ray angle.

properties:
  compatible:
    enum:
      - ovti,ov9281
      - ovti,ov9282
  reg:
    description: I2C address
    maxItems: 1

  assigned-clocks: true
  assigned-clock-parents: true
  assigned-clock-rates: true

  clocks:
    description: Clock frequency from 6 to 27MHz
    maxItems: 1

  reset-gpios:
    description: Reference to the GPIO connected to the XCLR pin, if any.
    maxItems: 1

  avdd-supply:
    description: Analog voltage supply, 2.8 volts

  dvdd-supply:
    description: Digital core voltage supply, 1.2 volts

  dovdd-supply:
    description: Digital I/O voltage supply, 1.8 volts

  port:
    additionalProperties: false
    $ref: /schemas/graph.yaml#/$defs/port-base

    properties:
      endpoint:
        $ref: /schemas/media/video-interfaces.yaml#
        unevaluatedProperties: false

        properties:
          data-lanes: true
          link-frequencies: true

        required:
          - data-lanes
          - link-frequencies

    required:
      - endpoint

required:
  - compatible
  - reg
  - clocks
  - port

additionalProperties: false

examples:
  - |
    i2c0 {
        #address-cells = <1>;
        #size-cells = <0>;

        camera@60 {
            compatible = "ovti,ov9282";
            reg = <0x60>;
            clocks = <&ov9282_clk>;

            assigned-clocks = <&ov9282_clk>;
            assigned-clock-parents = <&ov9282_clk_parent>;
            assigned-clock-rates = <24000000>;

            port {
                ov9282: endpoint {
                    remote-endpoint = <&cam>;
                    data-lanes = <1 2>;
                    link-frequencies = /bits/ 64 <800000000>;
                };
            };
        };
    };
...
```
