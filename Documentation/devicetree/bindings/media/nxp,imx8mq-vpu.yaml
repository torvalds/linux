## Documentation/devicetree/bindings/media/nxp,imx8mq-vpu.yaml
```yaml
# SPDX-License-Identifier: (GPL-2.0 OR BSD-2-Clause)

%YAML 1.2
---
$id: http://devicetree.org/schemas/media/nxp,imx8mq-vpu.yaml#
$schema: http://devicetree.org/meta-schemas/core.yaml#

title: Hantro G1/G2 VPU codecs implemented on i.MX8M SoCs

maintainers:
  - Philipp Zabel <p.zabel@pengutronix.de>

description:
  Hantro G1/G2 video decode accelerators present on i.MX8MQ SoCs.

properties:
  compatible:
    oneOf:
      - const: nxp,imx8mq-vpu
        deprecated: true
      - const: nxp,imx8mq-vpu-g1
      - const: nxp,imx8mq-vpu-g2
      - const: nxp,imx8mm-vpu-g1

  reg:
    maxItems: 1

  interrupts:
    maxItems: 1

  clocks:
    maxItems: 1

  power-domains:
    maxItems: 1

required:
  - compatible
  - reg
  - interrupts
  - clocks

additionalProperties: false

examples:
  - |
        #include <dt-bindings/clock/imx8mq-clock.h>
        #include <dt-bindings/power/imx8mq-power.h>
        #include <dt-bindings/interrupt-controller/arm-gic.h>

        vpu_g1: video-codec@38300000 {
                compatible = "nxp,imx8mq-vpu-g1";
                reg = <0x38300000 0x10000>;
                interrupts = <GIC_SPI 7 IRQ_TYPE_LEVEL_HIGH>;
                clocks = <&clk IMX8MQ_CLK_VPU_G1_ROOT>;
                power-domains = <&vpu_blk_ctrl IMX8MQ_VPUBLK_PD_G1>;
        };
  - |
        #include <dt-bindings/clock/imx8mq-clock.h>
        #include <dt-bindings/power/imx8mq-power.h>
        #include <dt-bindings/interrupt-controller/arm-gic.h>

        vpu_g2: video-codec@38300000 {
                compatible = "nxp,imx8mq-vpu-g2";
                reg = <0x38310000 0x10000>;
                interrupts = <GIC_SPI 8 IRQ_TYPE_LEVEL_HIGH>;
                clocks = <&clk IMX8MQ_CLK_VPU_G2_ROOT>;
                power-domains = <&vpu_blk_ctrl IMX8MQ_VPUBLK_PD_G2>;
        };
```

## Documentation/devicetree/bindings/media/pxa-camera.txt
```
Marvell PXA camera host interface

Required properties:
 - compatible: Should be "marvell,pxa270-qci"
 - reg: register base and size
 - interrupts: the interrupt number
 - any required generic properties defined in video-interfaces.txt

Optional properties:
 - clocks: input clock (see clock-bindings.txt)
 - clock-output-names: should contain the name of the clock driving the
                       sensor master clock MCLK
 - clock-frequency: host interface is driving MCLK, and MCLK rate is this rate

Example:

	pxa_camera: pxa_camera@50000000 {
		compatible = "marvell,pxa270-qci";
		reg = <0x50000000 0x1000>;
		interrupts = <33>;

		clocks = <&pxa2xx_clks 24>;
		clock-names = "ciclk";
		clock-frequency = <50000000>;
		clock-output-names = "qci_mclk";


		port {
			#address-cells = <1>;
			#size-cells = <0>;

			/* Parallel bus endpoint */
			qci: endpoint@0 {
				reg = <0>;		/* Local endpoint # */
				remote-endpoint = <&mt9m111_1>;
				bus-width = <8>;	/* Used data lines */
				hsync-active = <0>;	/* Active low */
				vsync-active = <0>;	/* Active low */
				pclk-sample = <1>;	/* Rising */
			};
		};
	};
```

## Documentation/devicetree/bindings/media/qcom,camss.txt
```
Qualcomm Camera Subsystem

* Properties

- compatible:
	Usage: required
	Value type: <stringlist>
	Definition: Should contain one of:
		- "qcom,msm8916-camss"
		- "qcom,msm8996-camss"
- reg:
	Usage: required
	Value type: <prop-encoded-array>
	Definition: Register ranges as listed in the reg-names property.
- reg-names:
	Usage: required
	Value type: <stringlist>
	Definition: Should contain the following entries:
		- "csiphy0"
		- "csiphy0_clk_mux"
		- "csiphy1"
		- "csiphy1_clk_mux"
		- "csiphy2"		(8996 only)
		- "csiphy2_clk_mux"	(8996 only)
		- "csid0"
		- "csid1"
		- "csid2"		(8996 only)
		- "csid3"		(8996 only)
		- "ispif"
		- "csi_clk_mux"
		- "vfe0"
		- "vfe1"		(8996 only)
- interrupts:
	Usage: required
	Value type: <prop-encoded-array>
	Definition: Interrupts as listed in the interrupt-names property.
- interrupt-names:
	Usage: required
	Value type: <stringlist>
	Definition: Should contain the following entries:
		- "csiphy0"
		- "csiphy1"
		- "csiphy2"		(8996 only)
		- "csid0"
		- "csid1"
		- "csid2"		(8996 only)
		- "csid3"		(8996 only)
		- "ispif"
		- "vfe0"
		- "vfe1"		(8996 only)
- power-domains:
	Usage: required
	Value type: <prop-encoded-array>
	Definition: A phandle and power domain specifier pairs to the
		    power domain which is responsible for collapsing
		    and restoring power to the peripheral.
- clocks:
	Usage: required
	Value type: <prop-encoded-array>
	Definition: A list of phandle and clock specifier pairs as listed
		    in clock-names property.
- clock-names:
	Usage: required
	Value type: <stringlist>
	Definition: Should contain the following entries:
		- "top_ahb"
		- "ispif_ahb"
		- "csiphy0_timer"
		- "csiphy1_timer"
		- "csiphy2_timer"	(8996 only)
		- "csi0_ahb"
		- "csi0"
		- "csi0_phy"
		- "csi0_pix"
		- "csi0_rdi"
		- "csi1_ahb"
		- "csi1"
		- "csi1_phy"
		- "csi1_pix"
		- "csi1_rdi"
		- "csi2_ahb"		(8996 only)
		- "csi2"		(8996 only)
		- "csi2_phy"		(8996 only)
		- "csi2_pix"		(8996 only)
		- "csi2_rdi"		(8996 only)
		- "csi3_ahb"		(8996 only)
		- "csi3"		(8996 only)
		- "csi3_phy"		(8996 only)
		- "csi3_pix"		(8996 only)
		- "csi3_rdi"		(8996 only)
		- "ahb"
		- "vfe0"
		- "csi_vfe0"
		- "vfe0_ahb",		(8996 only)
		- "vfe0_stream",	(8996 only)
		- "vfe1",		(8996 only)
		- "csi_vfe1",		(8996 only)
		- "vfe1_ahb",		(8996 only)
		- "vfe1_stream",	(8996 only)
		- "vfe_ahb"
		- "vfe_axi"
- vdda-supply:
	Usage: required
	Value type: <phandle>
	Definition: A phandle to voltage supply for CSI2.
- iommus:
	Usage: required
	Value type: <prop-encoded-array>
	Definition: A list of phandle and IOMMU specifier pairs.

* Nodes

- ports:
	Usage: required
	Definition: As described in video-interfaces.txt in same directory.
	Properties:
		- reg:
			Usage: required
			Value type: <u32>
			Definition: Selects CSI2 PHY interface - PHY0, PHY1
				    or PHY2 (8996 only)
	Endpoint node properties:
		- clock-lanes:
			Usage: required
			Value type: <u32>
			Definition: The physical clock lane index. On 8916
				    the value must always be <1> as the physical
				    clock lane is lane 1. On 8996 the value must
				    always be <7> as the hardware supports D-PHY
				    and C-PHY, indexes are in a common set and
				    D-PHY physical clock lane is labeled as 7.
		- data-lanes:
			Usage: required
			Value type: <prop-encoded-array>
			Definition: An array of physical data lanes indexes.
				    Position of an entry determines the logical
				    lane number, while the value of an entry
				    indicates physical lane index. Lane swapping
				    is supported. Physical lane indexes for
				    8916: 0, 2, 3, 4; for 8996: 0, 1, 2, 3.

* An Example

	camss: camss@1b00000 {
		compatible = "qcom,msm8916-camss";
		reg = <0x1b0ac00 0x200>,
			<0x1b00030 0x4>,
			<0x1b0b000 0x200>,
			<0x1b00038 0x4>,
			<0x1b08000 0x100>,
			<0x1b08400 0x100>,
			<0x1b0a000 0x500>,
			<0x1b00020 0x10>,
			<0x1b10000 0x1000>;
		reg-names = "csiphy0",
			"csiphy0_clk_mux",
			"csiphy1",
			"csiphy1_clk_mux",
			"csid0",
			"csid1",
			"ispif",
			"csi_clk_mux",
			"vfe0";
		interrupts = <GIC_SPI 78 0>,
			<GIC_SPI 79 0>,
			<GIC_SPI 51 0>,
			<GIC_SPI 52 0>,
			<GIC_SPI 55 0>,
			<GIC_SPI 57 0>;
		interrupt-names = "csiphy0",
			"csiphy1",
			"csid0",
			"csid1",
			"ispif",
			"vfe0";
		power-domains = <&gcc VFE_GDSC>;
		clocks = <&gcc GCC_CAMSS_TOP_AHB_CLK>,
			<&gcc GCC_CAMSS_ISPIF_AHB_CLK>,
			<&gcc GCC_CAMSS_CSI0PHYTIMER_CLK>,
			<&gcc GCC_CAMSS_CSI1PHYTIMER_CLK>,
			<&gcc GCC_CAMSS_CSI0_AHB_CLK>,
			<&gcc GCC_CAMSS_CSI0_CLK>,
			<&gcc GCC_CAMSS_CSI0PHY_CLK>,
			<&gcc GCC_CAMSS_CSI0PIX_CLK>,
			<&gcc GCC_CAMSS_CSI0RDI_CLK>,
			<&gcc GCC_CAMSS_CSI1_AHB_CLK>,
			<&gcc GCC_CAMSS_CSI1_CLK>,
			<&gcc GCC_CAMSS_CSI1PHY_CLK>,
			<&gcc GCC_CAMSS_CSI1PIX_CLK>,
			<&gcc GCC_CAMSS_CSI1RDI_CLK>,
			<&gcc GCC_CAMSS_AHB_CLK>,
			<&gcc GCC_CAMSS_VFE0_CLK>,
			<&gcc GCC_CAMSS_CSI_VFE0_CLK>,
			<&gcc GCC_CAMSS_VFE_AHB_CLK>,
			<&gcc GCC_CAMSS_VFE_AXI_CLK>;
		clock-names = "top_ahb",
			"ispif_ahb",
			"csiphy0_timer",
			"csiphy1_timer",
			"csi0_ahb",
			"csi0",
			"csi0_phy",
			"csi0_pix",
			"csi0_rdi",
			"csi1_ahb",
			"csi1",
			"csi1_phy",
			"csi1_pix",
			"csi1_rdi",
			"ahb",
			"vfe0",
			"csi_vfe0",
			"vfe_ahb",
			"vfe_axi";
		vdda-supply = <&pm8916_l2>;
		iommus = <&apps_iommu 3>;
		ports {
			#address-cells = <1>;
			#size-cells = <0>;
			port@0 {
				reg = <0>;
				csiphy0_ep: endpoint {
					clock-lanes = <1>;
					data-lanes = <0 2>;
					remote-endpoint = <&ov5645_ep>;
				};
			};
		};
	};
```

## Documentation/devicetree/bindings/media/qcom,msm8916-camss.yaml
```yaml
# SPDX-License-Identifier: (GPL-2.0 OR BSD-2-Clause)

%YAML 1.2
---
$id: "http://devicetree.org/schemas/media/qcom,msm8916-camss.yaml#"
$schema: "http://devicetree.org/meta-schemas/core.yaml#"

title: Qualcomm CAMSS ISP

maintainers:
  - Robert Foss <robert.foss@linaro.org>
  - Todor Tomov <todor.too@gmail.com>

description: |
  The CAMSS IP is a CSI decoder and ISP present on Qualcomm platforms

properties:
  compatible:
    const: qcom,msm8916-camss

  clocks:
    minItems: 19
    maxItems: 19

  clock-names:
    items:
      - const: top_ahb
      - const: ispif_ahb
      - const: csiphy0_timer
      - const: csiphy1_timer
      - const: csi0_ahb
      - const: csi0
      - const: csi0_phy
      - const: csi0_pix
      - const: csi0_rdi
      - const: csi1_ahb
      - const: csi1
      - const: csi1_phy
      - const: csi1_pix
      - const: csi1_rdi
      - const: ahb
      - const: vfe0
      - const: csi_vfe0
      - const: vfe_ahb
      - const: vfe_axi

  interrupts:
    minItems: 6
    maxItems: 6

  interrupt-names:
    items:
      - const: csiphy0
      - const: csiphy1
      - const: csid0
      - const: csid1
      - const: ispif
      - const: vfe0

  iommus:
    maxItems: 1

  power-domains:
    items:
      - description: VFE GDSC - Video Front End, Global Distributed Switch Controller.

  ports:
    $ref: /schemas/graph.yaml#/properties/ports

    description:
      CSI input ports.

    properties:
      port@0:
        $ref: /schemas/graph.yaml#/$defs/port-base
        unevaluatedProperties: false
        description:
          Input port for receiving CSI data.

        properties:
          endpoint:
            $ref: video-interfaces.yaml#
            unevaluatedProperties: false

            properties:
              clock-lanes:
                items:
                  - const: 1

              data-lanes:
                description:
                  An array of physical data lanes indexes.
                  Position of an entry determines the logical
                  lane number, while the value of an entry
                  indicates physical lane index. Lane swapping
                  is supported. Physical lane indexes;
                  0, 2, 3, 4.
                minItems: 1
                maxItems: 4

            required:
              - clock-lanes
              - data-lanes

      port@1:
        $ref: /schemas/graph.yaml#/$defs/port-base
        unevaluatedProperties: false
        description:
          Input port for receiving CSI data.

        properties:
          endpoint:
            $ref: video-interfaces.yaml#
            unevaluatedProperties: false

            properties:
              clock-lanes:
                items:
                  - const: 1

              data-lanes:
                minItems: 1
                maxItems: 4

            required:
              - clock-lanes
              - data-lanes

  reg:
    minItems: 9
    maxItems: 9

  reg-names:
    items:
      - const: csiphy0
      - const: csiphy0_clk_mux
      - const: csiphy1
      - const: csiphy1_clk_mux
      - const: csid0
      - const: csid1
      - const: ispif
      - const: csi_clk_mux
      - const: vfe0

  vdda-supply:
    description:
      Definition of the regulator used as analog power supply.

required:
  - clock-names
  - clocks
  - compatible
  - interrupt-names
  - interrupts
  - iommus
  - power-domains
  - reg
  - reg-names
  - vdda-supply

additionalProperties: false

examples:
  - |
    #include <dt-bindings/interrupt-controller/arm-gic.h>
    #include <dt-bindings/clock/qcom,gcc-msm8916.h>

    camss: camss@1b00000 {
      compatible = "qcom,msm8916-camss";

      clocks = <&gcc GCC_CAMSS_TOP_AHB_CLK>,
        <&gcc GCC_CAMSS_ISPIF_AHB_CLK>,
        <&gcc GCC_CAMSS_CSI0PHYTIMER_CLK>,
        <&gcc GCC_CAMSS_CSI1PHYTIMER_CLK>,
        <&gcc GCC_CAMSS_CSI0_AHB_CLK>,
        <&gcc GCC_CAMSS_CSI0_CLK>,
        <&gcc GCC_CAMSS_CSI0PHY_CLK>,
        <&gcc GCC_CAMSS_CSI0PIX_CLK>,
        <&gcc GCC_CAMSS_CSI0RDI_CLK>,
        <&gcc GCC_CAMSS_CSI1_AHB_CLK>,
        <&gcc GCC_CAMSS_CSI1_CLK>,
        <&gcc GCC_CAMSS_CSI1PHY_CLK>,
        <&gcc GCC_CAMSS_CSI1PIX_CLK>,
        <&gcc GCC_CAMSS_CSI1RDI_CLK>,
        <&gcc GCC_CAMSS_AHB_CLK>,
        <&gcc GCC_CAMSS_VFE0_CLK>,
        <&gcc GCC_CAMSS_CSI_VFE0_CLK>,
        <&gcc GCC_CAMSS_VFE_AHB_CLK>,
        <&gcc GCC_CAMSS_VFE_AXI_CLK>;

      clock-names = "top_ahb",
        "ispif_ahb",
        "csiphy0_timer",
        "csiphy1_timer",
        "csi0_ahb",
        "csi0",
        "csi0_phy",
        "csi0_pix",
        "csi0_rdi",
        "csi1_ahb",
        "csi1",
        "csi1_phy",
        "csi1_pix",
        "csi1_rdi",
        "ahb",
        "vfe0",
        "csi_vfe0",
        "vfe_ahb",
        "vfe_axi";

      interrupts = <GIC_SPI 78 IRQ_TYPE_EDGE_RISING>,
        <GIC_SPI 79 IRQ_TYPE_EDGE_RISING>,
        <GIC_SPI 51 IRQ_TYPE_EDGE_RISING>,
        <GIC_SPI 52 IRQ_TYPE_EDGE_RISING>,
        <GIC_SPI 55 IRQ_TYPE_EDGE_RISING>,
        <GIC_SPI 57 IRQ_TYPE_EDGE_RISING>;

      interrupt-names = "csiphy0",
        "csiphy1",
        "csid0",
        "csid1",
        "ispif",
        "vfe0";

      iommus = <&apps_iommu 3>;

      power-domains = <&gcc VFE_GDSC>;

      reg = <0x01b0ac00 0x200>,
        <0x01b00030 0x4>,
        <0x01b0b000 0x200>,
        <0x01b00038 0x4>,
        <0x01b08000 0x100>,
        <0x01b08400 0x100>,
        <0x01b0a000 0x500>,
        <0x01b00020 0x10>,
        <0x01b10000 0x1000>;

      reg-names = "csiphy0",
        "csiphy0_clk_mux",
        "csiphy1",
        "csiphy1_clk_mux",
        "csid0",
        "csid1",
        "ispif",
        "csi_clk_mux",
        "vfe0";

      vdda-supply = <&reg_2v8>;

      ports {
        #address-cells = <1>;
        #size-cells = <0>;
      };

    };
```
