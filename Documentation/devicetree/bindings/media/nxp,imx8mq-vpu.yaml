## Documentation/devicetree/bindings/media/qcom,msm8916-venus.yaml
```yaml
# SPDX-License-Identifier: (GPL-2.0 OR BSD-2-Clause)
%YAML 1.2
---
$id: http://devicetree.org/schemas/media/qcom,msm8916-venus.yaml#
$schema: http://devicetree.org/meta-schemas/core.yaml#

title: Qualcomm MSM8916 Venus video encode and decode accelerators

maintainers:
  - Stanimir Varbanov <stanimir.varbanov@linaro.org>

description: |
  The Venus IP is a video encode and decode accelerator present
  on Qualcomm platforms

allOf:
  - $ref: qcom,venus-common.yaml#

properties:
  compatible:
    const: qcom,msm8916-venus

  power-domains:
    maxItems: 1

  clocks:
    maxItems: 3

  clock-names:
    items:
      - const: core
      - const: iface
      - const: bus

  iommus:
    maxItems: 1

  video-decoder:
    type: object

    properties:
      compatible:
        const: venus-decoder

    required:
      - compatible

    additionalProperties: false

  video-encoder:
    type: object

    properties:
      compatible:
        const: venus-encoder

    required:
      - compatible

    additionalProperties: false

required:
  - compatible
  - iommus
  - video-decoder
  - video-encoder

unevaluatedProperties: false

examples:
  - |
    #include <dt-bindings/interrupt-controller/arm-gic.h>
    #include <dt-bindings/clock/qcom,gcc-msm8916.h>

    video-codec@1d00000 {
        compatible = "qcom,msm8916-venus";
        reg = <0x01d00000 0xff000>;
        interrupts = <GIC_SPI 44 IRQ_TYPE_LEVEL_HIGH>;
        clocks = <&gcc GCC_VENUS0_VCODEC0_CLK>,
                 <&gcc GCC_VENUS0_AHB_CLK>,
                 <&gcc GCC_VENUS0_AXI_CLK>;
        clock-names = "core", "iface", "bus";
        power-domains = <&gcc VENUS_GDSC>;
        iommus = <&apps_iommu 5>;
        memory-region = <&venus_mem>;

        video-decoder {
            compatible = "venus-decoder";
        };

        video-encoder {
            compatible = "venus-encoder";
        };
    };
```

## Documentation/devicetree/bindings/media/qcom,msm8939-camss.yaml
```yaml
# SPDX-License-Identifier: (GPL-2.0 OR BSD-2-Clause)
%YAML 1.2
---
$id: http://devicetree.org/schemas/media/qcom,msm8939-camss.yaml#
$schema: http://devicetree.org/meta-schemas/core.yaml#

title: Qualcomm MSM8939 Camera Subsystem (CAMSS)

maintainers:
  - Vincent Knecht <vincent.knecht@mailoo.org>

description:
  The CAMSS IP is a CSI decoder and ISP present on Qualcomm platforms

properties:
  compatible:
    const: qcom,msm8939-camss

  reg:
    maxItems: 11

  reg-names:
    items:
      - const: csiphy0
      - const: csiphy0_clk_mux
      - const: csiphy1
      - const: csiphy1_clk_mux
      - const: csid0
      - const: csid1
      - const: ispif
      - const: csi_clk_mux
      - const: vfe0
      - const: csid2
      - const: vfe0_vbif

  clocks:
    maxItems: 24

  clock-names:
    items:
      - const: top_ahb
      - const: ispif_ahb
      - const: csiphy0_timer
      - const: csiphy1_timer
      - const: csi0_ahb
      - const: csi0
      - const: csi0_phy
      - const: csi0_pix
      - const: csi0_rdi
      - const: csi1_ahb
      - const: csi1
      - const: csi1_phy
      - const: csi1_pix
      - const: csi1_rdi
      - const: ahb
      - const: vfe0
      - const: csi_vfe0
      - const: vfe_ahb
      - const: vfe_axi
      - const: csi2_ahb
      - const: csi2
      - const: csi2_phy
      - const: csi2_pix
      - const: csi2_rdi

  interrupts:
    maxItems: 7

  interrupt-names:
    items:
      - const: csiphy0
      - const: csiphy1
      - const: csid0
      - const: csid1
      - const: ispif
      - const: vfe0
      - const: csid2

  iommus:
    maxItems: 1

  power-domains:
    items:
      - description: VFE GDSC - Video Front End, Global Distributed Switch
          Controller.

  vdda-supply:
    description:
      Definition of the regulator used as 1.2V analog power supply.

  ports:
    $ref: /schemas/graph.yaml#/properties/ports

    description:
      CSI input ports.

    patternProperties:
      "^port@[0-1]$":
        $ref: /schemas/graph.yaml#/$defs/port-base
        unevaluatedProperties: false

        description:
          Input port for receiving CSI data.

        properties:
          endpoint:
            $ref: video-interfaces.yaml#
            unevaluatedProperties: false

            properties:
              data-lanes:
                minItems: 1
                maxItems: 4

              bus-type:
                enum:
                  - 4 # MEDIA_BUS_TYPE_CSI2_DPHY

            required:
              - data-lanes

required:
  - compatible
  - reg
  - reg-names
  - clocks
  - clock-names
  - interrupts
  - interrupt-names
  - iommus
  - power-domains
  - vdda-supply
  - ports

additionalProperties: false

examples:
  - |
    #include <dt-bindings/interrupt-controller/arm-gic.h>
    #include <dt-bindings/clock/qcom,gcc-msm8939.h>

    isp@1b0ac00 {
        compatible = "qcom,msm8939-camss";

        reg = <0x01b0ac00 0x200>,
              <0x01b00030 0x4>,
              <0x01b0b000 0x200>,
              <0x01b00038 0x4>,
              <0x01b08000 0x100>,
              <0x01b08400 0x100>,
              <0x01b0a000 0x500>,
              <0x01b00020 0x10>,
              <0x01b10000 0x1000>,
              <0x01b08800 0x100>,
              <0x01b40000 0x200>;

        reg-names = "csiphy0",
                    "csiphy0_clk_mux",
                    "csiphy1",
                    "csiphy1_clk_mux",
                    "csid0",
                    "csid1",
                    "ispif",
                    "csi_clk_mux",
                    "vfe0",
                    "csid2",
                    "vfe0_vbif";

        clocks = <&gcc GCC_CAMSS_TOP_AHB_CLK>,
                 <&gcc GCC_CAMSS_ISPIF_AHB_CLK>,
                 <&gcc GCC_CAMSS_CSI0PHYTIMER_CLK>,
                 <&gcc GCC_CAMSS_CSI1PHYTIMER_CLK>,
                 <&gcc GCC_CAMSS_CSI0_AHB_CLK>,
                 <&gcc GCC_CAMSS_CSI0_CLK>,
                 <&gcc GCC_CAMSS_CSI0PHY_CLK>,
                 <&gcc GCC_CAMSS_CSI0PIX_CLK>,
                 <&gcc GCC_CAMSS_CSI0RDI_CLK>,
                 <&gcc GCC_CAMSS_CSI1_AHB_CLK>,
                 <&gcc GCC_CAMSS_CSI1_CLK>,
                 <&gcc GCC_CAMSS_CSI1PHY_CLK>,
                 <&gcc GCC_CAMSS_CSI1PIX_CLK>,
                 <&gcc GCC_CAMSS_CSI1RDI_CLK>,
                 <&gcc GCC_CAMSS_AHB_CLK>,
                 <&gcc GCC_CAMSS_VFE0_CLK>,
                 <&gcc GCC_CAMSS_CSI_VFE0_CLK>,
                 <&gcc GCC_CAMSS_VFE_AHB_CLK>,
                 <&gcc GCC_CAMSS_VFE_AXI_CLK>,
                 <&gcc GCC_CAMSS_CSI2_AHB_CLK>,
                 <&gcc GCC_CAMSS_CSI2_CLK>,
                 <&gcc GCC_CAMSS_CSI2PHY_CLK>,
                 <&gcc GCC_CAMSS_CSI2PIX_CLK>,
                 <&gcc GCC_CAMSS_CSI2RDI_CLK>;

        clock-names = "top_ahb",
                      "ispif_ahb",
                      "csiphy0_timer",
                      "csiphy1_timer",
                      "csi0_ahb",
                      "csi0",
                      "csi0_phy",
                      "csi0_pix",
                      "csi0_rdi",
                      "csi1_ahb",
                      "csi1",
                      "csi1_phy",
                      "csi1_pix",
                      "csi1_rdi",
                      "ahb",
                      "vfe0",
                      "csi_vfe0",
                      "vfe_ahb",
                      "vfe_axi",
                      "csi2_ahb",
                      "csi2",
                      "csi2_phy",
                      "csi2_pix",
                      "csi2_rdi";

        interrupts = <GIC_SPI 78 IRQ_TYPE_EDGE_RISING>,
                     <GIC_SPI 79 IRQ_TYPE_EDGE_RISING>,
                     <GIC_SPI 51 IRQ_TYPE_EDGE_RISING>,
                     <GIC_SPI 52 IRQ_TYPE_EDGE_RISING>,
                     <GIC_SPI 55 IRQ_TYPE_EDGE_RISING>,
                     <GIC_SPI 57 IRQ_TYPE_EDGE_RISING>,
                     <GIC_SPI 153 IRQ_TYPE_EDGE_RISING>;

        interrupt-names = "csiphy0",
                          "csiphy1",
                          "csid0",
                          "csid1",
                          "ispif",
                          "vfe0",
                          "csid2";

        iommus = <&apps_iommu 3>;

        power-domains = <&gcc VFE_GDSC>;

        vdda-supply = <&reg_1v2>;

        ports {
            #address-cells = <1>;
            #size-cells = <0>;

            port@1 {
                reg = <1>;

                csiphy1_ep: endpoint {
                    data-lanes = <0 2>;
                    remote-endpoint = <&sensor_ep>;
                };
            };
        };
    };
```

## Documentation/devicetree/bindings/media/qcom,msm8939-venus.yaml
```yaml
# SPDX-License-Identifier: (GPL-2.0-only OR BSD-2-Clause)
%YAML 1.2
---
$id: http://devicetree.org/schemas/media/qcom,msm8939-venus.yaml#
$schema: http://devicetree.org/meta-schemas/core.yaml#

title: Qualcomm MSM8939 Venus video encode and decode accelerators

maintainers:
  - André Apitzsch <git@apitzsch.eu>
  - Erikas Bitovtas <xerikasxx@gmail.com>

description:
  The Venus IP is a video encode and decode accelerator present
  on Qualcomm platforms

allOf:
  - $ref: qcom,venus-common.yaml#

properties:
  compatible:
    const: qcom,msm8939-venus

  power-domains:
    maxItems: 3

  power-domain-names:
    items:
      - const: venus
      - const: vcodec0
      - const: vcodec1

  clocks:
    maxItems: 5

  clock-names:
    items:
      - const: core
      - const: iface
      - const: bus
      - const: vcodec0_core
      - const: vcodec1_core

  iommus:
    maxItems: 1

required:
  - compatible
  - iommus
  - power-domain-names

unevaluatedProperties: false

examples:
  - |
    #include <dt-bindings/interrupt-controller/arm-gic.h>
    #include <dt-bindings/clock/qcom,gcc-msm8939.h>

    video-codec@1d00000 {
      compatible = "qcom,msm8939-venus";
      reg = <0x01d00000 0xff000>;
      interrupts = <GIC_SPI 44 IRQ_TYPE_LEVEL_HIGH>;
      clocks = <&gcc GCC_VENUS0_VCODEC0_CLK>,
               <&gcc GCC_VENUS0_AHB_CLK>,
               <&gcc GCC_VENUS0_AXI_CLK>,
               <&gcc GCC_VENUS0_CORE0_VCODEC0_CLK>,
               <&gcc GCC_VENUS0_CORE1_VCODEC0_CLK>;
      clock-names = "core",
                    "iface",
                    "bus",
                    "vcodec0_core",
                    "vcodec1_core";
      power-domains = <&gcc VENUS_GDSC>,
                      <&gcc VENUS_CORE0_GDSC>,
                      <&gcc VENUS_CORE1_GDSC>;
      power-domain-names = "venus", "vcodec0", "vcodec1";
      iommus = <&apps_iommu 5>;
      memory-region = <&venus_mem>;
    };
```
