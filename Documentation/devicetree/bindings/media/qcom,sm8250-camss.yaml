## Documentation/devicetree/bindings/media/qcom,sm8750-iris.yaml
```yaml
# SPDX-License-Identifier: (GPL-2.0-only OR BSD-2-Clause)
%YAML 1.2
---
$id: http://devicetree.org/schemas/media/qcom,sm8750-iris.yaml#
$schema: http://devicetree.org/meta-schemas/core.yaml#

title: Qualcomm SM8750 SoC Iris video encoder and decoder

maintainers:
  - Krzysztof Kozlowski <krzysztof.kozlowski@linaro.org>

description:
  The Iris video processing unit on Qualcomm SM8750 SoC is a video encode and
  decode accelerator.

properties:
  compatible:
    enum:
      - qcom,sm8750-iris

  clocks:
    maxItems: 6

  clock-names:
    items:
      - const: iface          # AXI0
      - const: core
      - const: vcodec0_core
      - const: iface1         # AXI1
      - const: core_freerun
      - const: vcodec0_core_freerun

  dma-coherent: true

  interconnects:
    maxItems: 2

  interconnect-names:
    items:
      - const: cpu-cfg
      - const: video-mem

  iommus:
    maxItems: 2

  operating-points-v2: true
  opp-table:
    type: object

  power-domains:
    maxItems: 4

  power-domain-names:
    items:
      - const: venus
      - const: vcodec0
      - const: mxc
      - const: mmcx

  resets:
    maxItems: 4

  reset-names:
    items:
      - const: bus0
      - const: bus1
      - const: core
      - const: vcodec0_core

required:
  - compatible
  - dma-coherent
  - interconnects
  - interconnect-names
  - iommus
  - power-domain-names
  - resets
  - reset-names

allOf:
  - $ref: qcom,venus-common.yaml#

unevaluatedProperties: false

examples:
  - |
    #include <dt-bindings/clock/qcom,rpmh.h>
    #include <dt-bindings/clock/qcom,sm8750-gcc.h>
    #include <dt-bindings/interrupt-controller/arm-gic.h>
    #include <dt-bindings/interconnect/qcom,icc.h>
    #include <dt-bindings/interconnect/qcom,sm8750-rpmh.h>
    #include <dt-bindings/power/qcom-rpmpd.h>
    #include <dt-bindings/power/qcom,rpmhpd.h>

    video-codec@aa00000 {
        compatible = "qcom,sm8750-iris";
        reg = <0x0aa00000 0xf0000>;

        clocks = <&gcc GCC_VIDEO_AXI0_CLK>,
                 <&videocc_mvs0c_clk>,
                 <&videocc_mvs0_clk>,
                 <&gcc GCC_VIDEO_AXI1_CLK>,
                 <&videocc_mvs0c_freerun_clk>,
                 <&videocc_mvs0_freerun_clk>;
        clock-names = "iface",
                      "core",
                      "vcodec0_core",
                      "iface1",
                      "core_freerun",
                      "vcodec0_core_freerun";

        dma-coherent;
        iommus = <&apps_smmu 0x1940 0>,
                 <&apps_smmu 0x1947 0>;

        interconnects = <&gem_noc MASTER_APPSS_PROC QCOM_ICC_TAG_ACTIVE_ONLY
                         &config_noc SLAVE_VENUS_CFG QCOM_ICC_TAG_ACTIVE_ONLY>,
                        <&mmss_noc MASTER_VIDEO_MVP QCOM_ICC_TAG_ALWAYS
                         &mc_virt SLAVE_EBI1 QCOM_ICC_TAG_ALWAYS>;
        interconnect-names = "cpu-cfg",
                             "video-mem";

        interrupts = <GIC_SPI 174 IRQ_TYPE_LEVEL_HIGH>;

        operating-points-v2 = <&iris_opp_table>;

        memory-region = <&video_mem>;

        power-domains = <&videocc_mvs0c_gdsc>,
                        <&videocc_mvs0_gdsc>,
                        <&rpmhpd RPMHPD_MXC>,
                        <&rpmhpd RPMHPD_MMCX>;
        power-domain-names = "venus",
                             "vcodec0",
                             "mxc",
                             "mmcx";

        resets = <&gcc GCC_VIDEO_AXI0_CLK_ARES>,
                 <&gcc GCC_VIDEO_AXI1_CLK_ARES>,
                 <&videocc_mvs0c_freerun_clk_ares>,
                 <&videocc_mvs0_freerun_clk_ares>;
        reset-names = "bus0",
                      "bus1",
                      "core",
                      "vcodec0_core";

        iris_opp_table: opp-table {
            compatible = "operating-points-v2";

            opp-240000000 {
                opp-hz = /bits/ 64 <240000000>;
                required-opps = <&rpmhpd_opp_low_svs_d1>,
                                <&rpmhpd_opp_low_svs_d1>;
            };

            opp-338000000 {
                opp-hz = /bits/ 64 <338000000>;
                required-opps = <&rpmhpd_opp_low_svs>,
                                <&rpmhpd_opp_low_svs>;
            };

            opp-420000000 {
                opp-hz = /bits/ 64 <420000000>;
                required-opps = <&rpmhpd_opp_svs>,
                                <&rpmhpd_opp_svs>;
            };

            opp-444000000 {
                opp-hz = /bits/ 64 <444000000>;
                required-opps = <&rpmhpd_opp_svs_l1>,
                                <&rpmhpd_opp_svs_l1>;
            };

            opp-533333334 {
                opp-hz = /bits/ 64 <533333334>;
                required-opps = <&rpmhpd_opp_nom>,
                                <&rpmhpd_opp_nom>;
            };

            opp-630000000 {
                opp-hz = /bits/ 64 <630000000>;
                required-opps = <&rpmhpd_opp_turbo>,
                                <&rpmhpd_opp_turbo>;
            };
        };
    };
```

## Documentation/devicetree/bindings/media/qcom,venus-common.yaml
```yaml
# SPDX-License-Identifier: (GPL-2.0 OR BSD-2-Clause)
%YAML 1.2
---
$id: http://devicetree.org/schemas/media/qcom,venus-common.yaml#
$schema: http://devicetree.org/meta-schemas/core.yaml#

title: Qualcomm SoC Venus Video Encode and Decode Accelerators Common Properties

maintainers:
  - Stanimir Varbanov <stanimir.k.varbanov@gmail.com>
  - Vikash Garodia <quic_vgarodia@quicinc.com>

description: |
  The Venus IP is a video encode and decode accelerator present
  on Qualcomm platforms

properties:
  reg:
    maxItems: 1

  clocks:
    minItems: 3
    maxItems: 7

  clock-names:
    minItems: 3
    maxItems: 7

  firmware-name:
    maxItems: 1

  interrupts:
    maxItems: 1

  iommus:
    minItems: 1
    maxItems: 20

  memory-region:
    maxItems: 1

  power-domains:
    minItems: 1
    maxItems: 4

  power-domain-names:
    minItems: 1
    maxItems: 4

  video-firmware:
    type: object
    additionalProperties: false

    description: |
      Firmware subnode is needed when the platform does not
      have TrustZone.

    properties:
      iommus:
        maxItems: 1

    required:
      - iommus

required:
  - reg
  - clocks
  - clock-names
  - interrupts
  - memory-region
  - power-domains

additionalProperties: true
```

## Documentation/devicetree/bindings/media/qcom,venus.txt
```
* Qualcomm Venus video encoder/decoder accelerators

- compatible:
	Usage: required
	Value type: <stringlist>
	Definition: Value should contain one of:
		- "qcom,msm8916-venus"
		- "qcom,msm8996-venus"
- reg:
	Usage: required
	Value type: <prop-encoded-array>
	Definition: Register base address and length of the register map.
- interrupts:
	Usage: required
	Value type: <prop-encoded-array>
	Definition: Should contain interrupt line number.
- clocks:
	Usage: required
	Value type: <prop-encoded-array>
	Definition: A List of phandle and clock specifier pairs as listed
		    in clock-names property.
- clock-names:
	Usage: required for msm8916
	Value type: <stringlist>
	Definition: Should contain the following entries:
		- "core"	Core video accelerator clock
		- "iface"	Video accelerator AHB clock
		- "bus"		Video accelerator AXI clock
- clock-names:
	Usage: required for msm8996
	Value type: <stringlist>
	Definition: Should contain the following entries:
		- "core"	Core video accelerator clock
		- "iface"	Video accelerator AHB clock
		- "bus"		Video accelerator AXI clock
		- "mbus"	Video MAXI clock
- power-domains:
	Usage: required
	Value type: <prop-encoded-array>
	Definition: A phandle and power domain specifier pairs to the
		    power domain which is responsible for collapsing
		    and restoring power to the peripheral.
- iommus:
	Usage: required
	Value type: <prop-encoded-array>
	Definition: A list of phandle and IOMMU specifier pairs.
- memory-region:
	Usage: required
	Value type: <phandle>
	Definition: reference to the reserved-memory for the firmware
		    memory region.

* Subnodes
The Venus video-codec node must contain two subnodes representing
video-decoder and video-encoder.

Every of video-encoder or video-decoder subnode should have:

- compatible:
	Usage: required
	Value type: <stringlist>
	Definition: Value should contain "venus-decoder" or "venus-encoder"
- clocks:
	Usage: required for msm8996
	Value type: <prop-encoded-array>
	Definition: A List of phandle and clock specifier pairs as listed
		    in clock-names property.
- clock-names:
	Usage: required for msm8996
	Value type: <stringlist>
	Definition: Should contain the following entries:
		- "core"	Subcore video accelerator clock

- power-domains:
	Usage: required for msm8996
	Value type: <prop-encoded-array>
	Definition: A phandle and power domain specifier pairs to the
		    power domain which is responsible for collapsing
		    and restoring power to the subcore.

* An Example
	video-codec@1d00000 {
		compatible = "qcom,msm8916-venus";
		reg = <0x01d00000 0xff000>;
		interrupts = <GIC_SPI 44 IRQ_TYPE_LEVEL_HIGH>;
		clocks = <&gcc GCC_VENUS0_VCODEC0_CLK>,
			 <&gcc GCC_VENUS0_AHB_CLK>,
			 <&gcc GCC_VENUS0_AXI_CLK>;
		clock-names = "core", "iface", "bus";
		power-domains = <&gcc VENUS_GDSC>;
		iommus = <&apps_iommu 5>;
		memory-region = <&venus_mem>;

		video-decoder {
			compatible = "venus-decoder";
			clocks = <&mmcc VIDEO_SUBCORE0_CLK>;
			clock-names = "core";
			power-domains = <&mmcc VENUS_CORE0_GDSC>;
		};

		video-encoder {
			compatible = "venus-encoder";
			clocks = <&mmcc VIDEO_SUBCORE1_CLK>;
			clock-names = "core";
			power-domains = <&mmcc VENUS_CORE1_GDSC>;
		};
	};
```
