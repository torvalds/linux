## Documentation/devicetree/bindings/media/rc.yaml
```yaml
# SPDX-License-Identifier: GPL-2.0
%YAML 1.2
---
$id: http://devicetree.org/schemas/media/rc.yaml#
$schema: http://devicetree.org/meta-schemas/core.yaml#

title: Generic Infrared Remote Controller Device Tree Bindings

maintainers:
  - Mauro Carvalho Chehab <mchehab@kernel.org>
  - Sean Young <sean@mess.org>

properties:
  $nodename:
    pattern: "^ir(@[a-f0-9]+)?$"

  linux,rc-map-name:
    description:
      Specifies the scancode/key mapping table defined in-kernel for
      the remote controller.
    $ref: '/schemas/types.yaml#/definitions/string'
    enum:
      - rc-adstech-dvb-t-pci
      - rc-alink-dtu-m
      - rc-anysee
      - rc-apac-viewcomp
      - rc-astrometa-t2hybrid
      - rc-asus-pc39
      - rc-asus-ps3-100
      - rc-ati-tv-wonder-hd-600
      - rc-ati-x10
      - rc-avermedia
      - rc-avermedia-a16d
      - rc-avermedia-cardbus
      - rc-avermedia-dvbt
      - rc-avermedia-m135a
      - rc-avermedia-m733a-rm-k6
      - rc-avermedia-rm-ks
      - rc-avertv-303
      - rc-azurewave-ad-tu700
      - rc-beelink-gs1
      - rc-behold
      - rc-behold-columbus
      - rc-budget-ci-old
      - rc-cec
      - rc-cinergy
      - rc-cinergy-1400
      - rc-d680-dmb
      - rc-delock-61959
      - rc-dib0700-nec
      - rc-dib0700-rc5
      - rc-digitalnow-tinytwin
      - rc-digittrade
      - rc-dm1105-nec
      - rc-dntv-live-dvb-t
      - rc-dntv-live-dvbt-pro
      - rc-dtt200u
      - rc-dvbsky
      - rc-dvico-mce
      - rc-dvico-portable
      - rc-em-terratec
      - rc-empty
      - rc-encore-enltv
      - rc-encore-enltv-fm53
      - rc-encore-enltv2
      - rc-evga-indtube
      - rc-eztv
      - rc-flydvb
      - rc-flyvideo
      - rc-fusionhdtv-mce
      - rc-gadmei-rm008z
      - rc-geekbox
      - rc-genius-tvgo-a11mce
      - rc-gotview7135
      - rc-hauppauge
      - rc-hisi-poplar
      - rc-hisi-tv-demo
      - rc-imon-mce
      - rc-imon-pad
      - rc-imon-rsc
      - rc-iodata-bctv7e
      - rc-it913x-v1
      - rc-it913x-v2
      - rc-kaiomy
      - rc-khadas
      - rc-khamsin
      - rc-kworld-315u
      - rc-kworld-pc150u
      - rc-kworld-plus-tv-analog
      - rc-leadtek-y04g0051
      - rc-lme2510
      - rc-manli
      - rc-mecool-kii-pro
      - rc-mecool-kiii-pro
      - rc-medion-x10
      - rc-medion-x10-digitainer
      - rc-medion-x10-or2x
      - rc-minix-neo
      - rc-msi-digivox-ii
      - rc-msi-digivox-iii
      - rc-msi-tvanywhere
      - rc-msi-tvanywhere-plus
      - rc-nebula
      - rc-nec-terratec-cinergy-xs
      - rc-norwood
      - rc-npgtech
      - rc-odroid
      - rc-pctv-sedna
      - rc-pine64
      - rc-pinnacle-color
      - rc-pinnacle-grey
      - rc-pinnacle-pctv-hd
      - rc-pixelview
      - rc-pixelview-002t
      - rc-pixelview-mk12
      - rc-pixelview-new
      - rc-powercolor-real-angel
      - rc-proteus-2309
      - rc-purpletv
      - rc-pv951
      - rc-rc5-tv
      - rc-rc6-mce
      - rc-real-audio-220-32-keys
      - rc-reddo
      - rc-snapstream-firefly
      - rc-streamzap
      - rc-su3000
      - rc-tanix-tx3mini
      - rc-tanix-tx5max
      - rc-tbs-nec
      - rc-technisat-ts35
      - rc-technisat-usb2
      - rc-terratec-cinergy-c-pci
      - rc-terratec-cinergy-s2-hd
      - rc-terratec-cinergy-xs
      - rc-terratec-slim
      - rc-terratec-slim-2
      - rc-tevii-nec
      - rc-tivo
      - rc-total-media-in-hand
      - rc-total-media-in-hand-02
      - rc-trekstor
      - rc-tt-1500
      - rc-twinhan-dtv-cab-ci
      - rc-twinhan1027
      - rc-videomate-k100
      - rc-videomate-s350
      - rc-videomate-tv-pvr
      - rc-videostrong-kii-pro
      - rc-vega-s9x
      - rc-wetek-hub
      - rc-wetek-play2
      - rc-winfast
      - rc-winfast-usbii-deluxe
      - rc-x96max
      - rc-xbox-360
      - rc-xbox-dvd
      - rc-zx-irdec

additionalProperties: true
```

## Documentation/devicetree/bindings/media/rcar_vin.txt
```
Renesas R-Car Video Input driver (rcar_vin)
-------------------------------------------

The rcar_vin device provides video input capabilities for the Renesas R-Car
family of devices.

Each VIN instance has a single parallel input that supports RGB and YUV video,
with both external synchronization and BT.656 synchronization for the latter.
Depending on the instance the VIN input is connected to external SoC pins, or
on Gen3 platforms to a CSI-2 receiver.

 - compatible: Must be one or more of the following
   - "renesas,vin-r8a7743" for the R8A7743 device
   - "renesas,vin-r8a7744" for the R8A7744 device
   - "renesas,vin-r8a7745" for the R8A7745 device
   - "renesas,vin-r8a7778" for the R8A7778 device
   - "renesas,vin-r8a7779" for the R8A7779 device
   - "renesas,vin-r8a7790" for the R8A7790 device
   - "renesas,vin-r8a7791" for the R8A7791 device
   - "renesas,vin-r8a7792" for the R8A7792 device
   - "renesas,vin-r8a7793" for the R8A7793 device
   - "renesas,vin-r8a7794" for the R8A7794 device
   - "renesas,vin-r8a7795" for the R8A7795 device
   - "renesas,vin-r8a7796" for the R8A7796 device
   - "renesas,vin-r8a77965" for the R8A77965 device
   - "renesas,vin-r8a77970" for the R8A77970 device
   - "renesas,vin-r8a77995" for the R8A77995 device
   - "renesas,rcar-gen2-vin" for a generic R-Car Gen2 or RZ/G1 compatible
     device.

   When compatible with the generic version nodes must list the
   SoC-specific version corresponding to the platform first
   followed by the generic version.

 - reg: the register base and size for the device registers
 - interrupts: the interrupt for the device
 - clocks: Reference to the parent clock

Additionally, an alias named vinX will need to be created to specify
which video input device this is.

The per-board settings Gen2 platforms:

- port - sub-node describing a single endpoint connected to the VIN
  from external SoC pins as described in video-interfaces.txt[1].
  Only the first one will be considered as each vin interface has one
  input port.

  - Optional properties for endpoint nodes:
    - hsync-active: see [1] for description. Default is active high.
    - vsync-active: see [1] for description. Default is active high.
      If both HSYNC and VSYNC polarities are not specified, embedded
      synchronization is selected.
    - field-active-even: see [1] for description. Default is active high.
    - bus-width: see [1] for description. The selected bus width depends on
      the SoC type and selected input image format.
      Valid values are: 8, 10, 12, 16, 24 and 32.
    - data-shift: see [1] for description. Valid values are 0 and 8.
    - data-enable-active: polarity of CLKENB signal, see [1] for
      description. Default is active high.

The per-board settings Gen3 platforms:

Gen3 platforms can support both a single connected parallel input source
from external SoC pins (port@0) and/or multiple parallel input sources
from local SoC CSI-2 receivers (port@1) depending on SoC.

- renesas,id - ID number of the VIN, VINx in the documentation.
- ports
    - port@0 - sub-node describing a single endpoint connected to the VIN
      from external SoC pins as described in video-interfaces.txt[1].
      Describing more than one endpoint in port@0 is invalid. Only VIN
      instances that are connected to external pins should have port@0.

      Endpoint nodes of port@0 support the optional properties listed in
      the Gen2 per-board settings description.

    - port@1 - sub-nodes describing one or more endpoints connected to
      the VIN from local SoC CSI-2 receivers. The endpoint numbers must
      use the following schema.

        - endpoint@0 - sub-node describing the endpoint connected to CSI20
        - endpoint@1 - sub-node describing the endpoint connected to CSI21
        - endpoint@2 - sub-node describing the endpoint connected to CSI40
        - endpoint@3 - sub-node describing the endpoint connected to CSI41

      Endpoint nodes of port@1 do not support any optional endpoint property.

Device node example for Gen2 platforms
--------------------------------------

        aliases {
                vin0 = &vin0;
        };

        vin0: vin@e6ef0000 {
                compatible = "renesas,vin-r8a7790", "renesas,rcar-gen2-vin";
                clocks = <&mstp8_clks R8A7790_CLK_VIN0>;
                reg = <0 0xe6ef0000 0 0x1000>;
                interrupts = <0 188 IRQ_TYPE_LEVEL_HIGH>;
                status = "disabled";
        };

Board setup example for Gen2 platforms (vin1 composite video input)
-------------------------------------------------------------------

&i2c2   {
        status = "okay";
        pinctrl-0 = <&i2c2_pins>;
        pinctrl-names = "default";

        adv7180@20 {
                compatible = "adi,adv7180";
                reg = <0x20>;
                remote = <&vin1>;

                port {
                        adv7180: endpoint {
                                bus-width = <8>;
                                remote-endpoint = <&vin1ep0>;
                        };
                };
        };
};

/* composite video input */
&vin1 {
        pinctrl-0 = <&vin1_pins>;
        pinctrl-names = "default";

        status = "okay";

        port {
                vin1ep0: endpoint {
                        remote-endpoint = <&adv7180>;
                        bus-width = <8>;
                };
        };
};

Device node example for Gen3 platforms
--------------------------------------

        vin0: video@e6ef0000 {
                compatible = "renesas,vin-r8a7795";
                reg = <0 0xe6ef0000 0 0x1000>;
                interrupts = <GIC_SPI 188 IRQ_TYPE_LEVEL_HIGH>;
                clocks = <&cpg CPG_MOD 811>;
                power-domains = <&sysc R8A7795_PD_ALWAYS_ON>;
                resets = <&cpg 811>;
                renesas,id = <0>;

                ports {
                        #address-cells = <1>;
                        #size-cells = <0>;

                        port@1 {
                                #address-cells = <1>;
                                #size-cells = <0>;

                                reg = <1>;

                                vin0csi20: endpoint@0 {
                                        reg = <0>;
                                        remote-endpoint= <&csi20vin0>;
                                };
                                vin0csi21: endpoint@1 {
                                        reg = <1>;
                                        remote-endpoint= <&csi21vin0>;
                                };
                                vin0csi40: endpoint@2 {
                                        reg = <2>;
                                        remote-endpoint= <&csi40vin0>;
                                };
                        };
                };
        };

        csi20: csi2@fea80000 {
                compatible = "renesas,r8a7795-csi2";
                reg = <0 0xfea80000 0 0x10000>;
                interrupts = <GIC_SPI 184 IRQ_TYPE_LEVEL_HIGH>;
                clocks = <&cpg CPG_MOD 714>;
                power-domains = <&sysc R8A7795_PD_ALWAYS_ON>;
                resets = <&cpg 714>;

                ports {
                        #address-cells = <1>;
                        #size-cells = <0>;

                        port@0 {
                                reg = <0>;
                                csi20_in: endpoint {
                                        clock-lanes = <0>;
                                        data-lanes = <1>;
                                        remote-endpoint = <&adv7482_txb>;
                                };
                        };

                        port@1 {
                                #address-cells = <1>;
                                #size-cells = <0>;

                                reg = <1>;

                                csi20vin0: endpoint@0 {
                                        reg = <0>;
                                        remote-endpoint = <&vin0csi20>;
                                };
                        };
                };
        };

[1] video-interfaces.txt common video media interface
```

## Documentation/devicetree/bindings/media/renesas,ceu.txt
```
Renesas Capture Engine Unit (CEU)
----------------------------------------------

The Capture Engine Unit is the image capture interface found in the Renesas
SH Mobile, R-Mobile and RZ SoCs.

The interface supports a single parallel input with data bus width of 8 or 16
bits.

Required properties:
- compatible: Shall be one of the following values:
	"renesas,r7s72100-ceu" for CEU units found in RZ/A1H and RZ/A1M SoCs
	"renesas,r8a7740-ceu" for CEU units found in R-Mobile A1 R8A7740 SoCs
- reg: Registers address base and size.
- interrupts: The interrupt specifier.

The CEU supports a single parallel input and should contain a single 'port'
subnode with a single 'endpoint'. Connection to input devices are modeled
according to the video interfaces OF bindings specified in:
Documentation/devicetree/bindings/media/video-interfaces.txt

Optional endpoint properties applicable to parallel input bus described in
the above mentioned "video-interfaces.txt" file are supported.

- hsync-active: Active state of the HSYNC signal, 0/1 for LOW/HIGH respectively.
  If property is not present, default is active high.
- vsync-active: Active state of the VSYNC signal, 0/1 for LOW/HIGH respectively.
  If property is not present, default is active high.

Example:

The example describes the connection between the Capture Engine Unit and an
OV7670 image sensor connected to i2c1 interface.

ceu: ceu@e8210000 {
	reg = <0xe8210000 0x209c>;
	compatible = "renesas,r7s72100-ceu";
	interrupts = <GIC_SPI 332 IRQ_TYPE_LEVEL_HIGH>;

	pinctrl-names = "default";
	pinctrl-0 = <&vio_pins>;

	status = "okay";

	port {
		ceu_in: endpoint {
			remote-endpoint = <&ov7670_out>;

			hsync-active = <1>;
			vsync-active = <0>;
		};
	};
};

i2c1: i2c@fcfee400 {
	pinctrl-names = "default";
	pinctrl-0 = <&i2c1_pins>;

	status = "okay";

	clock-frequency = <100000>;

	ov7670: camera@21 {
		compatible = "ovti,ov7670";
		reg = <0x21>;

		pinctrl-names = "default";
		pinctrl-0 = <&vio_pins>;

		reset-gpios = <&port3 11 GPIO_ACTIVE_LOW>;
		powerdown-gpios = <&port3 12 GPIO_ACTIVE_HIGH>;

		port {
			ov7670_out: endpoint {
				remote-endpoint = <&ceu_in>;

				hsync-active = <1>;
				vsync-active = <0>;
			};
		};
	};
};
```
