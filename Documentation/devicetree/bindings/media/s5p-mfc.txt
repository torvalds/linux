## Documentation/devicetree/bindings/media/samsung-mipi-csis.txt
```
Samsung S5P/Exynos SoC series MIPI CSI-2 receiver (MIPI CSIS)
-------------------------------------------------------------

Required properties:

- compatible	  : "samsung,s5pv210-csis" for S5PV210 (S5PC110),
		    "samsung,exynos4210-csis" for Exynos4210 (S5PC210),
		    "samsung,exynos4212-csis" for Exynos4212/Exynos4412,
		    "samsung,exynos5250-csis" for Exynos5250;
- reg		  : offset and length of the register set for the device;
- interrupts      : should contain MIPI CSIS interrupt; the format of the
		    interrupt specifier depends on the interrupt controller;
- bus-width	  : maximum number of data lanes supported (SoC specific);
- vddio-supply    : MIPI CSIS I/O and PLL voltage supply (e.g. 1.8V);
- vddcore-supply  : MIPI CSIS Core voltage supply (e.g. 1.1V);
- clocks	  : list of clock specifiers, corresponding to entries in
		    clock-names property;
- clock-names	  : must contain "csis", "sclk_csis" entries, matching entries
		    in the clocks property.

Optional properties:

- clock-frequency : The IP's main (system bus) clock frequency in Hz, default
		    value when this property is not specified is 166 MHz;
- samsung,csis-wclk : CSI-2 wrapper clock selection. If this property is present
		    external clock from CMU will be used, or the bus clock if
		    if it's not specified.

The device node should contain one 'port' child node with one child 'endpoint'
node, according to the bindings defined in Documentation/devicetree/bindings/
media/video-interfaces.txt. The following are properties specific to those nodes.

port node
---------

- reg		  : (required) must be 3 for camera C input (CSIS0) or 4 for
		    camera D input (CSIS1);

endpoint node
-------------

- data-lanes	  : (required) an array specifying active physical MIPI-CSI2
		    data input lanes and their mapping to logical lanes; the
		    array's content is unused, only its length is meaningful;

- samsung,csis-hs-settle : (optional) differential receiver (HS-RX) settle time;


Example:

	reg0: regulator@0 {
	};

	reg1: regulator@1 {
	};

/* SoC properties */

	csis_0: csis@11880000 {
		compatible = "samsung,exynos4210-csis";
		reg = <0x11880000 0x1000>;
		interrupts = <0 78 0>;
		#address-cells = <1>;
		#size-cells = <0>;
	};

/* Board properties */

	csis_0: csis@11880000 {
		clock-frequency = <166000000>;
		vddio-supply = <&reg0>;
		vddcore-supply = <&reg1>;
		port {
			reg = <3>; /* 3 - CSIS0, 4 - CSIS1 */
			csis0_ep: endpoint {
				remote-endpoint = <...>;
				data-lanes = <1>, <2>;
				samsung,csis-hs-settle = <12>;
			};
		};
	};
```

## Documentation/devicetree/bindings/media/samsung-s5c73m3.txt
```
Samsung S5C73M3 8Mp camera ISP
------------------------------

The S5C73M3 camera ISP supports MIPI CSI-2 and parallel (ITU-R BT.656) video
data busses. The I2C bus is the main control bus and additionally the SPI bus
is used, mostly for transferring the firmware to and from the device. Two
slave device nodes corresponding to these control bus interfaces are required
and should be placed under respective bus controller nodes.

I2C slave device node
---------------------

Required properties:

- compatible	    : "samsung,s5c73m3";
- reg		    : I2C slave address of the sensor;
- vdd-int-supply    : digital power supply (1.2V);
- vdda-supply	    : analog power supply (1.2V);
- vdd-reg-supply    : regulator input power supply (2.8V);
- vddio-host-supply : host I/O power supply (1.8V to 2.8V);
- vddio-cis-supply  : CIS I/O power supply (1.2V to 1.8V);
- vdd-af-supply     : lens power supply (2.8V);
- xshutdown-gpios   : specifier of GPIO connected to the XSHUTDOWN pin;
- standby-gpios     : specifier of GPIO connected to the STANDBY pin;
- clocks	    : should contain list of phandle and clock specifier pairs
		      according to common clock bindings for the clocks described
		      in the clock-names property;
- clock-names	    : should contain "cis_extclk" entry for the CIS_EXTCLK clock;

Optional properties:

- clock-frequency   : the frequency at which the "cis_extclk" clock should be
		      configured to operate, in Hz; if this property is not
		      specified default 24 MHz value will be used.

The common video interfaces bindings (see video-interfaces.txt) should be used
to specify link from the S5C73M3 to an external image data receiver. The S5C73M3
device node should contain one 'port' child node with an 'endpoint' subnode for
this purpose. The data link from a raw image sensor to the S5C73M3 can be
similarly specified, but it is optional since the S5C73M3 ISP and a raw image
sensor are usually inseparable and form a hybrid module.

Following properties are valid for the endpoint node(s):

endpoint subnode
----------------

- data-lanes : (optional) specifies MIPI CSI-2 data lanes as covered in
  video-interfaces.txt. This sensor doesn't support data lane remapping
  and physical lane indexes in subsequent elements of the array should
  be only consecutive ascending values.

SPI device node
---------------

Required properties:

- compatible	    : "samsung,s5c73m3";

For more details see description of the SPI busses bindings
(../spi/spi-bus.txt) and bindings of a specific bus controller.

Example:

i2c@138A000000 {
	...
	s5c73m3@3c {
		compatible = "samsung,s5c73m3";
		reg = <0x3c>;
		vdd-int-supply = <&buck9_reg>;
		vdda-supply = <&ldo17_reg>;
		vdd-reg-supply = <&cam_io_reg>;
		vddio-host-supply = <&ldo18_reg>;
		vddio-cis-supply = <&ldo9_reg>;
		vdd-af-supply = <&cam_af_reg>;
		clock-frequency = <24000000>;
		clocks = <&clk 0>;
		clock-names = "cis_extclk";
		reset-gpios = <&gpf1 3 1>;
		standby-gpios = <&gpm0 1 1>;
		port {
			s5c73m3_ep: endpoint {
				remote-endpoint = <&csis0_ep>;
				data-lanes = <1 2 3 4>;
			};
		};
	};
};

spi@1392000 {
	...
	s5c73m3_spi: s5c73m3@0 {
		compatible = "samsung,s5c73m3";
		reg = <0>;
		...
	};
};
```

## Documentation/devicetree/bindings/media/samsung-s5k5baf.txt
```
Samsung S5K5BAF UXGA 1/5" 2M CMOS Image Sensor with embedded SoC ISP
--------------------------------------------------------------------

Required properties:

- compatible	  : "samsung,s5k5baf";
- reg		  : I2C slave address of the sensor;
- vdda-supply	  : analog power supply 2.8V (2.6V to 3.0V);
- vddreg-supply	  : regulator input power supply 1.8V (1.7V to 1.9V)
		    or 2.8V (2.6V to 3.0);
- vddio-supply	  : I/O power supply 1.8V (1.65V to 1.95V)
		    or 2.8V (2.5V to 3.1V);
- stbyn-gpios	  : GPIO connected to STDBYN pin;
- rstn-gpios	  : GPIO connected to RSTN pin;
- clocks	  : list of phandle and clock specifier pairs
		    according to common clock bindings for the
		    clocks described in clock-names;
- clock-names	  : should include "mclk" for the sensor's master clock;

Optional properties:

- clock-frequency : the frequency at which the "mclk" clock should be
		    configured to operate, in Hz; if this property is not
		    specified default 24 MHz value will be used.

The device node should contain one 'port' child node with one child 'endpoint'
node, according to the bindings defined in Documentation/devicetree/bindings/
media/video-interfaces.txt. The following are properties specific to those
nodes.

endpoint node
-------------

- data-lanes : (optional) specifies MIPI CSI-2 data lanes as covered in
	       video-interfaces.txt. If present it should be <1> - the device
	       supports only one data lane without re-mapping.

Example:

s5k5bafx@2d {
	compatible = "samsung,s5k5baf";
	reg = <0x2d>;
	vdda-supply = <&cam_io_en_reg>;
	vddreg-supply = <&vt_core_15v_reg>;
	vddio-supply = <&vtcam_reg>;
	stbyn-gpios = <&gpl2 0 1>;
	rstn-gpios = <&gpl2 1 1>;
	clock-names = "mclk";
	clocks = <&clock_cam 0>;
	clock-frequency = <24000000>;

	port {
		s5k5bafx_ep: endpoint {
			remote-endpoint = <&csis1_ep>;
			data-lanes = <1>;
		};
	};
};
```

## Documentation/devicetree/bindings/media/samsung-s5k6a3.txt
```
Samsung S5K6A3(YX) raw image sensor
---------------------------------

S5K6A3(YX) is a raw image sensor with MIPI CSI-2 and CCP2 image data interfaces
and CCI (I2C compatible) control bus.

Required properties:

- compatible	: "samsung,s5k6a3";
- reg		: I2C slave address of the sensor;
- svdda-supply	: core voltage supply;
- svddio-supply	: I/O voltage supply;
- afvdd-supply	: AF (actuator) voltage supply;
- gpios		: specifier of a GPIO connected to the RESET pin;
- clocks	: should contain list of phandle and clock specifier pairs
		  according to common clock bindings for the clocks described
		  in the clock-names property;
- clock-names	: should contain "extclk" entry for the sensor's EXTCLK clock;

Optional properties:

- clock-frequency : the frequency at which the "extclk" clock should be
		    configured to operate, in Hz; if this property is not
		    specified default 24 MHz value will be used.

The common video interfaces bindings (see video-interfaces.txt) should be
used to specify link to the image data receiver. The S5K6A3(YX) device
node should contain one 'port' child node with an 'endpoint' subnode.

Following properties are valid for the endpoint node:

- data-lanes : (optional) specifies MIPI CSI-2 data lanes as covered in
  video-interfaces.txt.  The sensor supports only one data lane.
```

## Documentation/devicetree/bindings/media/sh_mobile_ceu.txt
```
Bindings, specific for the sh_mobile_ceu_camera.c driver:
 - compatible: Should be "renesas,sh-mobile-ceu"
 - reg: register base and size
 - interrupts: the interrupt number
 - renesas,max-width: maximum image width, supported on this SoC
 - renesas,max-height: maximum image height, supported on this SoC

Example:

ceu0: ceu@fe910000 {
	compatible = "renesas,sh-mobile-ceu";
	reg = <0xfe910000 0xa0>;
	interrupt-parent = <&intcs>;
	interrupts = <0x880>;
	renesas,max-width = <8188>;
	renesas,max-height = <8188>;
};
```

## Documentation/devicetree/bindings/media/si470x.txt
```
* Silicon Labs FM Radio receiver

The Silicon Labs Si470x is family of FM radio receivers with receive power scan
supporting 76-108 MHz, programmable through an I2C interface.
Some of them includes an RDS encoder.

Required Properties:
- compatible: Should contain "silabs,si470x"
- reg: the I2C address of the device

Optional Properties:
- interrupts : The interrupt number
- reset-gpios: GPIO specifier for the chips reset line

Example:

&i2c2 {
        si470x@63 {
                compatible = "silabs,si470x";
                reg = <0x63>;

                interrupt-parent = <&gpj2>;
                interrupts = <4 IRQ_TYPE_EDGE_FALLING>;
                reset-gpios = <&gpj2 5 GPIO_ACTIVE_HIGH>;
        };
};
```

## Documentation/devicetree/bindings/media/si4713.txt
```
* Silicon Labs FM Radio transmitter

The Silicon Labs Si4713 is an FM radio transmitter with receive power scan
supporting 76-108 MHz. It includes an RDS encoder and has both, a stereo-analog
and a digital interface, which supports I2S, left-justified and a custom
DSP-mode format. It is programmable through an I2C interface.

Required Properties:
- compatible: Should contain "silabs,si4713"
- reg: the I2C address of the device

Optional Properties:
- interrupts-extended: Interrupt specifier for the chips interrupt
- reset-gpios: GPIO specifier for the chips reset line
- vdd-supply: phandle for Vdd regulator
- vio-supply: phandle for Vio regulator

Example:

&i2c2 {
        fmtx: si4713@63 {
                compatible = "silabs,si4713";
                reg = <0x63>;

                interrupts-extended = <&gpio2 21 IRQ_TYPE_EDGE_FALLING>; /* 53 */
                reset-gpios = <&gpio6 3 GPIO_ACTIVE_HIGH>; /* 163 */
                vio-supply = <&vio>;
                vdd-supply = <&vaux1>;
        };
};
```

## Documentation/devicetree/bindings/media/silabs,si470x.yaml
```yaml
# SPDX-License-Identifier: GPL-2.0-only OR BSD-2-Clause
%YAML 1.2
---
$id: http://devicetree.org/schemas/media/silabs,si470x.yaml#
$schema: http://devicetree.org/meta-schemas/core.yaml#

title: Silicon Labs Si470x FM Radio Receiver

maintainers:
  - Hans Verkuil <hverkuil@xs4all.nl>
  - Paweł Chmiel <pawel.mikolaj.chmiel@gmail.com>

properties:
  compatible:
    const: silabs,si470x

  reg:
    maxItems: 1

  interrupts:
    maxItems: 1

  reset-gpios:
    maxItems: 1

required:
  - compatible
  - reg

additionalProperties: false

examples:
  - |
    #include <dt-bindings/gpio/gpio.h>
    #include <dt-bindings/interrupt-controller/irq.h>

    i2c {
        #address-cells = <1>;
        #size-cells = <0>;

        fmradio@10 {
            compatible = "silabs,si470x";
            reg = <0x10>;
            interrupt-parent = <&gpj2>;
            interrupts = <4 IRQ_TYPE_EDGE_FALLING>;
            reset-gpios = <&gpj2 5 GPIO_ACTIVE_HIGH>;
        };
    };
```
