## Documentation/devicetree/bindings/media/snps,dw-hdmi-rx.yaml
```yaml
# SPDX-License-Identifier: (GPL-2.0-only OR BSD-2-Clause)
# Device Tree bindings for Synopsys DesignWare HDMI RX Controller

---
$id: http://devicetree.org/schemas/media/snps,dw-hdmi-rx.yaml#
$schema: http://devicetree.org/meta-schemas/core.yaml#

title: Synopsys DesignWare HDMI RX Controller

maintainers:
  - Shreeya Patel <shreeya.patel@collabora.com>

description:
  Synopsys DesignWare HDMI Input Controller preset on RK3588 SoCs
  allowing devices to receive and decode high-resolution video streams
  from external sources like media players, cameras, laptops, etc.

properties:
  compatible:
    items:
      - const: rockchip,rk3588-hdmirx-ctrler
      - const: snps,dw-hdmi-rx

  reg:
    maxItems: 1

  interrupts:
    maxItems: 3

  interrupt-names:
    items:
      - const: cec
      - const: hdmi
      - const: dma

  clocks:
    maxItems: 7

  clock-names:
    items:
      - const: aclk
      - const: audio
      - const: cr_para
      - const: pclk
      - const: ref
      - const: hclk_s_hdmirx
      - const: hclk_vo1

  power-domains:
    maxItems: 1

  resets:
    maxItems: 4

  reset-names:
    items:
      - const: axi
      - const: apb
      - const: ref
      - const: biu

  memory-region:
    maxItems: 1

  hpd-gpios:
    description: GPIO specifier for HPD.
    maxItems: 1

  rockchip,grf:
    $ref: /schemas/types.yaml#/definitions/phandle
    description:
      The phandle of the syscon node for the general register file
      containing HDMIRX PHY status bits.

  rockchip,vo1-grf:
    $ref: /schemas/types.yaml#/definitions/phandle
    description:
      The phandle of the syscon node for the Video Output GRF register
      to enable EDID transfer through SDAIN and SCLIN.

required:
  - compatible
  - reg
  - interrupts
  - interrupt-names
  - clocks
  - clock-names
  - power-domains
  - resets
  - pinctrl-0
  - hpd-gpios

additionalProperties: false

examples:
  - |
    #include <dt-bindings/clock/rockchip,rk3588-cru.h>
    #include <dt-bindings/gpio/gpio.h>
    #include <dt-bindings/interrupt-controller/arm-gic.h>
    #include <dt-bindings/interrupt-controller/irq.h>
    #include <dt-bindings/power/rk3588-power.h>
    #include <dt-bindings/reset/rockchip,rk3588-cru.h>
    hdmi_receiver: hdmi-receiver@fdee0000 {
      compatible = "rockchip,rk3588-hdmirx-ctrler", "snps,dw-hdmi-rx";
      reg = <0xfdee0000 0x6000>;
      interrupts = <GIC_SPI 177 IRQ_TYPE_LEVEL_HIGH 0>,
                   <GIC_SPI 178 IRQ_TYPE_LEVEL_HIGH 0>,
                   <GIC_SPI 179 IRQ_TYPE_LEVEL_HIGH 0>;
      interrupt-names = "cec", "hdmi", "dma";
      clocks = <&cru ACLK_HDMIRX>,
               <&cru CLK_HDMIRX_AUD>,
               <&cru CLK_CR_PARA>,
               <&cru PCLK_HDMIRX>,
               <&cru CLK_HDMIRX_REF>,
               <&cru PCLK_S_HDMIRX>,
               <&cru HCLK_VO1>;
      clock-names = "aclk",
                    "audio",
                    "cr_para",
                    "pclk",
                    "ref",
                    "hclk_s_hdmirx",
                    "hclk_vo1";
      power-domains = <&power RK3588_PD_VO1>;
      resets = <&cru SRST_A_HDMIRX>, <&cru SRST_P_HDMIRX>,
               <&cru SRST_HDMIRX_REF>, <&cru SRST_A_HDMIRX_BIU>;
      reset-names = "axi", "apb", "ref", "biu";
      memory-region = <&hdmi_receiver_cma>;
      pinctrl-0 = <&hdmim1_rx_cec &hdmim1_rx_hpdin &hdmim1_rx_scl &hdmim1_rx_sda &hdmirx_5v_detection>;
      pinctrl-names = "default";
      hpd-gpios = <&gpio1 22 GPIO_ACTIVE_LOW>;
    };
```

## Documentation/devicetree/bindings/media/spi/sony-cxd2880.txt
```
Sony CXD2880 DVB-T2/T tuner + demodulator driver SPI adapter

Required properties:
- compatible: Should be "sony,cxd2880".
- reg: SPI chip select number for the device.
- spi-max-frequency: Maximum bus speed, should be set to <55000000> (55MHz).

Optional properties:
- vcc-supply: Optional phandle to the vcc regulator to power the adapter,
  as described in the file ../regulator/regulator.txt

Example:

cxd2880@0 {
	compatible = "sony,cxd2880";
	reg = <0>; /* CE0 */
	spi-max-frequency = <55000000>; /* 55MHz */
};
```

## Documentation/devicetree/bindings/media/st,st-delta.txt
```
* STMicroelectronics DELTA multi-format video decoder

Required properties:
- compatible: should be "st,st-delta".
- clocks: from common clock binding: handle hardware IP needed clocks, the
  number of clocks may depend on the SoC type.
  See ../clock/clock-bindings.txt for details.
- clock-names: names of the clocks listed in clocks property in the same order.

Example:
	delta0 {
		compatible = "st,st-delta";
		clock-names = "delta", "delta-st231", "delta-flash-promip";
		clocks = <&clk_s_c0_flexgen CLK_VID_DMU>,
			 <&clk_s_c0_flexgen CLK_ST231_DMU>,
			 <&clk_s_c0_flexgen CLK_FLASH_PROMIP>;
	};
```

## Documentation/devicetree/bindings/media/st,st-hva.txt
```
st-hva: multi-format video encoder for STMicroelectronics SoC.

Required properties:
- compatible: should be "st,st-hva".
- reg: HVA physical address location and length, esram address location and
  length.
- reg-names: names of the registers listed in registers property in the same
  order.
- interrupts: HVA interrupt number.
- clocks: from common clock binding: handle hardware IP needed clocks, the
  number of clocks may depend on the SoC type.
  See ../clock/clock-bindings.txt for details.
- clock-names: names of the clocks listed in clocks property in the same order.

Example:
	hva@8c85000{
		compatible = "st,st-hva";
		reg = <0x8c85000 0x400>, <0x6000000 0x40000>;
		reg-names = "hva_registers", "hva_esram";
		interrupts = <GIC_SPI 58 IRQ_TYPE_NONE>,
			     <GIC_SPI 59 IRQ_TYPE_NONE>;
		clock-names = "clk_hva";
		clocks = <&clk_s_c0_flexgen CLK_HVA>;
	};
```

## Documentation/devicetree/bindings/media/st,stih4xx.txt
```
STMicroelectronics stih4xx platforms

bdisp: 2D blitter for STMicroelectronics SoC.

Required properties:
- compatible: should be "st,stih407-bdisp".
- reg: BDISP physical address location and length.
- interrupts: BDISP interrupt number.
- clocks: from common clock binding: handle hardware IP needed clocks, the
  number of clocks may depend on the SoC type.
  See ../clocks/clock-bindings.txt for details.
- clock-names: names of the clocks listed in clocks property in the same order.

Example:

	bdisp0:bdisp@9f10000 {
		compatible = "st,stih407-bdisp";
		reg = <0x9f10000 0x1000>;
		interrupts = <GIC_SPI 38 IRQ_TYPE_NONE>;
		clock-names = "bdisp";
		clocks = <&clk_s_c0_flexgen CLK_IC_BDISP_0>;
	};

Aliases:
Each BDISP should have a numbered alias in the aliases node, in the form of
bdispN, N = 0 or 1.

Example:

	aliases {
		bdisp0 = &bdisp0;
	};
```

## Documentation/devicetree/bindings/media/st,stm32-cec.txt
```
STMicroelectronics STM32 CEC driver

Required properties:
 - compatible : value should be "st,stm32-cec"
 - reg : Physical base address of the IP registers and length of memory
	 mapped region.
 - clocks : from common clock binding: handle to CEC clocks
 - clock-names : from common clock binding: must be "cec" and "hdmi-cec".
 - interrupts : CEC interrupt number to the CPU.

Example for stm32f746:

cec: cec@40006c00 {
	compatible = "st,stm32-cec";
	reg = <0x40006C00 0x400>;
	interrupts = <94>;
	clocks = <&rcc 0 STM32F7_APB1_CLOCK(CEC)>, <&rcc 1 CLK_HDMI_CEC>;
	clock-names = "cec", "hdmi-cec";
};
```
