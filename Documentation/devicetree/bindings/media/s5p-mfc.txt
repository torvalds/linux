## Documentation/devicetree/bindings/media/s5p-mfc.txt
```
* Samsung Multi Format Codec (MFC)

Multi Format Codec (MFC) is the IP present in Samsung SoCs which
supports high resolution decoding and encoding functionalities.
The MFC device driver is a v4l2 driver which can encode/decode
video raw/elementary streams and has support for all popular
video codecs.

Required properties:
  - compatible : value should be either one among the following
	(a) "samsung,mfc-v5" for MFC v5 present in Exynos4 SoCs
	(b) "samsung,mfc-v6" for MFC v6 present in Exynos5 SoCs
	(c) "samsung,mfc-v7" for MFC v7 present in Exynos5420 SoC
	(d) "samsung,mfc-v8" for MFC v8 present in Exynos5800 SoC
	(e) "samsung,exynos5433-mfc" for MFC v8 present in Exynos5433 SoC
	(f) "samsung,mfc-v10" for MFC v10 present in Exynos7880 SoC

  - reg : Physical base address of the IP registers and length of memory
	  mapped region.

  - interrupts : MFC interrupt number to the CPU.
  - clocks : from common clock binding: handle to mfc clock.
  - clock-names : from common clock binding: must contain "mfc",
		  corresponding to entry in the clocks property.

Optional properties:
  - power-domains : power-domain property defined with a phandle
			   to respective power domain.
  - memory-region : from reserved memory binding: phandles to two reserved
	memory regions, first is for "left" mfc memory bus interfaces,
	second if for the "right" mfc memory bus, used when no SYSMMU
	support is available; used only by MFC v5 present in Exynos4 SoCs

Obsolete properties:
  - samsung,mfc-r, samsung,mfc-l : support removed, please use memory-region
	property instead


Example:
SoC specific DT entry:

mfc: codec@13400000 {
	compatible = "samsung,mfc-v5";
	reg = <0x13400000 0x10000>;
	interrupts = <0 94 0>;
	power-domains = <&pd_mfc>;
	clocks = <&clock 273>;
	clock-names = "mfc";
};

Reserved memory specific DT entry for given board (see reserved memory binding
for more information):

reserved-memory {
	#address-cells = <1>;
	#size-cells = <1>;
	ranges;

	mfc_left: region@51000000 {
		compatible = "shared-dma-pool";
		no-map;
		reg = <0x51000000 0x800000>;
	};

	mfc_right: region@43000000 {
		compatible = "shared-dma-pool";
		no-map;
		reg = <0x43000000 0x800000>;
	};
};

Board specific DT entry:

codec@13400000 {
	memory-region = <&mfc_left>, <&mfc_right>;
};
```

## Documentation/devicetree/bindings/media/samsung,exynos4210-csis.yaml
```yaml
# SPDX-License-Identifier: GPL-2.0-only OR BSD-2-Clause
%YAML 1.2
---
$id: http://devicetree.org/schemas/media/samsung,exynos4210-csis.yaml#
$schema: http://devicetree.org/meta-schemas/core.yaml#

title: Samsung S5P/Exynos SoC series MIPI CSI-2 receiver (MIPI CSIS)

maintainers:
  - Krzysztof Kozlowski <krzysztof.kozlowski@linaro.org>
  - Sylwester Nawrocki <s.nawrocki@samsung.com>

properties:
  compatible:
    enum:
      - samsung,s5pv210-csis
      - samsung,exynos4210-csis
      - samsung,exynos4212-csis
      - samsung,exynos5250-csis

  reg:
    maxItems: 1

  '#address-cells':
    const: 1

  '#size-cells':
    const: 0

  bus-width:
    $ref: /schemas/types.yaml#/definitions/uint32
    enum: [2, 4]
    description:
      Number of data lines supported.

  clocks:
    maxItems: 2

  clock-names:
    items:
      - const: csis
      - const: sclk_csis

  clock-frequency:
    default: 166000000
    description:
      The IP's main (system bus) clock frequency in Hz.

  interrupts:
    maxItems: 1

  phys:
    maxItems: 1

  phy-names:
    items:
      - const: csis

  power-domains:
    maxItems: 1

  vddio-supply:
    description: MIPI CSIS I/O and PLL voltage supply (e.g. 1.8V).

  vddcore-supply:
    description: MIPI CSIS Core voltage supply (e.g. 1.1V).

patternProperties:
  "^port@[34]$":
    $ref: /schemas/graph.yaml#/$defs/port-base
    additionalProperties: false
    description:
      Camera input port.

    properties:
      reg:
        enum: [3, 4]

      endpoint:
        $ref: video-interfaces.yaml#
        unevaluatedProperties: false

        properties:
          data-lanes:
            minItems: 1
            maxItems: 4

          samsung,csis-hs-settle:
            $ref: /schemas/types.yaml#/definitions/uint32
            description: Differential receiver (HS-RX) settle time.

          samsung,csis-wclk:
            type: boolean
            description:
              CSI-2 wrapper clock selection. If this property is present external clock
              from CMU will be used, or the bus clock if it's not specified.

        required:
          - data-lanes

    required:
      - reg

required:
  - compatible
  - reg
  - bus-width
  - clocks
  - clock-names
  - interrupts
  - vddio-supply
  - vddcore-supply

anyOf:
  - required:
      - port@3
  - required:
      - port@4

allOf:
  - if:
      required:
        - samsung,isp-wb
    then:
      required:
        - samsung,sysreg

additionalProperties: false

examples:
  - |
    #include <dt-bindings/clock/exynos4.h>
    #include <dt-bindings/interrupt-controller/arm-gic.h>

    csis@11890000 {
        compatible = "samsung,exynos4210-csis";
        reg = <0x11890000 0x4000>;
        clocks = <&clock CLK_CSIS1>,
                 <&clock CLK_SCLK_CSIS1>;
        clock-names = "csis", "sclk_csis";
        assigned-clocks = <&clock CLK_MOUT_CSIS1>,
                          <&clock CLK_SCLK_CSIS1>;
        assigned-clock-parents = <&clock CLK_MOUT_MPLL_USER_T>;
        assigned-clock-rates = <0>, <176000000>;

        interrupts = <GIC_SPI 80 IRQ_TYPE_LEVEL_HIGH>;

        bus-width = <2>;
        power-domains = <&pd_cam>;
        phys = <&mipi_phy 2>;
        phy-names = "csis";

        vddcore-supply = <&ldo8_reg>;
        vddio-supply = <&ldo10_reg>;

        #address-cells = <1>;
        #size-cells = <0>;

        /* Camera D (4) MIPI CSI-2 (CSIS1) */
        port@4 {
            reg = <4>;

            endpoint {
                remote-endpoint = <&is_s5k6a3_ep>;
                data-lanes = <1>;
                samsung,csis-hs-settle = <18>;
                samsung,csis-wclk;
            };
        };
    };
```

## Documentation/devicetree/bindings/media/samsung,exynos4210-fimc.yaml
```yaml
# SPDX-License-Identifier: GPL-2.0-only OR BSD-2-Clause
%YAML 1.2
---
$id: http://devicetree.org/schemas/media/samsung,exynos4210-fimc.yaml#
$schema: http://devicetree.org/meta-schemas/core.yaml#

title: Samsung S5P/Exynos SoC Fully Integrated Mobile Camera

maintainers:
  - Krzysztof Kozlowski <krzysztof.kozlowski@linaro.org>
  - Sylwester Nawrocki <s.nawrocki@samsung.com>

description:
  Each FIMC device should have an alias in the aliases node, in the form of
  fimc<n>, where <n> is an integer specifying the IP block instance.

properties:
  compatible:
    enum:
      - samsung,exynos4210-fimc
      - samsung,exynos4212-fimc
      - samsung,s5pv210-fimc

  reg:
    maxItems: 1

  clocks:
    maxItems: 2

  clock-names:
    items:
      - const: fimc
      - const: sclk_fimc

  clock-frequency:
    description:
      Maximum FIMC local clock (LCLK) frequency.

  interrupts:
    maxItems: 1

  iommus:
    maxItems: 1

  power-domains:
    maxItems: 1

  samsung,cam-if:
    type: boolean
    description:
      The FIMC IP block includes the camera input interface.

  samsung,isp-wb:
    type: boolean
    description: |
      The FIMC IP block has the ISP writeback input.

  samsung,lcd-wb:
    type: boolean
    description: |
      The FIMC IP block has the LCD writeback input.

  samsung,mainscaler-ext:
    type: boolean
    description:
      FIMC IP supports extended image size and has CIEXTEN register.

  samsung,min-pix-alignment:
    $ref: /schemas/types.yaml#/definitions/uint32-array
    items:
      - description: Minimum supported image height alignment.
      - description: Horizontal image offset.
    description:
      The values are in pixels and default is <2 1>.

  samsung,min-pix-sizes:
    $ref: /schemas/types.yaml#/definitions/uint32-array
    maxItems: 2
    description: |
      An array specifying minimum image size in pixels at the FIMC input and
      output DMA, in the first and second cell respectively.  Default value
      is <16 16>.

  samsung,pix-limits:
    $ref: /schemas/types.yaml#/definitions/uint32-array
    maxItems: 4
    description: |
      An array of maximum supported image sizes in pixels, for details refer to
      Table 2-1 in the S5PV210 SoC User Manual. The meaning of each cell is as
      follows:
       0 - scaler input horizontal size
       1 - input horizontal size for the scaler bypassed
       2 - REAL_WIDTH without input rotation
       3 - REAL_HEIGHT with input rotation

  samsung,rotators:
    $ref: /schemas/types.yaml#/definitions/uint32
    default: 0x11
    description: |
      A bitmask specifying whether this IP has the input and the output
      rotator. Bits 4 and 0 correspond to input and output rotator
      respectively. If a rotator is present its corresponding bit should be
      set.

  samsung,sysreg:
    $ref: /schemas/types.yaml#/definitions/phandle
    description:
      System Registers (SYSREG) node.

required:
  - compatible
  - reg
  - clocks
  - clock-names
  - samsung,pix-limits

allOf:
  - if:
      required:
        - samsung,isp-wb
    then:
      required:
        - samsung,sysreg

additionalProperties: false

examples:
  - |
    #include <dt-bindings/clock/exynos4.h>
    #include <dt-bindings/interrupt-controller/arm-gic.h>

    fimc@11800000 {
        compatible = "samsung,exynos4212-fimc";
        reg = <0x11800000 0x1000>;
        clocks = <&clock CLK_FIMC0>,
                 <&clock CLK_SCLK_FIMC0>;
        clock-names = "fimc", "sclk_fimc";
        interrupts = <GIC_SPI 84 IRQ_TYPE_LEVEL_HIGH>;
        iommus = <&sysmmu_fimc0>;
        power-domains = <&pd_cam>;
        samsung,sysreg = <&sys_reg>;

        samsung,pix-limits = <4224 8192 1920 4224>;
        samsung,mainscaler-ext;
        samsung,isp-wb;
        samsung,cam-if;

        assigned-clocks = <&clock CLK_MOUT_FIMC0>,
                          <&clock CLK_SCLK_FIMC0>;
        assigned-clock-parents = <&clock CLK_MOUT_MPLL_USER_T>;
        assigned-clock-rates = <0>, <176000000>;
    };
```
