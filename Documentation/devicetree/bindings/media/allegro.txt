## Documentation/devicetree/bindings/media/allegro.txt
```
Device-tree bindings for the Allegro DVT video IP codecs present in the Xilinx
ZynqMP SoC. The IP core may either be a H.264/H.265 encoder or H.264/H.265
decoder ip core.

Each actual codec engines is controlled by a microcontroller (MCU). Host
software uses a provided mailbox interface to communicate with the MCU. The
MCU share an interrupt.

Required properties:
  - compatible: value should be one of the following
    "allegro,al5e-1.1", "allegro,al5e": encoder IP core
    "allegro,al5d-1.1", "allegro,al5d": decoder IP core
  - reg: base and length of the memory mapped register region and base and
    length of the memory mapped sram
  - reg-names: must include "regs" and "sram"
  - interrupts: shared interrupt from the MCUs to the processing system
  - clocks: must contain an entry for each entry in clock-names
  - clock-names: must include "core_clk", "mcu_clk", "m_axi_core_aclk",
    "m_axi_mcu_aclk", "s_axi_lite_aclk"

Example:
	al5e: video-codec@a0009000 {
		compatible = "allegro,al5e-1.1", "allegro,al5e";
		reg = <0 0xa0009000 0 0x1000>,
		      <0 0xa0000000 0 0x8000>;
		reg-names = "regs", "sram";
		interrupts = <0 96 4>;
		clocks = <&xlnx_vcu 0>, <&xlnx_vcu 1>,
			 <&clkc 71>, <&clkc 71>, <&clkc 71>;
		clock-names = "core_clk", "mcu_clk", "m_axi_core_aclk",
			      "m_axi_mcu_aclk", "s_axi_lite_aclk"
	};
	al5d: video-codec@a0029000 {
		compatible = "allegro,al5d-1.1", "allegro,al5d";
		reg = <0 0xa0029000 0 0x1000>,
		      <0 0xa0020000 0 0x8000>;
		reg-names = "regs", "sram";
		interrupts = <0 96 4>;
		clocks = <&xlnx_vcu 2>, <&xlnx_vcu 3>,
			 <&clkc 71>, <&clkc 71>, <&clkc 71>;
		clock-names = "core_clk", "mcu_clk", "m_axi_core_aclk",
			      "m_axi_mcu_aclk", "s_axi_lite_aclk"
	};
```

## Documentation/devicetree/bindings/media/allwinner,sun4i-a10-csi.yaml
```yaml
# SPDX-License-Identifier: (GPL-2.0 OR BSD-2-Clause)
%YAML 1.2
---
$id: http://devicetree.org/schemas/media/allwinner,sun4i-a10-csi.yaml#
$schema: http://devicetree.org/meta-schemas/core.yaml#

title: Allwinner A10 CMOS Sensor Interface (CSI) Device Tree Bindings

maintainers:
  - Chen-Yu Tsai <wens@csie.org>
  - Maxime Ripard <mripard@kernel.org>

description: |-
  The Allwinner A10 and later has a CMOS Sensor Interface to retrieve
  frames from a parallel or BT656 sensor.

properties:
  compatible:
    oneOf:
      - const: allwinner,sun4i-a10-csi1
      - const: allwinner,sun7i-a20-csi0
      - items:
          - const: allwinner,sun7i-a20-csi1
          - const: allwinner,sun4i-a10-csi1
      - items:
          - const: allwinner,sun8i-r40-csi0
          - const: allwinner,sun7i-a20-csi0

  reg:
    maxItems: 1

  interrupts:
    maxItems: 1

  clocks:
    oneOf:
      - items:
          - description: The CSI interface clock
          - description: The CSI DRAM clock

      - items:
          - description: The CSI interface clock
          - description: The CSI ISP clock
          - description: The CSI DRAM clock

  clock-names:
    oneOf:
      - items:
          - const: bus
          - const: ram

      - items:
          - const: bus
          - const: isp
          - const: ram

  resets:
    maxItems: 1

  # FIXME: This should be made required eventually once every SoC will
  # have the MBUS declared.
  interconnects:
    maxItems: 1

  # FIXME: This should be made required eventually once every SoC will
  # have the MBUS declared.
  interconnect-names:
    const: dma-mem

  port:
    $ref: /schemas/graph.yaml#/$defs/port-base
    additionalProperties: false

    properties:
      endpoint:
        $ref: video-interfaces.yaml#
        unevaluatedProperties: false

        properties:
          bus-width:
            enum: [8, 16]

          data-active: true
          hsync-active: true
          pclk-sample: true
          vsync-active: true

        required:
          - bus-width
          - data-active
          - hsync-active
          - pclk-sample
          - vsync-active

required:
  - compatible
  - reg
  - interrupts
  - clocks

additionalProperties: false

examples:
  - |
    #include <dt-bindings/interrupt-controller/arm-gic.h>
    #include <dt-bindings/clock/sun7i-a20-ccu.h>
    #include <dt-bindings/reset/sun4i-a10-ccu.h>

    csi0: csi@1c09000 {
        compatible = "allwinner,sun7i-a20-csi0";
        reg = <0x01c09000 0x1000>;
        interrupts = <GIC_SPI 42 IRQ_TYPE_LEVEL_HIGH>;
        clocks = <&ccu CLK_AHB_CSI0>, <&ccu CLK_CSI_SCLK>, <&ccu CLK_DRAM_CSI0>;
        clock-names = "bus", "isp", "ram";
        resets = <&ccu RST_CSI0>;

        port {
            csi_from_ov5640: endpoint {
                remote-endpoint = <&ov5640_to_csi>;
                bus-width = <8>;
                hsync-active = <1>; /* Active high */
                vsync-active = <0>; /* Active low */
                data-active = <1>;  /* Active high */
                pclk-sample = <1>;  /* Rising */
            };
        };
    };

...
```

## Documentation/devicetree/bindings/media/allwinner,sun4i-a10-ir.yaml
```yaml
# SPDX-License-Identifier: GPL-2.0
%YAML 1.2
---
$id: http://devicetree.org/schemas/media/allwinner,sun4i-a10-ir.yaml#
$schema: http://devicetree.org/meta-schemas/core.yaml#

title: Allwinner A10 Infrared Controller

maintainers:
  - Chen-Yu Tsai <wens@csie.org>
  - Maxime Ripard <mripard@kernel.org>

allOf:
  - $ref: rc.yaml#

properties:
  compatible:
    oneOf:
      - const: allwinner,sun4i-a10-ir
      - const: allwinner,sun5i-a13-ir
      - const: allwinner,sun6i-a31-ir
      - items:
          - enum:
              - allwinner,suniv-f1c100s-ir
              - allwinner,sun8i-a83t-ir
              - allwinner,sun8i-r40-ir
              - allwinner,sun50i-a64-ir
              - allwinner,sun50i-h6-ir
              - allwinner,sun50i-h616-ir
          - const: allwinner,sun6i-a31-ir

  reg:
    maxItems: 1

  interrupts:
    maxItems: 1

  clocks:
    items:
      - description: Bus Clock
      - description: Module Clock

  clock-names:
    items:
      - const: apb
      - const: ir

  resets:
    maxItems: 1

  clock-frequency:
    default: 8000000
    description:
      IR Receiver clock frequency, in Hertz.

required:
  - compatible
  - reg
  - interrupts
  - clocks
  - clock-names

unevaluatedProperties: false

examples:
  - |
      ir0: ir@1c21800 {
          compatible = "allwinner,sun4i-a10-ir";
          clocks = <&apb0_gates 6>, <&ir0_clk>;
          clock-names = "apb", "ir";
          clock-frequency = <3000000>;
          resets = <&apb0_rst 1>;
          interrupts = <0 5 1>;
          reg = <0x01C21800 0x40>;
          linux,rc-map-name = "rc-rc6-mce";
      };

...
```

## Documentation/devicetree/bindings/media/allwinner,sun4i-a10-video-engine.yaml
```yaml
# SPDX-License-Identifier: GPL-2.0-only
%YAML 1.2
---
$id: http://devicetree.org/schemas/media/allwinner,sun4i-a10-video-engine.yaml#
$schema: http://devicetree.org/meta-schemas/core.yaml#

title: Allwinner A10 Video Engine Device Tree Bindings

maintainers:
  - Chen-Yu Tsai <wens@csie.org>
  - Maxime Ripard <mripard@kernel.org>

properties:
  compatible:
    enum:
      - allwinner,sun4i-a10-video-engine
      - allwinner,sun5i-a13-video-engine
      - allwinner,sun7i-a20-video-engine
      - allwinner,sun8i-a33-video-engine
      - allwinner,sun8i-h3-video-engine
      - allwinner,sun8i-v3s-video-engine
      - allwinner,sun8i-r40-video-engine
      - allwinner,sun50i-a64-video-engine
      - allwinner,sun50i-h5-video-engine
      - allwinner,sun50i-h6-video-engine

  reg:
    maxItems: 1

  interrupts:
    maxItems: 1

  clocks:
    items:
      - description: Bus Clock
      - description: Module Clock
      - description: RAM Clock

  clock-names:
    items:
      - const: ahb
      - const: mod
      - const: ram

  resets:
    maxItems: 1

  allwinner,sram:
    $ref: /schemas/types.yaml#/definitions/phandle-array
    description: Phandle to the device SRAM

  iommus:
    maxItems: 1

  memory-region:
    description:
      CMA pool to use for buffers allocation instead of the default
      CMA pool.

required:
  - compatible
  - reg
  - interrupts
  - clocks
  - clock-names
  - resets
  - allwinner,sram

additionalProperties: false

examples:
  - |
    #include <dt-bindings/interrupt-controller/arm-gic.h>
    #include <dt-bindings/clock/sun7i-a20-ccu.h>
    #include <dt-bindings/reset/sun4i-a10-ccu.h>

    video-codec@1c0e000 {
        compatible = "allwinner,sun7i-a20-video-engine";
        reg = <0x01c0e000 0x1000>;
        interrupts = <GIC_SPI 53 IRQ_TYPE_LEVEL_HIGH>;
        clocks = <&ccu CLK_AHB_VE>, <&ccu CLK_VE>,
                 <&ccu CLK_DRAM_VE>;
        clock-names = "ahb", "mod", "ram";
        resets = <&ccu RST_VE>;
        allwinner,sram = <&ve_sram 1>;
    };

...
```

## Documentation/devicetree/bindings/media/allwinner,sun50i-h6-vpu-g2.yaml
```yaml
# SPDX-License-Identifier: (GPL-2.0 OR BSD-2-Clause)

%YAML 1.2
---
$id: http://devicetree.org/schemas/media/allwinner,sun50i-h6-vpu-g2.yaml#
$schema: http://devicetree.org/meta-schemas/core.yaml#

title: Hantro G2 VPU codec implemented on Allwinner H6 SoC

maintainers:
  - Jernej Skrabec <jernej.skrabec@gmail.com>

description:
  Hantro G2 video decode accelerator present on Allwinner H6 SoC.

properties:
  compatible:
    const: allwinner,sun50i-h6-vpu-g2

  reg:
    maxItems: 1

  interrupts:
    maxItems: 1

  clocks:
    items:
      - description: Bus Clock
      - description: Module Clock

  clock-names:
    items:
      - const: bus
      - const: mod

  resets:
    maxItems: 1

  iommus:
    maxItems: 1

required:
  - compatible
  - reg
  - interrupts
  - clocks
  - clock-names
  - resets
  - iommus

additionalProperties: false

examples:
  - |
    #include <dt-bindings/interrupt-controller/arm-gic.h>
    #include <dt-bindings/clock/sun50i-h6-ccu.h>
    #include <dt-bindings/reset/sun50i-h6-ccu.h>

    video-codec-g2@1c00000 {
        compatible = "allwinner,sun50i-h6-vpu-g2";
        reg = <0x01c00000 0x1000>;
        interrupts = <GIC_SPI 90 IRQ_TYPE_LEVEL_HIGH>;
        clocks = <&ccu CLK_BUS_VP9>, <&ccu CLK_VP9>;
        clock-names = "bus", "mod";
        resets = <&ccu RST_BUS_VP9>;
        iommus = <&iommu 5>;
    };

...
```

## Documentation/devicetree/bindings/media/allwinner,sun6i-a31-csi.yaml
```yaml
# SPDX-License-Identifier: GPL-2.0
%YAML 1.2
---
$id: http://devicetree.org/schemas/media/allwinner,sun6i-a31-csi.yaml#
$schema: http://devicetree.org/meta-schemas/core.yaml#

title: Allwinner A31 CMOS Sensor Interface (CSI)

maintainers:
  - Chen-Yu Tsai <wens@csie.org>
  - Maxime Ripard <mripard@kernel.org>

properties:
  compatible:
    enum:
      - allwinner,sun6i-a31-csi
      - allwinner,sun8i-a83t-csi
      - allwinner,sun8i-h3-csi
      - allwinner,sun8i-v3s-csi
      - allwinner,sun50i-a64-csi

  reg:
    maxItems: 1

  interrupts:
    maxItems: 1

  clocks:
    items:
      - description: Bus Clock
      - description: Module Clock
      - description: DRAM Clock

  clock-names:
    items:
      - const: bus
      - const: mod
      - const: ram

  resets:
    maxItems: 1

  port:
    $ref: /schemas/graph.yaml#/$defs/port-base
    description: Parallel input port, connect to a parallel sensor

    properties:
      endpoint:
        $ref: video-interfaces.yaml#
        unevaluatedProperties: false

        properties:
          bus-width:
            enum: [ 8, 10, 12, 16 ]

          pclk-sample: true
          hsync-active: true
          vsync-active: true

        required:
          - bus-width

    unevaluatedProperties: false

  ports:
    $ref: /schemas/graph.yaml#/properties/ports

    properties:
      port@0:
        $ref: "#/properties/port"

      port@1:
        $ref: /schemas/graph.yaml#/properties/port
        description: MIPI CSI-2 bridge input port

      port@2:
        $ref: /schemas/graph.yaml#/properties/port
        description: Internal output port to the ISP

    anyOf:
      - required:
          - port@0
      - required:
          - port@1

required:
  - compatible
  - reg
  - interrupts
  - clocks
  - clock-names
  - resets

oneOf:
  - required:
      - ports
  - required:
      - port

additionalProperties: false

examples:
  - |
    #include <dt-bindings/interrupt-controller/arm-gic.h>
    #include <dt-bindings/clock/sun8i-v3s-ccu.h>
    #include <dt-bindings/reset/sun8i-v3s-ccu.h>

    csi1: csi@1cb4000 {
        compatible = "allwinner,sun8i-v3s-csi";
        reg = <0x01cb4000 0x1000>;
        interrupts = <GIC_SPI 84 IRQ_TYPE_LEVEL_HIGH>;
        clocks = <&ccu CLK_BUS_CSI>,
                 <&ccu CLK_CSI1_SCLK>,
                 <&ccu CLK_DRAM_CSI>;
        clock-names = "bus",
                      "mod",
                      "ram";
        resets = <&ccu RST_BUS_CSI>;

        ports {
            #address-cells = <1>;
            #size-cells = <0>;

            port@0 {
                reg = <0>;
                /* Parallel bus endpoint */
                csi1_ep: endpoint {
                    remote-endpoint = <&adv7611_ep>;
                    bus-width = <16>;

                    /*
                     * If hsync-active/vsync-active are missing,
                     * embedded BT.656 sync is used.
                     */
                    hsync-active = <0>; /* Active low */
                    vsync-active = <0>; /* Active low */
                    pclk-sample = <1>;  /* Rising */
                };
            };
        };
    };

...
```

## Documentation/devicetree/bindings/media/allwinner,sun6i-a31-isp.yaml
```yaml
# SPDX-License-Identifier: (GPL-2.0 OR BSD-2-Clause)
%YAML 1.2
---
$id: http://devicetree.org/schemas/media/allwinner,sun6i-a31-isp.yaml#
$schema: http://devicetree.org/meta-schemas/core.yaml#

title: Allwinner A31 Image Signal Processor Driver (ISP)

maintainers:
  - Paul Kocialkowski <paul.kocialkowski@bootlin.com>

properties:
  compatible:
    enum:
      - allwinner,sun6i-a31-isp
      - allwinner,sun8i-v3s-isp

  reg:
    maxItems: 1

  interrupts:
    maxItems: 1

  clocks:
    items:
      - description: Bus Clock
      - description: Module Clock
      - description: DRAM Clock

  clock-names:
    items:
      - const: bus
      - const: mod
      - const: ram

  resets:
    maxItems: 1

  ports:
    $ref: /schemas/graph.yaml#/properties/ports

    properties:
      port@0:
        $ref: /schemas/graph.yaml#/properties/port
        description: CSI0 input port

      port@1:
        $ref: /schemas/graph.yaml#/properties/port
        description: CSI1 input port

    if:
      properties:
        compatible:
          contains:
            enum:
              - allwinner,sun8i-v3s-isp
    then:
      required:
        - port@0

required:
  - compatible
  - reg
  - interrupts
  - clocks
  - clock-names
  - resets

additionalProperties: false

examples:
  - |
    #include <dt-bindings/interrupt-controller/arm-gic.h>
    #include <dt-bindings/clock/sun8i-v3s-ccu.h>
    #include <dt-bindings/reset/sun8i-v3s-ccu.h>

    isp: isp@1cb8000 {
        compatible = "allwinner,sun8i-v3s-isp";
        reg = <0x01cb8000 0x1000>;
        interrupts = <GIC_SPI 83 IRQ_TYPE_LEVEL_HIGH>;
        clocks = <&ccu CLK_BUS_CSI>,
             <&ccu CLK_CSI1_SCLK>,
             <&ccu CLK_DRAM_CSI>;
        clock-names = "bus", "mod", "ram";
        resets = <&ccu RST_BUS_CSI>;

        ports {
            #address-cells = <1>;
            #size-cells = <0>;

            port@0 {
                reg = <0>;

                isp_in_csi0: endpoint {
                    remote-endpoint = <&csi0_out_isp>;
                };
            };
        };
    };

...
```
