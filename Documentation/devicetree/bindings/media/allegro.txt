## Documentation/devicetree/bindings/media/amphion,vpu.yaml
```yaml
# SPDX-License-Identifier: (GPL-2.0 OR BSD-2-Clause)

%YAML 1.2
---
$id: http://devicetree.org/schemas/media/amphion,vpu.yaml#
$schema: http://devicetree.org/meta-schemas/core.yaml#

title: Amphion VPU codec IP

maintainers:
  - Ming Qian <ming.qian@nxp.com>
  - Shijie Qin <shijie.qin@nxp.com>

description: |-
  The Amphion MXC video encoder(Windsor) and decoder(Malone) accelerators present
  on NXP i.MX8Q SoCs.

properties:
  $nodename:
    pattern: "^vpu@[0-9a-f]+$"

  compatible:
    items:
      - enum:
          - nxp,imx8qm-vpu
          - nxp,imx8qxp-vpu

  reg:
    maxItems: 1

  power-domains:
    maxItems: 1

  "#address-cells":
    const: 1

  "#size-cells":
    const: 1

  ranges: true

patternProperties:
  "^mailbox@[0-9a-f]+$":
    description:
      Each vpu encoder or decoder correspond a MU, which used for communication
      between driver and firmware. Implement via mailbox on driver.
    $ref: ../mailbox/fsl,mu.yaml#


  "^vpu-core@[0-9a-f]+$":
    description:
      Each core correspond a decoder or encoder, need to configure them
      separately. NXP i.MX8QM SoC has one decoder and two encoder, i.MX8QXP SoC
      has one decoder and one encoder.
    type: object

    properties:
      compatible:
        items:
          - enum:
              - nxp,imx8q-vpu-decoder
              - nxp,imx8q-vpu-encoder

      reg:
        maxItems: 1

      power-domains:
        maxItems: 1

      mbox-names:
        items:
          - const: tx0
          - const: tx1
          - const: rx

      mboxes:
        description:
          List of phandle of 2 MU channels for tx, 1 MU channel for rx.
        maxItems: 3

      memory-region:
        description:
          Phandle to the reserved memory nodes to be associated with the
          remoteproc device. The reserved memory nodes should be carveout nodes,
          and should be defined as per the bindings in
          Documentation/devicetree/bindings/reserved-memory/reserved-memory.txt
        items:
          - description: region reserved for firmware image sections.
          - description: region used for RPC shared memory between firmware and
                         driver.

    required:
      - compatible
      - reg
      - power-domains
      - mbox-names
      - mboxes
      - memory-region

    additionalProperties: false

required:
  - compatible
  - reg
  - power-domains

additionalProperties: false

examples:
  # Device node example for i.MX8QM platform:
  - |
    #include <dt-bindings/firmware/imx/rsrc.h>

    vpu: vpu@2c000000 {
      compatible = "nxp,imx8qm-vpu";
      ranges = <0x2c000000 0x2c000000 0x2000000>;
      reg = <0x2c000000 0x1000000>;
      #address-cells = <1>;
      #size-cells = <1>;
      power-domains = <&pd IMX_SC_R_VPU>;

      mu_m0: mailbox@2d000000 {
        compatible = "fsl,imx6sx-mu";
        reg = <0x2d000000 0x20000>;
        interrupts = <0 472 4>;
        #mbox-cells = <2>;
        power-domains = <&pd IMX_SC_R_VPU_MU_0>;
      };

      mu1_m0: mailbox@2d020000 {
        compatible = "fsl,imx6sx-mu";
        reg = <0x2d020000 0x20000>;
        interrupts = <0 473 4>;
        #mbox-cells = <2>;
        power-domains = <&pd IMX_SC_R_VPU_MU_1>;
      };

      mu2_m0: mailbox@2d040000 {
        compatible = "fsl,imx6sx-mu";
        reg = <0x2d040000 0x20000>;
        interrupts = <0 474 4>;
        #mbox-cells = <2>;
        power-domains = <&pd IMX_SC_R_VPU_MU_2>;
      };

      vpu_core0: vpu-core@2d080000 {
        compatible = "nxp,imx8q-vpu-decoder";
        reg = <0x2d080000 0x10000>;
        power-domains = <&pd IMX_SC_R_VPU_DEC_0>;
        mbox-names = "tx0", "tx1", "rx";
        mboxes = <&mu_m0 0 0>,
                 <&mu_m0 0 1>,
                 <&mu_m0 1 0>;
        memory-region = <&decoder_boot>, <&decoder_rpc>;
      };

      vpu_core1: vpu-core@2d090000 {
        compatible = "nxp,imx8q-vpu-encoder";
        reg = <0x2d090000 0x10000>;
        power-domains = <&pd IMX_SC_R_VPU_ENC_0>;
        mbox-names = "tx0", "tx1", "rx";
        mboxes = <&mu1_m0 0 0>,
                 <&mu1_m0 0 1>,
                 <&mu1_m0 1 0>;
        memory-region = <&encoder1_boot>, <&encoder1_rpc>;
      };

      vpu_core2: vpu-core@2d0a0000 {
        reg = <0x2d0a0000 0x10000>;
        compatible = "nxp,imx8q-vpu-encoder";
        power-domains = <&pd IMX_SC_R_VPU_ENC_1>;
        mbox-names = "tx0", "tx1", "rx";
        mboxes = <&mu2_m0 0 0>,
                 <&mu2_m0 0 1>,
                 <&mu2_m0 1 0>;
        memory-region = <&encoder2_boot>, <&encoder2_rpc>;
      };
    };

...
```

## Documentation/devicetree/bindings/media/arm,mali-c55.yaml
```yaml
# SPDX-License-Identifier: (GPL-2.0-only OR BSD-2-Clause)
%YAML 1.2
---
$id: http://devicetree.org/schemas/media/arm,mali-c55.yaml#
$schema: http://devicetree.org/meta-schemas/core.yaml#

title: ARM Mali-C55 Image Signal Processor

maintainers:
  - Daniel Scally <dan.scally@ideasonboard.com>
  - Jacopo Mondi <jacopo.mondi@ideasonboard.com>

properties:
  compatible:
    const: arm,mali-c55

  reg:
    maxItems: 1

  interrupts:
    maxItems: 1

  clocks:
    items:
      - description: ISP Video Clock
      - description: ISP AXI clock
      - description: ISP AHB-lite clock

  clock-names:
    items:
      - const: vclk
      - const: aclk
      - const: hclk

  resets:
    items:
      - description: vclk domain reset
      - description: aclk domain reset
      - description: hclk domain reset

  reset-names:
    items:
      - const: vresetn
      - const: aresetn
      - const: hresetn

  port:
    $ref: /schemas/graph.yaml#/properties/port
    description: Input parallel video bus

    properties:
      endpoint:
        $ref: /schemas/graph.yaml#/properties/endpoint

required:
  - compatible
  - reg
  - interrupts
  - clocks
  - clock-names
  - resets
  - reset-names
  - port

additionalProperties: false

examples:
  - |
    #include <dt-bindings/interrupt-controller/arm-gic.h>

    isp@400000 {
      compatible = "arm,mali-c55";
      reg = <0x400000 0x200000>;
      clocks = <&clk 0>, <&clk 1>, <&clk 2>;
      clock-names = "vclk", "aclk", "hclk";
      resets = <&resets 0>, <&resets 1>, <&resets 2>;
      reset-names = "vresetn", "aresetn", "hresetn";
      interrupts = <GIC_SPI 861 IRQ_TYPE_EDGE_RISING>;

      port {
        isp_in: endpoint {
            remote-endpoint = <&csi2_rx_out>;
        };
      };
    };
...
```

## Documentation/devicetree/bindings/media/aspeed,video-engine.yaml
```yaml
# SPDX-License-Identifier: (GPL-2.0-only OR BSD-2-Clause)
%YAML 1.2
---
$id: http://devicetree.org/schemas/media/aspeed,video-engine.yaml#
$schema: http://devicetree.org/meta-schemas/core.yaml#

title: ASPEED Video Engine

maintainers:
  - Eddie James <eajames@linux.ibm.com>

description:
  The Video Engine (VE) embedded in the ASPEED SOCs can be configured to
  capture and compress video data from digital or analog sources.

properties:
  compatible:
    enum:
      - aspeed,ast2400-video-engine
      - aspeed,ast2500-video-engine
      - aspeed,ast2600-video-engine

  reg:
    maxItems: 1

  clocks:
    maxItems: 2

  clock-names:
    items:
      - const: vclk
      - const: eclk

  resets:
    maxItems: 1

  interrupts:
    maxItems: 1

  memory-region:
    maxItems: 1
    description: |
      Phandle to the reserved memory nodes to be associated with the
      VE. VE will acquires memory space for 3 purposes:
        1. JPEG header
        2. Compressed result
        3. Temporary transformed image data

required:
  - compatible
  - reg
  - clocks
  - clock-names
  - interrupts

additionalProperties: false

examples:
  - |
    #include <dt-bindings/interrupt-controller/arm-gic.h>
    #include <dt-bindings/clock/ast2600-clock.h>

    video@1e700000 {
        compatible = "aspeed,ast2600-video-engine";
        reg = <0x1e700000 0x1000>;
        clocks = <&syscon ASPEED_CLK_GATE_VCLK>,
                 <&syscon ASPEED_CLK_GATE_ECLK>;
        clock-names = "vclk", "eclk";
        interrupts = <GIC_SPI 7 IRQ_TYPE_LEVEL_HIGH>;
    };
```

## Documentation/devicetree/bindings/media/aspeed-video.txt
```
* Device tree bindings for Aspeed Video Engine

The Video Engine (VE) embedded in the Aspeed AST2400/2500/2600 SOCs can
capture and compress video data from digital or analog sources.

Required properties:
 - compatible:		"aspeed,ast2400-video-engine" or
			"aspeed,ast2500-video-engine" or
			"aspeed,ast2600-video-engine"
 - reg:			contains the offset and length of the VE memory region
 - clocks:		clock specifiers for the syscon clocks associated with
			the VE (ordering must match the clock-names property)
 - clock-names:		"vclk" and "eclk"
 - resets:		reset specifier for the syscon reset associated with
			the VE
 - interrupts:		the interrupt associated with the VE on this platform

Optional properties:
 - memory-region:
	phandle to a memory region to allocate from, as defined in
	Documentation/devicetree/bindings/reserved-memory/reserved-memory.txt

Example:

video-engine@1e700000 {
    compatible = "aspeed,ast2500-video-engine";
    reg = <0x1e700000 0x20000>;
    clocks = <&syscon ASPEED_CLK_GATE_VCLK>, <&syscon ASPEED_CLK_GATE_ECLK>;
    clock-names = "vclk", "eclk";
    resets = <&syscon ASPEED_RESET_VIDEO>;
    interrupts = <7>;
    memory-region = <&video_engine_memory>;
};
```

## Documentation/devicetree/bindings/media/atmel,isc.yaml
```yaml
# SPDX-License-Identifier: GPL-2.0-only
# Copyright (C) 2016-2021 Microchip Technology, Inc.
%YAML 1.2
---
$id: http://devicetree.org/schemas/media/atmel,isc.yaml#
$schema: http://devicetree.org/meta-schemas/core.yaml#

title: Atmel Image Sensor Controller (ISC)

maintainers:
  - Eugen Hristev <eugen.hristev@microchip.com>

description: |
  The Image Sensor Controller (ISC) device provides the video input capabilities for the
  Atmel/Microchip AT91 SAMA family of devices.

  The ISC has a single parallel input that supports RAW Bayer, RGB or YUV video,
  with both external synchronization and BT.656 synchronization for the latter.

properties:
  compatible:
    const: atmel,sama5d2-isc

  reg:
    maxItems: 1

  interrupts:
    maxItems: 1

  clocks:
    minItems: 3
    maxItems: 3

  clock-names:
    items:
      - const: hclock
      - const: iscck
      - const: gck

  '#clock-cells':
    const: 0

  clock-output-names:
    const: isc-mck

  port:
    $ref: /schemas/graph.yaml#/$defs/port-base
    unevaluatedProperties: false
    description:
      Input port node, single endpoint describing the input pad.

    properties:
      endpoint:
        $ref: video-interfaces.yaml#

        properties:
          remote-endpoint: true

          bus-width:
            enum: [8, 9, 10, 11, 12]
            default: 12

          hsync-active:
            enum: [0, 1]
            default: 1

          vsync-active:
            enum: [0, 1]
            default: 1

          pclk-sample:
            enum: [0, 1]
            default: 1

        required:
          - remote-endpoint

        additionalProperties: false

    additionalProperties: false

required:
  - compatible
  - reg
  - clocks
  - clock-names
  - '#clock-cells'
  - clock-output-names
  - port

additionalProperties: false

examples:
  - |
    #include <dt-bindings/interrupt-controller/irq.h>

    isc: isc@f0008000 {
        compatible = "atmel,sama5d2-isc";
        reg = <0xf0008000 0x4000>;
        interrupts = <46 IRQ_TYPE_LEVEL_HIGH 5>;
        clocks = <&isc_clk>, <&iscck>, <&isc_gclk>;
        clock-names = "hclock", "iscck", "gck";
        #clock-cells = <0>;
        clock-output-names = "isc-mck";

        port {
                isc_0: endpoint {
                       remote-endpoint = <&ov7740_0>;
                       hsync-active = <1>;
                       vsync-active = <0>;
                       pclk-sample = <1>;
                       bus-width = <8>;
                };
        };
    };
```
