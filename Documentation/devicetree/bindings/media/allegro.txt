## Documentation/devicetree/bindings/media/amlogic,c3-mipi-csi2.yaml
```yaml
# SPDX-License-Identifier: (GPL-2.0-only OR BSD-2-Clause)
%YAML 1.2
---
$id: http://devicetree.org/schemas/media/amlogic,c3-mipi-csi2.yaml#
$schema: http://devicetree.org/meta-schemas/core.yaml#

title: Amlogic C3 MIPI CSI-2 receiver

maintainers:
  - Keke Li <keke.li@amlogic.com>

description:
  MIPI CSI-2 receiver contains CSI-2 RX PHY and host controller.
  It receives the MIPI data from the image sensor and sends MIPI data
  to MIPI adapter.

properties:
  compatible:
    enum:
      - amlogic,c3-mipi-csi2

  reg:
    maxItems: 3

  reg-names:
    items:
      - const: aphy
      - const: dphy
      - const: host

  power-domains:
    maxItems: 1

  clocks:
    maxItems: 2

  clock-names:
    items:
      - const: vapb
      - const: phy0

  ports:
    $ref: /schemas/graph.yaml#/properties/ports

    properties:
      port@0:
        $ref: /schemas/graph.yaml#/$defs/port-base
        unevaluatedProperties: false
        description: input port node, connected to sensor.

        properties:
          endpoint:
            $ref: video-interfaces.yaml#
            unevaluatedProperties: false

            properties:
              data-lanes:
                minItems: 1
                maxItems: 4

            required:
              - data-lanes

      port@1:
        $ref: /schemas/graph.yaml#/properties/port
        description: output port node

    required:
      - port@0
      - port@1

required:
  - compatible
  - reg
  - reg-names
  - power-domains
  - clocks
  - clock-names
  - ports

additionalProperties: false

examples:
  - |
    #include <dt-bindings/clock/amlogic,c3-peripherals-clkc.h>
    #include <dt-bindings/power/amlogic,c3-pwrc.h>

    soc {
        #address-cells = <2>;
        #size-cells = <2>;

        csi: csi@ff018000 {
            compatible = "amlogic,c3-mipi-csi2";
            reg = <0x0 0xff018000 0x0 0x400>,
                  <0x0 0xff019000 0x0 0x300>,
                  <0x0 0xff01a000 0x0 0x100>;
            reg-names = "aphy", "dphy", "host";
            power-domains = <&pwrc PWRC_C3_MIPI_ISP_WRAP_ID>;
            clocks =  <&clkc_periphs CLKID_VAPB>,
                      <&clkc_periphs CLKID_CSI_PHY0>;
            clock-names = "vapb", "phy0";
            assigned-clocks = <&clkc_periphs CLKID_VAPB>,
                              <&clkc_periphs CLKID_CSI_PHY0>;
            assigned-clock-rates = <0>, <200000000>;

            ports {
                #address-cells = <1>;
                #size-cells = <0>;

                port@0 {
                    reg = <0>;
                    c3_mipi_csi_in: endpoint {
                        remote-endpoint = <&imx290_out>;
                        data-lanes = <1 2 3 4>;
                    };
                };

                port@1 {
                    reg = <1>;
                    c3_mipi_csi_out: endpoint {
                        remote-endpoint = <&c3_adap_in>;
                    };
                };
            };
        };
    };
...
```

## Documentation/devicetree/bindings/media/amlogic,gx-vdec.yaml
```yaml
# SPDX-License-Identifier: (GPL-2.0 OR BSD-2-Clause)
# Copyright 2019 BayLibre, SAS
%YAML 1.2
---
$id: http://devicetree.org/schemas/media/amlogic,gx-vdec.yaml#
$schema: http://devicetree.org/meta-schemas/core.yaml#

title: Amlogic Video Decoder

maintainers:
  - Neil Armstrong <neil.armstrong@linaro.org>
  - Maxime Jourdan <mjourdan@baylibre.com>

description: |
  The video decoding IP lies within the DOS memory region,
  except for the hardware bitstream parser that makes use of an undocumented
  region.

  It makes use of the following blocks:
  - ESPARSER is a bitstream parser that outputs to a VIFIFO. Further VDEC blocks
    then feed from this VIFIFO.
  - VDEC_1 can decode MPEG-1, MPEG-2, MPEG-4 part 2, MJPEG, H.263, H.264, VC-1.
  - VDEC_HEVC can decode HEVC and VP9.

  Both VDEC_1 and VDEC_HEVC share the "vdec" IRQ and as such cannot run
  concurrently.

properties:
  compatible:
    oneOf:
      - items:
          - enum:
              - amlogic,gxbb-vdec # GXBB (S905)
              - amlogic,gxl-vdec # GXL (S905X, S905D)
              - amlogic,gxm-vdec # GXM (S912)
          - const: amlogic,gx-vdec
      - enum:
          - amlogic,g12a-vdec # G12A (S905X2, S905D2)
          - amlogic,sm1-vdec # SM1 (S905X3, S905D3)

  interrupts:
    minItems: 2

  interrupt-names:
    items:
      - const: vdec
      - const: esparser

  reg:
    minItems: 2

  reg-names:
    items:
      - const: dos
      - const: esparser

  resets:
    maxItems: 1

  reset-names:
    items:
      - const: esparser

  clocks:
    minItems: 4
    maxItems: 5

  clock-names:
    minItems: 4
    items:
      - const: dos_parser
      - const: dos
      - const: vdec_1
      - const: vdec_hevc
      - const: vdec_hevcf

  amlogic,ao-sysctrl:
    description: should point to the AOBUS sysctrl node
    $ref: /schemas/types.yaml#/definitions/phandle

  amlogic,canvas:
    description: should point to a canvas provider node
    $ref: /schemas/types.yaml#/definitions/phandle

allOf:
  - if:
      properties:
        compatible:
          contains:
            enum:
              - amlogic,gx-vdec

    then:
      properties:
        clock-names:
          maxItems: 4

  - if:
      properties:
        compatible:
          contains:
            enum:
              - amlogic,g12a-vdec
              - amlogic,sm1-vdec

    then:
      properties:
        clock-names:
          minItems: 5

required:
  - compatible
  - reg
  - reg-names
  - interrupts
  - interrupt-names
  - clocks
  - clock-names
  - resets
  - reset-names
  - amlogic,ao-sysctrl
  - amlogic,canvas

additionalProperties: false

examples:
  - |
    vdec: video-decoder@c8820000 {
          compatible = "amlogic,gxl-vdec", "amlogic,gx-vdec";
          reg = <0xc8820000 0x10000>, <0xc110a580 0xe4>;
          reg-names = "dos", "esparser";
          interrupts = <44>, <32>;
          interrupt-names = "vdec", "esparser";
          clocks = <&clk_dos_parser> ,<&clk_dos>, <&clk_vdec_1>, <&clk_vdec_hevc>;
          clock-names = "dos_parser", "dos", "vdec_1", "vdec_hevc";
          resets = <&reset_parser>;
          reset-names = "esparser";
          amlogic,ao-sysctrl = <&sysctrl_AO>;
          amlogic,canvas = <&canvas>;
    };
```

## Documentation/devicetree/bindings/media/amlogic,meson-gx-ao-cec.yaml
```yaml
# SPDX-License-Identifier: (GPL-2.0 OR BSD-2-Clause)
# Copyright 2019 BayLibre, SAS
%YAML 1.2
---
$id: "http://devicetree.org/schemas/media/amlogic,meson-gx-ao-cec.yaml#"
$schema: "http://devicetree.org/meta-schemas/core.yaml#"

title: Amlogic Meson AO-CEC Controller

maintainers:
  - Neil Armstrong <narmstrong@baylibre.com>

description: |
  The Amlogic Meson AO-CEC module is present is Amlogic SoCs and its purpose is
  to handle communication between HDMI connected devices over the CEC bus.

properties:
  compatible:
    enum:
      - amlogic,meson-gx-ao-cec # GXBB, GXL, GXM, G12A and SM1 AO_CEC_A module
      - amlogic,meson-g12a-ao-cec # G12A AO_CEC_B module
      - amlogic,meson-sm1-ao-cec # SM1 AO_CEC_B module

  reg:
    maxItems: 1

  clocks:
    maxItems: 1

  clock-names:
    maxItems: 1

  interrupts:
    maxItems: 1

  hdmi-phandle:
    description: phandle to the HDMI controller
    $ref: /schemas/types.yaml#/definitions/phandle

allOf:
  - if:
      properties:
        compatible:
          contains:
            enum:
              - amlogic,meson-gx-ao-cec

    then:
      properties:
        clocks:
          items:
            - description: AO-CEC clock

        clock-names:
          items:
            - const: core

  - if:
      properties:
        compatible:
          contains:
            enum:
              - amlogic,meson-g12a-ao-cec
              - amlogic,meson-sm1-ao-cec

    then:
      properties:
        clocks:
          items:
            - description: AO-CEC clock generator source

        clock-names:
          items:
            - const: oscin

required:
  - compatible
  - reg
  - interrupts
  - hdmi-phandle
  - clocks
  - clock-names

additionalProperties: false

examples:
  - |
    cec_AO: cec@100 {
        compatible = "amlogic,meson-gx-ao-cec";
        reg = <0x0 0x00100 0x0 0x14>;
        interrupts = <199>;
        clocks = <&clkc_cec>;
        clock-names = "core";
        hdmi-phandle = <&hdmi_tx>;
    };
```

## Documentation/devicetree/bindings/media/amlogic,meson-ir-tx.yaml
```yaml
# SPDX-License-Identifier: (GPL-2.0-only OR BSD-2-Clause)
%YAML 1.2
---
$id: http://devicetree.org/schemas/media/amlogic,meson-ir-tx.yaml#
$schema: http://devicetree.org/meta-schemas/core.yaml#

title: Amlogic Meson IR transmitter

maintainers:
  - Viktor Prutyanov <viktor.prutyanov@phystech.edu>

description: |
  Some Amlogic SoCs such as A311D and T950D4 have IR transmitter
  (also called blaster) controller onboard. It is capable of
  sending IR signals with arbitrary carrier frequency and duty cycle.

properties:
  compatible:
    oneOf:
      - const: amlogic,meson-ir-tx
      - items:
          - const: amlogic,meson-g12a-ir-tx
          - const: amlogic,meson-ir-tx

  reg:
    maxItems: 1

  interrupts:
    maxItems: 1

  clocks:
    maxItems: 2

  clock-names:
    items:
      - const: sysclk
      - const: xtal

required:
  - compatible
  - reg
  - interrupts
  - clocks
  - clock-names

additionalProperties: false

examples:
  - |
    #include <dt-bindings/interrupt-controller/irq.h>
    #include <dt-bindings/clock/g12a-clkc.h>

    ir@ff80014c {
      compatible = "amlogic,meson-g12a-ir-tx", "amlogic,meson-ir-tx";
      reg = <0xff80014c 0x10>;
      interrupts = <0 198 IRQ_TYPE_EDGE_RISING>;
      clocks = <&clkc CLKID_CLK81>, <&xtal>;
      clock-names = "sysclk", "xtal";
    };
```

## Documentation/devicetree/bindings/media/amlogic,meson6-ir.yaml
```yaml
# SPDX-License-Identifier: (GPL-2.0-only OR BSD-2-Clause)
%YAML 1.2
---
$id: http://devicetree.org/schemas/media/amlogic,meson6-ir.yaml#
$schema: http://devicetree.org/meta-schemas/core.yaml#

title: Amlogic Meson IR remote control receiver

maintainers:
  - Neil Armstrong <neil.armstrong@linaro.org>

allOf:
  - $ref: rc.yaml#

properties:
  compatible:
    oneOf:
      - enum:
          - amlogic,meson6-ir
          - amlogic,meson8b-ir
          - amlogic,meson-gxbb-ir
      - items:
          - const: amlogic,meson-gx-ir
          - const: amlogic,meson-gxbb-ir

  reg:
    maxItems: 1

  interrupts:
    maxItems: 1

required:
  - compatible
  - reg
  - interrupts

unevaluatedProperties: false

examples:
  - |
    #include <dt-bindings/interrupt-controller/irq.h>
    #include <dt-bindings/interrupt-controller/arm-gic.h>
    ir-receiver@c8100480 {
        compatible = "amlogic,meson6-ir";
        reg = <0xc8100480 0x20>;
        interrupts = <GIC_SPI 15 IRQ_TYPE_EDGE_RISING>;
    };
```

## Documentation/devicetree/bindings/media/amlogic,vdec.txt
```
Amlogic Video Decoder
================================

The video decoding IP lies within the DOS memory region,
except for the hardware bitstream parser that makes use of an undocumented
region.

It makes use of the following blocks:

- ESPARSER is a bitstream parser that outputs to a VIFIFO. Further VDEC blocks
then feed from this VIFIFO.
- VDEC_1 can decode MPEG-1, MPEG-2, MPEG-4 part 2, MJPEG, H.263, H.264, VC-1.
- VDEC_HEVC can decode HEVC and VP9.

Both VDEC_1 and VDEC_HEVC share the "vdec" IRQ and as such cannot run
concurrently.

Device Tree Bindings:
---------------------

VDEC: Video Decoder
--------------------------

Required properties:
- compatible: value should be different for each SoC family as :
	- GXBB (S905) : "amlogic,gxbb-vdec"
	- GXL (S905X, S905D) : "amlogic,gxl-vdec"
	- GXM (S912) : "amlogic,gxm-vdec"
	followed by the common "amlogic,gx-vdec"
- reg: base address and size of he following memory-mapped regions :
	- dos
	- esparser
- reg-names: should contain the names of the previous memory regions
- interrupts: should contain the following IRQs:
	- vdec
	- esparser
- interrupt-names: should contain the names of the previous interrupts
- amlogic,ao-sysctrl: should point to the AOBUS sysctrl node
- amlogic,canvas: should point to a canvas provider node
- clocks: should contain the following clocks :
	- dos_parser
	- dos
	- vdec_1
	- vdec_hevc
- clock-names: should contain the names of the previous clocks
- resets: should contain the parser reset
- reset-names: should be "esparser"

Example:

vdec: video-codec@c8820000 {
	compatible = "amlogic,gxbb-vdec", "amlogic,gx-vdec";
	reg = <0x0 0xc8820000 0x0 0x10000>,
	      <0x0 0xc110a580 0x0 0xe4>;
	reg-names = "dos", "esparser";

	interrupts = <GIC_SPI 44 IRQ_TYPE_EDGE_RISING>,
		     <GIC_SPI 32 IRQ_TYPE_EDGE_RISING>;
	interrupt-names = "vdec", "esparser";

	amlogic,ao-sysctrl = <&sysctrl_AO>;
	amlogic,canvas = <&canvas>;

	clocks = <&clkc CLKID_DOS_PARSER>,
		 <&clkc CLKID_DOS>,
		 <&clkc CLKID_VDEC_1>,
		 <&clkc CLKID_VDEC_HEVC>;
	clock-names = "dos_parser", "dos", "vdec_1", "vdec_hevc";

	resets = <&reset RESET_PARSER>;
	reset-names = "esparser";
};
```
