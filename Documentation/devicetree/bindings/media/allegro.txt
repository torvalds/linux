## Documentation/devicetree/bindings/media/allwinner,sun6i-a31-mipi-csi2.yaml
```yaml
# SPDX-License-Identifier: (GPL-2.0 OR BSD-2-Clause)
%YAML 1.2
---
$id: http://devicetree.org/schemas/media/allwinner,sun6i-a31-mipi-csi2.yaml#
$schema: http://devicetree.org/meta-schemas/core.yaml#

title: Allwinner A31 MIPI CSI-2

maintainers:
  - Paul Kocialkowski <paul.kocialkowski@bootlin.com>

properties:
  compatible:
    oneOf:
      - const: allwinner,sun6i-a31-mipi-csi2
      - items:
          - const: allwinner,sun8i-v3s-mipi-csi2
          - const: allwinner,sun6i-a31-mipi-csi2

  reg:
    maxItems: 1

  interrupts:
    maxItems: 1

  clocks:
    items:
      - description: Bus Clock
      - description: Module Clock

  clock-names:
    items:
      - const: bus
      - const: mod

  phys:
    maxItems: 1
    description: MIPI D-PHY

  phy-names:
    items:
      - const: dphy

  resets:
    maxItems: 1

  ports:
    $ref: /schemas/graph.yaml#/properties/ports

    properties:
      port@0:
        $ref: /schemas/graph.yaml#/$defs/port-base
        description: Input port, connect to a MIPI CSI-2 sensor

        properties:
          reg:
            const: 0

          endpoint:
            $ref: video-interfaces.yaml#
            unevaluatedProperties: false

            properties:
              data-lanes:
                minItems: 1
                maxItems: 4

            required:
              - data-lanes

        unevaluatedProperties: false

      port@1:
        $ref: /schemas/graph.yaml#/properties/port
        description: Output port, connect to a CSI controller

    required:
      - port@0
      - port@1

required:
  - compatible
  - reg
  - interrupts
  - clocks
  - clock-names
  - phys
  - phy-names
  - resets
  - ports

additionalProperties: false

examples:
  - |
    #include <dt-bindings/interrupt-controller/arm-gic.h>
    #include <dt-bindings/clock/sun8i-v3s-ccu.h>
    #include <dt-bindings/reset/sun8i-v3s-ccu.h>

    mipi_csi2: csi@1cb1000 {
        compatible = "allwinner,sun8i-v3s-mipi-csi2",
                     "allwinner,sun6i-a31-mipi-csi2";
        reg = <0x01cb1000 0x1000>;
        interrupts = <GIC_SPI 90 IRQ_TYPE_LEVEL_HIGH>;
        clocks = <&ccu CLK_BUS_CSI>,
                 <&ccu CLK_CSI1_SCLK>;
        clock-names = "bus", "mod";
        resets = <&ccu RST_BUS_CSI>;

        phys = <&dphy>;
        phy-names = "dphy";

        ports {
            #address-cells = <1>;
            #size-cells = <0>;

            mipi_csi2_in: port@0 {
                reg = <0>;

                mipi_csi2_in_ov5648: endpoint {
                    data-lanes = <1 2 3 4>;

                    remote-endpoint = <&ov5648_out_mipi_csi2>;
                };
            };

            mipi_csi2_out: port@1 {
                reg = <1>;

                mipi_csi2_out_csi0: endpoint {
                    remote-endpoint = <&csi0_in_mipi_csi2>;
                };
            };
        };
    };

...
```

## Documentation/devicetree/bindings/media/allwinner,sun8i-a83t-de2-rotate.yaml
```yaml
# SPDX-License-Identifier: (GPL-2.0 OR BSD-2-Clause)
%YAML 1.2
---
$id: http://devicetree.org/schemas/media/allwinner,sun8i-a83t-de2-rotate.yaml#
$schema: http://devicetree.org/meta-schemas/core.yaml#

title: Allwinner A83T DE2 Rotate

maintainers:
  - Jernej Skrabec <jernej.skrabec@siol.net>
  - Chen-Yu Tsai <wens@csie.org>
  - Maxime Ripard <mripard@kernel.org>

description: |-
  The Allwinner A83T and A64 have a rotation core used for
  rotating and flipping images.

properties:
  compatible:
    oneOf:
      - const: allwinner,sun8i-a83t-de2-rotate
      - items:
          - const: allwinner,sun50i-a64-de2-rotate
          - const: allwinner,sun8i-a83t-de2-rotate

  reg:
    maxItems: 1

  interrupts:
    maxItems: 1

  clocks:
    items:
      - description: Rotate interface clock
      - description: Rotate module clock

  clock-names:
    items:
      - const: bus
      - const: mod

  resets:
    maxItems: 1

required:
  - compatible
  - reg
  - interrupts
  - clocks

additionalProperties: false

examples:
  - |
    #include <dt-bindings/interrupt-controller/arm-gic.h>
    #include <dt-bindings/clock/sun8i-de2.h>
    #include <dt-bindings/reset/sun8i-de2.h>

    rotate: rotate@1020000 {
        compatible = "allwinner,sun8i-a83t-de2-rotate";
        reg = <0x1020000 0x10000>;
        interrupts = <GIC_SPI 92 IRQ_TYPE_LEVEL_HIGH>;
        clocks = <&display_clocks CLK_BUS_ROT>,
                 <&display_clocks CLK_ROT>;
        clock-names = "bus",
                      "mod";
        resets = <&display_clocks RST_ROT>;
    };

...
```

## Documentation/devicetree/bindings/media/allwinner,sun8i-a83t-mipi-csi2.yaml
```yaml
# SPDX-License-Identifier: (GPL-2.0 OR BSD-2-Clause)
%YAML 1.2
---
$id: http://devicetree.org/schemas/media/allwinner,sun8i-a83t-mipi-csi2.yaml#
$schema: http://devicetree.org/meta-schemas/core.yaml#

title: Allwinner A83T MIPI CSI-2 Device Tree Bindings

maintainers:
  - Paul Kocialkowski <paul.kocialkowski@bootlin.com>

properties:
  compatible:
    const: allwinner,sun8i-a83t-mipi-csi2

  reg:
    maxItems: 1

  interrupts:
    maxItems: 1

  clocks:
    items:
      - description: Bus Clock
      - description: Module Clock
      - description: MIPI-specific Clock
      - description: Misc CSI Clock

  clock-names:
    items:
      - const: bus
      - const: mod
      - const: mipi
      - const: misc

  resets:
    maxItems: 1

  ports:
    $ref: /schemas/graph.yaml#/properties/ports

    properties:
      port@0:
        $ref: /schemas/graph.yaml#/$defs/port-base
        description: Input port, connect to a MIPI CSI-2 sensor

        properties:
          reg:
            const: 0

          endpoint:
            $ref: video-interfaces.yaml#
            unevaluatedProperties: false

            properties:
              data-lanes:
                minItems: 1
                maxItems: 4

            required:
              - data-lanes

        unevaluatedProperties: false

      port@1:
        $ref: /schemas/graph.yaml#/properties/port
        description: Output port, connect to a CSI controller

    required:
      - port@0
      - port@1

required:
  - compatible
  - reg
  - interrupts
  - clocks
  - clock-names
  - resets
  - ports

additionalProperties: false

examples:
  - |
    #include <dt-bindings/interrupt-controller/arm-gic.h>
    #include <dt-bindings/clock/sun8i-a83t-ccu.h>
    #include <dt-bindings/reset/sun8i-a83t-ccu.h>

    mipi_csi2: csi@1cb1000 {
        compatible = "allwinner,sun8i-a83t-mipi-csi2";
        reg = <0x01cb1000 0x1000>;
        interrupts = <GIC_SPI 83 IRQ_TYPE_LEVEL_HIGH>;
        clocks = <&ccu CLK_BUS_CSI>,
                 <&ccu CLK_CSI_SCLK>,
                 <&ccu CLK_MIPI_CSI>,
                 <&ccu CLK_CSI_MISC>;
        clock-names = "bus", "mod", "mipi", "misc";
        resets = <&ccu RST_BUS_CSI>;

        ports {
            #address-cells = <1>;
            #size-cells = <0>;

            mipi_csi2_in: port@0 {
                reg = <0>;

                mipi_csi2_in_ov8865: endpoint {
                    data-lanes = <1 2 3 4>;

                    remote-endpoint = <&ov8865_out_mipi_csi2>;
                };
            };

            mipi_csi2_out: port@1 {
                reg = <1>;

                mipi_csi2_out_csi: endpoint {
                    remote-endpoint = <&csi_in_mipi_csi2>;
                };
            };
        };
    };

...
```

## Documentation/devicetree/bindings/media/allwinner,sun8i-h3-deinterlace.yaml
```yaml
# SPDX-License-Identifier: (GPL-2.0 OR BSD-2-Clause)
%YAML 1.2
---
$id: http://devicetree.org/schemas/media/allwinner,sun8i-h3-deinterlace.yaml#
$schema: http://devicetree.org/meta-schemas/core.yaml#

title: Allwinner H3 Deinterlace Device Tree Bindings

maintainers:
  - Jernej Skrabec <jernej.skrabec@siol.net>
  - Chen-Yu Tsai <wens@csie.org>
  - Maxime Ripard <mripard@kernel.org>

description: |-
  The Allwinner H3 and later has a deinterlace core used for
  deinterlacing interlaced video content.

properties:
  compatible:
    oneOf:
      - const: allwinner,sun8i-h3-deinterlace
      - items:
          - const: allwinner,sun50i-a64-deinterlace
          - const: allwinner,sun8i-h3-deinterlace

  reg:
    maxItems: 1

  interrupts:
    maxItems: 1

  clocks:
    items:
      - description: Deinterlace interface clock
      - description: Deinterlace module clock
      - description: Deinterlace DRAM clock

  clock-names:
    items:
      - const: bus
      - const: mod
      - const: ram

  resets:
    maxItems: 1

  interconnects:
    maxItems: 1

  interconnect-names:
    const: dma-mem

required:
  - compatible
  - reg
  - interrupts
  - clocks

additionalProperties: false

examples:
  - |
    #include <dt-bindings/interrupt-controller/arm-gic.h>
    #include <dt-bindings/clock/sun8i-h3-ccu.h>
    #include <dt-bindings/reset/sun8i-h3-ccu.h>

    deinterlace: deinterlace@1400000 {
        compatible = "allwinner,sun8i-h3-deinterlace";
        reg = <0x01400000 0x20000>;
        clocks = <&ccu CLK_BUS_DEINTERLACE>,
                 <&ccu CLK_DEINTERLACE>,
                 <&ccu CLK_DRAM_DEINTERLACE>;
        clock-names = "bus", "mod", "ram";
        resets = <&ccu RST_BUS_DEINTERLACE>;
        interrupts = <GIC_SPI 93 IRQ_TYPE_LEVEL_HIGH>;
        interconnects = <&mbus 9>;
        interconnect-names = "dma-mem";
    };

...
```

## Documentation/devicetree/bindings/media/amlogic,axg-ge2d.yaml
```yaml
# SPDX-License-Identifier: (GPL-2.0 OR BSD-2-Clause)
# Copyright 2020 BayLibre, SAS
%YAML 1.2
---
$id: "http://devicetree.org/schemas/media/amlogic,axg-ge2d.yaml#"
$schema: "http://devicetree.org/meta-schemas/core.yaml#"

title: Amlogic GE2D Acceleration Unit

maintainers:
  - Neil Armstrong <neil.armstrong@linaro.org>

properties:
  compatible:
    enum:
      - amlogic,axg-ge2d

  interrupts:
    minItems: 1

  reg:
    minItems: 1

  resets:
    maxItems: 1

  clocks:
    minItems: 1

required:
  - compatible
  - reg
  - interrupts
  - clocks
  - resets

additionalProperties: false

examples:
  - |
    ge2d: ge2d@ff940000 {
          compatible = "amlogic,axg-ge2d";
          reg = <0xff940000 0x10000>;
          interrupts = <150>;
          clocks = <&clk_ge2d>;
          resets = <&reset_ge2d>;
    };
```

## Documentation/devicetree/bindings/media/amlogic,c3-isp.yaml
```yaml
# SPDX-License-Identifier: (GPL-2.0-only OR BSD-2-Clause)
%YAML 1.2
---
$id: http://devicetree.org/schemas/media/amlogic,c3-isp.yaml#
$schema: http://devicetree.org/meta-schemas/core.yaml#

title: Amlogic C3 Image Signal Processing Unit

maintainers:
  - Keke Li <keke.li@amlogic.com>

description:
  Amlogic ISP is the RAW image processing module
  and supports three channels image output.

properties:
  compatible:
    enum:
      - amlogic,c3-isp

  reg:
    maxItems: 1

  reg-names:
    items:
      - const: isp

  power-domains:
    maxItems: 1

  clocks:
    maxItems: 2

  clock-names:
    items:
      - const: vapb
      - const: isp0

  interrupts:
    maxItems: 1

  port:
    $ref: /schemas/graph.yaml#/properties/port
    description: input port node.

required:
  - compatible
  - reg
  - reg-names
  - power-domains
  - clocks
  - clock-names
  - interrupts
  - port

additionalProperties: false

examples:
  - |
    #include <dt-bindings/interrupt-controller/arm-gic.h>
    #include <dt-bindings/clock/amlogic,c3-peripherals-clkc.h>
    #include <dt-bindings/power/amlogic,c3-pwrc.h>

    soc {
        #address-cells = <2>;
        #size-cells = <2>;

        isp: isp@ff000000 {
            compatible = "amlogic,c3-isp";
            reg = <0x0 0xff000000 0x0 0xf000>;
            reg-names = "isp";
            power-domains = <&pwrc PWRC_C3_ISP_TOP_ID>;
            clocks = <&clkc_periphs CLKID_VAPB>,
                     <&clkc_periphs CLKID_ISP0>;
            clock-names = "vapb", "isp0";
            assigned-clocks = <&clkc_periphs CLKID_VAPB>,
                              <&clkc_periphs CLKID_ISP0>;
            assigned-clock-rates = <0>, <400000000>;
            interrupts = <GIC_SPI 145 IRQ_TYPE_EDGE_RISING>;

            port {
                c3_isp_in: endpoint {
                    remote-endpoint = <&c3_adap_out>;
                };
            };
        };
    };
...
```

## Documentation/devicetree/bindings/media/amlogic,c3-mipi-adapter.yaml
```yaml
# SPDX-License-Identifier: (GPL-2.0-only OR BSD-2-Clause)
%YAML 1.2
---
$id: http://devicetree.org/schemas/media/amlogic,c3-mipi-adapter.yaml#
$schema: http://devicetree.org/meta-schemas/core.yaml#

title: Amlogic C3 MIPI adapter receiver

maintainers:
  - Keke Li <keke.li@amlogic.com>

description:
  MIPI adapter is used to convert the MIPI CSI-2 data
  into an ISP supported data format.

properties:
  compatible:
    enum:
      - amlogic,c3-mipi-adapter

  reg:
    maxItems: 3

  reg-names:
    items:
      - const: top
      - const: fd
      - const: rd

  power-domains:
    maxItems: 1

  clocks:
    maxItems: 2

  clock-names:
    items:
      - const: vapb
      - const: isp0

  ports:
    $ref: /schemas/graph.yaml#/properties/ports

    properties:
      port@0:
        $ref: /schemas/graph.yaml#/properties/port
        description: input port node.

      port@1:
        $ref: /schemas/graph.yaml#/properties/port
        description: output port node.

    required:
      - port@0
      - port@1

required:
  - compatible
  - reg
  - reg-names
  - power-domains
  - clocks
  - clock-names
  - ports

additionalProperties: false

examples:
  - |
    #include <dt-bindings/clock/amlogic,c3-peripherals-clkc.h>
    #include <dt-bindings/power/amlogic,c3-pwrc.h>

    soc {
        #address-cells = <2>;
        #size-cells = <2>;

        adap: adap@ff010000 {
            compatible = "amlogic,c3-mipi-adapter";
            reg = <0x0 0xff010000 0x0 0x100>,
                  <0x0 0xff01b000 0x0 0x100>,
                  <0x0 0xff01d000 0x0 0x200>;
            reg-names = "top", "fd", "rd";
            power-domains = <&pwrc PWRC_C3_ISP_TOP_ID>;
            clocks = <&clkc_periphs CLKID_VAPB>,
                     <&clkc_periphs CLKID_ISP0>;
            clock-names = "vapb", "isp0";
            assigned-clocks = <&clkc_periphs CLKID_VAPB>,
                              <&clkc_periphs CLKID_ISP0>;
            assigned-clock-rates = <0>, <400000000>;

            ports {
                #address-cells = <1>;
                #size-cells = <0>;

                port@0 {
                    reg = <0>;
                    c3_adap_in: endpoint {
                        remote-endpoint = <&c3_mipi_csi_out>;
                    };
                };

                port@1 {
                    reg = <1>;
                    c3_adap_out: endpoint {
                        remote-endpoint = <&c3_isp_in>;
                    };
                };
            };
        };
    };
...
```
