## Documentation/devicetree/bindings/media/nvidia,tegra-vde.txt
```
NVIDIA Tegra Video Decoder Engine

Required properties:
- compatible : Must contain one of the following values:
   - "nvidia,tegra20-vde"
   - "nvidia,tegra30-vde"
   - "nvidia,tegra114-vde"
   - "nvidia,tegra124-vde"
   - "nvidia,tegra132-vde"
- reg : Must contain an entry for each entry in reg-names.
- reg-names : Must include the following entries:
  - sxe
  - bsev
  - mbe
  - ppe
  - mce
  - tfe
  - ppb
  - vdma
  - frameid
- iram : Must contain phandle to the mmio-sram device node that represents
         IRAM region used by VDE.
- interrupts : Must contain an entry for each entry in interrupt-names.
- interrupt-names : Must include the following entries:
  - sync-token
  - bsev
  - sxe
- clocks : Must include the following entries:
  - vde
- resets : Must contain an entry for each entry in reset-names.
- reset-names : Should include the following entries:
  - vde

Optional properties:
- resets : Must contain an entry for each entry in reset-names.
- reset-names : Must include the following entries:
  - mc

Example:

video-codec@6001a000 {
	compatible = "nvidia,tegra20-vde";
	reg = <0x6001a000 0x1000 /* Syntax Engine */
	       0x6001b000 0x1000 /* Video Bitstream Engine */
	       0x6001c000  0x100 /* Macroblock Engine */
	       0x6001c200  0x100 /* Post-processing Engine */
	       0x6001c400  0x100 /* Motion Compensation Engine */
	       0x6001c600  0x100 /* Transform Engine */
	       0x6001c800  0x100 /* Pixel prediction block */
	       0x6001ca00  0x100 /* Video DMA */
	       0x6001d800  0x300 /* Video frame controls */>;
	reg-names = "sxe", "bsev", "mbe", "ppe", "mce",
		    "tfe", "ppb", "vdma", "frameid";
	iram = <&vde_pool>; /* IRAM region */
	interrupts = <GIC_SPI  9 IRQ_TYPE_LEVEL_HIGH>, /* Sync token interrupt */
		     <GIC_SPI 10 IRQ_TYPE_LEVEL_HIGH>, /* BSE-V interrupt */
		     <GIC_SPI 12 IRQ_TYPE_LEVEL_HIGH>; /* SXE interrupt */
	interrupt-names = "sync-token", "bsev", "sxe";
	clocks = <&tegra_car TEGRA20_CLK_VDE>;
	reset-names = "vde", "mc";
	resets = <&tegra_car 61>, <&mc TEGRA20_MC_RESET_VDE>;
};
```

## Documentation/devicetree/bindings/media/nvidia,tegra-vde.yaml
```yaml
# SPDX-License-Identifier: (GPL-2.0-only OR BSD-2-Clause)
%YAML 1.2
---
$id: http://devicetree.org/schemas/media/nvidia,tegra-vde.yaml#
$schema: http://devicetree.org/meta-schemas/core.yaml#

title: NVIDIA Tegra Video Decoder Engine

maintainers:
  - Dmitry Osipenko <digetx@gmail.com>
  - Jon Hunter <jonathanh@nvidia.com>
  - Thierry Reding <thierry.reding@gmail.com>

properties:
  compatible:
    oneOf:
      - items:
          - enum:
              - nvidia,tegra132-vde
              - nvidia,tegra124-vde
              - nvidia,tegra114-vde
      - items:
          - const: nvidia,tegra30-vde
          - const: nvidia,tegra20-vde
      - items:
          - const: nvidia,tegra20-vde

  reg:
    maxItems: 9

  reg-names:
    items:
      - const: sxe
      - const: bsev
      - const: mbe
      - const: ppe
      - const: mce
      - const: tfe
      - const: ppb
      - const: vdma
      - const: frameid

  clocks:
    maxItems: 1

  resets:
    maxItems: 2

  reset-names:
    items:
      - const: vde
      - const: mc

  interrupts:
    maxItems: 3

  interrupt-names:
    items:
      - const: sync-token
      - const: bsev
      - const: sxe

  iommus:
    maxItems: 1

  iram:
    $ref: /schemas/types.yaml#/definitions/phandle
    description:
      Phandle of the SRAM MMIO node.

  operating-points-v2:
    description:
      Should contain freqs and voltages and opp-supported-hw property,
      which is a bitfield indicating SoC speedo or process ID mask.

  power-domains:
    maxItems: 1
    description:
      Phandle to the SoC core power domain.

required:
  - compatible
  - reg
  - reg-names
  - clocks
  - resets
  - reset-names
  - interrupts
  - interrupt-names

additionalProperties: false

examples:
  - |
    video-codec@6001a000 {
      compatible = "nvidia,tegra20-vde";
      reg = <0x6001a000 0x1000>, /* Syntax Engine */
            <0x6001b000 0x1000>, /* Video Bitstream Engine */
            <0x6001c000  0x100>, /* Macroblock Engine */
            <0x6001c200  0x100>, /* Post-processing Engine */
            <0x6001c400  0x100>, /* Motion Compensation Engine */
            <0x6001c600  0x100>, /* Transform Engine */
            <0x6001c800  0x100>, /* Pixel prediction block */
            <0x6001ca00  0x100>, /* Video DMA */
            <0x6001d800  0x300>; /* Video frame controls */
      reg-names = "sxe", "bsev", "mbe", "ppe", "mce",
                  "tfe", "ppb", "vdma", "frameid";
      iram = <&iram>; /* IRAM MMIO region */
      interrupts = <0  9 4>, /* Sync token */
                   <0 10 4>, /* BSE-V */
                   <0 12 4>; /* SXE */
      interrupt-names = "sync-token", "bsev", "sxe";
      clocks = <&clk 61>;
      reset-names = "vde", "mc";
      resets = <&rst 61>, <&mem 13>;
      iommus = <&mem 15>;
      operating-points-v2 = <&dvfs_opp_table>;
      power-domains = <&domain>;
    };
```

## Documentation/devicetree/bindings/media/nxp,dw100.yaml
```yaml
# SPDX-License-Identifier: (GPL-2.0-only OR BSD-2-Clause)
%YAML 1.2
---
$id: http://devicetree.org/schemas/media/nxp,dw100.yaml#
$schema: http://devicetree.org/meta-schemas/core.yaml#

title: NXP i.MX8MP DW100 Dewarper core

maintainers:
  - Xavier Roumegue <xavier.roumegue@oss.nxp.com>

description: |-
  The Dewarp Engine provides high-performance dewarp processing for the
  correction of the distortion that is introduced in images produced by fisheye
  and wide angle lenses. It is implemented with a line/tile-cache based
  architecture. With configurable address mapping look up tables and per tile
  processing, it successfully generates a corrected output image.
  The engine can be used to perform scaling, cropping and pixel format
  conversion.

properties:
  compatible:
    enum:
      - nxp,imx8mp-dw100

  reg:
    maxItems: 1

  interrupts:
    maxItems: 1

  clocks:
    items:
      - description: The AXI clock
      - description: The AHB clock

  clock-names:
    items:
      - const: axi
      - const: ahb

  power-domains:
    maxItems: 1

required:
  - compatible
  - reg
  - interrupts
  - clocks
  - clock-names
  - power-domains

additionalProperties: false

examples:
  - |
    #include <dt-bindings/clock/imx8mp-clock.h>
    #include <dt-bindings/interrupt-controller/arm-gic.h>
    #include <dt-bindings/power/imx8mp-power.h>

    dewarp: dwe@32e30000 {
            compatible = "nxp,imx8mp-dw100";
            reg = <0x32e30000 0x10000>;
            interrupts = <GIC_SPI 100 IRQ_TYPE_LEVEL_HIGH>;
            clocks = <&clk IMX8MP_CLK_MEDIA_AXI_ROOT>,
                     <&clk IMX8MP_CLK_MEDIA_APB_ROOT>;
            clock-names = "axi", "ahb";
            power-domains = <&media_blk_ctrl IMX8MP_MEDIABLK_PD_DWE>;
    };
```

## Documentation/devicetree/bindings/media/nxp,imx7-csi.yaml
```yaml
# SPDX-License-Identifier: (GPL-2.0-only OR BSD-2-Clause)
%YAML 1.2
---
$id: http://devicetree.org/schemas/media/nxp,imx7-csi.yaml#
$schema: http://devicetree.org/meta-schemas/core.yaml#

title: i.MX7 and i.MX8 CSI bridge (CMOS Sensor Interface)

maintainers:
  - Rui Miguel Silva <rmfrfs@gmail.com>

description: |
  This is device node for the CMOS Sensor Interface (CSI) which enables the
  chip to connect directly to external CMOS image sensors.

properties:
  compatible:
    oneOf:
      - enum:
          - fsl,imx8mq-csi
          - fsl,imx7-csi
          - fsl,imx6ul-csi
      - items:
          - const: fsl,imx8mm-csi
          - const: fsl,imx7-csi

  reg:
    maxItems: 1

  interrupts:
    maxItems: 1

  clocks:
    maxItems: 1

  clock-names:
    items:
      - const: mclk

  power-domains:
    maxItems: 1

  port:
    $ref: /schemas/graph.yaml#/properties/port

required:
  - compatible
  - reg
  - interrupts
  - clocks
  - clock-names
  - port

additionalProperties: false

allOf:
  - if:
      properties:
        compatible:
          contains:
            enum:
              - fsl,imx8mq-csi
              - fsl,imx8mm-csi
    then:
      required:
        - power-domains

examples:
  - |
    #include <dt-bindings/clock/imx7d-clock.h>
    #include <dt-bindings/interrupt-controller/arm-gic.h>
    #include <dt-bindings/interrupt-controller/irq.h>

    csi: csi@30710000 {
            compatible = "fsl,imx7-csi";
            reg = <0x30710000 0x10000>;
            interrupts = <GIC_SPI 7 IRQ_TYPE_LEVEL_HIGH>;
            clocks = <&clks IMX7D_CSI_MCLK_ROOT_CLK>;
            clock-names = "mclk";

            port {
                    csi_from_csi_mux: endpoint {
                            remote-endpoint = <&csi_mux_to_csi>;
                    };
            };
    };

...
```

## Documentation/devicetree/bindings/media/nxp,imx7-mipi-csi2.yaml
```yaml
# SPDX-License-Identifier: (GPL-2.0-only OR BSD-2-Clause)
%YAML 1.2
---
$id: http://devicetree.org/schemas/media/nxp,imx7-mipi-csi2.yaml#
$schema: http://devicetree.org/meta-schemas/core.yaml#

title: NXP i.MX7 and i.MX8 MIPI CSI-2 receiver

maintainers:
  - Rui Miguel Silva <rmfrfs@gmail.com>
  - Laurent Pinchart <laurent.pinchart@ideasonboard.com>

description: |-
  The NXP i.MX7 and i.MX8 families contain SoCs that include a MIPI CSI-2
  receiver IP core named CSIS. The IP core originates from Samsung, and may be
  compatible with some of the Exynos4 and S5P SoCs. i.MX7 SoCs use CSIS version
  3.3, and i.MX8 SoCs use CSIS version 3.6.3.

  While the CSI-2 receiver is separate from the MIPI D-PHY IP core, the PHY is
  completely wrapped by the CSIS and doesn't expose a control interface of its
  own. This binding thus covers both IP cores.

properties:
  compatible:
    enum:
      - fsl,imx7-mipi-csi2
      - fsl,imx8mm-mipi-csi2

  reg:
    maxItems: 1

  interrupts:
    maxItems: 1

  clocks:
    minItems: 3
    items:
      - description: The peripheral clock (a.k.a. APB clock)
      - description: The external clock (optionally used as the pixel clock)
      - description: The MIPI D-PHY clock
      - description: The AXI clock

  clock-names:
    minItems: 3
    items:
      - const: pclk
      - const: wrap
      - const: phy
      - const: axi

  power-domains:
    maxItems: 1

  phy-supply:
    description: The MIPI D-PHY digital power supply

  resets:
    items:
      - description: MIPI D-PHY slave reset

  clock-frequency:
    description: The desired external clock ("wrap") frequency, in Hz
    default: 166000000

  ports:
    $ref: /schemas/graph.yaml#/properties/ports

    properties:
      port@0:
        $ref: /schemas/graph.yaml#/$defs/port-base
        unevaluatedProperties: false
        description:
          Input port node, single endpoint describing the CSI-2 transmitter.

        properties:
          endpoint:
            $ref: video-interfaces.yaml#
            unevaluatedProperties: false

            properties:
              data-lanes:
                description:
                  Note that 'fsl,imx7-mipi-csi2' only supports up to 2 data lines.
                items:
                  minItems: 1
                  maxItems: 4
                  items:
                    - const: 1
                    - const: 2
                    - const: 3
                    - const: 4

            required:
              - data-lanes

      port@1:
        $ref: /schemas/graph.yaml#/properties/port
        description:
          Output port node

required:
  - compatible
  - reg
  - interrupts
  - clocks
  - clock-names
  - power-domains
  - ports

additionalProperties: false

allOf:
  - if:
      properties:
        compatible:
          contains:
            const: fsl,imx7-mipi-csi2
    then:
      required:
        - phy-supply
        - resets
    else:
      properties:
        clocks:
          minItems: 4
        clock-names:
          minItems: 4
        phy-supply: false
        resets: false

examples:
  - |
    #include <dt-bindings/clock/imx7d-clock.h>
    #include <dt-bindings/interrupt-controller/arm-gic.h>
    #include <dt-bindings/interrupt-controller/irq.h>
    #include <dt-bindings/reset/imx7-reset.h>

    mipi-csi@30750000 {
        compatible = "fsl,imx7-mipi-csi2";
        reg = <0x30750000 0x10000>;
        interrupts = <GIC_SPI 25 IRQ_TYPE_LEVEL_HIGH>;

        clocks = <&clks IMX7D_IPG_ROOT_CLK>,
                 <&clks IMX7D_MIPI_CSI_ROOT_CLK>,
                 <&clks IMX7D_MIPI_DPHY_ROOT_CLK>;
        clock-names = "pclk", "wrap", "phy";
        clock-frequency = <166000000>;

        power-domains = <&pgc_mipi_phy>;
        phy-supply = <&reg_1p0d>;
        resets = <&src IMX7_RESET_MIPI_PHY_MRST>;

        ports {
            #address-cells = <1>;
            #size-cells = <0>;

            port@0 {
                reg = <0>;

                mipi_from_sensor: endpoint {
                    remote-endpoint = <&ov2680_to_mipi>;
                    data-lanes = <1>;
                };
            };

            port@1 {
                reg = <1>;

                mipi_vc0_to_csi_mux: endpoint {
                    remote-endpoint = <&csi_mux_from_mipi_vc0>;
                };
            };
        };
    };

  - |
    #include <dt-bindings/clock/imx8mm-clock.h>
    #include <dt-bindings/interrupt-controller/arm-gic.h>
    #include <dt-bindings/interrupt-controller/irq.h>

    mipi-csi@32e30000 {
        compatible = "fsl,imx8mm-mipi-csi2";
        reg = <0x32e30000 0x1000>;
        interrupts = <GIC_SPI 17 IRQ_TYPE_LEVEL_HIGH>;
        clock-frequency = <333000000>;
        clocks = <&clk IMX8MM_CLK_DISP_APB_ROOT>,
                 <&clk IMX8MM_CLK_CSI1_ROOT>,
                 <&clk IMX8MM_CLK_CSI1_PHY_REF>,
                 <&clk IMX8MM_CLK_DISP_AXI_ROOT>;
        clock-names = "pclk", "wrap", "phy", "axi";
        power-domains = <&mipi_pd>;

        ports {
            #address-cells = <1>;
            #size-cells = <0>;

            port@0 {
                reg = <0>;

                imx8mm_mipi_csi_in: endpoint {
                    remote-endpoint = <&imx477_out>;
                    data-lanes = <1 2 3 4>;
                };
            };

            port@1 {
                reg = <1>;

                imx8mm_mipi_csi_out: endpoint {
                    remote-endpoint = <&csi_in>;
                };
            };
        };
    };

...
```
