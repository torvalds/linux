## Documentation/devicetree/bindings/media/nxp,imx8-isi.yaml
```yaml
# SPDX-License-Identifier: (GPL-2.0-only OR BSD-2-Clause)
%YAML 1.2
---
$id: http://devicetree.org/schemas/media/nxp,imx8-isi.yaml#
$schema: http://devicetree.org/meta-schemas/core.yaml#

title: i.MX8 Image Sensing Interface

maintainers:
  - Laurent Pinchart <laurent.pinchart@ideasonboard.com>

description: |
  The Image Sensing Interface (ISI) combines image processing pipelines with
  DMA engines to process and capture frames originating from a variety of
  sources. The inputs to the ISI go through Pixel Link interfaces, and their
  number and nature is SoC-dependent. They cover both capture interfaces (MIPI
  CSI-2 RX, HDMI RX, ...) and display engine outputs for writeback support.

properties:
  compatible:
    enum:
      - fsl,imx8mn-isi
      - fsl,imx8mp-isi
      - fsl,imx93-isi

  reg:
    maxItems: 1

  clocks:
    items:
      - description: The AXI clock
      - description: The APB clock
      # TODO: Check if the per-channel ipg_proc_clk clocks need to be specified
      # as well, in case some SoCs have the ability to control them separately.
      # This may be the case of the i.MX8[DQ]X(P)

  clock-names:
    items:
      - const: axi
      - const: apb

  fsl,blk-ctrl:
    $ref: /schemas/types.yaml#/definitions/phandle
    description:
      A phandle referencing the block control that contains the CSIS to ISI
      gasket.

  interrupts:
    description: Processing pipeline interrupts, one per pipeline
    minItems: 1
    maxItems: 2

  power-domains:
    maxItems: 1

  ports:
    $ref: /schemas/graph.yaml#/properties/ports
    description: |
      Ports represent the Pixel Link inputs to the ISI. Their number and
      assignment are model-dependent. Each port shall have a single endpoint.

required:
  - compatible
  - reg
  - interrupts
  - clocks
  - clock-names
  - fsl,blk-ctrl
  - ports

allOf:
  - if:
      properties:
        compatible:
          contains:
            enum:
              - fsl,imx8mn-isi
              - fsl,imx93-isi
    then:
      properties:
        interrupts:
          maxItems: 1
        ports:
          properties:
            port@0:
              description: MIPI CSI-2 RX
          required:
            - port@0

  - if:
      properties:
        compatible:
          contains:
            const: fsl,imx8mp-isi
    then:
      properties:
        interrupts:
          maxItems: 2
        ports:
          properties:
            port@0:
              description: MIPI CSI-2 RX 0
            port@1:
              description: MIPI CSI-2 RX 1
          required:
            - port@0
            - port@1

additionalProperties: false

examples:
  - |
    #include <dt-bindings/clock/imx8mn-clock.h>
    #include <dt-bindings/interrupt-controller/arm-gic.h>
    #include <dt-bindings/interrupt-controller/irq.h>
    #include <dt-bindings/power/imx8mn-power.h>

    isi@32e20000 {
        compatible = "fsl,imx8mn-isi";
        reg = <0x32e20000 0x100>;
        interrupts = <GIC_SPI 16 IRQ_TYPE_LEVEL_HIGH>;
        clocks = <&clk IMX8MN_CLK_DISP_AXI_ROOT>,
                 <&clk IMX8MN_CLK_DISP_APB_ROOT>;
        clock-names = "axi", "apb";
        fsl,blk-ctrl = <&disp_blk_ctrl>;
        power-domains = <&disp_blk_ctrl IMX8MN_DISPBLK_PD_ISI>;

        ports {
            #address-cells = <1>;
            #size-cells = <0>;

            port@0 {
                reg = <0>;
                isi_in: endpoint {
                    remote-endpoint = <&mipi_csi_out>;
                };
            };
        };
    };

  - |
    #include <dt-bindings/clock/imx8mp-clock.h>
    #include <dt-bindings/interrupt-controller/arm-gic.h>
    #include <dt-bindings/interrupt-controller/irq.h>

    isi@32e00000 {
        compatible = "fsl,imx8mp-isi";
        reg = <0x32e00000 0x4000>;
        interrupts = <GIC_SPI 16 IRQ_TYPE_LEVEL_HIGH>,
                     <GIC_SPI 42 IRQ_TYPE_LEVEL_HIGH>;
        clocks = <&clk IMX8MP_CLK_MEDIA_AXI_ROOT>,
                 <&clk IMX8MP_CLK_MEDIA_APB_ROOT>;
        clock-names = "axi", "apb";
        fsl,blk-ctrl = <&media_blk_ctrl>;
        power-domains = <&mediamix_pd>;

        ports {
            #address-cells = <1>;
            #size-cells = <0>;

            port@0 {
                reg = <0>;
                isi_in_0: endpoint {
                    remote-endpoint = <&mipi_csi_0_out>;
                };
            };

            port@1 {
                reg = <1>;
                isi_in_1: endpoint {
                    remote-endpoint = <&mipi_csi_1_out>;
                };
            };
        };
    };
...
```

## Documentation/devicetree/bindings/media/nxp,imx8-jpeg.yaml
```yaml
# SPDX-License-Identifier: (GPL-2.0 OR BSD-2-Clause)
%YAML 1.2
---
$id: http://devicetree.org/schemas/media/nxp,imx8-jpeg.yaml#
$schema: http://devicetree.org/meta-schemas/core.yaml#

title: i.MX8QXP/QM JPEG decoder/encoder

maintainers:
  - Mirela Rabulea <mirela.rabulea@nxp.com>

description: |-
  The JPEG decoder/encoder present in iMX8QXP and iMX8QM SoCs is an
  ISO/IEC 10918-1 JPEG standard compliant decoder/encoder, for Baseline
  and Extended Sequential DCT modes.

properties:
  compatible:
    oneOf:
      - items:
          enum:
            - nxp,imx8qxp-jpgdec
            - nxp,imx8qxp-jpgenc
      - items:
          - const: nxp,imx8qm-jpgdec
          - const: nxp,imx8qxp-jpgdec
      - items:
          - const: nxp,imx8qm-jpgenc
          - const: nxp,imx8qxp-jpgenc

  reg:
    maxItems: 1

  clocks:
    items:
      - description: AXI DMA engine clock for fetching JPEG bitstream from memory (per)
      - description: IP bus clock for register access (ipg)

  interrupts:
    description: |
      There are 4 slots available in the IP, which the driver may use
      If a certain slot is used, it should have an associated interrupt
      The interrupt with index i is assumed to be for slot i
    minItems: 1               # At least one slot is needed by the driver
    maxItems: 4               # The IP has 4 slots available for use

  power-domains:
    description:
      List of phandle and PM domain specifier as documented in
      Documentation/devicetree/bindings/power/power_domain.txt
    minItems: 2               # Wrapper and 1 slot
    maxItems: 5               # Wrapper and 4 slots

required:
  - compatible
  - reg
  - clocks
  - interrupts
  - power-domains

additionalProperties: false

examples:
  - |
    #include <dt-bindings/clock/imx8-lpcg.h>
    #include <dt-bindings/interrupt-controller/arm-gic.h>
    #include <dt-bindings/firmware/imx/rsrc.h>

    jpegdec: jpegdec@58400000 {
        compatible = "nxp,imx8qxp-jpgdec";
        reg = <0x58400000 0x00050000 >;
        clocks = <&img_jpeg_dec_lpcg IMX_LPCG_CLK_0>,
                 <&img_jpeg_dec_lpcg IMX_LPCG_CLK_4>;
        interrupts = <GIC_SPI 309 IRQ_TYPE_LEVEL_HIGH>,
                     <GIC_SPI 310 IRQ_TYPE_LEVEL_HIGH>,
                     <GIC_SPI 311 IRQ_TYPE_LEVEL_HIGH>,
                     <GIC_SPI 312 IRQ_TYPE_LEVEL_HIGH>;
        power-domains = <&pd IMX_SC_R_MJPEG_DEC_MP>,
                        <&pd IMX_SC_R_MJPEG_DEC_S0>,
                        <&pd IMX_SC_R_MJPEG_DEC_S1>,
                        <&pd IMX_SC_R_MJPEG_DEC_S2>,
                        <&pd IMX_SC_R_MJPEG_DEC_S3>;
    };

    jpegenc: jpegenc@58450000 {
        compatible = "nxp,imx8qm-jpgenc", "nxp,imx8qxp-jpgenc";
        reg = <0x58450000 0x00050000 >;
        clocks = <&img_jpeg_enc_lpcg IMX_LPCG_CLK_0>,
                 <&img_jpeg__lpcg IMX_LPCG_CLK_4>;
        interrupts = <GIC_SPI 305 IRQ_TYPE_LEVEL_HIGH>,
                     <GIC_SPI 306 IRQ_TYPE_LEVEL_HIGH>,
                     <GIC_SPI 307 IRQ_TYPE_LEVEL_HIGH>,
                     <GIC_SPI 308 IRQ_TYPE_LEVEL_HIGH>;
        power-domains = <&pd IMX_SC_R_MJPEG_ENC_MP>,
                        <&pd IMX_SC_R_MJPEG_ENC_S0>,
                        <&pd IMX_SC_R_MJPEG_ENC_S1>,
                        <&pd IMX_SC_R_MJPEG_ENC_S2>,
                        <&pd IMX_SC_R_MJPEG_ENC_S3>;
    };
...
```

## Documentation/devicetree/bindings/media/nxp,imx8mq-mipi-csi2.yaml
```yaml
# SPDX-License-Identifier: (GPL-2.0-only OR BSD-2-Clause)
%YAML 1.2
---
$id: http://devicetree.org/schemas/media/nxp,imx8mq-mipi-csi2.yaml#
$schema: http://devicetree.org/meta-schemas/core.yaml#

title: NXP i.MX8MQ MIPI CSI-2 receiver

maintainers:
  - Martin Kepplinger <martin.kepplinger@puri.sm>

description: |-
  This binding covers the CSI-2 RX PHY and host controller included in the
  NXP i.MX8MQ SoC. It handles the sensor/image input and process for all the
  input imaging devices.

properties:
  compatible:
    enum:
      - fsl,imx8mq-mipi-csi2

  reg:
    maxItems: 1

  clocks:
    items:
      - description: core is the RX Controller Core Clock input. This clock
                     must be exactly equal to or faster than the receive
                     byteclock from the RX DPHY.
      - description: esc is the Rx Escape Clock. This must be the same escape
                     clock that the RX DPHY receives.
      - description: ui is the pixel clock (phy_ref up to 333Mhz).
                     See the reference manual for details.

  clock-names:
    items:
      - const: core
      - const: esc
      - const: ui

  power-domains:
    maxItems: 1

  resets:
    items:
      - description: CORE_RESET reset register bit definition
      - description: PHY_REF_RESET reset register bit definition
      - description: ESC_RESET reset register bit definition

  fsl,mipi-phy-gpr:
    description: |
      The phandle to the imx8mq syscon iomux-gpr with the register
      for setting RX_ENABLE for the mipi receiver.

      The format should be as follows:
      <gpr req_gpr>
      gpr is the phandle to general purpose register node.
      req_gpr is the gpr register offset of RX_ENABLE for the mipi phy.
    $ref: /schemas/types.yaml#/definitions/phandle-array
    items:
      items:
        - description: The 'gpr' is the phandle to general purpose register node.
        - description: The 'req_gpr' is the gpr register offset containing
                       CSI2_1_RX_ENABLE or CSI2_2_RX_ENABLE respectively.
          maximum: 0xff

  interconnects:
    maxItems: 1

  interconnect-names:
    const: dram

  ports:
    $ref: /schemas/graph.yaml#/properties/ports

    properties:
      port@0:
        $ref: /schemas/graph.yaml#/$defs/port-base
        unevaluatedProperties: false
        description:
          Input port node, single endpoint describing the CSI-2 transmitter.

        properties:
          endpoint:
            $ref: video-interfaces.yaml#
            unevaluatedProperties: false

            properties:
              data-lanes:
                items:
                  minItems: 1
                  maxItems: 4
                  items:
                    - const: 1
                    - const: 2
                    - const: 3
                    - const: 4

            required:
              - data-lanes

      port@1:
        $ref: /schemas/graph.yaml#/properties/port
        description:
          Output port node

    required:
      - port@0
      - port@1

required:
  - compatible
  - reg
  - clocks
  - clock-names
  - power-domains
  - resets
  - fsl,mipi-phy-gpr
  - ports

additionalProperties: false

examples:
  - |
    #include <dt-bindings/clock/imx8mq-clock.h>
    #include <dt-bindings/interconnect/imx8mq.h>
    #include <dt-bindings/reset/imx8mq-reset.h>

    csi@30a70000 {
        compatible = "fsl,imx8mq-mipi-csi2";
        reg = <0x30a70000 0x1000>;
        clocks = <&clk IMX8MQ_CLK_CSI1_CORE>,
                 <&clk IMX8MQ_CLK_CSI1_ESC>,
                 <&clk IMX8MQ_CLK_CSI1_PHY_REF>;
        clock-names = "core", "esc", "ui";
        assigned-clocks = <&clk IMX8MQ_CLK_CSI1_CORE>,
                          <&clk IMX8MQ_CLK_CSI1_PHY_REF>,
                          <&clk IMX8MQ_CLK_CSI1_ESC>;
        assigned-clock-rates = <266000000>, <200000000>, <66000000>;
        assigned-clock-parents = <&clk IMX8MQ_SYS1_PLL_266M>,
                                 <&clk IMX8MQ_SYS2_PLL_1000M>,
                                 <&clk IMX8MQ_SYS1_PLL_800M>;
        power-domains = <&pgc_mipi_csi1>;
        resets = <&src IMX8MQ_RESET_MIPI_CSI1_CORE_RESET>,
                 <&src IMX8MQ_RESET_MIPI_CSI1_PHY_REF_RESET>,
                 <&src IMX8MQ_RESET_MIPI_CSI1_ESC_RESET>;
        fsl,mipi-phy-gpr = <&iomuxc_gpr 0x88>;
        interconnects = <&noc IMX8MQ_ICM_CSI1 &noc IMX8MQ_ICS_DRAM>;
        interconnect-names = "dram";

        ports {
            #address-cells = <1>;
            #size-cells = <0>;

            port@0 {
                reg = <0>;

                imx8mm_mipi_csi_in: endpoint {
                    remote-endpoint = <&imx477_out>;
                    data-lanes = <1 2 3 4>;
                };
            };

            port@1 {
                reg = <1>;

                imx8mm_mipi_csi_out: endpoint {
                    remote-endpoint = <&csi_in>;
                };
            };
        };
    };

...
```
