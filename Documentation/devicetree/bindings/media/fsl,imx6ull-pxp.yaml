## Documentation/devicetree/bindings/media/i2c/alliedvision,alvium-csi2.yaml
```yaml
# SPDX-License-Identifier: GPL-2.0-only OR BSD-2-Clause
%YAML 1.2
---
$id: http://devicetree.org/schemas/media/i2c/alliedvision,alvium-csi2.yaml#
$schema: http://devicetree.org/meta-schemas/core.yaml#

title: Allied Vision Alvium Camera

maintainers:
  - Tommaso Merciai <tomm.merciai@gmail.com>
  - Martin Hecht <martin.hecht@avnet.eu>

allOf:
  - $ref: /schemas/media/video-interface-devices.yaml#

properties:
  compatible:
    const: alliedvision,alvium-csi2

  reg:
    maxItems: 1

  vcc-ext-in-supply:
    description: |
      The regulator that supplies power to the VCC_EXT_IN pins.

  port:
    description: Digital Output Port
    $ref: /schemas/graph.yaml#/$defs/port-base
    additionalProperties: false

    properties:
      endpoint:
        $ref: /schemas/media/video-interfaces.yaml#
        unevaluatedProperties: false

        properties:
          link-frequencies: true

          data-lanes:
            minItems: 1
            items:
              - const: 1
              - const: 2
              - const: 3
              - const: 4

        required:
          - data-lanes
          - link-frequencies

required:
  - compatible
  - reg
  - vcc-ext-in-supply
  - port

additionalProperties: false

examples:
  - |
    i2c {
        #address-cells = <1>;
        #size-cells = <0>;

        alvium: camera@3c {
            compatible = "alliedvision,alvium-csi2";
            reg = <0x3c>;
            vcc-ext-in-supply = <&reg_vcc_ext_in>;

            port {
                alvium_out: endpoint {
                    remote-endpoint = <&mipi_csi_0_in>;
                    data-lanes = <1 2 3 4>;
                    link-frequencies = /bits/ 64 <681250000>;
                };
            };
        };
    };

...
```

## Documentation/devicetree/bindings/media/i2c/aptina,mt9p031.yaml
```yaml
# SPDX-License-Identifier: (GPL-2.0-only OR BSD-2-Clause)
%YAML 1.2
---
$id: http://devicetree.org/schemas/media/i2c/aptina,mt9p031.yaml#
$schema: http://devicetree.org/meta-schemas/core.yaml#

title: Aptina 1/2.5-Inch 5Mp CMOS Digital Image Sensor

maintainers:
  - Laurent Pinchart <laurent.pinchart@ideasonboard.com>

description: |
  The Aptina MT9P031 is a 1/2.5-inch CMOS active pixel digital image sensor
  with an active array size of 2592H x 1944V. It is programmable through a
  simple two-wire serial interface.

properties:
  compatible:
    enum:
      - aptina,mt9p031
      - aptina,mt9p031m

  reg:
    description: I2C device address
    maxItems: 1

  clocks:
    maxItems: 1

  vdd-supply:
    description: Digital supply voltage, 1.8 V

  vdd_io-supply:
    description: I/O supply voltage, 1.8 or 2.8 V

  vaa-supply:
    description: Analog supply voltage, 2.8 V

  reset-gpios:
    maxItems: 1
    description: Chip reset GPIO

  port:
    $ref: /schemas/graph.yaml#/$defs/port-base
    additionalProperties: false

    properties:
      endpoint:
        $ref: /schemas/media/video-interfaces.yaml#
        unevaluatedProperties: false

        properties:
          input-clock-frequency:
            $ref: /schemas/types.yaml#/definitions/uint32
            minimum: 6000000
            maximum: 96000000
            description: Input clock frequency

          pixel-clock-frequency:
            $ref: /schemas/types.yaml#/definitions/uint32
            maximum: 96000000
            description: Target pixel clock frequency

          pclk-sample:
            default: 0

        required:
          - input-clock-frequency
          - pixel-clock-frequency

required:
  - compatible
  - reg
  - clocks
  - vdd-supply
  - vdd_io-supply
  - vaa-supply
  - port

additionalProperties: false

examples:
  - |
    i2c0 {
        #address-cells = <1>;
        #size-cells = <0>;

        mt9p031@5d {
            compatible = "aptina,mt9p031";
            reg = <0x5d>;
            reset-gpios = <&gpio_sensor 0 0>;

            clocks = <&sensor_clk>;

            vdd-supply = <&reg_vdd>;
            vdd_io-supply = <&reg_vdd_io>;
            vaa-supply = <&reg_vaa>;

            port {
                mt9p031_1: endpoint {
                    input-clock-frequency = <6000000>;
                    pixel-clock-frequency = <96000000>;
                };
            };
        };
    };

...
```

## Documentation/devicetree/bindings/media/i2c/aptina,mt9v111.txt
```
* Aptina MT9V111 CMOS sensor
----------------------------

The Aptina MT9V111 is a 1/4-Inch VGA-format digital image sensor with a core
based on Aptina MT9V011 sensor and an integrated Image Flow Processor (IFP).

The sensor has an active pixel array of 640x480 pixels and can output a number
of image resolution and formats controllable through a simple two-wires
interface.

Required properties:
--------------------

- compatible: shall be "aptina,mt9v111".
- clocks: reference to the system clock input provider.

Optional properties:
--------------------

- enable-gpios: output enable signal, pin name "OE#". Active low.
- standby-gpios: low power state control signal, pin name "STANDBY".
  Active high.
- reset-gpios: chip reset signal, pin name "RESET#". Active low.

The device node must contain one 'port' child node with one 'endpoint' child
sub-node for its digital output video port, in accordance with the video
interface bindings defined in:
Documentation/devicetree/bindings/media/video-interfaces.txt

Example:
--------

        &i2c1 {
                camera@48 {
                        compatible = "aptina,mt9v111";
                        reg = <0x48>;

                        clocks = <&camera_clk>;

                        port {
                                mt9v111_out: endpoint {
                                        remote-endpoint = <&ceu_in>;
                                };
                        };
                };
        };
```

## Documentation/devicetree/bindings/media/i2c/aptina,mt9v111.yaml
```yaml
# SPDX-License-Identifier: (GPL-2.0-only OR BSD-2-Clause)
%YAML 1.2
---
$id: http://devicetree.org/schemas/media/i2c/aptina,mt9v111.yaml#
$schema: http://devicetree.org/meta-schemas/core.yaml#

title: Aptina MT9V111 CMOS sensor

maintainers:
  - Jacopo Mondi <jacopo@jmondi.org>

description: |
  The Aptina MT9V111 is a 1/4-Inch VGA-format digital image sensor with a core
  based on Aptina MT9V011 sensor and an integrated Image Flow Processor (IFP).

  The sensor has an active pixel array of 640x480 pixels and can output a number
  of image resolutions and formats controllable through a simple two-wires
  interface.

properties:
  compatible:
    const: aptina,mt9v111

  reg:
    maxItems: 1

  clocks:
    maxItems: 1

  enable-gpios:
    description: Enable signal, pin name "OE#". Active low.
    maxItems: 1

  standby-gpios:
    description: |
      Low power state control signal, pin name "STANDBY". Active high.
    maxItems: 1

  reset-gpios:
    description: Chip reset signal, pin name "RESET#". Active low.
    maxItems: 1

  port:
    $ref: /schemas/graph.yaml#/properties/port
    description: |
      Output video port.

required:
  - compatible
  - reg
  - clocks
  - port

additionalProperties: false

examples:
  - |
    i2c {
        #address-cells = <1>;
        #size-cells = <0>;

        camera@48 {
            compatible = "aptina,mt9v111";
            reg = <0x48>;
            clocks = <&camera_clk>;

            port {
                mt9v111_out: endpoint {
                    remote-endpoint = <&ceu_in>;
                };
            };
        };
    };

...
```

## Documentation/devicetree/bindings/media/i2c/asahi-kasei,ak7375.yaml
```yaml
# SPDX-License-Identifier: (GPL-2.0-only OR BSD-2-Clause)
%YAML 1.2
---
$id: http://devicetree.org/schemas/media/i2c/asahi-kasei,ak7375.yaml#
$schema: http://devicetree.org/meta-schemas/core.yaml#

title: Asahi Kasei Microdevices AK7375 voice coil lens actuator

maintainers:
  - Tianshu Qiu <tian.shu.qiu@intel.com>

description:
  AK7375 is a voice coil motor (VCM) camera lens actuator that
  is controlled over I2C.

properties:
  compatible:
    const: asahi-kasei,ak7375

  reg:
    maxItems: 1

  vdd-supply:
    description: VDD supply

  vio-supply:
    description: I/O pull-up supply

required:
  - compatible
  - reg
  - vdd-supply
  - vio-supply

additionalProperties: false

examples:
  - |
    i2c {
        #address-cells = <1>;
        #size-cells = <0>;

        ak7375: camera-lens@c {
            compatible = "asahi-kasei,ak7375";
            reg = <0x0c>;

            vdd-supply = <&vreg_l23a_2p8>;
            vio-supply = <&vreg_lvs1a_1p8>;
        };
    };

...
```

## Documentation/devicetree/bindings/media/i2c/aw36518.txt
```
* AW36518 flash driver support

Required Properties:
- compatible: Must contain "awinic,aw36518"
- reg: I2C slave address
- enable-gpios: Specifier of the GPIO connected to strobe/torch EN pin
this pin is for hardware flash/torch mode, if not, will using i2c control.
- tx-gpio: Specifier of the GPIO connected to TX pin
this pin is synchronization input for RF power Amplifier Pulse Eventr;
if not, will using assist mode.

A discrete LED element connected to the device must be represented by a child
node - see Documentation/devicetree/bindings/leds/common.txt.

Required properties of the LED child node:
- led-max-microamp : see Documentation/devicetree/bindings/leds/common.txt
- flash-max-microamp : see Documentation/devicetree/bindings/leds/common.txt
- flash-max-timeout-us : see Documentation/devicetree/bindings/leds/common.txt

Special properties:
- rockchip,camera-module-index : indicate which camera the flash belongs to.
- rockchip,camera-module-facing : indicate the camera facing.

Example:

&i2c1 {
	...
	aw36518: aw36518@63 {
		#address-cells = <1>;
		#size-cells = <0>;
		compatible = "awinic,aw36518";
		status = "okay";
		reg = <0x63>;
		rockchip,camera-module-index = <0>;
		rockchip,camera-module-facing = "back";
		enable-gpio = <&gpio3 RK_PC3 GPIO_ACTIVE_HIGH>;
		tx-gpio = <&gpio3 RK_PC2 GPIO_ACTIVE_HIGH>;
		aw36518_led0: led@0 {
			reg = <0x0>;
			led-max-microamp = <386000>;
			flash-max-microamp = <1500000>;
			flash-max-timeout-us = <1600000>;
		};
	};
	...
	ov13850: ov13850@10 {
		...
		flash-leds = <&aw36518_led0>;
		...
	};
	...
}
```
