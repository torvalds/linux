## Documentation/devicetree/bindings/media/fsl,imx6ull-pxp.yaml
```yaml
# SPDX-License-Identifier: (GPL-2.0 OR BSD-2-Clause)

%YAML 1.2
---
$id: http://devicetree.org/schemas/media/fsl,imx6ull-pxp.yaml#
$schema: http://devicetree.org/meta-schemas/core.yaml#

title: Freescale Pixel Pipeline

maintainers:
  - Philipp Zabel <p.zabel@pengutronix.de>
  - Michael Tretter <m.tretter@pengutronix.de>

description:
  The Pixel Pipeline (PXP) is a memory-to-memory graphics processing engine
  that supports scaling, colorspace conversion, alpha blending, rotation, and
  pixel conversion via lookup table. Different versions are present on various
  i.MX SoCs from i.MX23 to i.MX7.

properties:
  compatible:
    oneOf:
      - enum:
          - fsl,imx6ul-pxp
          - fsl,imx6ull-pxp
          - fsl,imx7d-pxp
      - items:
          - enum:
              - fsl,imx6sll-pxp
              - fsl,imx6sx-pxp
          - const: fsl,imx6ull-pxp

  reg:
    maxItems: 1

  interrupts:
    minItems: 1
    maxItems: 2

  clocks:
    maxItems: 1

  clock-names:
    const: axi

  power-domains:
    maxItems: 1

required:
  - compatible
  - reg
  - interrupts
  - clocks
  - clock-names

allOf:
  - if:
      properties:
        compatible:
          contains:
            enum:
              - fsl,imx6sx-pxp
              - fsl,imx6ul-pxp
    then:
      properties:
        interrupts:
          maxItems: 1
    else:
      properties:
        interrupts:
          minItems: 2
          maxItems: 2

additionalProperties: false

examples:
  - |
    #include <dt-bindings/clock/imx6ul-clock.h>
    #include <dt-bindings/interrupt-controller/arm-gic.h>

    pxp: pxp@21cc000 {
        compatible = "fsl,imx6ull-pxp";
        reg = <0x021cc000 0x4000>;
        interrupts = <GIC_SPI 8 IRQ_TYPE_LEVEL_HIGH>,
                     <GIC_SPI 18 IRQ_TYPE_LEVEL_HIGH>;
        clock-names = "axi";
        clocks = <&clks IMX6UL_CLK_PXP>;
    };
```

## Documentation/devicetree/bindings/media/fsl,imx8qxp-isi.yaml
```yaml
# SPDX-License-Identifier: (GPL-2.0-only OR BSD-2-Clause)
%YAML 1.2
---
$id: http://devicetree.org/schemas/media/fsl,imx8qxp-isi.yaml#
$schema: http://devicetree.org/meta-schemas/core.yaml#

title: i.MX8QXP Image Sensing Interface

maintainers:
  - Frank Li <Frank.Li@nxp.com>

description:
  The Image Sensing Interface (ISI) combines image processing pipelines with
  DMA engines to process and capture frames originating from a variety of
  sources. The inputs to the ISI go through Pixel Link interfaces, and their
  number and nature is SoC-dependent. They cover both capture interfaces (MIPI
  CSI-2 RX, HDMI RX, ...) and display engine outputs for writeback support.

properties:
  compatible:
    enum:
      - fsl,imx8qxp-isi

  reg:
    maxItems: 1

  clocks:
    maxItems: 6

  clock-names:
    items:
      - const: per0
      - const: per1
      - const: per2
      - const: per3
      - const: per4
      - const: per5

  interrupts:
    maxItems: 6

  power-domains:
    maxItems: 6

  ports:
    $ref: /schemas/graph.yaml#/properties/ports
    properties:
      port@2:
        $ref: /schemas/graph.yaml#/properties/port
        description: MIPI CSI-2 RX 0
      port@6:
        $ref: /schemas/graph.yaml#/properties/port
        description: CSI-2 Parallel RX

required:
  - compatible
  - reg
  - clocks
  - clock-names
  - interrupts
  - power-domains
  - ports

additionalProperties: false

examples:
  - |
    #include <dt-bindings/interrupt-controller/arm-gic.h>
    #include <dt-bindings/interrupt-controller/irq.h>
    #include <dt-bindings/clock/imx8-clock.h>
    #include <dt-bindings/clock/imx8-lpcg.h>
    #include <dt-bindings/firmware/imx/rsrc.h>

    image-controller@58100000 {
        compatible = "fsl,imx8qxp-isi";
        reg = <0x58100000 0x60000>;
        interrupts = <GIC_SPI 297 IRQ_TYPE_LEVEL_HIGH>,
                     <GIC_SPI 298 IRQ_TYPE_LEVEL_HIGH>,
                     <GIC_SPI 299 IRQ_TYPE_LEVEL_HIGH>,
                     <GIC_SPI 300 IRQ_TYPE_LEVEL_HIGH>,
                     <GIC_SPI 301 IRQ_TYPE_LEVEL_HIGH>,
                     <GIC_SPI 302 IRQ_TYPE_LEVEL_HIGH>;
        clocks = <&pdma0_lpcg IMX_LPCG_CLK_0>,
                 <&pdma1_lpcg IMX_LPCG_CLK_0>,
                 <&pdma2_lpcg IMX_LPCG_CLK_0>,
                 <&pdma3_lpcg IMX_LPCG_CLK_0>,
                 <&pdma4_lpcg IMX_LPCG_CLK_0>,
                 <&pdma5_lpcg IMX_LPCG_CLK_0>;
        clock-names = "per0", "per1", "per2", "per3", "per4", "per5";
        power-domains = <&pd IMX_SC_R_ISI_CH0>, <&pd IMX_SC_R_ISI_CH1>,
                        <&pd IMX_SC_R_ISI_CH2>, <&pd IMX_SC_R_ISI_CH3>,
                        <&pd IMX_SC_R_ISI_CH4>, <&pd IMX_SC_R_ISI_CH5>;

        ports {
            #address-cells = <1>;
            #size-cells = <0>;

            port@2 {
                reg = <2>;
                endpoint {
                    remote-endpoint = <&mipi_csi0_out>;
                };
            };
        };
    };
...
```

## Documentation/devicetree/bindings/media/fsl-pxp.txt
```
Freescale Pixel Pipeline
========================

The Pixel Pipeline (PXP) is a memory-to-memory graphics processing engine
that supports scaling, colorspace conversion, alpha blending, rotation, and
pixel conversion via lookup table. Different versions are present on various
i.MX SoCs from i.MX23 to i.MX7.

Required properties:
- compatible: should be "fsl,<soc>-pxp", where SoC can be one of imx23, imx28,
  imx6dl, imx6sl, imx6sll, imx6ul, imx6sx, imx6ull, or imx7d.
- reg: the register base and size for the device registers
- interrupts: the PXP interrupt, two interrupts for imx6ull and imx7d.
- clock-names: should be "axi"
- clocks: the PXP AXI clock

Example:

pxp@21cc000 {
	compatible = "fsl,imx6ull-pxp";
	reg = <0x021cc000 0x4000>;
	interrupts = <GIC_SPI 8 IRQ_TYPE_LEVEL_HIGH>,
		     <GIC_SPI 18 IRQ_TYPE_LEVEL_HIGH>;
	clock-names = "axi";
	clocks = <&clks IMX6UL_CLK_PXP>;
};
```

## Documentation/devicetree/bindings/media/fsl-vdoa.txt
```
Freescale Video Data Order Adapter
==================================

The Video Data Order Adapter (VDOA) is present on the i.MX6q. Its sole purpose
is to reorder video data from the macroblock tiled order produced by the CODA
960 VPU to the conventional raster-scan order for scanout.

Required properties:
- compatible: must be "fsl,imx6q-vdoa"
- reg: the register base and size for the device registers
- interrupts: the VDOA interrupt
- clocks: the vdoa clock

Example:

vdoa@21e4000 {
        compatible = "fsl,imx6q-vdoa";
        reg = <0x021e4000 0x4000>;
        interrupts = <0 18 IRQ_TYPE_LEVEL_HIGH>;
        clocks = <&clks IMX6QDL_CLK_VDOA>;
};
```

## Documentation/devicetree/bindings/media/gpio-ir-receiver.txt
```
Device-Tree bindings for GPIO IR receiver

Required properties:
	- compatible: should be "gpio-ir-receiver".
	- gpios: specifies GPIO used for IR signal reception.

Optional properties:
	- linux,rc-map-name: see rc.txt file in the same
	  directory.

Example node:

	ir: ir-receiver {
		compatible = "gpio-ir-receiver";
		gpios = <&gpio0 19 1>;
		linux,rc-map-name = "rc-rc6-mce";
	};
```

## Documentation/devicetree/bindings/media/gpio-ir-receiver.yaml
```yaml
# SPDX-License-Identifier: GPL-2.0
%YAML 1.2
---
$id: http://devicetree.org/schemas/media/gpio-ir-receiver.yaml#
$schema: http://devicetree.org/meta-schemas/core.yaml#

title: GPIO Based IR receiver

maintainers:
  - Sebastian Hesselbarth <sebastian.hesselbarth@gmail.com>

allOf:
  - $ref: rc.yaml#

properties:
  compatible:
    const: gpio-ir-receiver

  gpios:
    maxItems: 1

  linux,autosuspend-period:
    description: autosuspend delay time in milliseconds
    $ref: /schemas/types.yaml#/definitions/uint32

  wakeup-source:
    description: IR receiver can wake-up the system.

required:
  - compatible
  - gpios

unevaluatedProperties: false

examples:
  - |
    ir-receiver {
        compatible = "gpio-ir-receiver";
        gpios = <&gpio0 19 1>;
        linux,rc-map-name = "rc-rc6-mce";
        linux,autosuspend-period = <125>;
    };
...
```

## Documentation/devicetree/bindings/media/hix5hd2-ir.txt
```
Device-Tree bindings for hix5hd2 ir IP

Required properties:
	- compatible: Should contain "hisilicon,hix5hd2-ir".
	- reg: Base physical address of the controller and length of memory
	  mapped region.
	- interrupts: interrupt-specifier for the sole interrupt generated by
	  the device. The interrupt specifier format depends on the interrupt
	  controller parent.
	- clocks: clock phandle and specifier pair.

Optional properties:
	- linux,rc-map-name : Remote control map name.
	- hisilicon,power-syscon: DEPRECATED. Don't use this in new dts files.
		Provide correct clocks instead.

Example node:

	ir: ir@f8001000 {
		compatible = "hisilicon,hix5hd2-ir";
		reg = <0xf8001000 0x1000>;
		interrupts = <0 47 4>;
		clocks = <&clock HIX5HD2_IR_CLOCK>;
		linux,rc-map-name = "rc-tivo";
	};
```

## Documentation/devicetree/bindings/media/i2c/ad5820.txt
```
* Analog Devices AD5820 autofocus coil

Required Properties:

  - compatible: Must contain one of:
		- "adi,ad5820"
		- "adi,ad5821"
		- "adi,ad5823"

  - reg: I2C slave address

  - VANA-supply: supply of voltage for VANA pin

Optional properties:

   - enable-gpios : GPIO spec for the XSHUTDOWN pin. The XSHUTDOWN signal is
active low, a high level on the pin enables the device.

Example:

       ad5820: coil@c {
               compatible = "adi,ad5820";
               reg = <0x0c>;

               VANA-supply = <&vaux4>;
               enable-gpios = <&msmgpio 26 GPIO_ACTIVE_HIGH>;
       };
```

## Documentation/devicetree/bindings/media/i2c/adi,ad5820.yaml
```yaml
# SPDX-License-Identifier: (GPL-2.0-only OR BSD-2-Clause)
%YAML 1.2
---
$id: http://devicetree.org/schemas/media/i2c/adi,ad5820.yaml#
$schema: http://devicetree.org/meta-schemas/core.yaml#

title: Analog Devices AD5820 autofocus coil

maintainers:
  - Pavel Machek <pavel@ucw.cz>

description:
  The AD5820 is a current sink driver designed for precise control of
  voice coil motors (VCMs) in camera autofocus systems.

properties:
  compatible:
    enum:
      - adi,ad5820
      - adi,ad5821
      - adi,ad5823

  reg:
    maxItems: 1

  enable-gpios:
    maxItems: 1
    description:
      GPIO spec for the XSHUTDOWN pin. The XSHUTDOWN signal is active low,
      a high level on the pin enables the device.

  VANA-supply:
    description: supply of voltage for VANA pin

required:
  - compatible
  - reg
  - VANA-supply

additionalProperties: false

examples:
  - |
    #include <dt-bindings/gpio/gpio.h>

    i2c {
        #address-cells = <1>;
        #size-cells = <0>;
        coil@c {
            compatible = "adi,ad5820";
            reg = <0x0c>;

            enable-gpios = <&msmgpio 26 GPIO_ACTIVE_HIGH>;
            VANA-supply = <&vaux4>;
        };
    };
```
