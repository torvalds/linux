## Documentation/devicetree/bindings/media/i2c/adi,adv7180.yaml
```yaml
# SPDX-License-Identifier: (GPL-2.0-only OR BSD-2-Clause)
%YAML 1.2
---
$id: http://devicetree.org/schemas/media/i2c/adi,adv7180.yaml#
$schema: http://devicetree.org/meta-schemas/core.yaml#

title: Analog Devices ADV7180 analog video decoder family

maintainers:
  - Lars-Peter Clausen <lars@metafoo.de>

description:
  The adv7180 family devices are used to capture analog video to different
  digital interfaces like MIPI CSI-2 or parallel video.

properties:
  compatible:
    items:
      - enum:
          - adi,adv7180
          - adi,adv7180cp
          - adi,adv7180st
          - adi,adv7182
          - adi,adv7280
          - adi,adv7280-m
          - adi,adv7281
          - adi,adv7281-m
          - adi,adv7281-ma
          - adi,adv7282
          - adi,adv7282-m

  reg:
    minItems: 1
    items:
      - description: main register map
      - description: VPP or CSI register map
      - description: CSI register map
    description:
      The ADV7180 family may have up to three register maps. All chips have
      the main register map. The availability of the CSI and VPP register maps
      depends on the chip variant.

      The addresses of the CSI and VPP register maps are programmable by
      software. They depend on the board layout and other devices on the I2C
      bus and are determined by the hardware designer to avoid address
      conflicts on the I2C bus.

  reg-names:
    minItems: 1
    items:
      - const: main
      - enum: [ csi, vpp ]
      - const: csi

  powerdown-gpios:
    maxItems: 1

  reset-gpios:
    maxItems: 1

  adv,force-bt656-4:
    deprecated: true
    description:
      Indicates that the output is a BT.656-4 compatible stream.
    type: boolean

  adi,force-bt656-4:
    description:
      Indicates that the output is a BT.656-4 compatible stream.
    type: boolean

  interrupts:
    items:
      - description: The GPIO connected to the INTRQ pin.

  port:
    $ref: /schemas/graph.yaml#/$defs/port-base
    unevaluatedProperties: false

    properties:
      endpoint:
        $ref: /schemas/media/video-interfaces.yaml#
        unevaluatedProperties: false

  ports: true

additionalProperties: false

required:
  - compatible
  - reg

allOf:
  - if:
      properties:
        compatible:
          enum:
            - adi,adv7180
            - adi,adv7182
            - adi,adv7280
            - adi,adv7280-m
            - adi,adv7281
            - adi,adv7281-m
            - adi,adv7281-ma
            - adi,adv7282
            - adi,adv7282-m
    then:
      required:
        - port

  - if:
      properties:
        compatible:
          contains:
            const: adi,adv7180cp
    then:
      properties:
        ports:
          $ref: /schemas/graph.yaml#/properties/ports
          properties:
            port@3:
              $ref: /schemas/graph.yaml#/properties/port
              description: Output port

          patternProperties:
            "^port@[0-2]$":
              $ref: /schemas/graph.yaml#/properties/port
              description: Input port

          required:
            - port@3

      required:
        - ports

  - if:
      properties:
        compatible:
          contains:
            const: adi,adv7180st
    then:
      properties:
        ports:
          $ref: /schemas/graph.yaml#/properties/ports
          properties:
            port@6:
              $ref: /schemas/graph.yaml#/properties/port
              description: Output port

          patternProperties:
            "^port@[0-5]$":
              $ref: /schemas/graph.yaml#/properties/port
              description: Input port

          required:
            - port@6

      required:
        - ports

  - if:
      properties:
        compatible:
          contains:
            enum:
              - adi,adv7180
              - adi,adv7180cp
              - adi,adv7180st
              - adi,adv7182
    then:
      properties:
        reg:
          maxItems: 1

        reg-names:
          maxItems: 1

  - if:
      properties:
        compatible:
          contains:
            enum:
              - adi,adv7281
              - adi,adv7281-m
              - adi,adv7281-ma
    then:
      properties:
        reg:
          minItems: 1
          maxItems: 2

        reg-names:
          minItems: 1
          items:
            - const: main
            - const: csi

  - if:
      properties:
        compatible:
          contains:
            enum:
              - adi,adv7280
              - adi,adv7282
    then:
      properties:
        reg:
          minItems: 1
          maxItems: 2

        reg-names:
          minItems: 1
          items:
            - const: main
            - const: vpp

examples:
  - |
    i2c {
            #address-cells = <1>;
            #size-cells = <0>;

            composite-in@20 {
                    compatible = "adi,adv7180";
                    reg = <0x20>;

                    port {
                            adv7180: endpoint {
                                    bus-width = <8>;
                                    remote-endpoint = <&vin1ep>;
                            };
                    };
            };

    };

  - |
    i2c {
            #address-cells = <1>;
            #size-cells = <0>;

            composite-in@20 {
                    compatible = "adi,adv7180cp";
                    reg = <0x20>;

                    ports {
                            #address-cells = <1>;
                            #size-cells = <0>;

                            port@0 {
                                    reg = <0>;
                                    adv7180_in: endpoint {
                                            remote-endpoint = <&composite_con_in>;
                                    };
                            };

                            port@3 {
                                    reg = <3>;
                                    adv7180_out: endpoint {
                                            remote-endpoint = <&vin4_in>;
                                    };
                            };
                    };
            };
    };

  - |
    i2c {
            #address-cells = <1>;
            #size-cells = <0>;

            composite-in@20 {
                    compatible = "adi,adv7280-m";
                    reg = <0x20>, <0x42>, <0x44>;
                    reg-names = "main", "vpp", "csi";

                    port {
                            adv7280_out: endpoint {
                                    bus-width = <8>;
                                    remote-endpoint = <&vin1ep>;
                            };
                    };
            };
    };
```

## Documentation/devicetree/bindings/media/i2c/adp1653.txt
```
* Analog Devices ADP1653 flash LED driver

Required Properties:

  - compatible: Must contain "adi,adp1653"

  - reg: I2C slave address

  - enable-gpios: Specifier of the GPIO connected to EN pin

There are two LED outputs available - flash and indicator. One LED is
represented by one child node, nodes need to be named "flash" and "indicator".

Required properties of the LED child node:
- max-microamp : see Documentation/devicetree/bindings/leds/common.txt

Required properties of the flash LED child node:

- flash-max-microamp : see Documentation/devicetree/bindings/leds/common.txt
- flash-timeout-us : see Documentation/devicetree/bindings/leds/common.txt

Example:

	adp1653: led-controller@30 {
		compatible = "adi,adp1653";
		reg = <0x30>;
		enable-gpios = <&gpio3 24 GPIO_ACTIVE_HIGH>; /* 88 */

		flash {
			flash-timeout-us = <500000>;
			flash-max-microamp = <320000>;
			max-microamp = <50000>;
		};
		indicator {
			max-microamp = <17500>;
		};
	};
```

## Documentation/devicetree/bindings/media/i2c/adv7180.txt
```
* Analog Devices ADV7180 analog video decoder family

The adv7180 family devices are used to capture analog video to different
digital interfaces like MIPI CSI-2 or parallel video.

Required Properties :
- compatible : value must be one of
		"adi,adv7180"
		"adi,adv7180cp"
		"adi,adv7180st"
		"adi,adv7182"
		"adi,adv7280"
		"adi,adv7280-m"
		"adi,adv7281"
		"adi,adv7281-m"
		"adi,adv7281-ma"
		"adi,adv7282"
		"adi,adv7282-m"

Device nodes of "adi,adv7180cp" and "adi,adv7180st" must contain one
'port' child node per device input and output port, in accordance with the
video interface bindings defined in
Documentation/devicetree/bindings/media/video-interfaces.txt. The port
nodes are numbered as follows.

  Port		adv7180cp	adv7180st
-------------------------------------------------------------------
  Input		0-2		0-5
  Output	3		6

The digital output port node must contain at least one endpoint.

Optional Properties :
- powerdown-gpios: reference to the GPIO connected to the powerdown pin,
  if any.


Example:

	i2c0@1c22000 {
		...
		...
		adv7180@21 {
			compatible = "adi,adv7180";
			reg = <0x21>;
		};
		...
	};
```

## Documentation/devicetree/bindings/media/i2c/adv7180.yaml
```yaml
# SPDX-License-Identifier: (GPL-2.0-only OR BSD-2-Clause)
%YAML 1.2
---
$id: http://devicetree.org/schemas/media/i2c/adv7180.yaml#
$schema: http://devicetree.org/meta-schemas/core.yaml#

title: Analog Devices ADV7180 analog video decoder family

maintainers:
  - Lars-Peter Clausen <lars@metafoo.de>

description:
  The adv7180 family devices are used to capture analog video to different
  digital interfaces like MIPI CSI-2 or parallel video.

properties:
  compatible:
    items:
      - enum:
          - adi,adv7180
          - adi,adv7180cp
          - adi,adv7180st
          - adi,adv7182
          - adi,adv7280
          - adi,adv7280-m
          - adi,adv7281
          - adi,adv7281-m
          - adi,adv7281-ma
          - adi,adv7282
          - adi,adv7282-m

  reg:
    maxItems: 1

  powerdown-gpios:
    maxItems: 1

  reset-gpios:
    maxItems: 1

  adv,force-bt656-4:
    deprecated: true
    description:
      Indicates that the output is a BT.656-4 compatible stream.
    type: boolean

  adi,force-bt656-4:
    description:
      Indicates that the output is a BT.656-4 compatible stream.
    type: boolean

  interrupts:
    items:
      - description: The GPIO connected to the INTRQ pin.

  port:
    $ref: /schemas/graph.yaml#/$defs/port-base
    unevaluatedProperties: false

    properties:
      endpoint:
        $ref: /schemas/media/video-interfaces.yaml#
        unevaluatedProperties: false

  ports: true

additionalProperties: false

required:
  - compatible
  - reg

allOf:
  - if:
      properties:
        compatible:
          enum:
            - adi,adv7180
            - adi,adv7182
            - adi,adv7280
            - adi,adv7280-m
            - adi,adv7281
            - adi,adv7281-m
            - adi,adv7281-ma
            - adi,adv7282
            - adi,adv7282-m
    then:
      required:
        - port

  - if:
      properties:
        compatible:
          contains:
            const: adi,adv7180cp
    then:
      properties:
        ports:
          $ref: /schemas/graph.yaml#/properties/ports
          properties:
            port@3:
              $ref: /schemas/graph.yaml#/properties/port
              description: Output port

          patternProperties:
            "^port@[0-2]$":
              $ref: /schemas/graph.yaml#/properties/port
              description: Input port

          required:
            - port@3

      required:
        - ports

  - if:
      properties:
        compatible:
          contains:
            const: adi,adv7180st
    then:
      properties:
        ports:
          $ref: /schemas/graph.yaml#/properties/ports
          properties:
            port@6:
              $ref: /schemas/graph.yaml#/properties/port
              description: Output port

          patternProperties:
            "^port@[0-5]$":
              $ref: /schemas/graph.yaml#/properties/port
              description: Input port

          required:
            - port@6

      required:
        - ports

examples:
  - |
    i2c {
            #address-cells = <1>;
            #size-cells = <0>;

            composite-in@20 {
                    compatible = "adi,adv7180";
                    reg = <0x20>;

                    port {
                            adv7180: endpoint {
                                    bus-width = <8>;
                                    remote-endpoint = <&vin1ep>;
                            };
                    };
            };

    };

  - |
    i2c {
            #address-cells = <1>;
            #size-cells = <0>;

            composite-in@20 {
                    compatible = "adi,adv7180cp";
                    reg = <0x20>;

                    ports {
                            #address-cells = <1>;
                            #size-cells = <0>;

                            port@0 {
                                    reg = <0>;
                                    adv7180_in: endpoint {
                                            remote-endpoint = <&composite_con_in>;
                                    };
                            };

                            port@3 {
                                    reg = <3>;
                                    adv7180_out: endpoint {
                                            remote-endpoint = <&vin4_in>;
                                    };
                            };
                    };
            };
    };
```

## Documentation/devicetree/bindings/media/i2c/adv7343.txt
```
* Analog Devices adv7343 video encoder

The ADV7343 are high speed, digital-to-analog video encoders in a 64-lead LQFP
package. Six high speed, 3.3 V, 11-bit video DACs provide support for composite
(CVBS), S-Video (Y-C), and component (YPrPb/RGB) analog outputs in standard
definition (SD), enhanced definition (ED), or high definition (HD) video
formats.

Required Properties :
- compatible: Must be "adi,adv7343"

Optional Properties :
- adi,power-mode-sleep-mode: on enable the current consumption is reduced to
			      micro ampere level. All DACs and the internal PLL
			      circuit are disabled.
- adi,power-mode-pll-ctrl: PLL and oversampling control. This control allows
			   internal PLL 1 circuit to be powered down and the
			   oversampling to be switched off.
- ad,adv7343-power-mode-dac: array configuring the power on/off DAC's 1..6,
			      0 = OFF and 1 = ON, Default value when this
			      property is not specified is <0 0 0 0 0 0>.
- ad,adv7343-sd-config-dac-out: array configure SD DAC Output's 1 and 2, 0 = OFF
				 and 1 = ON, Default value when this property is
				 not specified is <0 0>.

Example:

i2c0@1c22000 {
	...
	...

	adv7343@2a {
		compatible = "adi,adv7343";
		reg = <0x2a>;

		port {
			adv7343_1: endpoint {
					adi,power-mode-sleep-mode;
					adi,power-mode-pll-ctrl;
					/* Use DAC1..3, DAC6 */
					adi,dac-enable = <1 1 1 0 0 1>;
					/* Use SD DAC output 1 */
					adi,sd-dac-enable = <1 0>;
			};
		};
	};
	...
};
```
