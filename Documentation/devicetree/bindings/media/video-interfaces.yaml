## Documentation/devicetree/bindings/memory-controllers/atmel,ebi.txt
```
* Device tree bindings for Atmel EBI

The External Bus Interface (EBI) controller is a bus where you can connect
asynchronous (NAND, NOR, SRAM, ....) and synchronous memories (SDR/DDR SDRAMs).
The EBI provides a glue-less interface to asynchronous memories through the SMC
(Static Memory Controller).

Required properties:

- compatible:		"atmel,at91sam9260-ebi"
			"atmel,at91sam9261-ebi"
			"atmel,at91sam9263-ebi0"
			"atmel,at91sam9263-ebi1"
			"atmel,at91sam9rl-ebi"
			"atmel,at91sam9g45-ebi"
			"atmel,at91sam9x5-ebi"
			"atmel,sama5d3-ebi"

- reg:			Contains offset/length value for EBI memory mapping.
			This property might contain several entries if the EBI
			memory range is not contiguous

- #address-cells:	Must be 2.
			The first cell encodes the CS.
			The second cell encode the offset into the CS memory
			range.

- #size-cells:		Must be set to 1.

- ranges:		Encodes CS to memory region association.

- clocks:		Clock feeding the EBI controller.
			See clock-bindings.txt

Children device nodes are representing device connected to the EBI bus.

Required device node properties:

- reg:			Contains the chip-select id, the offset and the length
			of the memory region requested by the device.

EBI bus configuration will be defined directly in the device subnode.

Optional EBI/SMC properties:

- atmel,smc-bus-width:		width of the asynchronous device's data bus
				8, 16 or 32.
				Default to 8 when undefined.

- atmel,smc-byte-access-type	"write" or "select" (see Atmel datasheet).
				Default to "select" when undefined.

- atmel,smc-read-mode		"nrd" or "ncs".
				Default to "ncs" when undefined.

- atmel,smc-write-mode		"nwe" or "ncs".
				Default to "ncs" when undefined.

- atmel,smc-exnw-mode		"disabled", "frozen" or "ready".
				Default to "disabled" when undefined.

- atmel,smc-page-mode		enable page mode if present. The provided value
				defines the page size (supported values: 4, 8,
				16 and 32).

- atmel,smc-tdf-mode:		"normal" or "optimized". When set to
				"optimized" the data float time is optimized
				depending on the next device being accessed
				(next device setup time is subtracted to the
				current device data float time).
				Default to "normal" when undefined.

If at least one atmel,smc- property is defined the following SMC timing
properties become mandatory. In the other hand, if none of the atmel,smc-
properties are specified, we assume that the EBI bus configuration will be
handled by the sub-device driver, and none of those properties should be
defined.

All the timings are expressed in nanoseconds (see Atmel datasheet for a full
description).

- atmel,smc-ncs-rd-setup-ns
- atmel,smc-nrd-setup-ns
- atmel,smc-ncs-wr-setup-ns
- atmel,smc-nwe-setup-ns
- atmel,smc-ncs-rd-pulse-ns
- atmel,smc-nrd-pulse-ns
- atmel,smc-ncs-wr-pulse-ns
- atmel,smc-nwe-pulse-ns
- atmel,smc-nwe-cycle-ns
- atmel,smc-nrd-cycle-ns
- atmel,smc-tdf-ns

Example:

	ebi: ebi@10000000 {
		compatible = "atmel,sama5d3-ebi";
		#address-cells = <2>;
		#size-cells = <1>;
		atmel,smc = <&hsmc>;
		atmel,matrix = <&matrix>;
		reg = <0x10000000 0x10000000
		       0x40000000 0x30000000>;
		ranges = <0x0 0x0 0x10000000 0x10000000
			  0x1 0x0 0x40000000 0x10000000
			  0x2 0x0 0x50000000 0x10000000
			  0x3 0x0 0x60000000 0x10000000>;
		clocks = <&mck>;

		pinctrl-names = "default";
		pinctrl-0 = <&pinctrl_ebi_addr>;

		nor: flash@0,0 {
			compatible = "cfi-flash";
			#address-cells = <1>;
			#size-cells = <1>;
			reg = <0x0 0x0 0x1000000>;
			bank-width = <2>;

			atmel,smc-read-mode = "nrd";
			atmel,smc-write-mode = "nwe";
			atmel,smc-bus-width = <16>;
			atmel,smc-ncs-rd-setup-ns = <0>;
			atmel,smc-ncs-wr-setup-ns = <0>;
			atmel,smc-nwe-setup-ns = <8>;
			atmel,smc-nrd-setup-ns = <16>;
			atmel,smc-ncs-rd-pulse-ns = <84>;
			atmel,smc-ncs-wr-pulse-ns = <84>;
			atmel,smc-nrd-pulse-ns = <76>;
			atmel,smc-nwe-pulse-ns = <76>;
			atmel,smc-nrd-cycle-ns = <107>;
			atmel,smc-nwe-cycle-ns = <84>;
			atmel,smc-tdf-ns = <16>;
		};
	};
```

## Documentation/devicetree/bindings/memory-controllers/brcm,brcmstb-memc-ddr.yaml
```yaml
# SPDX-License-Identifier: (GPL-2.0-only OR BSD-2-Clause)
%YAML 1.2
---
$id: http://devicetree.org/schemas/memory-controllers/brcm,brcmstb-memc-ddr.yaml#
$schema: http://devicetree.org/meta-schemas/core.yaml#

title: Memory controller (MEMC) for Broadcom STB

maintainers:
  - Florian Fainelli <f.fainelli@gmail.com>

properties:
  compatible:
    items:
      - enum:
          - brcm,brcmstb-memc-ddr-rev-b.1.x
          - brcm,brcmstb-memc-ddr-rev-b.2.0
          - brcm,brcmstb-memc-ddr-rev-b.2.1
          - brcm,brcmstb-memc-ddr-rev-b.2.2
          - brcm,brcmstb-memc-ddr-rev-b.2.3
          - brcm,brcmstb-memc-ddr-rev-b.2.5
          - brcm,brcmstb-memc-ddr-rev-b.2.6
          - brcm,brcmstb-memc-ddr-rev-b.2.7
          - brcm,brcmstb-memc-ddr-rev-b.2.8
          - brcm,brcmstb-memc-ddr-rev-b.3.0
          - brcm,brcmstb-memc-ddr-rev-b.3.1
          - brcm,brcmstb-memc-ddr-rev-c.1.0
          - brcm,brcmstb-memc-ddr-rev-c.1.1
          - brcm,brcmstb-memc-ddr-rev-c.1.2
          - brcm,brcmstb-memc-ddr-rev-c.1.3
          - brcm,brcmstb-memc-ddr-rev-c.1.4
      - const: brcm,brcmstb-memc-ddr

  reg:
    maxItems: 1

  clock-frequency:
    description: DDR PHY frequency in Hz

required:
  - compatible
  - reg

additionalProperties: false

examples:
  - |
    memory-controller@9902000 {
        compatible = "brcm,brcmstb-memc-ddr-rev-c.1.1", "brcm,brcmstb-memc-ddr";
        reg = <0x9902000 0x600>;
        clock-frequency = <2133000000>;
    };
```

## Documentation/devicetree/bindings/memory-controllers/brcm,dpfe-cpu.txt
```
DDR PHY Front End (DPFE) for Broadcom STB
=========================================

DPFE and the DPFE firmware provide an interface for the host CPU to
communicate with the DCPU, which resides inside the DDR PHY.

There are three memory regions for interacting with the DCPU. These are
specified in a single reg property.

Required properties:
  - compatible: must be "brcm,bcm7271-dpfe-cpu", "brcm,bcm7268-dpfe-cpu"
    or "brcm,dpfe-cpu"
  - reg: must reference three register ranges
      - start address and length of the DCPU register space
      - start address and length of the DCPU data memory space
      - start address and length of the DCPU instruction memory space
  - reg-names: must contain "dpfe-cpu", "dpfe-dmem", and "dpfe-imem";
        they must be in the same order as the register declarations

Example:
	dpfe_cpu0: dpfe-cpu@f1132000 {
		compatible = "brcm,bcm7271-dpfe-cpu", "brcm,dpfe-cpu";
		reg =  <0xf1132000 0x180
			0xf1134000 0x1000
			0xf1138000 0x4000>;
		reg-names = "dpfe-cpu", "dpfe-dmem", "dpfe-imem";
	};
```

## Documentation/devicetree/bindings/memory-controllers/brcm,dpfe-cpu.yaml
```yaml
# SPDX-License-Identifier: (GPL-2.0-only OR BSD-2-Clause)
%YAML 1.2
---
$id: http://devicetree.org/schemas/memory-controllers/brcm,dpfe-cpu.yaml#
$schema: http://devicetree.org/meta-schemas/core.yaml#

title: DDR PHY Front End (DPFE) for Broadcom STB

maintainers:
  - Krzysztof Kozlowski <krzysztof.kozlowski@canonical.com>
  - Markus Mayer <mmayer@broadcom.com>

properties:
  compatible:
    items:
      - enum:
          - brcm,bcm7271-dpfe-cpu
          - brcm,bcm7268-dpfe-cpu
      - const: brcm,dpfe-cpu

  reg:
    items:
      - description: DCPU register space
      - description: DCPU data memory space
      - description: DCPU instruction memory space

  reg-names:
    items:
      - const: dpfe-cpu
      - const: dpfe-dmem
      - const: dpfe-imem

required:
  - compatible
  - reg
  - reg-names

additionalProperties: false

examples:
  - |
    dpfe-cpu@f1132000 {
        compatible = "brcm,bcm7271-dpfe-cpu", "brcm,dpfe-cpu";
        reg = <0xf1132000 0x180>,
              <0xf1134000 0x1000>,
              <0xf1138000 0x4000>;
        reg-names = "dpfe-cpu", "dpfe-dmem", "dpfe-imem";
    };
```

## Documentation/devicetree/bindings/memory-controllers/calxeda-ddr-ctrlr.yaml
```yaml
# SPDX-License-Identifier: (GPL-2.0-only OR BSD-2-Clause)
%YAML 1.2
---
$id: http://devicetree.org/schemas/memory-controllers/calxeda-ddr-ctrlr.yaml#
$schema: http://devicetree.org/meta-schemas/core.yaml#

title: Calxeda DDR memory controller

description: |
  The Calxeda DDR memory controller is initialised and programmed by the
  firmware, but an OS might want to read its registers for error reporting
  purposes and to learn about the DRAM topology.

maintainers:
  - Andre Przywara <andre.przywara@arm.com>

properties:
  compatible:
    enum:
      - calxeda,hb-ddr-ctrl
      - calxeda,ecx-2000-ddr-ctrl

  reg:
    maxItems: 1

  interrupts:
    maxItems: 1

required:
  - compatible
  - reg
  - interrupts

additionalProperties: false

examples:
  - |
    memory-controller@fff00000 {
        compatible = "calxeda,hb-ddr-ctrl";
        reg = <0xfff00000 0x1000>;
        interrupts = <0 91 4>;
    };
```

## Documentation/devicetree/bindings/memory-controllers/canaan,k210-sram.yaml
```yaml
# SPDX-License-Identifier: (GPL-2.0-only OR BSD-2-Clause)
%YAML 1.2
---
$id: http://devicetree.org/schemas/memory-controllers/canaan,k210-sram.yaml#
$schema: http://devicetree.org/meta-schemas/core.yaml#

title: Canaan K210 SRAM memory controller

description:
  The Canaan K210 SRAM memory controller is responsible for the system's 8 MiB
  of SRAM. The controller is initialised by the bootloader, which configures
  its clocks, before OS bringup.

maintainers:
  - Conor Dooley <conor@kernel.org>

properties:
  compatible:
    enum:
      - canaan,k210-sram

  clocks:
    minItems: 1
    items:
      - description: sram0 clock
      - description: sram1 clock
      - description: aisram clock

  clock-names:
    minItems: 1
    items:
      - const: sram0
      - const: sram1
      - const: aisram

required:
  - compatible
  - clocks
  - clock-names

additionalProperties: false

examples:
  - |
    #include <dt-bindings/clock/k210-clk.h>
    memory-controller {
        compatible = "canaan,k210-sram";
        clocks = <&sysclk K210_CLK_SRAM0>,
                 <&sysclk K210_CLK_SRAM1>,
                 <&sysclk K210_CLK_AI>;
        clock-names = "sram0", "sram1", "aisram";
    };
```

## Documentation/devicetree/bindings/memory-controllers/ddr/jedec,ddr4.yaml
```yaml
# SPDX-License-Identifier: (GPL-2.0-only OR BSD-2-Clause)
%YAML 1.2
---
$id: http://devicetree.org/schemas/memory-controllers/ddr/jedec,ddr4.yaml#
$schema: http://devicetree.org/meta-schemas/core.yaml#

title: DDR4 SDRAM compliant to JEDEC JESD79-4D

maintainers:
  - Krzysztof Kozlowski <krzk@kernel.org>

allOf:
  - $ref: jedec,sdram-props.yaml#

properties:
  compatible:
    items:
      - pattern: "^ddr4-[0-9a-f]{4},[a-z]{1,20}-[0-9a-f]{2}$"
      - const: jedec,ddr4

required:
  - compatible
  - density
  - io-width

unevaluatedProperties: false

examples:
  - |
    ddr {
        compatible = "ddr4-00ff,azaz-ff", "jedec,ddr4";
        density = <8192>;
        io-width = <8>;
    };
```

## Documentation/devicetree/bindings/memory-controllers/ddr/jedec,lpddr-channel.yaml
```yaml
# SPDX-License-Identifier: (GPL-2.0-only OR BSD-2-Clause)
%YAML 1.2
---
$id: http://devicetree.org/schemas/memory-controllers/ddr/jedec,lpddr-channel.yaml#
$schema: http://devicetree.org/meta-schemas/core.yaml#

title: LPDDR channel with chip/rank topology description

description:
  An LPDDR channel is a completely independent set of LPDDR pins (DQ, CA, CS,
  CK, etc.) that connect one or more LPDDR chips to a host system. The main
  purpose of this node is to overall LPDDR topology of the system, including the
  amount of individual LPDDR chips and the ranks per chip.

maintainers:
  - Julius Werner <jwerner@chromium.org>

properties:
  compatible:
    enum:
      - jedec,lpddr2-channel
      - jedec,lpddr3-channel
      - jedec,lpddr4-channel
      - jedec,lpddr5-channel

  io-width:
    description:
      The number of DQ pins in the channel. If this number is different
      from (a multiple of) the io-width of the LPDDR chip, that means that
      multiple instances of that type of chip are wired in parallel on this
      channel (with the channel's DQ pins split up between the different
      chips, and the CA, CS, etc. pins of the different chips all shorted
      together).  This means that the total physical memory controlled by a
      channel is equal to the sum of the densities of each rank on the
      connected LPDDR chip, times the io-width of the channel divided by
      the io-width of the LPDDR chip.
    enum:
      - 8
      - 16
      - 32
      - 64
      - 128

  "#address-cells":
    const: 1

  "#size-cells":
    const: 0

patternProperties:
  "^rank@[0-9]+$":
    type: object
    description:
      Each physical LPDDR chip may have one or more ranks. Ranks are
      internal but fully independent sub-units of the chip. Each LPDDR bus
      transaction on the channel targets exactly one rank, based on the
      state of the CS pins. Different ranks may have different densities and
      timing requirements.
    required:
      - reg

allOf:
  - if:
      properties:
        compatible:
          contains:
            const: jedec,lpddr2-channel
    then:
      patternProperties:
        "^rank@[0-9]+$":
          $ref: /schemas/memory-controllers/ddr/jedec,lpddr2.yaml#
  - if:
      properties:
        compatible:
          contains:
            const: jedec,lpddr3-channel
    then:
      patternProperties:
        "^rank@[0-9]+$":
          $ref: /schemas/memory-controllers/ddr/jedec,lpddr3.yaml#
  - if:
      properties:
        compatible:
          contains:
            const: jedec,lpddr4-channel
    then:
      patternProperties:
        "^rank@[0-9]+$":
          $ref: /schemas/memory-controllers/ddr/jedec,lpddr4.yaml#
  - if:
      properties:
        compatible:
          contains:
            const: jedec,lpddr5-channel
    then:
      patternProperties:
        "^rank@[0-9]+$":
          $ref: /schemas/memory-controllers/ddr/jedec,lpddr5.yaml#

required:
  - compatible
  - io-width
  - "#address-cells"
  - "#size-cells"

additionalProperties: false

examples:
  - |
    lpddr-channel0 {
      #address-cells = <1>;
      #size-cells = <0>;
      compatible = "jedec,lpddr3-channel";
      io-width = <32>;

      rank@0 {
        compatible = "lpddr3-ff,0100", "jedec,lpddr3";
        reg = <0>;
        density = <8192>;
        io-width = <16>;
        revision-id = <1 0>;
      };
    };

    lpddr-channel1 {
      #address-cells = <1>;
      #size-cells = <0>;
      compatible = "jedec,lpddr4-channel";
      io-width = <32>;

      rank@0 {
        compatible = "lpddr4-05,0301", "jedec,lpddr4";
        reg = <0>;
        density = <4096>;
        io-width = <32>;
        revision-id = <3 1>;
      };

      rank@1 {
        compatible = "lpddr4-05,0301", "jedec,lpddr4";
        reg = <1>;
        density = <2048>;
        io-width = <32>;
        revision-id = <3 1>;
      };
    };
```
