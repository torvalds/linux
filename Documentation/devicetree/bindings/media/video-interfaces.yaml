## Documentation/devicetree/bindings/memory-controllers/arm,pl172.yaml
```yaml
# SPDX-License-Identifier: (GPL-2.0-only OR BSD-2-Clause)
%YAML 1.2
---
$id: http://devicetree.org/schemas/memory-controllers/arm,pl172.yaml#
$schema: http://devicetree.org/meta-schemas/core.yaml#

title: ARM PL172/PL175/PL176 MultiPort Memory Controller

maintainers:
  - Frank Li <Frank.Li@nxp.com>

# We need a select here so we don't match all nodes with 'arm,primecell'
select:
  properties:
    compatible:
      contains:
        enum:
          - arm,pl172
          - arm,pl175
          - arm,pl176
  required:
    - compatible

properties:
  compatible:
    items:
      - enum:
          - arm,pl172
          - arm,pl175
          - arm,pl176
      - const: arm,primecell

  reg:
    maxItems: 1

  '#address-cells':
    const: 2

  '#size-cells':
    const: 1

  ranges: true

  clocks:
    maxItems: 2

  clock-names:
    items:
      - const: mpmcclk
      - const: apb_pclk

  clock-ranges: true

  resets:
    maxItems: 1

patternProperties:
  "^cs[0-9]$":
    type: object
    additionalProperties: false
    patternProperties:
      "^flash@[0-9],[0-9a-f]+$":
        type: object
        $ref: /schemas/mtd/mtd-physmap.yaml#
        unevaluatedProperties: false

      "^(gpio|sram)@[0-9],[0-9a-f]+$":
        type: object
        additionalProperties: true

    properties:
      '#address-cells':
        const: 2

      '#size-cells':
        const: 1

      ranges: true

      clocks:
        maxItems: 2

      clock-ranges: true

      mpmc,cs:
        $ref: /schemas/types.yaml#/definitions/uint32
        description:
          Chip select number. Indicates to the pl0172 driver
          which chipselect is used for accessing the memory.

      mpmc,memory-width:
        $ref: /schemas/types.yaml#/definitions/uint32
        enum: [8, 16, 32]
        description:
          Width of the chip select memory. Must be equal to either 8, 16 or 32.

      mpmc,async-page-mode:
        $ref: /schemas/types.yaml#/definitions/flag
        description:
          Enable asynchronous page mode.

      mpmc,cs-active-high:
        $ref: /schemas/types.yaml#/definitions/flag
        description:
          Set chip select polarity to active high.

      mpmc,byte-lane-low:
        $ref: /schemas/types.yaml#/definitions/flag
        description:
          Set byte lane state to low.

      mpmc,extended-wait:
        $ref: /schemas/types.yaml#/definitions/flag
        description:
          Enable extended wait.

      mpmc,buffer-enable:
        $ref: /schemas/types.yaml#/definitions/flag
        description:
          Enable write buffer, option is not supported by
          PL175 and PL176 controllers.

      mpmc,write-protect:
        $ref: /schemas/types.yaml#/definitions/flag
        description:
          Enable write protect.

      mpmc,read-enable-delay:
        $ref: /schemas/types.yaml#/definitions/uint32
        description:
          Delay from chip select assertion to read
          enable (RE signal) in nano seconds.

      mpmc,write-enable-delay:
        $ref: /schemas/types.yaml#/definitions/uint32
        description:
          Delay from chip select assertion to write
          enable (WE signal) in nano seconds.

      mpmc,output-enable-delay:
        $ref: /schemas/types.yaml#/definitions/uint32
        description:
          Delay from chip select assertion to output
          enable (OE signal) in nano seconds.

      mpmc,write-access-delay:
        $ref: /schemas/types.yaml#/definitions/uint32
        description:
          Delay from chip select assertion to write
          access in nano seconds.

      mpmc,read-access-delay:
        $ref: /schemas/types.yaml#/definitions/uint32
        description:
          Delay from chip select assertion to read
          access in nano seconds.

      mpmc,page-mode-read-delay:
        $ref: /schemas/types.yaml#/definitions/uint32
        description:
          Delay for asynchronous page mode sequential
          accesses in nano seconds.

      mpmc,turn-round-delay:
        $ref: /schemas/types.yaml#/definitions/uint32
        description:
          Delay between access to memory banks in nano
          seconds.

required:
  - compatible
  - reg
  - '#address-cells'
  - '#size-cells'
  - ranges
  - clocks
  - clock-names

additionalProperties: false

examples:
  - |
    #include <dt-bindings/clock/lpc18xx-ccu.h>

    memory-controller@40005000 {
        compatible = "arm,pl172", "arm,primecell";
        reg = <0x40005000 0x1000>;
        clocks = <&ccu1 CLK_CPU_EMCDIV>, <&ccu1 CLK_CPU_EMC>;
        clock-names = "mpmcclk", "apb_pclk";
        #address-cells = <2>;
        #size-cells = <1>;
        ranges = <0 0 0x1c000000 0x1000000
                  1 0 0x1d000000 0x1000000
                  2 0 0x1e000000 0x1000000
                  3 0 0x1f000000 0x1000000>;

        cs0 {
            #address-cells = <2>;
            #size-cells = <1>;
            ranges;

            mpmc,cs = <0>;
            mpmc,memory-width = <16>;
            mpmc,byte-lane-low;
            mpmc,write-enable-delay = <0>;
            mpmc,output-enable-delay = <0>;
            mpmc,read-enable-delay = <70>;
            mpmc,page-mode-read-delay = <70>;

            flash@0,0 {
                compatible = "sst,sst39vf320", "cfi-flash";
                reg = <0 0 0x400000>;
                bank-width = <2>;
                #address-cells = <1>;
                #size-cells = <1>;
                partition@0 {
                    label = "data";
                    reg = <0 0x400000>;
                };
            };
        };
    };
```

## Documentation/devicetree/bindings/memory-controllers/arm,pl353-smc.yaml
```yaml
# SPDX-License-Identifier: (GPL-2.0-only OR BSD-2-Clause)
%YAML 1.2
---
$id: http://devicetree.org/schemas/memory-controllers/arm,pl353-smc.yaml#
$schema: http://devicetree.org/meta-schemas/core.yaml#

title: ARM PL353 Static Memory Controller (SMC) device-tree bindings

maintainers:
  - Miquel Raynal <miquel.raynal@bootlin.com>
  - Naga Sureshkumar Relli <naga.sureshkumar.relli@xilinx.com>

description:
  The PL353 Static Memory Controller is a bus where you can connect two kinds
  of memory interfaces, which are NAND and memory mapped interfaces (such as
  SRAM or NOR).

# We need a select here so we don't match all nodes with 'arm,primecell'
select:
  properties:
    compatible:
      contains:
        const: arm,pl353-smc-r2p1
  required:
    - compatible

properties:
  $nodename:
    pattern: "^memory-controller@[0-9a-f]+$"

  compatible:
    items:
      - const: arm,pl353-smc-r2p1
      - const: arm,primecell

  "#address-cells":
    const: 2

  "#size-cells":
    const: 1

  reg:
    items:
      - description:
          Configuration registers for the host and sub-controllers.
          The three chip select regions are defined in 'ranges'.

  clocks:
    items:
      - description: clock for the memory device bus
      - description: main clock of the SMC

  clock-names:
    items:
      - const: memclk
      - const: apb_pclk

  ranges:
    minItems: 1
    maxItems: 3
    description: |
      Memory bus areas for interacting with the devices. Reflects
      the memory layout with four integer values following:
      <cs-number> 0 <offset> <size>
    items:
      - description: NAND bank 0
      - description: NOR/SRAM bank 0
      - description: NOR/SRAM bank 1

  interrupts: true

patternProperties:
  "@[0-3],[a-f0-9]+$":
    type: object
    description: |
      The child device node represents the controller connected to the SMC
      bus. The controller can be a NAND controller or a pair of any memory
      mapped controllers such as NOR and SRAM controllers.

    properties:
      compatible:
        description:
          Compatible of memory controller.

      reg:
        items:
          - items:
              - description: |
                  Chip-select ID, as in the parent range property.
                minimum: 0
                maximum: 2
              - description: |
                  Offset of the memory region requested by the device.
              - description: |
                  Length of the memory region requested by the device.

    required:
      - compatible
      - reg

required:
  - compatible
  - reg
  - clock-names
  - clocks
  - "#address-cells"
  - "#size-cells"
  - ranges

additionalProperties: false

examples:
  - |
    smcc: memory-controller@e000e000 {
      compatible = "arm,pl353-smc-r2p1", "arm,primecell";
      reg = <0xe000e000 0x0001000>;
      clock-names = "memclk", "apb_pclk";
      clocks = <&clkc 11>, <&clkc 44>;
      ranges = <0x0 0x0 0xe1000000 0x1000000 /* Nand CS region */
                0x1 0x0 0xe2000000 0x2000000 /* SRAM/NOR CS0 region */
                0x2 0x0 0xe4000000 0x2000000>; /* SRAM/NOR CS1 region */
      #address-cells = <2>;
      #size-cells = <1>;

      nfc0: nand-controller@0,0 {
        compatible = "arm,pl353-nand-r2p1";
        reg = <0 0 0x1000000>;
        #address-cells = <1>;
        #size-cells = <0>;
      };
    };
```

## Documentation/devicetree/bindings/memory-controllers/arm,pl35x-smc.yaml
```yaml
# SPDX-License-Identifier: (GPL-2.0-only OR BSD-2-Clause)
%YAML 1.2
---
$id: http://devicetree.org/schemas/memory-controllers/arm,pl35x-smc.yaml#
$schema: http://devicetree.org/meta-schemas/core.yaml#

title: Arm PL35x Series Static Memory Controller (SMC)

maintainers:
  - Miquel Raynal <miquel.raynal@bootlin.com>
  - Naga Sureshkumar Relli <naga.sureshkumar.relli@xilinx.com>

description: |
  The PL35x Static Memory Controller is a bus where you can connect two kinds
  of memory interfaces, which are NAND and memory mapped interfaces (such as
  SRAM or NOR) depending on the specific configuration.

  The TRM is available here:
  https://documentation-service.arm.com/static/5e8e2524fd977155116a58aa

# We need a select here so we don't match all nodes with 'arm,primecell'
select:
  properties:
    compatible:
      contains:
        enum:
          - arm,pl353-smc-r2p1
          - arm,pl354
  required:
    - compatible

properties:
  $nodename:
    pattern: "^memory-controller@[0-9a-f]+$"

  compatible:
    items:
      - enum:
          - arm,pl353-smc-r2p1
          - arm,pl354
      - const: arm,primecell

  "#address-cells":
    const: 2

  "#size-cells":
    const: 1

  reg:
    items:
      - description:
          Configuration registers for the host and sub-controllers.
          The three chip select regions are defined in 'ranges'.

  clocks:
    minItems: 1
    maxItems: 2

  clock-names:
    minItems: 1
    maxItems: 2

  ranges:
    minItems: 1
    maxItems: 8

  interrupts:
    minItems: 1
    items:
      - description: Combined or Memory interface 0 IRQ
      - description: Memory interface 1 IRQ

patternProperties:
  "@[0-7],[a-f0-9]+$":
    type: object
    description: |
      The child device node represents the controller connected to the SMC
      bus. The controller can be a NAND controller or a pair of any memory
      mapped controllers such as NOR and SRAM controllers.

    properties:
      compatible:
        description:
          Compatible of memory controller.

      reg:
        items:
          - items:
              - description: |
                  Chip-select ID, as in the parent range property.
                minimum: 0
                maximum: 7
              - description: |
                  Offset of the memory region requested by the device.
              - description: |
                  Length of the memory region requested by the device.

    required:
      - compatible
      - reg

required:
  - compatible
  - reg
  - clock-names
  - clocks

additionalProperties: false

allOf:
  - if:
      properties:
        compatible:
          contains:
            const: arm,pl354
    then:
      properties:
        clocks:
          # According to TRM, really should be 3 clocks
          maxItems: 1

        clock-names:
          const: apb_pclk

    else:
      properties:
        clocks:
          items:
            - description: clock for the memory device bus
            - description: main clock of the SMC

        clock-names:
          items:
            - const: memclk
            - const: apb_pclk

examples:
  - |
    smcc: memory-controller@e000e000 {
      compatible = "arm,pl353-smc-r2p1", "arm,primecell";
      reg = <0xe000e000 0x0001000>;
      clock-names = "memclk", "apb_pclk";
      clocks = <&clkc 11>, <&clkc 44>;
      ranges = <0x0 0x0 0xe1000000 0x1000000 /* Nand CS region */
                0x1 0x0 0xe2000000 0x2000000 /* SRAM/NOR CS0 region */
                0x2 0x0 0xe4000000 0x2000000>; /* SRAM/NOR CS1 region */
      #address-cells = <2>;
      #size-cells = <1>;

      nfc0: nand-controller@0,0 {
        compatible = "arm,pl353-nand-r2p1";
        reg = <0 0 0x1000000>;
        #address-cells = <1>;
        #size-cells = <0>;
      };
    };
```

## Documentation/devicetree/bindings/memory-controllers/ath79-ddr-controller.txt
```
Binding for Qualcomm  Atheros AR7xxx/AR9xxx DDR controller

The DDR controller of the AR7xxx and AR9xxx families provides an interface
to flush the FIFO between various devices and the DDR. This is mainly used
by the IRQ controller to flush the FIFO before running the interrupt handler
of such devices.

Required properties:

- compatible: has to be "qca,<soc-type>-ddr-controller",
  "qca,[ar7100|ar7240]-ddr-controller" as fallback.
  On SoC with PCI support "qca,ar7100-ddr-controller" should be used as
  fallback, otherwise "qca,ar7240-ddr-controller" should be used.
- reg: Base address and size of the controller's memory area
- #qca,ddr-wb-channel-cells: Specifies the number of cells needed to encode
			     the write buffer channel index, should be 1.

Example:

	ddr_ctrl: memory-controller@18000000 {
		compatible = "qca,ar9132-ddr-controller",
				"qca,ar7240-ddr-controller";
		reg = <0x18000000 0x100>;

		#qca,ddr-wb-channel-cells = <1>;
	};

	...

	interrupt-controller {
		...
		qca,ddr-wb-channel-interrupts = <2>, <3>, <4>, <5>;
		qca,ddr-wb-channels = <&ddr_ctrl 3>, <&ddr_ctrl 2>,
					<&ddr_ctrl 0>, <&ddr_ctrl 1>;
	};
```
