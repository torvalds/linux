## Documentation/devicetree/bindings/iommu/rockchip,iommu.txt
```
Rockchip IOMMU
==============

A Rockchip DRM iommu translates io virtual addresses to physical addresses for
its master device.  Each slave device is bound to a single master device, and
shares its clocks, power domain and irq.

Required properties:
- compatible      : Should be "rockchip,iommu"
- reg             : Address space for the configuration registers
- interrupts      : Interrupt specifier for the IOMMU instance
- interrupt-names : Interrupt name for the IOMMU instance
- clocks          : Iommu share clocks with master, to make map buffer success
                    when master disable clocks, iommu should control related
                    clocks itself
- clock-names     : Iommu related clock name, it should be "aclk" and "hclk" on
                    RK3399 SoC platform
- power-domains   : Iommu share power-domains with master, it have the same purpose
                    with the clocks
- #iommu-cells    : Should be <0>.  This indicates the iommu is a
                    "single-master" device, and needs no additional information
                    to associate with its master device.  See:
                    Documentation/devicetree/bindings/iommu/iommu.txt

Optional properties:
- rockchip,disable-mmu-reset 	: Don't use the mmu reset operation.
				  Some mmu instances may produce unexpected results
				  when the reset operation is used.
- rk_iommu,disable_reset_quirk  : Same with above, for compatible with previous code

- rockchip,skip-mmu-read 	: Some iommu instances are not able to be read, skip
				  reading operation to make iommu work as normal

Example:

	vopl_mmu: iommu@ff8f3f00 {
		compatible = "rockchip,iommu";
		reg = <0x0 0xff8f3f00 0x0 0x100>;
		interrupts = <GIC_SPI 119 IRQ_TYPE_LEVEL_HIGH 0>;
		interrupt-names = "vopl_mmu";
		clocks = <&cru ACLK_VOP1>, <&cru HCLK_VOP1>;
		clock-names = "aclk", "hclk";
		power-domains = <&power RK3399_PD_VOPL>;
		#iommu-cells = <0>;
	};
```

## Documentation/devicetree/bindings/iommu/rockchip,iommu.yaml
```yaml
# SPDX-License-Identifier: GPL-2.0-only
%YAML 1.2
---
$id: http://devicetree.org/schemas/iommu/rockchip,iommu.yaml#
$schema: http://devicetree.org/meta-schemas/core.yaml#

title: Rockchip IOMMU

maintainers:
  - Heiko Stuebner <heiko@sntech.de>

description: |+
  A Rockchip DRM iommu translates io virtual addresses to physical addresses for
  its master device. Each slave device is bound to a single master device and
  shares its clocks, power domain and irq.

  For information on assigning IOMMU controller to its peripheral devices,
  see generic IOMMU bindings.

properties:
  compatible:
    enum:
      - rockchip,iommu
      - rockchip,rk3568-iommu

  reg:
    items:
      - description: configuration registers for MMU instance 0
      - description: configuration registers for MMU instance 1
    minItems: 1

  interrupts:
    items:
      - description: interruption for MMU instance 0
      - description: interruption for MMU instance 1
    minItems: 1

  clocks:
    items:
      - description: Core clock
      - description: Interface clock

  clock-names:
    items:
      - const: aclk
      - const: iface

  "#iommu-cells":
    const: 0

  power-domains:
    maxItems: 1

  rockchip,disable-mmu-reset:
    $ref: /schemas/types.yaml#/definitions/flag
    description: |
      Do not use the mmu reset operation.
      Some mmu instances may produce unexpected results
      when the reset operation is used.

required:
  - compatible
  - reg
  - interrupts
  - clocks
  - clock-names
  - "#iommu-cells"

additionalProperties: false

examples:
  - |
    #include <dt-bindings/clock/rk3399-cru.h>
    #include <dt-bindings/interrupt-controller/arm-gic.h>

    vopl_mmu: iommu@ff940300 {
      compatible = "rockchip,iommu";
      reg = <0xff940300 0x100>;
      interrupts = <GIC_SPI 16 IRQ_TYPE_LEVEL_HIGH>;
      clocks = <&cru ACLK_VOP1>, <&cru HCLK_VOP1>;
      clock-names = "aclk", "iface";
      #iommu-cells = <0>;
    };
```

## Documentation/devicetree/bindings/iommu/rockchip,rk32-iommu.txt
```
ROCKCHIP rk32 IOMMU H/W

Required properties:
- compatible : "iommu,iep_mmu"
- reg : Should contain address and length for each
  of the IOMMU register blocks.
- interrupts : Should contain irq type,irq no,and level type 

Example:
	iep_mmu {
		dbgname = "iep";
		compatible = "iommu,iep_mmu";
		reg = <0xff900800 0x100>;
		interrupts = <GIC_SPI 17 IRQ_TYPE_LEVEL_HIGH>;
		interrupt-names = "iep_mmu";
	};
```

## Documentation/devicetree/bindings/iommu/samsung,exynos4210-sysmmu.txt
```
Samsung Exynos IOMMU H/W, System MMU (System Memory Management Unit)

Samsung's Exynos architecture contains System MMUs that enables scattered
physical memory chunks visible as a contiguous region to DMA-capable peripheral
devices like MFC, FIMC, FIMD, GScaler, FIMC-IS and so forth.

System MMU is an IOMMU and supports identical translation table format to
ARMv7 translation tables with minimum set of page properties including access
permissions, shareability and security protection. In addition, System MMU has
another capabilities like L2 TLB or block-fetch buffers to minimize translation
latency.

System MMUs are in many to one relation with peripheral devices, i.e. single
peripheral device might have multiple System MMUs (usually one for each bus
master), but one System MMU can handle transactions from only one peripheral
device. The relation between a System MMU and the peripheral device needs to be
defined in device node of the peripheral device.

MFC in all Exynos SoCs and FIMD, M2M Scalers and G2D in Exynos5420 has 2 System
MMUs.
* MFC has one System MMU on its left and right bus.
* FIMD in Exynos5420 has one System MMU for window 0 and 4, the other system MMU
  for window 1, 2 and 3.
* M2M Scalers and G2D in Exynos5420 has one System MMU on the read channel and
  the other System MMU on the write channel.
The drivers must consider how to handle those System MMUs. One of the idea is
to implement child devices or sub-devices which are the client devices of the
System MMU.

Required properties:
- compatible: Should be one of:
		"samsung,sysmmu-v1"
		"samsung,sysmmu-v2"
		"samsung,sysmmu-v3.1"
		"samsung,sysmmu-v3.2"
		"samsung,sysmmu-v3.3"

- reg: A tuple of base address and size of System MMU registers.
- interrupt-parent: The phandle of the interrupt controller of System MMU
- interrupts: An interrupt specifier for interrupt signal of System MMU,
	      according to the format defined by a particular interrupt
	      controller.
- clock-names: Should be "sysmmu" if the System MMU is needed to gate its clock.
               Please refer to the following documents:
	       Documentation/devicetree/bindings/clock/clock-bindings.txt
	       Documentation/devicetree/bindings/clock/exynos4-clock.txt
	       Documentation/devicetree/bindings/clock/exynos5250-clock.txt
	       Documentation/devicetree/bindings/clock/exynos5420-clock.txt
	       Optional "master" if the clock to the System MMU is gated by
	       another gate clock other than "sysmmu". The System MMU driver
	       sets "master" the parent of "sysmmu".
	       Exynos4 SoCs, there needs no "master" clockj.
	       Exynos5 SoCs, some System MMUs must have "master" clocks.
- clocks: Required if the System MMU is needed to gate its clock.
	  Please refer to the documents listed above.
- samsung,power-domain: Required if the System MMU is needed to gate its power.
	  Please refer to the following document:
	  Documentation/devicetree/bindings/arm/exynos/power_domain.txt
- mmu-masters: A phandle to device nodes representing the master for which
               the System MMU can provide a translation. Any additional values
	       after the phandle will be ignored because a System MMU never
	       have two or more masters. "#stream-id-cells" specified in the
	       master's node will be also ignored.
	       If more than one phandle is specified, only the first phandle
	       will be treated.

Examples:
	gsc_0: gsc@13e00000 {
		compatible = "samsung,exynos5-gsc";
		reg = <0x13e00000 0x1000>;
		interrupts = <0 85 0>;
		samsung,power-domain = <&pd_gsc>;
		clocks = <&clock 256>;
		clock-names = "gscl";
	};

	sysmmu_gsc0: sysmmu@13E80000 {
		compatible = "samsung,exynos4210-sysmmu";
		reg = <0x13E80000 0x1000>;
		interrupt-parent = <&combiner>;
		interrupts = <2 0>;
		clock-names = "sysmmu", "master";
		clocks = <&clock 262>, <&clock 256>;
		samsung,power-domain = <&pd_gsc>;
		mmu-masters = <&gsc_0>;
	};
```

## Documentation/devicetree/bindings/iommu/samsung,sysmmu.txt
```
Samsung Exynos IOMMU H/W, System MMU (System Memory Management Unit)

Samsung's Exynos architecture contains System MMUs that enables scattered
physical memory chunks visible as a contiguous region to DMA-capable peripheral
devices like MFC, FIMC, FIMD, GScaler, FIMC-IS and so forth.

System MMU is an IOMMU and supports identical translation table format to
ARMv7 translation tables with minimum set of page properties including access
permissions, shareability and security protection. In addition, System MMU has
another capabilities like L2 TLB or block-fetch buffers to minimize translation
latency.

System MMUs are in many to one relation with peripheral devices, i.e. single
peripheral device might have multiple System MMUs (usually one for each bus
master), but one System MMU can handle transactions from only one peripheral
device. The relation between a System MMU and the peripheral device needs to be
defined in device node of the peripheral device.

MFC in all Exynos SoCs and FIMD, M2M Scalers and G2D in Exynos5420 has 2 System
MMUs.
* MFC has one System MMU on its left and right bus.
* FIMD in Exynos5420 has one System MMU for window 0 and 4, the other system MMU
  for window 1, 2 and 3.
* M2M Scalers and G2D in Exynos5420 has one System MMU on the read channel and
  the other System MMU on the write channel.

For information on assigning System MMU controller to its peripheral devices,
see generic IOMMU bindings.

Required properties:
- compatible: Should be "samsung,exynos-sysmmu"
- reg: A tuple of base address and size of System MMU registers.
- #iommu-cells: Should be <0>.
- interrupt-parent: The phandle of the interrupt controller of System MMU
- interrupts: An interrupt specifier for interrupt signal of System MMU,
	      according to the format defined by a particular interrupt
	      controller.
- clock-names: Should be "sysmmu" or a pair of "aclk" and "pclk" to gate
	       SYSMMU core clocks.
	       Optional "master" if the clock to the System MMU is gated by
	       another gate clock other core  (usually main gate clock
	       of peripheral device this SYSMMU belongs to).
- clocks: Phandles for respective clocks described by clock-names.
- power-domains: Required if the System MMU is needed to gate its power.
	  Please refer to the following document:
	  Documentation/devicetree/bindings/power/pd-samsung.txt

Examples:
	gsc_0: gsc@13e00000 {
		compatible = "samsung,exynos5-gsc";
		reg = <0x13e00000 0x1000>;
		interrupts = <0 85 0>;
		power-domains = <&pd_gsc>;
		clocks = <&clock CLK_GSCL0>;
		clock-names = "gscl";
		iommus = <&sysmmu_gsc0>;
	};

	sysmmu_gsc0: sysmmu@13E80000 {
		compatible = "samsung,exynos-sysmmu";
		reg = <0x13E80000 0x1000>;
		interrupt-parent = <&combiner>;
		interrupts = <2 0>;
		clock-names = "sysmmu", "master";
		clocks = <&clock CLK_SMMU_GSCL0>, <&clock CLK_GSCL0>;
		power-domains = <&pd_gsc>;
		#iommu-cells = <0>;
	};
```

## Documentation/devicetree/bindings/iommu/samsung,sysmmu.yaml
```yaml
# SPDX-License-Identifier: GPL-2.0
%YAML 1.2
---
$id: http://devicetree.org/schemas/iommu/samsung,sysmmu.yaml#
$schema: http://devicetree.org/meta-schemas/core.yaml#

title: Samsung Exynos IOMMU H/W, System MMU (System Memory Management Unit)

maintainers:
  - Marek Szyprowski <m.szyprowski@samsung.com>

description: |+
  Samsung's Exynos architecture contains System MMUs that enables scattered
  physical memory chunks visible as a contiguous region to DMA-capable peripheral
  devices like MFC, FIMC, FIMD, GScaler, FIMC-IS and so forth.

  System MMU is an IOMMU and supports identical translation table format to
  ARMv7 translation tables with minimum set of page properties including access
  permissions, shareability and security protection. In addition, System MMU has
  another capabilities like L2 TLB or block-fetch buffers to minimize translation
  latency.

  System MMUs are in many to one relation with peripheral devices, i.e. single
  peripheral device might have multiple System MMUs (usually one for each bus
  master), but one System MMU can handle transactions from only one peripheral
  device. The relation between a System MMU and the peripheral device needs to be
  defined in device node of the peripheral device.

  MFC in all Exynos SoCs and FIMD, M2M Scalers and G2D in Exynos5420 has 2 System
  MMUs.
  * MFC has one System MMU on its left and right bus.
  * FIMD in Exynos5420 has one System MMU for window 0 and 4, the other system MMU
    for window 1, 2 and 3.
  * M2M Scalers and G2D in Exynos5420 has one System MMU on the read channel and
    the other System MMU on the write channel.

  For information on assigning System MMU controller to its peripheral devices,
  see generic IOMMU bindings.

properties:
  compatible:
    const: samsung,exynos-sysmmu

  reg:
    maxItems: 1

  interrupts:
    maxItems: 1

  clocks:
    minItems: 1
    maxItems: 2

  clock-names:
    oneOf:
      - items:
          - const: sysmmu
      - items:
          - const: sysmmu
          - const: master
      - items:
          - const: aclk
          - const: pclk

  "#iommu-cells":
    const: 0

  power-domains:
    description: |
      Required if the System MMU is needed to gate its power.
      Please refer to the following document:
      Documentation/devicetree/bindings/power/pd-samsung.yaml
    maxItems: 1

required:
  - compatible
  - reg
  - interrupts
  - clocks
  - clock-names
  - "#iommu-cells"

additionalProperties: false

examples:
  - |
    #include <dt-bindings/clock/exynos5250.h>

    sysmmu_gsc0: iommu@13e80000 {
      compatible = "samsung,exynos-sysmmu";
      reg = <0x13E80000 0x1000>;
      interrupt-parent = <&combiner>;
      interrupts = <2 0>;
      clock-names = "sysmmu", "master";
      clocks = <&clock CLK_SMMU_GSCL0>,
               <&clock CLK_GSCL0>;
      power-domains = <&pd_gsc>;
      #iommu-cells = <0>;
    };
```

## Documentation/devicetree/bindings/iommu/sprd,iommu.yaml
```yaml
# SPDX-License-Identifier: (GPL-2.0-only OR BSD-2-Clause)
# Copyright 2020 Unisoc Inc.
%YAML 1.2
---
$id: http://devicetree.org/schemas/iommu/sprd,iommu.yaml#
$schema: http://devicetree.org/meta-schemas/core.yaml#

title: Unisoc IOMMU and Multi-media MMU

maintainers:
  - Chunyan Zhang <zhang.lyra@gmail.com>

properties:
  compatible:
    enum:
      - sprd,iommu-v1

  "#iommu-cells":
    const: 0
    description:
      Unisoc IOMMUs are all single-master IOMMU devices, therefore no
      additional information needs to associate with its master device.
      Please refer to the generic bindings document for more details,
      Documentation/devicetree/bindings/iommu/iommu.txt

  reg:
    maxItems: 1

  clocks:
    description:
      Reference to a gate clock phandle, since access to some of IOMMUs are
      controlled by gate clock, but this is not required.

required:
  - compatible
  - reg
  - "#iommu-cells"

additionalProperties: false

examples:
  - |
    iommu_disp: iommu@63000800 {
      compatible = "sprd,iommu-v1";
      reg = <0x63000800 0x80>;
      #iommu-cells = <0>;
    };

  - |
    iommu_jpg: iommu@62300300 {
      compatible = "sprd,iommu-v1";
      reg = <0x62300300 0x80>;
      #iommu-cells = <0>;
      clocks = <&mm_gate 1>;
    };

...
```
