## Documentation/devicetree/bindings/iommu/ti,omap-iommu.txt
```
OMAP2+ IOMMU

Required properties:
- compatible : Should be one of,
		"ti,omap2-iommu" for OMAP2/OMAP3 IOMMU instances
		"ti,omap4-iommu" for OMAP4/OMAP5 IOMMU instances
		"ti,dra7-dsp-iommu" for DRA7xx DSP IOMMU instances
		"ti,dra7-iommu" for DRA7xx IOMMU instances
- ti,hwmods  : Name of the hwmod associated with the IOMMU instance
- reg        : Address space for the configuration registers
- interrupts : Interrupt specifier for the IOMMU instance
- #iommu-cells : Should be 0. OMAP IOMMUs are all "single-master" devices,
                 and needs no additional data in the pargs specifier. Please
                 also refer to the generic bindings document for more info
                 on this property,
                     Documentation/devicetree/bindings/iommu/iommu.txt

Optional properties:
- ti,#tlb-entries : Number of entries in the translation look-aside buffer.
                    Should be either 8 or 32 (default: 32)
- ti,iommu-bus-err-back : Indicates the IOMMU instance supports throwing
		          back a bus error response on MMU faults.
- ti,syscon-mmuconfig : Should be a pair of the phandle to the DSP_SYSTEM
                        syscon node that contains the additional control
                        register for enabling the MMU, and the MMU instance
                        number (0-indexed) within the sub-system. This property
                        is required for DSP IOMMU instances on DRA7xx SoCs. The
                        instance number should be 0 for DSP MDMA MMUs and 1 for
                        DSP EDMA MMUs.

Example:
	/* OMAP3 ISP MMU */
	mmu_isp: mmu@480bd400 {
		#iommu-cells = <0>;
		compatible = "ti,omap2-iommu";
		reg = <0x480bd400 0x80>;
		interrupts = <24>;
		ti,hwmods = "mmu_isp";
		ti,#tlb-entries = <8>;
	};

	/* DRA74x DSP2 MMUs */
	mmu0_dsp2: mmu@41501000 {
		compatible = "ti,dra7-dsp-iommu";
		reg = <0x41501000 0x100>;
		interrupts = <GIC_SPI 146 IRQ_TYPE_LEVEL_HIGH>;
		ti,hwmods = "mmu0_dsp2";
		#iommu-cells = <0>;
		ti,syscon-mmuconfig = <&dsp2_system 0x0>;
	};

	mmu1_dsp2: mmu@41502000 {
		compatible = "ti,dra7-dsp-iommu";
		reg = <0x41502000 0x100>;
		interrupts = <GIC_SPI 147 IRQ_TYPE_LEVEL_HIGH>;
		ti,hwmods = "mmu1_dsp2";
		#iommu-cells = <0>;
		ti,syscon-mmuconfig = <&dsp2_system 0x1>;
	};
```

## Documentation/devicetree/bindings/iommu/verisilicon,iommu.yaml
```yaml
# SPDX-License-Identifier: (GPL-2.0-only OR BSD-2-Clause)
%YAML 1.2
---
$id: http://devicetree.org/schemas/iommu/verisilicon,iommu.yaml#
$schema: http://devicetree.org/meta-schemas/core.yaml#

title: Verisilicon IOMMU

maintainers:
  - Benjamin Gaignard <benjamin.gaignard@collabora.com>

description: |+
  A Versilicon iommu translates io virtual addresses to physical addresses for
  its associated video decoder.

properties:
  compatible:
    items:
      - const: rockchip,rk3588-av1-iommu
      - const: verisilicon,iommu-1.2

  reg:
    maxItems: 1

  interrupts:
    maxItems: 1

  clocks:
    items:
      - description: Core clock
      - description: Interface clock

  clock-names:
    items:
      - const: core
      - const: iface

  "#iommu-cells":
    const: 0

  power-domains:
    maxItems: 1

required:
  - compatible
  - reg
  - interrupts
  - clocks
  - clock-names
  - "#iommu-cells"

additionalProperties: false

examples:
  - |
    #include <dt-bindings/clock/rockchip,rk3588-cru.h>
    #include <dt-bindings/interrupt-controller/arm-gic.h>

    bus {
      #address-cells = <2>;
      #size-cells = <2>;

      iommu@fdca0000 {
        compatible = "rockchip,rk3588-av1-iommu","verisilicon,iommu-1.2";
        reg = <0x0 0xfdca0000 0x0 0x600>;
        interrupts = <GIC_SPI 109 IRQ_TYPE_LEVEL_HIGH 0>;
        clocks = <&cru ACLK_AV1>, <&cru PCLK_AV1>;
        clock-names = "core", "iface";
        #iommu-cells = <0>;
      };
    };
```

## Documentation/devicetree/bindings/iommu/xen,grant-dma.yaml
```yaml
# SPDX-License-Identifier: (GPL-2.0-only OR BSD-2-Clause)
%YAML 1.2
---
$id: http://devicetree.org/schemas/iommu/xen,grant-dma.yaml#
$schema: http://devicetree.org/meta-schemas/core.yaml#

title: Xen specific IOMMU for virtualized devices (e.g. virtio)

maintainers:
  - Stefano Stabellini <sstabellini@kernel.org>

description:
  The Xen IOMMU represents the Xen grant table interface. Grant mappings
  are to be used with devices connected to the Xen IOMMU using the "iommus"
  property, which also specifies the ID of the backend domain.
  The binding is required to restrict memory access using Xen grant mappings.

properties:
  compatible:
    const: xen,grant-dma

  '#iommu-cells':
    const: 1
    description:
      The single cell is the domid (domain ID) of the domain where the backend
      is running.

required:
  - compatible
  - "#iommu-cells"

additionalProperties: false

examples:
  - |
    iommu {
        compatible = "xen,grant-dma";
        #iommu-cells = <1>;
    };
```

## Documentation/devicetree/bindings/ipmi/aspeed,ast2400-ibt-bmc.txt
```
* Aspeed BT (Block Transfer) IPMI interface

The Aspeed SOCs (AST2400 and AST2500) are commonly used as BMCs
(BaseBoard Management Controllers) and the BT interface can be used to
perform in-band IPMI communication with their host.

Required properties:

- compatible : should be one of
	"aspeed,ast2400-ibt-bmc"
	"aspeed,ast2500-ibt-bmc"
	"aspeed,ast2600-ibt-bmc"
- reg: physical address and size of the registers

Optional properties:

- interrupts: interrupt generated by the BT interface. without an
  interrupt, the driver will operate in poll mode.

Example:

	ibt@1e789140 {
		compatible = "aspeed,ast2400-ibt-bmc";
		reg = <0x1e789140 0x18>;
		interrupts = <8>;
	};
```

## Documentation/devicetree/bindings/ipmi/aspeed,ast2400-ibt-bmc.yaml
```yaml
# SPDX-License-Identifier: (GPL-2.0-only OR BSD-2-Clause)
%YAML 1.2
---
$id: http://devicetree.org/schemas/ipmi/aspeed,ast2400-ibt-bmc.yaml#
$schema: http://devicetree.org/meta-schemas/core.yaml#

title: Aspeed Block Transfer (BT) IPMI interface

maintainers:
  - Joel Stanley <joel@jms.id.au>

properties:
  compatible:
    enum:
      - aspeed,ast2400-ibt-bmc
      - aspeed,ast2500-ibt-bmc
      - aspeed,ast2600-ibt-bmc

  reg:
    maxItems: 1

  clocks:
    maxItems: 1

  interrupts:
    maxItems: 1

required:
  - compatible
  - reg
  - clocks

additionalProperties: false

examples:
  - |
    #include <dt-bindings/clock/aspeed-clock.h>

    bt@1e789140 {
        compatible = "aspeed,ast2400-ibt-bmc";
        reg = <0x1e789140 0x18>;
        interrupts = <8>;
        clocks = <&syscon ASPEED_CLK_GATE_LCLK>;
    };
```

## Documentation/devicetree/bindings/ipmi/aspeed,ast2400-kcs-bmc.yaml
```yaml
# SPDX-License-Identifier: (GPL-2.0-only OR BSD-2-Clause)
%YAML 1.2
---
$id: http://devicetree.org/schemas/ipmi/aspeed,ast2400-kcs-bmc.yaml#
$schema: http://devicetree.org/meta-schemas/core.yaml#

title: ASPEED BMC KCS Devices

maintainers:
  - Andrew Jeffery <andrew@aj.id.au>

description: |
  The Aspeed BMC SoCs typically use the Keyboard-Controller-Style (KCS)
  interfaces on the LPC bus for in-band IPMI communication with their host.

properties:
  compatible:
    oneOf:
      - description: Channel ID derived from reg
        items:
          enum:
            - aspeed,ast2400-kcs-bmc-v2
            - aspeed,ast2500-kcs-bmc-v2
            - aspeed,ast2600-kcs-bmc

      - description: Old-style with explicit channel ID, no reg
        deprecated: true
        items:
          enum:
            - aspeed,ast2400-kcs-bmc
            - aspeed,ast2500-kcs-bmc

  interrupts:
    maxItems: 1

  reg:
    # maxItems: 3
    items:
      - description: IDR register
      - description: ODR register
      - description: STR register

  clocks:
    maxItems: 1

  aspeed,lpc-io-reg:
    $ref: /schemas/types.yaml#/definitions/uint32-array
    minItems: 1
    maxItems: 2
    description: |
      The host CPU LPC IO data and status addresses for the device. For most
      channels the status address is derived from the data address, but the
      status address may be optionally provided.

  aspeed,lpc-interrupts:
    $ref: /schemas/types.yaml#/definitions/uint32-array
    minItems: 2
    maxItems: 2
    description: |
      A 2-cell property expressing the LPC SerIRQ number and the interrupt
      level/sense encoding (specified in the standard fashion).

      Note that the generated interrupt is issued from the BMC to the host, and
      thus the target interrupt controller is not captured by the BMC's
      devicetree.

  kcs_chan:
    deprecated: true
    $ref: /schemas/types.yaml#/definitions/uint32
    description: The LPC channel number in the controller

  kcs_addr:
    deprecated: true
    $ref: /schemas/types.yaml#/definitions/uint32
    description: The host CPU IO map address

required:
  - compatible
  - interrupts

additionalProperties: false

allOf:
  - if:
      properties:
        compatible:
          contains:
            enum:
              - aspeed,ast2400-kcs-bmc
              - aspeed,ast2500-kcs-bmc
    then:
      required:
        - kcs_chan
        - kcs_addr
    else:
      required:
        - reg
        - aspeed,lpc-io-reg

examples:
  - |
    #include <dt-bindings/interrupt-controller/irq.h>
    kcs3: kcs@24 {
        compatible = "aspeed,ast2600-kcs-bmc";
        reg = <0x24 0x1>, <0x30 0x1>, <0x3c 0x1>;
        aspeed,lpc-io-reg = <0xca2>;
        aspeed,lpc-interrupts = <11 IRQ_TYPE_LEVEL_LOW>;
        interrupts = <8>;
    };
```

## Documentation/devicetree/bindings/ipmi/aspeed-kcs-bmc.txt
```
# Aspeed KCS (Keyboard Controller Style) IPMI interface

The Aspeed SOCs (AST2400 and AST2500) are commonly used as BMCs
(Baseboard Management Controllers) and the KCS interface can be
used to perform in-band IPMI communication with their host.

## v1
Required properties:
- compatible : should be one of
    "aspeed,ast2400-kcs-bmc"
    "aspeed,ast2500-kcs-bmc"
- interrupts : interrupt generated by the controller
- kcs_chan : The LPC channel number in the controller
- kcs_addr : The host CPU IO map address

## v2
Required properties:
- compatible : should be one of
    "aspeed,ast2400-kcs-bmc-v2"
    "aspeed,ast2500-kcs-bmc-v2"
- reg : The address and size of the IDR, ODR and STR registers
- interrupts : interrupt generated by the controller
- aspeed,lpc-io-reg : The host CPU LPC IO address for the device

Example:

    kcs3: kcs@24 {
        compatible = "aspeed,ast2500-kcs-bmc-v2";
        reg = <0x24 0x1>, <0x30 0x1>, <0x3c 0x1>;
        aspeed,lpc-reg = <0xca2>;
        interrupts = <8>;
        status = "okay";
    };
```

## Documentation/devicetree/bindings/ipmi/ipmb-dev.yaml
```yaml
# SPDX-License-Identifier: (GPL-2.0-only OR BSD-2-Clause)
%YAML 1.2
---
$id: http://devicetree.org/schemas/ipmi/ipmb-dev.yaml#
$schema: http://devicetree.org/meta-schemas/core.yaml#

title: The Intelligent Platform Management Bus(IPMB) Device

description: |
  The IPMB is an I2C bus which provides interconnection between a Baseboard
  Management Controller(BMC) and chassis electronics. The BMC sends IPMI
  requests to intelligent controllers like Satellite Management Controller(MC)
  devices via IPMB and the device sends responses back to the BMC.
  This device uses an I2C slave device to send and receive IPMB messages,
  either on a BMC or other MC. A miscellaneous device provices a user space
  program to communicate with the kernel and the backend device. Some IPMB
  devices only support the I2C protocol and not the SMB protocol.

  IPMB communications protocol Specification V1.0
  https://www.intel.com/content/dam/www/public/us/en/documents/product-briefs/ipmp-spec-v1.0.pdf

maintainers:
  - Ninad Palsule <ninad@linux.ibm.com>

properties:
  compatible:
    enum:
      - ipmb-dev

  reg:
    maxItems: 1

  i2c-protocol:
    description:
      Use I2C block transfer instead of SMBUS block transfer.
    type: boolean

required:
  - compatible
  - reg

additionalProperties: false

examples:
  - |
    #include <dt-bindings/i2c/i2c.h>
    i2c {
        #address-cells = <1>;
        #size-cells = <0>;

        ipmb-dev@10 {
            compatible = "ipmb-dev";
            reg = <(0x10 | I2C_OWN_SLAVE_ADDRESS)>;
            i2c-protocol;
        };
    };
```

## Documentation/devicetree/bindings/ipmi/ipmi-ipmb.yaml
```yaml
# SPDX-License-Identifier: (GPL-2.0-only OR BSD-2-Clause)
%YAML 1.2
---
$id: http://devicetree.org/schemas/ipmi/ipmi-ipmb.yaml#
$schema: http://devicetree.org/meta-schemas/core.yaml#

title: IPMI IPMB device

description: IPMI IPMB device bindings

maintainers:
  - Corey Minyard <cminyard@mvista.com>

properties:
  compatible:
    enum:
      - ipmi-ipmb

  device_type:
    items:
      - const: "ipmi"

  reg:
    maxItems: 1

  bmcaddr:
    $ref: /schemas/types.yaml#/definitions/uint8
    description: The address of the BMC on the IPMB bus.  Defaults to 0x20.

  retry-time:
    $ref: /schemas/types.yaml#/definitions/uint32
    description: |
      Time between retries of sends, in milliseconds.  Defaults to 250.

  max-retries:
    $ref: /schemas/types.yaml#/definitions/uint32
    description: Number of retries before a failure is declared.  Defaults to 1.

  slave-dev:
    $ref: /schemas/types.yaml#/definitions/phandle
    description: |
      The slave i2c device.  If not present, the main device is used. This
      lets you use two devices on the IPMB, one for master and one for slave,
      in case you have a slave device that can only be a slave.  The slave
      will receive messages and the master will transmit.

required:
  - compatible
  - reg

additionalProperties: false

examples:
  - |
    i2c {
            #address-cells = <1>;
            #size-cells = <0>;

            ipmi-ipmb@40 {
                    compatible = "ipmi-ipmb";
                    device_type = "ipmi";
                    reg = <0x40>;
                    bmcaddr = /bits/ 8 <0x20>;
                    retry-time = <250>;
                    max-retries = <1>;
            };
    };
```

## Documentation/devicetree/bindings/ipmi/ipmi-smic.txt
```
IPMI device

Required properties:
- compatible: should be one of ipmi-kcs, ipmi-smic, or ipmi-bt
- device_type: should be ipmi
- reg: Address and length of the register set for the device

Optional properties:
- interrupts: The interrupt for the device.  Without this the interface
	is polled.
- reg-size - The size of the register.  Defaults to 1
- reg-spacing - The number of bytes between register starts.  Defaults to 1
- reg-shift - The amount to shift the registers to the right to get the data
	into bit zero.

Example:

smic@fff3a000 {
	compatible = "ipmi-smic";
	device_type = "ipmi";
	reg = <0xfff3a000 0x1000>;
	interrupts = <0 24 4>;
	reg-size = <4>;
	reg-spacing = <4>;
};
```
