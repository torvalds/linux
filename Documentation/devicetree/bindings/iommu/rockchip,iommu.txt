## Documentation/devicetree/bindings/ipmi/ipmi-smic.yaml
```yaml
# SPDX-License-Identifier: (GPL-2.0-only OR BSD-2-Clause)
%YAML 1.2
---
$id: http://devicetree.org/schemas/ipmi/ipmi-smic.yaml#
$schema: http://devicetree.org/meta-schemas/core.yaml#

title: IPMI device bindings

description: IPMI device bindings

maintainers:
  - Corey Minyard <cminyard@mvista.com>

properties:
  compatible:
    enum:
      - ipmi-kcs
      - ipmi-smic
      - ipmi-bt

  device_type:
    items:
      - const: "ipmi"

  reg:
    maxItems: 1

  interrupts:
    description: Interface is polled if this property is omitted.
    maxItems: 1

  reg-size:
    description: The access width of the register in bytes. Defaults to 1.
    $ref: /schemas/types.yaml#/definitions/uint32
    enum: [1, 2, 4, 8]

  reg-spacing:
    $ref: /schemas/types.yaml#/definitions/uint32
    description: The number of bytes between register starts. Defaults to 1.

  reg-shift:
    description: |
      The amount of bits to shift the register content to the right to get
      the data into bit zero.
    $ref: /schemas/types.yaml#/definitions/uint32
    maximum: 56

required:
  - compatible
  - reg

additionalProperties: false

examples:
  - |
    smic@fff3a000 {
        compatible = "ipmi-smic";
        device_type = "ipmi";
        reg = <0xfff3a000 0x1000>;
        interrupts = <0 24 4>;
        reg-size = <4>;
        reg-spacing = <4>;
    };
```

## Documentation/devicetree/bindings/ipmi/npcm7xx-kcs-bmc.txt
```
* Nuvoton NPCM KCS (Keyboard Controller Style) IPMI interface

The Nuvoton SOCs (NPCM) are commonly used as BMCs
(Baseboard Management Controllers) and the KCS interface can be
used to perform in-band IPMI communication with their host.

Required properties:
- compatible : should be one of
    "nuvoton,npcm750-kcs-bmc"
    "nuvoton,npcm845-kcs-bmc", "nuvoton,npcm750-kcs-bmc"
- interrupts : interrupt generated by the controller
- kcs_chan : The KCS channel number in the controller

Example:

    lpc_kcs: lpc_kcs@f0007000 {
        compatible = "nuvoton,npcm750-lpc-kcs", "simple-mfd", "syscon";
        reg = <0xf0007000 0x40>;
        reg-io-width = <1>;

        #address-cells = <1>;
        #size-cells = <1>;
        ranges = <0x0 0xf0007000 0x40>;

        kcs1: kcs1@0 {
            compatible = "nuvoton,npcm750-kcs-bmc";
            reg = <0x0 0x40>;
            interrupts = <0 9 4>;
            kcs_chan = <1>;
            status = "disabled";
        };

        kcs2: kcs2@0 {
            compatible = "nuvoton,npcm750-kcs-bmc";
            reg = <0x0 0x40>;
            interrupts = <0 9 4>;
            kcs_chan = <2>;
            status = "disabled";
        };
    };
```

## Documentation/devicetree/bindings/ipmi/nuvoton,npcm750-kcs-bmc.yaml
```yaml
# SPDX-License-Identifier: (GPL-2.0-only OR BSD-2-Clause)
%YAML 1.2
---
$id: http://devicetree.org/schemas/ipmi/nuvoton,npcm750-kcs-bmc.yaml#
$schema: http://devicetree.org/meta-schemas/core.yaml#

title: Nuvoton NPCM KCS BMC

maintainers:
  - Avi Fishman <avifishman70@gmail.com>
  - Tomer Maimon <tmaimon77@gmail.com>
  - Tali Perry <tali.perry1@gmail.com>

description:
  The Nuvoton SOCs (NPCM) are commonly used as BMCs (Baseboard Management
  Controllers) and the KCS interface can be used to perform in-band IPMI
  communication with their host.

properties:
  compatible:
    oneOf:
      - const: nuvoton,npcm750-kcs-bmc
      - items:
          - enum:
              - nuvoton,npcm845-kcs-bmc
          - const: nuvoton,npcm750-kcs-bmc

  reg:
    maxItems: 1

  interrupts:
    maxItems: 1

  kcs_chan:
    description: The KCS channel number in the controller
    $ref: /schemas/types.yaml#/definitions/uint32
    minimum: 1
    maximum: 3

required:
  - compatible
  - reg
  - interrupts
  - kcs_chan

additionalProperties: false

examples:
  - |
    kcs@0 {
        compatible = "nuvoton,npcm750-kcs-bmc";
        reg = <0x0 0x40>;
        interrupts = <9 4>;
        kcs_chan = <1>;
    };
```

## Documentation/devicetree/bindings/ipmi/ssif-bmc.yaml
```yaml
# SPDX-License-Identifier: (GPL-2.0-only OR BSD-2-Clause)
%YAML 1.2
---
$id: http://devicetree.org/schemas/ipmi/ssif-bmc.yaml#
$schema: http://devicetree.org/meta-schemas/core.yaml#

title: SSIF IPMI BMC interface

description: SSIF IPMI BMC device bindings

maintainers:
  - Quan Nguyen <quan@os.amperecomputing.com>

properties:
  compatible:
    enum:
      - ssif-bmc

  reg:
    maxItems: 1

required:
  - compatible
  - reg

additionalProperties: false

examples:
  - |
    i2c {
        #address-cells = <1>;
        #size-cells = <0>;

        ssif-bmc@10 {
            compatible = "ssif-bmc";
            reg = <0x10>;
        };
    };
```

## Documentation/devicetree/bindings/jailhouse.txt
```
Jailhouse non-root cell device tree bindings
--------------------------------------------

When running in a non-root Jailhouse cell (partition), the device tree of this
platform shall have a top-level "hypervisor" node with the following
properties:

- compatible = "jailhouse,cell"
```

## Documentation/devicetree/bindings/leds/allwinner,sun50i-a100-ledc.yaml
```yaml
# SPDX-License-Identifier: GPL-2.0-only OR BSD-2-Clause
%YAML 1.2
---
$id: http://devicetree.org/schemas/leds/allwinner,sun50i-a100-ledc.yaml#
$schema: http://devicetree.org/meta-schemas/core.yaml#

title: Allwinner A100 LED Controller

maintainers:
  - Samuel Holland <samuel@sholland.org>

description:
  The LED controller found in Allwinner sunxi SoCs uses a one-wire serial
  interface to drive up to 1024 RGB LEDs.

properties:
  compatible:
    oneOf:
      - const: allwinner,sun50i-a100-ledc
      - items:
          - enum:
              - allwinner,sun20i-d1-ledc
              - allwinner,sun50i-r329-ledc
          - const: allwinner,sun50i-a100-ledc

  reg:
    maxItems: 1

  "#address-cells":
    const: 1

  "#size-cells":
    const: 0

  interrupts:
    maxItems: 1

  clocks:
    items:
      - description: Bus clock
      - description: Module clock

  clock-names:
    items:
      - const: bus
      - const: mod

  resets:
    maxItems: 1

  dmas:
    maxItems: 1
    description: TX DMA channel

  dma-names:
    const: tx

  allwinner,pixel-format:
    description: Pixel format (subpixel transmission order), default is "grb"
    enum:
      - bgr
      - brg
      - gbr
      - grb
      - rbg
      - rgb

  allwinner,t0h-ns:
    default: 336
    description: Length of high pulse when transmitting a "0" bit

  allwinner,t0l-ns:
    default: 840
    description: Length of low pulse when transmitting a "0" bit

  allwinner,t1h-ns:
    default: 882
    description: Length of high pulse when transmitting a "1" bit

  allwinner,t1l-ns:
    default: 294
    description: Length of low pulse when transmitting a "1" bit

  allwinner,treset-ns:
    default: 300000
    description: Minimum delay between transmission frames

patternProperties:
  "^multi-led@[0-9a-f]+$":
    type: object
    $ref: leds-class-multicolor.yaml#
    unevaluatedProperties: false
    properties:
      reg:
        minimum: 0
        maximum: 1023
        description: Index of the LED in the series (must be contiguous)

    required:
      - reg

required:
  - compatible
  - reg
  - interrupts
  - clocks
  - clock-names
  - resets

additionalProperties: false

examples:
  - |
    #include <dt-bindings/interrupt-controller/irq.h>
    #include <dt-bindings/leds/common.h>

    ledc: led-controller@2008000 {
      compatible = "allwinner,sun20i-d1-ledc",
                   "allwinner,sun50i-a100-ledc";
      reg = <0x2008000 0x400>;
      interrupts = <36 IRQ_TYPE_LEVEL_HIGH>;
      clocks = <&ccu 12>, <&ccu 34>;
      clock-names = "bus", "mod";
      resets = <&ccu 12>;
      dmas = <&dma 42>;
      dma-names = "tx";
      #address-cells = <1>;
      #size-cells = <0>;

      multi-led@0 {
        reg = <0x0>;
        color = <LED_COLOR_ID_RGB>;
        function = LED_FUNCTION_INDICATOR;
      };
    };

...
```

## Documentation/devicetree/bindings/leds/ams,as3645a.txt
```
Analog devices AS3645A device tree bindings

The AS3645A flash LED controller can drive two LEDs, one high current
flash LED and one indicator LED. The high current flash LED can be
used in torch mode as well.

Ranges below noted as [a, b] are closed ranges between a and b, i.e. a
and b are included in the range.

Please also see common.txt in the same directory.


Required properties
===================

compatible	: Must be "ams,as3645a".
reg		: The I2C address of the device. Typically 0x30.
#address-cells	: 1
#size-cells	: 0


Required properties of the flash child node (0)
===============================================

reg: 0
flash-timeout-us: Flash timeout in microseconds. The value must be in
		  the range [100000, 850000] and divisible by 50000.
flash-max-microamp: Maximum flash current in microamperes. Has to be
		    in the range between [200000, 500000] and
		    divisible by 20000.
led-max-microamp: Maximum torch (assist) current in microamperes. The
		  value must be in the range between [20000, 160000] and
		  divisible by 20000.
ams,input-max-microamp: Maximum flash controller input current. The
			value must be in the range [1250000, 2000000]
			and divisible by 50000.


Optional properties of the flash child node
===========================================

label		: The label of the flash LED.


Required properties of the indicator child node (1)
===================================================

reg: 1
led-max-microamp: Maximum indicator current. The allowed values are
		  2500, 5000, 7500 and 10000.

Optional properties of the indicator child node
===============================================

label		: The label of the indicator LED.


Example
=======

	as3645a@30 {
		#address-cells: 1
		#size-cells: 0
		reg = <0x30>;
		compatible = "ams,as3645a";
		flash@0 {
			reg = <0x0>;
			flash-timeout-us = <150000>;
			flash-max-microamp = <320000>;
			led-max-microamp = <60000>;
			ams,input-max-microamp = <1750000>;
			label = "as3645a:flash";
		};
		indicator@1 {
			reg = <0x1>;
			led-max-microamp = <10000>;
			label = "as3645a:indicator";
		};
	};
```

## Documentation/devicetree/bindings/leds/ams,as3645a.yaml
```yaml
# SPDX-License-Identifier: (GPL-2.0-only OR BSD-2-Clause)
%YAML 1.2
---
$id: http://devicetree.org/schemas/leds/ams,as3645a.yaml#
$schema: http://devicetree.org/meta-schemas/core.yaml#

title: Analog Devices AS3645A LED Controller

maintainers:
  - Sakari Ailus <sakari.ailus@iki.fi>

description:
  The AS3645A flash LED controller can drive two LEDs, one
  high current flash LED and one indicator LED. The high
  current flash LED can be used in torch mode as well.

properties:
  compatible:
    const: ams,as3645a

  "#address-cells":
    const: 1

  "#size-cells":
    const: 0

  reg:
    maxItems: 1

  led@0:
    description: led0 describes the 'flash' feature
    type: object
    $ref: common.yaml#
    unevaluatedProperties: false

    properties:
      reg:
        const: 0

      flash-timeout-us:
        minimum: 100000
        maximum: 850000
        multipleOf: 50000

      flash-max-microamp:
        minimum: 200000
        maximum: 500000
        multipleOf: 20000

      led-max-microamp:
        minimum: 20000
        maximum: 160000
        multipleOf: 20000
        description:
          Maximum current when in torch (assist) mode.

      ams,input-max-microamp:
        minimum: 1250000
        maximum: 2000000
        multipleOf: 50000

    required:
      - reg
      - flash-timeout-us
      - flash-max-microamp
      - led-max-microamp
      - ams,input-max-microamp

  led@1:
    description: led1 describes the 'indicator' feature
    type: object
    $ref: common.yaml#
    unevaluatedProperties: false

    properties:
      reg:
        const: 1

      led-max-microamp:
        enum:
          - 2500
          - 5000
          - 7500
          - 10000
        description:
          Maximum indicator current.

    required:
      - reg
      - led-max-microamp

required:
  - compatible
  - reg
  - "#size-cells"
  - "#address-cells"

additionalProperties: false

examples:
  - |
    #include <dt-bindings/leds/common.h>

    i2c{
        #address-cells = <1>;
        #size-cells = <0>;

        led-controller@30 {
            compatible = "ams,as3645a";
            #address-cells = <1>;
            #size-cells = <0>;
            reg = <0x30>;

            led@0 {
                reg = <0>;
                flash-timeout-us = <150000>;
                flash-max-microamp = <320000>;
                led-max-microamp = <60000>;
                ams,input-max-microamp = <1750000>;
                function = LED_FUNCTION_FLASH;
            };

            led@1 {
                reg = <1>;
                led-max-microamp = <10000>;
                function = LED_FUNCTION_INDICATOR;
            };
        };
    };
...
```
