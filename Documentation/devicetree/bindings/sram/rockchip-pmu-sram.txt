## Documentation/devicetree/bindings/thermal/amazon,al-thermal.yaml
```yaml
# SPDX-License-Identifier: (GPL-2.0-only OR BSD-2-Clause)
%YAML 1.2
---
$id: http://devicetree.org/schemas/thermal/amazon,al-thermal.yaml#
$schema: http://devicetree.org/meta-schemas/core.yaml#

title: Amazon Annapurna Labs Thermal Sensor

maintainers:
  - Talel Shenhar <talel@amazon.com>

description:
  Simple thermal device that allows temperature reading by a single MMIO
  transaction.

properties:
  compatible:
    items:
      - const: amazon,al-thermal

  reg:
    maxItems: 1

  '#thermal-sensor-cells':
    const: 1

additionalProperties: false

examples:
  - |
    thermal: thermal@5002860 {
        compatible = "amazon,al-thermal";
        reg = <0x05002860 0x1>;
        #thermal-sensor-cells = <0x1>;
    };

    thermal-zones {
        z0-thermal {
            polling-delay-passive = <250>;
            polling-delay = <1000>;
            thermal-sensors = <&thermal 0>;
            trips {
                critical {
                    temperature = <105000>;
                    hysteresis = <2000>;
                    type = "critical";
                };
            };
        };
    };
```

## Documentation/devicetree/bindings/thermal/amlogic,thermal.yaml
```yaml
# SPDX-License-Identifier: (GPL-2.0 OR BSD-2-Clause)
%YAML 1.2
---
$id: http://devicetree.org/schemas/thermal/amlogic,thermal.yaml#
$schema: http://devicetree.org/meta-schemas/core.yaml#

title: Amlogic Thermal

maintainers:
  - Guillaume La Roque <glaroque@baylibre.com>

description: Binding for Amlogic Thermal

$ref: thermal-sensor.yaml#

properties:
  compatible:
    oneOf:
      - items:
          - enum:
              - amlogic,g12a-cpu-thermal
              - amlogic,g12a-ddr-thermal
          - const: amlogic,g12a-thermal
      - enum:
          - amlogic,a1-cpu-thermal
          - amlogic,t7-thermal

  reg:
    maxItems: 1

  interrupts:
    maxItems: 1

  clocks:
    maxItems: 1

  power-domains:
    maxItems: 1

  amlogic,ao-secure:
    description: phandle to the ao-secure syscon
    $ref: /schemas/types.yaml#/definitions/phandle

  '#thermal-sensor-cells':
    const: 0

  amlogic,secure-monitor:
    description: phandle to the secure monitor
    $ref: /schemas/types.yaml#/definitions/phandle-array
    items:
      - items:
          - description: phandle to the secure monitor
          - description: sensor index to get specific calibration data

required:
  - compatible
  - reg
  - interrupts
  - clocks

allOf:
  - if:
      properties:
        compatible:
          contains:
            enum:
              - amlogic,a1-cpu-thermal
              - amlogic,g12a-thermal
    then:
      required:
        - amlogic,ao-secure
    else:
      required:
        - amlogic,secure-monitor

unevaluatedProperties: false

examples:
  - |
    temperature-sensor@ff634800 {
        compatible = "amlogic,g12a-cpu-thermal",
                     "amlogic,g12a-thermal";
        reg = <0xff634800 0x50>;
        interrupts = <0x0 0x24 0x0>;
        clocks = <&clk 164>;
        #thermal-sensor-cells = <0>;
        amlogic,ao-secure = <&sec_AO>;
    };
  - |
    #include <dt-bindings/clock/amlogic,t7-peripherals-clkc.h>
    #include <dt-bindings/interrupt-controller/arm-gic.h>

    temperature-sensor@20000 {
        compatible = "amlogic,t7-thermal";
        reg = <0x20000 0x50>;
        interrupts = <GIC_SPI 31 IRQ_TYPE_LEVEL_HIGH>;
        clocks = <&clkc_periphs CLKID_TS>;
        #thermal-sensor-cells = <0>;
        amlogic,secure-monitor = <&sm 1>;
    };
...
```

## Documentation/devicetree/bindings/thermal/armada-thermal.txt
```
* Marvell Armada 370/375/380/XP thermal management

Required properties:

- compatible: Should be set to one of the following:
    * marvell,armada370-thermal
    * marvell,armada375-thermal
    * marvell,armada380-thermal
    * marvell,armadaxp-thermal
    * marvell,armada-ap806-thermal
    * marvell,armada-ap807-thermal
    * marvell,armada-cp110-thermal

Note: these bindings are deprecated for AP806/CP110 and should instead
follow the rules described in:
Documentation/devicetree/bindings/arm/marvell/ap80x-system-controller.txt
Documentation/devicetree/bindings/arm/marvell/cp110-system-controller.txt

- reg: Device's register space.
  Two entries are expected, see the examples below. The first one points
  to the status register (4B). The second one points to the control
  registers (8B).
  Note: The compatibles marvell,armada370-thermal,
  marvell,armada380-thermal, and marvell,armadaxp-thermal must point to
  "control MSB/control 1", with size of 4 (deprecated binding), or point
  to "control LSB/control 0" with size of 8 (current binding). All other
  compatibles must point to "control LSB/control 0" with size of 8.

Examples:

	/* Legacy bindings */
	thermal@d0018300 {
		compatible = "marvell,armada370-thermal";
		reg = <0xd0018300 0x4
		       0xd0018304 0x4>;
	};

	ap_thermal: thermal@6f8084 {
		compatible = "marvell,armada-ap806-thermal";
		reg = <0x6f808C 0x4>,
		      <0x6f8084 0x8>;
	};
```

## Documentation/devicetree/bindings/thermal/brcm,avs-ro-thermal.yaml
```yaml
# SPDX-License-Identifier: (GPL-2.0-only OR BSD-2-Clause)
%YAML 1.2
---
$id: http://devicetree.org/schemas/thermal/brcm,avs-ro-thermal.yaml#
$schema: http://devicetree.org/meta-schemas/core.yaml#

title: Broadcom AVS ring oscillator thermal

maintainers:
  - Stefan Wahren <wahrenst@gmx.net>

description: |+
  The thermal node should be the child of a syscon node with the
  required property:

  - compatible: Should be one of the following:
                "brcm,bcm2711-avs-monitor", "syscon", "simple-mfd"

  Refer to the the bindings described in
  Documentation/devicetree/bindings/mfd/syscon.yaml

properties:
  compatible:
    const: brcm,bcm2711-thermal

  # See ./thermal.txt for details
  "#thermal-sensor-cells":
    const: 0

required:
  - compatible
  - '#thermal-sensor-cells'

additionalProperties: false

examples:
  - |
        avs-monitor@7d5d2000 {
                compatible = "brcm,bcm2711-avs-monitor",
                             "syscon", "simple-mfd";
                reg = <0x7d5d2000 0xf00>;

                thermal: thermal {
                        compatible = "brcm,bcm2711-thermal";
                        #thermal-sensor-cells = <0>;
                };
        };
...
```

## Documentation/devicetree/bindings/thermal/brcm,avs-tmon.txt
```
* Broadcom STB thermal management

Thermal management core, provided by the AVS TMON hardware block.

Required properties:
- compatible: must be one of:
	"brcm,avs-tmon-bcm7216"
	"brcm,avs-tmon-bcm7445"
	"brcm,avs-tmon"
- reg: address range for the AVS TMON registers
- interrupts: temperature monitor interrupt, for high/low threshold triggers,
	      required except for "brcm,avs-tmon-bcm7216"
- interrupt-names: should be "tmon"

Example:

	thermal@f04d1500 {
		compatible = "brcm,avs-tmon-bcm7445", "brcm,avs-tmon";
		reg = <0xf04d1500 0x28>;
		interrupts = <0x6>;
		interrupt-names = "tmon";
		interrupt-parent = <&avs_host_l2_intc>;
	};
```

## Documentation/devicetree/bindings/thermal/brcm,avs-tmon.yaml
```yaml
# SPDX-License-Identifier: (GPL-2.0-only OR BSD-2-Clause)
%YAML 1.2
---
$id: http://devicetree.org/schemas/thermal/brcm,avs-tmon.yaml#
$schema: http://devicetree.org/meta-schemas/core.yaml#

title: Broadcom STB thermal management

description: Thermal management core, provided by the AVS TMON hardware block.

maintainers:
  - Florian Fainelli <f.fainelli@gmail.com>

allOf:
  - $ref: thermal-sensor.yaml#

properties:
  compatible:
    items:
      - enum:
          - brcm,avs-tmon-bcm7216
          - brcm,avs-tmon-bcm7445
      - const: brcm,avs-tmon

  reg:
    maxItems: 1
    description: >
      Address range for the AVS TMON registers

  interrupts:
    maxItems: 1

  interrupt-names:
    items:
      - const: tmon

  "#thermal-sensor-cells":
    const: 0

additionalProperties: false

required:
  - compatible
  - reg

examples:
  - |
    thermal@f04d1500 {
        compatible = "brcm,avs-tmon-bcm7445", "brcm,avs-tmon";
        reg = <0xf04d1500 0x28>;
        interrupts = <0x6>;
        interrupt-names = "tmon";
        interrupt-parent = <&avs_host_l2_intc>;
        #thermal-sensor-cells = <0>;
    };
```

## Documentation/devicetree/bindings/thermal/brcm,bcm2835-thermal.txt
```
Binding for Thermal Sensor driver for BCM2835 SoCs.

Required parameters:
-------------------

compatible: 		should be one of: "brcm,bcm2835-thermal",
			"brcm,bcm2836-thermal" or "brcm,bcm2837-thermal"
reg:			Address range of the thermal registers.
clocks: 		Phandle of the clock used by the thermal sensor.
#thermal-sensor-cells:	should be 0 (see thermal.txt)

Example:

thermal-zones {
	cpu_thermal: cpu-thermal {
		polling-delay-passive = <0>;
		polling-delay = <1000>;

		thermal-sensors = <&thermal>;

		trips {
			cpu-crit {
				temperature	= <80000>;
				hysteresis	= <0>;
				type		= "critical";
			};
		};

		coefficients = <(-538)	407000>;

		cooling-maps {
		};
	};
};

thermal: thermal@7e212000 {
	compatible = "brcm,bcm2835-thermal";
	reg = <0x7e212000 0x8>;
	clocks = <&clocks BCM2835_CLOCK_TSENS>;
	#thermal-sensor-cells = <0>;
};
```

## Documentation/devicetree/bindings/thermal/brcm,bcm2835-thermal.yaml
```yaml
# SPDX-License-Identifier: (GPL-2.0-only OR BSD-2-Clause)
%YAML 1.2
---
$id: http://devicetree.org/schemas/thermal/brcm,bcm2835-thermal.yaml#
$schema: http://devicetree.org/meta-schemas/core.yaml#

title: Broadcom BCM2835 thermal sensor

maintainers:
  - Stefan Wahren <stefan.wahren@i2se.com>

allOf:
  - $ref: thermal-sensor.yaml#

properties:
  compatible:
    enum:
      - brcm,bcm2835-thermal
      - brcm,bcm2836-thermal
      - brcm,bcm2837-thermal

  reg:
    maxItems: 1

  clocks:
    maxItems: 1

  "#thermal-sensor-cells":
    const: 0

unevaluatedProperties: false

required:
  - compatible
  - reg
  - clocks

examples:
  - |
    #include <dt-bindings/clock/bcm2835.h>

    thermal@7e212000 {
      compatible = "brcm,bcm2835-thermal";
      reg = <0x7e212000 0x8>;
      clocks = <&clocks BCM2835_CLOCK_TSENS>;
      #thermal-sensor-cells = <0>;
    };
```

## Documentation/devicetree/bindings/thermal/brcm,ns-thermal.yaml
```yaml
# SPDX-License-Identifier: GPL-2.0-only OR BSD-2-Clause
%YAML 1.2
---
$id: http://devicetree.org/schemas/thermal/brcm,ns-thermal.yaml#
$schema: http://devicetree.org/meta-schemas/core.yaml#

title: Broadcom Northstar Thermal

maintainers:
  - Rafał Miłecki <rafal@milecki.pl>

description:
  Thermal sensor that is part of Northstar's DMU (Device Management Unit).

allOf:
  - $ref: thermal-sensor.yaml#

properties:
  compatible:
    const: brcm,ns-thermal

  reg:
    description: PVTMON registers range
    maxItems: 1

  "#thermal-sensor-cells":
    const: 0

unevaluatedProperties: false

required:
  - reg

examples:
  - |
    thermal: thermal@1800c2c0 {
        compatible = "brcm,ns-thermal";
        reg = <0x1800c2c0 0x10>;
        #thermal-sensor-cells = <0>;
    };

    thermal-zones {
        cpu-thermal {
            polling-delay-passive = <0>;
            polling-delay = <1000>;
            coefficients = <(-556) 418000>;
            thermal-sensors = <&thermal>;

            trips {
                cpu-crit {
                    temperature = <125000>;
                    hysteresis = <0>;
                    type = "critical";
                };
            };

            cooling-maps {
            };
        };
    };
```
