## Documentation/devicetree/bindings/staging/dwc2.txt
```
Platform DesignWare HS OTG USB 2.0 controller
-----------------------------------------------------

Required properties:
- compatible : "snps,dwc2"
- reg : Should contain 1 register range (address and length)
- interrupts : Should contain 1 interrupt
- clocks: clock provider specifier
- clock-names: shall be "otg"
Refer to clk/clock-bindings.txt for generic clock consumer properties

Optional properties:
- phys: phy provider specifier
- phy-names: shall be "device"
Refer to phy/phy-bindings.txt for generic phy consumer properties

Example:

        usb@101c0000 {
                compatible = "ralink,rt3050-usb, snps,dwc2";
                reg = <0x101c0000 40000>;
                interrupts = <18>;
		clocks = <&usb_otg_ahb_clk>;
		clock-names = "otg";
		phys = <&usbphy>;
		phy-names = "usb2-phy";
        };
```

## Documentation/devicetree/bindings/staging/iio/adc/mxs-lradc.txt
```
* Freescale i.MX28 LRADC device driver

Required properties:
- compatible: Should be "fsl,imx23-lradc" for i.MX23 SoC and "fsl,imx28-lradc"
              for i.MX28 SoC
- reg: Address and length of the register set for the device
- interrupts: Should contain the LRADC interrupts

Optional properties:
- fsl,lradc-touchscreen-wires: Number of wires used to connect the touchscreen
                               to LRADC. Valid value is either 4 or 5. If this
                               property is not present, then the touchscreen is
                               disabled. 5 wires is valid for i.MX28 SoC only.
- fsl,ave-ctrl: number of samples per direction to calculate an average value.
                Allowed value is 1 ... 32, default is 4
- fsl,ave-delay: delay between consecutive samples. Allowed value is
                 2 ... 2048. It is used if 'fsl,ave-ctrl' > 1, counts at
                 2 kHz and its default is 2 (= 1 ms)
- fsl,settling: delay between plate switch to next sample. Allowed value is
                1 ... 2047. It counts at 2 kHz and its default is
                10 (= 5 ms)

Example for i.MX23 SoC:

	lradc@80050000 {
		compatible = "fsl,imx23-lradc";
		reg = <0x80050000 0x2000>;
		interrupts = <36 37 38 39 40 41 42 43 44>;
		status = "okay";
		fsl,lradc-touchscreen-wires = <4>;
		fsl,ave-ctrl = <4>;
		fsl,ave-delay = <2>;
		fsl,settling = <10>;
	};

Example for i.MX28 SoC:

	lradc@80050000 {
		compatible = "fsl,imx28-lradc";
		reg = <0x80050000 0x2000>;
		interrupts = <10 14 15 16 17 18 19 20 21 22 23 24 25>;
		status = "okay";
		fsl,lradc-touchscreen-wires = <5>;
		fsl,ave-ctrl = <4>;
		fsl,ave-delay = <2>;
		fsl,settling = <10>;
	};
```

## Documentation/devicetree/bindings/staging/iio/adc/spear-adc.txt
```
* ST SPEAr ADC device driver

Required properties:
- compatible: Should be "st,spear600-adc"
- reg: Address and length of the register set for the device
- interrupts: Should contain the ADC interrupt
- sampling-frequency: Default sampling frequency

Optional properties:
- vref-external: External voltage reference in milli-volts. If omitted
  the internal voltage reference will be used.
- average-samples: Number of samples to generate an average value. If
  omitted, single data conversion will be used.

Examples:

	adc: adc@d8200000 {
		compatible = "st,spear600-adc";
		reg = <0xd8200000 0x1000>;
		interrupt-parent = <&vic1>;
		interrupts = <6>;
		sampling-frequency = <5000000>;
		vref-external = <2500>;	/* 2.5V VRef */
	};
```

## Documentation/devicetree/bindings/staging/imx-drm/fsl-imx-drm.txt
```
Freescale i.MX DRM master device
================================

The freescale i.MX DRM master device is a virtual device needed to list all
IPU or other display interface nodes that comprise the graphics subsystem.

Required properties:
- compatible: Should be "fsl,imx-display-subsystem"
- ports: Should contain a list of phandles pointing to display interface ports
  of IPU devices

example:

display-subsystem {
	compatible = "fsl,display-subsystem";
	ports = <&ipu_di0>;
};


Freescale i.MX IPUv3
====================

Required properties:
- compatible: Should be "fsl,<chip>-ipu"
- reg: should be register base and length as documented in the
  datasheet
- interrupts: Should contain sync interrupt and error interrupt,
  in this order.
- resets: phandle pointing to the system reset controller and
          reset line index, see reset/fsl,imx-src.txt for details
Optional properties:
- port@[0-3]: Port nodes with endpoint definitions as defined in
  Documentation/devicetree/bindings/media/video-interfaces.txt.
  Ports 0 and 1 should correspond to CSI0 and CSI1,
  ports 2 and 3 should correspond to DI0 and DI1, respectively.

example:

ipu: ipu@18000000 {
	#address-cells = <1>;
	#size-cells = <0>;
	compatible = "fsl,imx53-ipu";
	reg = <0x18000000 0x080000000>;
	interrupts = <11 10>;
	resets = <&src 2>;

	ipu_di0: port@2 {
		reg = <2>;

		ipu_di0_disp0: endpoint {
			remote-endpoint = <&display_in>;
		};
	};
};

Parallel display support
========================

Required properties:
- compatible: Should be "fsl,imx-parallel-display"
Optional properties:
- interface_pix_fmt: How this display is connected to the
  display interface. Currently supported types: "rgb24", "rgb565", "bgr666"
  and "lvds666".
- edid: verbatim EDID data block describing attached display.
- ddc: phandle describing the i2c bus handling the display data
  channel
- port: A port node with endpoint definitions as defined in
  Documentation/devicetree/bindings/media/video-interfaces.txt.

example:

display@di0 {
	compatible = "fsl,imx-parallel-display";
	edid = [edid-data];
	interface-pix-fmt = "rgb24";

	port {
		display_in: endpoint {
			remote-endpoint = <&ipu_di0_disp0>;
		};
	};
};
```

## Documentation/devicetree/bindings/staging/ion/hi6220-ion.txt
```
Hi6220 SoC ION
===================================================================
Required properties:
- compatible : "hisilicon,hi6220-ion"
- list of the ION heaps
	- heap name : maybe heap_sys_user@0
	- heap id   : id should be unique in the system.
	- heap base : base ddr address of the heap,0 means that
	it is dynamic.
	- heap size : memory size and 0 means it is dynamic.
	- heap type : the heap type of the heap, please also
	see the define in ion.h(drivers/staging/android/uapi/ion.h)
-------------------------------------------------------------------
Example:
	hi6220-ion {
		compatible = "hisilicon,hi6220-ion";
		heap_sys_user@0 {
			heap-name = "sys_user";
			heap-id   = <0x0>;
			heap-base = <0x0>;
			heap-size = <0x0>;
			heap-type = "ion_system";
		};
		heap_sys_contig@0 {
			heap-name = "sys_contig";
			heap-id   = <0x1>;
			heap-base = <0x0>;
			heap-size = <0x0>;
			heap-type = "ion_system_contig";
		};
	};
```

## Documentation/devicetree/bindings/staging/ion/rockchip-ion.txt
```
* Rockchip Ion driver

Required properties:
- compatible: Should be "rockchip,ion"

Optional properties:
- cma-heap: Allocate continous physicall region.
  Should define reg with two u32 values:
    - reg0: base address of cma region
    - reg1: size of cma region
- system-heap: Allocate continous virtual region

Examples:
	ion {
		compatible = "rockchip,ion";
		#address-cells = <1>;
		#size-cells = <0>;

		cma-heap {
			reg = <0x00000000 0x02000000>;
		};

		system-heap {
		};
	};
```

## Documentation/devicetree/bindings/submitting-patches.txt
```
  Submitting devicetree (DT) binding patches

I. For patch submitters

  0) Normal patch submission rules from Documentation/SubmittingPatches
     applies.

  1) The Documentation/ portion of the patch should be a separate patch.

  2) Submit the entire series to the devicetree mailinglist at

       devicetree@vger.kernel.org

  3) The Documentation/ portion of the patch should come in the series before
     the code implementing the binding.

  4) Any compatible strings used in a chip or board DTS file must be
     previously documented in the corresponding DT binding text file
     in Documentation/devicetree/bindings.  This rule applies even if
     the Linux device driver does not yet match on the compatible
     string.  [ checkpatch will emit warnings if this step is not
     followed as of commit bff5da4335256513497cc8c79f9a9d1665e09864
     ("checkpatch: add DT compatible string documentation checks"). ]

  5) The wildcard "<chip>" may be used in compatible strings, as in
     the following example:

         - compatible: Must contain '"nvidia,<chip>-pcie",
           "nvidia,tegra20-pcie"' where <chip> is tegra30, tegra132, ...

     As in the above example, the known values of "<chip>" should be
     documented if it is used.

  6) If a documented compatible string is not yet matched by the
     driver, the documentation should also include a compatible
     string that is matched by the driver (as in the "nvidia,tegra20-pcie"
     example above).


II. For kernel maintainers

  1) If you aren't comfortable reviewing a given binding, reply to it and ask
     the devicetree maintainers for guidance.  This will help them prioritize
     which ones to review and which ones are ok to let go.

  2) For driver (not subsystem) bindings: If you are comfortable with the
     binding, and it hasn't received an Acked-by from the devicetree
     maintainers after a few weeks, go ahead and take it.

     Subsystem bindings (anything affecting more than a single device)
     then getting a devicetree maintainer to review it is required.

  3) For a series going though multiple trees, the binding patch should be
     kept with the driver using the binding.

III. Notes

  0) Please see ...bindings/ABI.txt for details regarding devicetree ABI.

  1) This document is intended as a general familiarization with the process as
     decided at the 2013 Kernel Summit.  When in doubt, the current word of the
     devicetree maintainers overrules this document.  In that situation, a patch
     updating this document would be appreciated.
```

## Documentation/devicetree/bindings/thermal/airoha,en7581-thermal.yaml
```yaml
# SPDX-License-Identifier: (GPL-2.0 OR BSD-2-Clause)
%YAML 1.2
---
$id: http://devicetree.org/schemas/thermal/airoha,en7581-thermal.yaml#
$schema: http://devicetree.org/meta-schemas/core.yaml#

title: Airoha EN7581 Thermal Sensor and Monitor

maintainers:
  - Christian Marangi <ansuelsmth@gmail.com>

properties:
  compatible:
    const: airoha,en7581-thermal

  reg:
    maxItems: 1

  interrupts:
    maxItems: 1

  airoha,chip-scu:
    description: phandle to the chip SCU syscon
    $ref: /schemas/types.yaml#/definitions/phandle

  '#thermal-sensor-cells':
    const: 0

required:
  - compatible
  - reg
  - interrupts
  - airoha,chip-scu

additionalProperties: false

examples:
  - |
    #include <dt-bindings/interrupt-controller/arm-gic.h>

    thermal-sensor@1efbd800 {
        compatible = "airoha,en7581-thermal";
        reg = <0x1efbd000 0xd5c>;
        interrupts = <GIC_SPI 23 IRQ_TYPE_LEVEL_HIGH>;
        airoha,chip-scu = <&chip_scu>;

        #thermal-sensor-cells = <0>;
    };
```

## Documentation/devicetree/bindings/thermal/allwinner,sun8i-a83t-ths.yaml
```yaml
# SPDX-License-Identifier: GPL-2.0
%YAML 1.2
---
$id: http://devicetree.org/schemas/thermal/allwinner,sun8i-a83t-ths.yaml#
$schema: http://devicetree.org/meta-schemas/core.yaml#

title: Allwinner SUN8I Thermal Controller

maintainers:
  - Vasily Khoruzhick <anarsoul@gmail.com>
  - Yangtao Li <tiny.windzz@gmail.com>

$ref: thermal-sensor.yaml#

properties:
  compatible:
    enum:
      - allwinner,sun8i-a83t-ths
      - allwinner,sun8i-h3-ths
      - allwinner,sun8i-r40-ths
      - allwinner,sun20i-d1-ths
      - allwinner,sun50i-a64-ths
      - allwinner,sun50i-a100-ths
      - allwinner,sun50i-h5-ths
      - allwinner,sun50i-h6-ths
      - allwinner,sun50i-h616-ths

  clocks:
    minItems: 1
    items:
      - description: Bus Clock
      - description: Module Clock

  clock-names:
    minItems: 1
    items:
      - const: bus
      - const: mod

  reg:
    maxItems: 1

  interrupts:
    maxItems: 1

  resets:
    maxItems: 1

  nvmem-cells:
    maxItems: 1
    description: Calibration data for thermal sensors

  nvmem-cell-names:
    const: calibration

  allwinner,sram:
    maxItems: 1
    description: phandle to device controlling temperate offset SYS_CFG register

  "#thermal-sensor-cells":
    enum:
      - 0
      - 1

allOf:
  - if:
      properties:
        compatible:
          contains:
            enum:
              - allwinner,sun20i-d1-ths
              - allwinner,sun50i-a100-ths
              - allwinner,sun50i-h6-ths
              - allwinner,sun50i-h616-ths

    then:
      properties:
        clocks:
          maxItems: 1

        clock-names:
          maxItems: 1

    else:
      properties:
        clocks:
          minItems: 2

        clock-names:
          minItems: 2

  - if:
      not:
        properties:
          compatible:
            contains:
              const: allwinner,sun50i-h616-ths

    then:
      properties:
        allwinner,sram: false

  - if:
      properties:
        compatible:
          contains:
            enum:
              - allwinner,sun8i-h3-ths
              - allwinner,sun20i-d1-ths

    then:
      properties:
        "#thermal-sensor-cells":
          const: 0

    else:
      properties:
        "#thermal-sensor-cells":
          const: 1

  - if:
      not:
        properties:
          compatible:
            contains:
              enum:
                - allwinner,sun8i-a83t-ths

    then:
      required:
        - clocks
        - clock-names
        - resets

required:
  - compatible
  - reg
  - interrupts

unevaluatedProperties: false

examples:
  - |
    thermal-sensor@1f04000 {
        compatible = "allwinner,sun8i-a83t-ths";
        reg = <0x01f04000 0x100>;
        interrupts = <0 31 0>;
        nvmem-cells = <&ths_calibration>;
        nvmem-cell-names = "calibration";
        #thermal-sensor-cells = <1>;
    };

  - |
    thermal-sensor@1c25000 {
        compatible = "allwinner,sun8i-h3-ths";
        reg = <0x01c25000 0x400>;
        clocks = <&ccu 0>, <&ccu 1>;
        clock-names = "bus", "mod";
        resets = <&ccu 2>;
        interrupts = <0 31 0>;
        nvmem-cells = <&ths_calibration>;
        nvmem-cell-names = "calibration";
        #thermal-sensor-cells = <0>;
    };

  - |
    thermal-sensor@5070400 {
        compatible = "allwinner,sun50i-h6-ths";
        reg = <0x05070400 0x100>;
        clocks = <&ccu 0>;
        clock-names = "bus";
        resets = <&ccu 2>;
        interrupts = <0 15 0>;
        nvmem-cells = <&ths_calibration>;
        nvmem-cell-names = "calibration";
        #thermal-sensor-cells = <1>;
    };

...
```

## Documentation/devicetree/bindings/thermal/amazon,al-thermal.txt
```
Amazon's Annapurna Labs Thermal Sensor

Simple thermal device that allows temperature reading by a single MMIO
transaction.

Required properties:
- compatible: "amazon,al-thermal".
- reg: The physical base address and length of the sensor's registers.
- #thermal-sensor-cells: Must be 1. See Documentation/devicetree/bindings/thermal/thermal-sensor.yaml for a description.

Example:
	thermal: thermal {
		compatible = "amazon,al-thermal";
		reg = <0x0 0x05002860 0x0 0x1>;
		#thermal-sensor-cells = <0x1>;
	};

	thermal-zones {
		thermal-z0 {
			polling-delay-passive = <250>;
			polling-delay = <1000>;
			thermal-sensors = <&thermal 0>;
			trips {
				critical {
					temperature = <105000>;
					hysteresis = <2000>;
					type = "critical";
				};
			};

		};
	};
```
