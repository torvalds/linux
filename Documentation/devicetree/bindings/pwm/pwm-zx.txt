## Documentation/devicetree/bindings/pwm/toshiba,pwm-visconti.yaml
```yaml
# SPDX-License-Identifier: GPL-2.0-only OR BSD-2-Clause
%YAML 1.2
---
$id: http://devicetree.org/schemas/pwm/toshiba,pwm-visconti.yaml#
$schema: http://devicetree.org/meta-schemas/core.yaml#

title: Toshiba Visconti PWM Controller

maintainers:
  - Nobuhiro Iwamatsu <nobuhiro1.iwamatsu@toshiba.co.jp>

properties:
  compatible:
    items:
      - const: toshiba,visconti-pwm

  reg:
    maxItems: 1

  '#pwm-cells':
    const: 2

required:
  - compatible
  - reg
  - '#pwm-cells'

additionalProperties: false

examples:
  - |
    soc {
        #address-cells = <2>;
        #size-cells = <2>;

        pwm: pwm@241c0000 {
            compatible = "toshiba,visconti-pwm";
            reg = <0 0x241c0000 0 0x1000>;
            pinctrl-names = "default";
            pinctrl-0 = <&pwm_mux>;
            #pwm-cells = <2>;
        };
    };
```

## Documentation/devicetree/bindings/pwm/via,vt8500-pwm.yaml
```yaml
# SPDX-License-Identifier: GPL-2.0-only OR BSD-2-Clause
%YAML 1.2
---
$id: http://devicetree.org/schemas/pwm/via,vt8500-pwm.yaml#
$schema: http://devicetree.org/meta-schemas/core.yaml#

title: VIA/Wondermedia VT8500/WM8xxx series SoC PWM controller

maintainers:
  - Alexey Charkov <alchark@gmail.com>

allOf:
  - $ref: pwm.yaml#

properties:
  compatible:
    items:
      - const: via,vt8500-pwm

  reg:
    maxItems: 1

  '#pwm-cells':
    const: 3

  clocks:
    maxItems: 1

required:
  - compatible
  - reg
  - clocks

additionalProperties: false

examples:
  - |
    pwm1: pwm@d8220000 {
        compatible = "via,vt8500-pwm";
        reg = <0xd8220000 0x1000>;
        #pwm-cells = <3>;
        clocks = <&clkpwm>;
    };
```

## Documentation/devicetree/bindings/pwm/vt8500-pwm.txt
```
VIA/Wondermedia VT8500/WM8xxx series SoC PWM controller

Required properties:
- compatible: should be "via,vt8500-pwm"
- reg: physical base address and length of the controller's registers
- #pwm-cells: should be 3. See pwm.yaml in this directory for a description of
  the cells format. The only third cell flag supported by this binding is
  PWM_POLARITY_INVERTED.
- clocks: phandle to the PWM source clock

Example:

pwm1: pwm@d8220000 {
	#pwm-cells = <3>;
	compatible = "via,vt8500-pwm";
	reg = <0xd8220000 0x1000>;
	clocks = <&clkpwm>;
};
```

## Documentation/devicetree/bindings/regmap/regmap.txt
```
Devicetree binding for regmap

Optional properties:

   little-endian,
   big-endian,
   native-endian:	See common-properties.txt for a definition

Note:
Regmap defaults to little-endian register access on MMIO based
devices, this is by far the most common setting. On CPU
architectures that typically run big-endian operating systems
(e.g. PowerPC), registers can be defined as big-endian and must
be marked that way in the devicetree.

On SoCs that can be operated in both big-endian and little-endian
modes, with a single hardware switch controlling both the endianness
of the CPU and a byteswap for MMIO registers (e.g. many Broadcom MIPS
chips), "native-endian" is used to allow using the same device tree
blob in both cases.

Examples:
Scenario 1 : a register set in big-endian mode.
dev: dev@40031000 {
	      compatible = "syscon";
	      reg = <0x40031000 0x1000>;
	      big-endian;
	      ...
};
```
