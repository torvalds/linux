## Documentation/devicetree/bindings/pwm/pwm-zx.txt
```
ZTE ZX PWM controller

Required properties:
 - compatible: Should be "zte,zx296718-pwm".
 - reg: Physical base address and length of the controller's registers.
 - clocks : The phandle and specifier referencing the controller's clocks.
 - clock-names: "pclk" for PCLK, "wclk" for WCLK to the PWM controller.  The
   PCLK is for register access, while WCLK is the reference clock for
   calculating period and duty cycles.
 - #pwm-cells: Should be 3. See pwm.yaml in this directory for a description of
   the cells format.

Example:

	pwm: pwm@1439000 {
		compatible = "zte,zx296718-pwm";
		reg = <0x1439000 0x1000>;
		clocks = <&lsp1crm LSP1_PWM_PCLK>,
			 <&lsp1crm LSP1_PWM_WCLK>;
		clock-names = "pclk", "wclk";
		#pwm-cells = <3>;
	};
```

## Documentation/devicetree/bindings/pwm/pwm.txt
```
Specifying PWM information for devices
======================================

1) PWM user nodes
-----------------

PWM users should specify a list of PWM devices that they want to use
with a property containing a 'pwm-list':

	pwm-list ::= <single-pwm> [pwm-list]
	single-pwm ::= <pwm-phandle> <pwm-specifier>
	pwm-phandle : phandle to PWM controller node
	pwm-specifier : array of #pwm-cells specifying the given PWM
			(controller specific)

PWM properties should be named "pwms". The exact meaning of each pwms
property must be documented in the device tree binding for each device.
An optional property "pwm-names" may contain a list of strings to label
each of the PWM devices listed in the "pwms" property. If no "pwm-names"
property is given, the name of the user node will be used as fallback.

Drivers for devices that use more than a single PWM device can use the
"pwm-names" property to map the name of the PWM device requested by the
pwm_get() call to an index into the list given by the "pwms" property.

The following example could be used to describe a PWM-based backlight
device:

	pwm: pwm {
		#pwm-cells = <2>;
	};

	[...]

	bl: backlight {
		pwms = <&pwm 0 5000000>;
		pwm-names = "backlight";
	};

Note that in the example above, specifying the "pwm-names" is redundant
because the name "backlight" would be used as fallback anyway.

pwm-specifier typically encodes the chip-relative PWM number and the PWM
period in nanoseconds.

Optionally, the pwm-specifier can encode a number of flags (defined in
<dt-bindings/pwm/pwm.h>) in a third cell:
- PWM_POLARITY_INVERTED: invert the PWM signal polarity

Example with optional PWM specifier for inverse polarity

	bl: backlight {
		pwms = <&pwm 0 5000000 PWM_POLARITY_INVERTED>;
		pwm-names = "backlight";
	};

2) PWM controller nodes
-----------------------

PWM controller nodes must specify the number of cells used for the
specifier using the '#pwm-cells' property.

An example PWM controller might look like this:

	pwm: pwm@7000a000 {
		compatible = "nvidia,tegra20-pwm";
		reg = <0x7000a000 0x100>;
		#pwm-cells = <2>;
	};
```

## Documentation/devicetree/bindings/pwm/pwm.yaml
```yaml
# SPDX-License-Identifier: GPL-2.0
%YAML 1.2
---
$id: http://devicetree.org/schemas/pwm/pwm.yaml#
$schema: http://devicetree.org/meta-schemas/core.yaml#

title: PWM controllers (providers)

maintainers:
  - Thierry Reding <thierry.reding@gmail.com>

select: false

properties:
  $nodename:
    pattern: "^pwm(@.*|-([0-9]|[1-9][0-9]+))?$"

  "#pwm-cells":
    description: |
      Number of cells in a PWM specifier. Typically the cells represent, in
      order: the chip-relative PWM number, the PWM period in nanoseconds and
      optionally a number of flags (defined in <dt-bindings/pwm/pwm.h>).

required:
  - "#pwm-cells"

additionalProperties: true

examples:
  - |
    pwm: pwm@1c20e00 {
        compatible = "allwinner,sun7i-a20-pwm";
        reg = <0x01c20e00 0xc>;
        clocks = <&osc24M>;
        #pwm-cells = <3>;
    };
```

## Documentation/devicetree/bindings/pwm/pxa-pwm.txt
```
Marvell PWM controller

Required properties:
- compatible: should be one or more of:
  - "marvell,pxa250-pwm"
  - "marvell,pxa270-pwm"
  - "marvell,pxa168-pwm"
  - "marvell,pxa910-pwm"
- reg: Physical base address and length of the registers used by the PWM channel
  Note that one device instance must be created for each PWM that is used, so the
  length covers only the register window for one PWM output, not that of the
  entire PWM controller.  Currently length is 0x10 for all supported devices.
- #pwm-cells: Should be 1.  This cell is used to specify the period in
  nanoseconds.

Example PWM device node:

pwm0: pwm@40b00000 {
	compatible = "marvell,pxa250-pwm";
	reg = <0x40b00000 0x10>;
	#pwm-cells = <1>;
};

Example PWM client node:

backlight {
	compatible = "pwm-backlight";
	pwms = <&pwm0 5000000>;
	...
}
```

## Documentation/devicetree/bindings/pwm/qcom,ipq6018-pwm.yaml
```yaml
# SPDX-License-Identifier: (GPL-2.0-only OR BSD-2-Clause)
%YAML 1.2
---
$id: http://devicetree.org/schemas/pwm/qcom,ipq6018-pwm.yaml#
$schema: http://devicetree.org/meta-schemas/core.yaml#

title: Qualcomm IPQ6018 PWM controller

maintainers:
  - George Moussalem <george.moussalem@outlook.com>

properties:
  compatible:
    oneOf:
      - items:
          - enum:
              - qcom,ipq5018-pwm
              - qcom,ipq5332-pwm
              - qcom,ipq9574-pwm
          - const: qcom,ipq6018-pwm
      - const: qcom,ipq6018-pwm

  reg:
    maxItems: 1

  clocks:
    maxItems: 1

  "#pwm-cells":
    const: 3

required:
  - compatible
  - reg
  - clocks
  - "#pwm-cells"

additionalProperties: false

examples:
  - |
    #include <dt-bindings/clock/qcom,gcc-ipq6018.h>

    pwm: pwm@1941010 {
        compatible = "qcom,ipq6018-pwm";
        reg = <0x01941010 0x20>;
        clocks = <&gcc GCC_ADSS_PWM_CLK>;
        assigned-clocks = <&gcc GCC_ADSS_PWM_CLK>;
        assigned-clock-rates = <100000000>;
        #pwm-cells = <3>;
    };
```

## Documentation/devicetree/bindings/pwm/renesas,pwm-rcar.txt
```
* Renesas R-Car PWM Timer Controller

Required Properties:
- compatible: should be "renesas,pwm-rcar" and one of the following.
 - "renesas,pwm-r8a7743": for RZ/G1M
 - "renesas,pwm-r8a7745": for RZ/G1E
 - "renesas,pwm-r8a7778": for R-Car M1A
 - "renesas,pwm-r8a7779": for R-Car H1
 - "renesas,pwm-r8a7790": for R-Car H2
 - "renesas,pwm-r8a7791": for R-Car M2-W
 - "renesas,pwm-r8a7794": for R-Car E2
 - "renesas,pwm-r8a7795": for R-Car H3
 - "renesas,pwm-r8a7796": for R-Car M3-W
 - "renesas,pwm-r8a77965": for R-Car M3-N
 - "renesas,pwm-r8a77990": for R-Car E3
 - "renesas,pwm-r8a77995": for R-Car D3
- reg: base address and length of the registers block for the PWM.
- #pwm-cells: should be 2. See pwm.txt in this directory for a description of
  the cells format.
- clocks: clock phandle and specifier pair.
- pinctrl-0: phandle, referring to a default pin configuration node.
- pinctrl-names: Set to "default".

Example: R8A7743 (RZ/G1M) PWM Timer node

	pwm0: pwm@e6e30000 {
		compatible = "renesas,pwm-r8a7743", "renesas,pwm-rcar";
		reg = <0 0xe6e30000 0 0x8>;
		clocks = <&cpg CPG_MOD 523>;
		power-domains = <&sysc R8A7743_PD_ALWAYS_ON>;
		resets = <&cpg 523>;
		#pwm-cells = <2>;
		pinctrl-0 = <&pwm0_pins>;
		pinctrl-names = "default";
	};
```

## Documentation/devicetree/bindings/pwm/renesas,pwm-rcar.yaml
```yaml
# SPDX-License-Identifier: GPL-2.0
%YAML 1.2
---
$id: http://devicetree.org/schemas/pwm/renesas,pwm-rcar.yaml#
$schema: http://devicetree.org/meta-schemas/core.yaml#

title: Renesas R-Car PWM Timer Controller

maintainers:
  - Yoshihiro Shimoda <yoshihiro.shimoda.uh@renesas.com>

properties:
  compatible:
    items:
      - enum:
          - renesas,pwm-r8a7743   # RZ/G1M
          - renesas,pwm-r8a7744   # RZ/G1N
          - renesas,pwm-r8a7745   # RZ/G1E
          - renesas,pwm-r8a77470  # RZ/G1C
          - renesas,pwm-r8a774a1  # RZ/G2M
          - renesas,pwm-r8a774b1  # RZ/G2N
          - renesas,pwm-r8a774c0  # RZ/G2E
          - renesas,pwm-r8a7778   # R-Car M1A
          - renesas,pwm-r8a7779   # R-Car H1
          - renesas,pwm-r8a7790   # R-Car H2
          - renesas,pwm-r8a7791   # R-Car M2-W
          - renesas,pwm-r8a7794   # R-Car E2
          - renesas,pwm-r8a7795   # R-Car H3
          - renesas,pwm-r8a7796   # R-Car M3-W
          - renesas,pwm-r8a77961  # R-Car M3-W+
          - renesas,pwm-r8a77965  # R-Car M3-N
          - renesas,pwm-r8a77970  # R-Car V3M
          - renesas,pwm-r8a77980  # R-Car V3H
          - renesas,pwm-r8a77990  # R-Car E3
          - renesas,pwm-r8a77995  # R-Car D3
      - const: renesas,pwm-rcar

  reg:
    # base address and length of the registers block for the PWM.
    maxItems: 1

  '#pwm-cells':
    # should be 2. See pwm.yaml in this directory for a description of
    # the cells format.
    const: 2

  clocks:
    # clock phandle and specifier pair.
    maxItems: 1

  power-domains:
    maxItems: 1

  resets:
    maxItems: 1

required:
  - compatible
  - reg
  - '#pwm-cells'
  - clocks

additionalProperties: false

examples:
  - |
    #include <dt-bindings/clock/r8a7743-cpg-mssr.h>
    #include <dt-bindings/power/r8a7743-sysc.h>

    pwm0: pwm@e6e30000 {
        compatible = "renesas,pwm-r8a7743", "renesas,pwm-rcar";
        reg = <0xe6e30000 0x8>;
        clocks = <&cpg CPG_MOD 523>;
        power-domains = <&sysc R8A7743_PD_ALWAYS_ON>;
        resets = <&cpg 523>;
        #pwm-cells = <2>;
        pinctrl-0 = <&pwm0_pins>;
        pinctrl-names = "default";
    };
```
