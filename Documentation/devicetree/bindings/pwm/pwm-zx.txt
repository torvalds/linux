## Documentation/devicetree/bindings/pwm/renesas,tpu-pwm.txt
```
* Renesas R-Car Timer Pulse Unit PWM Controller

Required Properties:

  - compatible: should be one of the following.
    - "renesas,tpu-r8a73a4": for R8A73A4 (R-Mobile APE6) compatible PWM controller.
    - "renesas,tpu-r8a7740": for R8A7740 (R-Mobile A1) compatible PWM controller.
    - "renesas,tpu-r8a7743": for R8A7743 (RZ/G1M) compatible PWM controller.
    - "renesas,tpu-r8a7745": for R8A7745 (RZ/G1E) compatible PWM controller.
    - "renesas,tpu-r8a7790": for R8A7790 (R-Car H2) compatible PWM controller.
    - "renesas,tpu": for generic R-Car and RZ/G1 TPU PWM controller.

  - reg: Base address and length of each memory resource used by the PWM
    controller hardware module.

  - #pwm-cells: should be 3. See pwm.txt in this directory for a description of
    the cells format. The only third cell flag supported by this binding is
    PWM_POLARITY_INVERTED.

Please refer to pwm.txt in this directory for details of the common PWM bindings
used by client devices.

Example: R8A7740 (R-Mobile A1) TPU controller node

	tpu: pwm@e6600000 {
		compatible = "renesas,tpu-r8a7740", "renesas,tpu";
		reg = <0xe6600000 0x148>;
		#pwm-cells = <3>;
	};
```

## Documentation/devicetree/bindings/pwm/renesas,tpu-pwm.yaml
```yaml
# SPDX-License-Identifier: GPL-2.0
%YAML 1.2
---
$id: http://devicetree.org/schemas/pwm/renesas,tpu-pwm.yaml#
$schema: http://devicetree.org/meta-schemas/core.yaml#

title: Renesas R-Car Timer Pulse Unit PWM Controller

maintainers:
  - Laurent Pinchart <laurent.pinchart+renesas@ideasonboard.com>

select:
  properties:
    compatible:
      contains:
        const: renesas,tpu
  required:
    - compatible
    - '#pwm-cells'

properties:
  compatible:
    items:
      - enum:
          - renesas,tpu-r8a73a4   # R-Mobile APE6
          - renesas,tpu-r8a7740   # R-Mobile A1
          - renesas,tpu-r8a7742   # RZ/G1H
          - renesas,tpu-r8a7743   # RZ/G1M
          - renesas,tpu-r8a7744   # RZ/G1N
          - renesas,tpu-r8a7745   # RZ/G1E
          - renesas,tpu-r8a7790   # R-Car H2
          - renesas,tpu-r8a7791   # R-Car M2-W
          - renesas,tpu-r8a7792   # R-Car V2H
          - renesas,tpu-r8a7793   # R-Car M2-N
          - renesas,tpu-r8a7794   # R-Car E2
          - renesas,tpu-r8a7795   # R-Car H3
          - renesas,tpu-r8a7796   # R-Car M3-W
          - renesas,tpu-r8a77961  # R-Car M3-W+
          - renesas,tpu-r8a77965  # R-Car M3-N
          - renesas,tpu-r8a77970  # R-Car V3M
          - renesas,tpu-r8a77980  # R-Car V3H
          - renesas,tpu-r8a779a0  # R-Car V3U
          - renesas,tpu-r8a779g0  # R-Car V4H
      - const: renesas,tpu

  reg:
    # Base address and length of each memory resource used by the PWM
    # controller hardware module.
    maxItems: 1

  interrupts:
    maxItems: 1

  '#pwm-cells':
    # should be 3. See pwm.yaml in this directory for a description of
    # the cells format. The only third cell flag supported by this binding is
    # PWM_POLARITY_INVERTED.
    const: 3

  clocks:
    maxItems: 1

  power-domains:
    maxItems: 1

  resets:
    maxItems: 1

required:
  - compatible
  - reg
  - clocks
  - power-domains

allOf:
  - $ref: pwm.yaml#

  - if:
      not:
        properties:
          compatible:
            contains:
              enum:
                - renesas,tpu-r8a73a4
                - renesas,tpu-r8a7740
    then:
      required:
        - resets

additionalProperties: false

examples:
  - |
    #include <dt-bindings/clock/r8a7740-clock.h>

    tpu: pwm@e6600000 {
        compatible = "renesas,tpu-r8a7740", "renesas,tpu";
        reg = <0xe6600000 0x148>;
        clocks = <&mstp3_clks R8A7740_CLK_TPU0>;
        power-domains = <&pd_a3sp>;
        #pwm-cells = <3>;
    };
```

## Documentation/devicetree/bindings/pwm/rockchip-pwm.txt
```
Rockchip PWM controller

Required properties:
- compatible: should be "rockchip,<name>-pwm"
- reg: physical base address and length of the controller's registers
- #pwm-cells: should be 2.  The first cell specifies the per-chip index
  of the PWM to use and the second cell is the period in nanoseconds.
- pinctrl-names: must contain a "default" entry.
- pinctrl-0: the pincontrol settings to configurethe.
- clocks: phandle to the PWM source clock
- clock-names: list of clock names sorted in the same order as the clocks.
- status: for device state control (enabled/disabled).

Example:

pwm1: pwm@53fb4000 {
	#pwm-cells = <2>;
	compatible = "fsl,imx53-pwm", "fsl,imx27-pwm";
	reg = <0x53fb4000 0x4000>;
	interrupts = <61>;
};
pwm0: pwm@ff680000 {
	compatible = "rockchip,rk-pwm";                                                                                                                                    
	reg = <0xff680000 0x10>;                                                                                                                                           
	#pwm-cells = <2>;                                                                                                                                                  
	pinctrl-names = "default";                                                                                                                                         
	pinctrl-0 = <&pwm0_pin>;                                                                                                                                           
	clocks = <&clk_gates11 11>;                                                                                                                                        
	clock-names = "pclk_pwm";                                                                                                                                          
	status = "disabled";                                                                                                                                               
};                                   
```

## Documentation/devicetree/bindings/pwm/snps,dw-apb-timers-pwm2.yaml
```yaml
# SPDX-License-Identifier: (GPL-2.0-only OR BSD-2-Clause)
# Copyright (C) 2022 SiFive, Inc.
%YAML 1.2
---
$id: http://devicetree.org/schemas/pwm/snps,dw-apb-timers-pwm2.yaml#
$schema: http://devicetree.org/meta-schemas/core.yaml#

title: Synopsys DW-APB timers PWM controller

maintainers:
  - Ben Dooks <ben.dooks@sifive.com>

description:
  This describes the DesignWare APB timers module when used in the PWM
  mode. The IP core can be generated with various options which can
  control the functionality, the number of PWMs available and other
  internal controls the designer requires.

  The IP block has a version register so this can be used for detection
  instead of having to encode the IP version number in the device tree
  comaptible.

allOf:
  - $ref: pwm.yaml#

properties:
  compatible:
    const: snps,dw-apb-timers-pwm2

  reg:
    maxItems: 1

  "#pwm-cells":
    const: 3

  clocks:
    items:
      - description: Interface bus clock
      - description: PWM reference clock

  clock-names:
    items:
      - const: bus
      - const: timer

  snps,pwm-number:
    $ref: /schemas/types.yaml#/definitions/uint32
    description: The number of PWM channels configured for this instance
    enum: [1, 2, 3, 4, 5, 6, 7, 8]

required:
  - compatible
  - reg
  - "#pwm-cells"
  - clocks
  - clock-names

additionalProperties: false

examples:
  - |
    pwm: pwm@180000 {
      compatible = "snps,dw-apb-timers-pwm2";
      reg = <0x180000 0x200>;
      #pwm-cells = <3>;
      clocks = <&bus>, <&timer>;
      clock-names = "bus", "timer";
    };
```

## Documentation/devicetree/bindings/pwm/sophgo,sg2042-pwm.yaml
```yaml
# SPDX-License-Identifier: (GPL-2.0 OR BSD-2-Clause)
%YAML 1.2
---
$id: http://devicetree.org/schemas/pwm/sophgo,sg2042-pwm.yaml#
$schema: http://devicetree.org/meta-schemas/core.yaml#

title: Sophgo SG2042 PWM controller

maintainers:
  - Chen Wang <unicorn_wang@outlook.com>

description:
  This controller contains 4 channels which can generate PWM waveforms.

allOf:
  - $ref: pwm.yaml#

properties:
  compatible:
    enum:
      - sophgo,sg2042-pwm
      - sophgo,sg2044-pwm

  reg:
    maxItems: 1

  clocks:
    maxItems: 1

  clock-names:
    items:
      - const: apb

  resets:
    maxItems: 1

  "#pwm-cells":
    const: 3

required:
  - compatible
  - reg
  - clocks
  - clock-names
  - resets

unevaluatedProperties: false

examples:
  - |
    #include <dt-bindings/reset/sophgo,sg2042-reset.h>

    pwm@7f006000 {
        compatible = "sophgo,sg2042-pwm";
        reg = <0x7f006000 0x1000>;
        #pwm-cells = <3>;
        clocks = <&clock 67>;
        clock-names = "apb";
        resets = <&rstgen RST_PWM>;
    };
```

## Documentation/devicetree/bindings/pwm/spear-pwm.txt
```
== ST SPEAr SoC PWM controller ==

Required properties:
- compatible: should be one of:
  - "st,spear320-pwm"
  - "st,spear1340-pwm"
- reg: physical base address and length of the controller's registers
- #pwm-cells: should be 2. See pwm.yaml in this directory for a description of
  the cells format.

Example:

        pwm: pwm@a8000000 {
            compatible ="st,spear320-pwm";
            reg = <0xa8000000 0x1000>;
            #pwm-cells = <2>;
        };
```

## Documentation/devicetree/bindings/pwm/sprd,ums512-pwm.yaml
```yaml
# SPDX-License-Identifier: GPL-2.0-only OR BSD-2-Clause
%YAML 1.2
---
$id: http://devicetree.org/schemas/pwm/sprd,ums512-pwm.yaml#
$schema: http://devicetree.org/meta-schemas/core.yaml#

title: Spreadtrum/Unisoc UMS512 PWM Controller

maintainers:
  - Orson Zhai <orsonzhai@gmail.com>
  - Baolin Wang <baolin.wang@linux.alibaba.com>
  - Chunyan Zhang <zhang.lyra@gmail.com>

properties:
  compatible:
    const: sprd,ums512-pwm

  reg:
    maxItems: 1

  clocks:
    maxItems: 8

  clock-names:
    items:
      - const: pwm0
      - const: enable0
      - const: pwm1
      - const: enable1
      - const: pwm2
      - const: enable2
      - const: pwm3
      - const: enable3

  '#pwm-cells':
    const: 2

required:
  - compatible
  - reg
  - clocks
  - clock-names

allOf:
  - $ref: pwm.yaml#

unevaluatedProperties: false

examples:
  - |
    #include <dt-bindings/clock/sprd,ums512-clk.h>

    pwm@32260000 {
      compatible = "sprd,ums512-pwm";
      reg = <0x32260000 0x10000>;
      clocks = <&aon_clk CLK_PWM0>, <&aonapb_gate CLK_PWM0_EB>,
               <&aon_clk CLK_PWM1>, <&aonapb_gate CLK_PWM1_EB>,
               <&aon_clk CLK_PWM2>, <&aonapb_gate CLK_PWM2_EB>,
               <&aon_clk CLK_PWM3>, <&aonapb_gate CLK_PWM3_EB>;
      clock-names = "pwm0", "enable0",
                    "pwm1", "enable1",
                    "pwm2", "enable2",
                    "pwm3", "enable3";
      #pwm-cells = <2>;
    };
...
```

## Documentation/devicetree/bindings/pwm/st,stmpe-pwm.txt
```
== ST STMPE PWM controller ==

This is a PWM block embedded in the ST Microelectronics STMPE
(ST Multi-Purpose Expander) chips. The PWM is registered as a
subdevices of the STMPE MFD device.

Required properties:
- compatible: should be:
  - "st,stmpe-pwm"
- #pwm-cells: should be 2. See pwm.yaml in this directory for a description of
  the cells format.

Example:

pwm0: pwm {
	compatible = "st,stmpe-pwm";
	#pwm-cells = <2>;
};
```

## Documentation/devicetree/bindings/pwm/sunplus,sp7021-pwm.yaml
```yaml
# SPDX-License-Identifier: (GPL-2.0-only OR BSD-2-Clause)
# Copyright (C) Sunplus Co., Ltd. 2021
%YAML 1.2
---
$id: http://devicetree.org/schemas/pwm/sunplus,sp7021-pwm.yaml#
$schema: http://devicetree.org/meta-schemas/core.yaml#

title: Sunplus SoC SP7021 PWM Controller

maintainers:
  - Hammer Hsieh <hammerh0314@gmail.com>

allOf:
  - $ref: pwm.yaml#

properties:
  compatible:
    const: sunplus,sp7021-pwm

  reg:
    maxItems: 1

  clocks:
    maxItems: 1

  '#pwm-cells':
    const: 2

unevaluatedProperties: false

required:
  - reg
  - clocks

examples:
  - |
    pwm: pwm@9c007a00 {
      compatible = "sunplus,sp7021-pwm";
      reg = <0x9c007a00 0x80>;
      clocks = <&clkc 0xa2>;
      #pwm-cells = <2>;
    };
```

## Documentation/devicetree/bindings/pwm/thead,th1520-pwm.yaml
```yaml
# SPDX-License-Identifier: (GPL-2.0-only OR BSD-2-Clause)
%YAML 1.2
---
$id: http://devicetree.org/schemas/pwm/thead,th1520-pwm.yaml#
$schema: http://devicetree.org/meta-schemas/core.yaml#

title: T-HEAD TH1520 PWM controller

maintainers:
  - Michal Wilczynski <m.wilczynski@samsung.com>

allOf:
  - $ref: pwm.yaml#

properties:
  compatible:
    const: thead,th1520-pwm

  reg:
    maxItems: 1

  clocks:
    items:
      - description: SoC PWM clock

  "#pwm-cells":
    const: 3

required:
  - compatible
  - reg
  - clocks

unevaluatedProperties: false

examples:
  - |
    #include <dt-bindings/clock/thead,th1520-clk-ap.h>
    soc {
      #address-cells = <2>;
      #size-cells = <2>;
      pwm@ffec01c000 {
          compatible = "thead,th1520-pwm";
          reg = <0xff 0xec01c000 0x0 0x4000>;
          clocks = <&clk CLK_PWM>;
          #pwm-cells = <3>;
      };
    };
```

## Documentation/devicetree/bindings/pwm/ti,omap-dmtimer-pwm.yaml
```yaml
# SPDX-License-Identifier: GPL-2.0-only OR BSD-2-Clause
%YAML 1.2
---
$id: http://devicetree.org/schemas/pwm/ti,omap-dmtimer-pwm.yaml#
$schema: http://devicetree.org/meta-schemas/core.yaml#

title: TI dual mode timer PWM controller

maintainers:
  - Tony Lindgren <tony@atomide.com>

description:
  TI dual mode timer instances have an IO pin for PWM capability

allOf:
  - $ref: pwm.yaml#

properties:
  compatible:
    const: ti,omap-dmtimer-pwm

  "#pwm-cells":
    const: 3

  ti,timers:
    description: Timer instance phandle for the PWM
    $ref: /schemas/types.yaml#/definitions/phandle

  ti,prescaler:
    description: |
      Legacy clock prescaler for timer. The timer counter is prescaled
      with 2^n where n is the prescaler.
    $ref: /schemas/types.yaml#/definitions/uint32
    enum: [ 0, 1, 2, 3, 4, 5, 6, 7 ]
    deprecated: true

  ti,clock-source:
    description: |
      Legacy clock for timer, please use assigned-clocks instead.
      0x00 - high-frequency system clock (timer_sys_ck)
      0x01 - 32-kHz always-on clock (timer_32k_ck)
      0x02 - external clock (timer_ext_ck, OMAP2 only)
    $ref: /schemas/types.yaml#/definitions/uint32
    enum: [ 0, 1, 2 ]
    deprecated: true

required:
  - compatible
  - ti,timers

unevaluatedProperties: false

examples:
  - |
    pwm9: pwm {
      compatible = "ti,omap-dmtimer-pwm";
      ti,timers = <&timer9>;
      #pwm-cells = <3>;
    };
```

## Documentation/devicetree/bindings/pwm/ti,twl-pwm.txt
```
Texas Instruments TWL series PWM drivers

Supported PWMs:
On TWL4030 series: PWM1 and PWM2
On TWL6030 series: PWM0 and PWM1

Required properties:
- compatible: "ti,twl4030-pwm" or "ti,twl6030-pwm"
- #pwm-cells: should be 2. See pwm.txt in this directory for a description of
  the cells format.

Example:

twl_pwm: pwm {
	compatible = "ti,twl6030-pwm";
	#pwm-cells = <2>;
};
```

## Documentation/devicetree/bindings/pwm/ti,twl-pwmled.txt
```
Texas Instruments TWL series PWM drivers connected to LED terminals

Supported PWMs:
On TWL4030 series: PWMA and PWMB (connected to LEDA and LEDB terminals)
On TWL6030 series: LED PWM (mainly used as charging indicator LED)

Required properties:
- compatible: "ti,twl4030-pwmled" or "ti,twl6030-pwmled"
- #pwm-cells: should be 2. See pwm.yaml in this directory for a description of
  the cells format.

Example:

twl_pwmled: pwmled {
	compatible = "ti,twl6030-pwmled";
	#pwm-cells = <2>;
};
```
