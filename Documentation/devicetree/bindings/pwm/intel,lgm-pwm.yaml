## Documentation/devicetree/bindings/pwm/intel,lgm-pwm.yaml
```yaml
# SPDX-License-Identifier: (GPL-2.0-only OR BSD-2-Clause)
%YAML 1.2
---
$id: http://devicetree.org/schemas/pwm/intel,lgm-pwm.yaml#
$schema: http://devicetree.org/meta-schemas/core.yaml#

title: LGM SoC PWM fan controller

maintainers:
  - Rahul Tanwar <rtanwar@maxlinear.com>

properties:
  compatible:
    const: intel,lgm-pwm

  reg:
    maxItems: 1

  "#pwm-cells":
    const: 2

  clocks:
    maxItems: 1

  resets:
    maxItems: 1

required:
  - compatible
  - reg
  - clocks
  - resets

additionalProperties: false

examples:
  - |
    pwm: pwm@e0d00000 {
        compatible = "intel,lgm-pwm";
        reg = <0xe0d00000 0x30>;
        #pwm-cells = <2>;
        clocks = <&cgu0 126>;
        resets = <&rcu0 0x30 21>;
    };
```

## Documentation/devicetree/bindings/pwm/iqs620a-pwm.yaml
```yaml
# SPDX-License-Identifier: (GPL-2.0 OR BSD-2-Clause)
%YAML 1.2
---
$id: http://devicetree.org/schemas/pwm/iqs620a-pwm.yaml#
$schema: http://devicetree.org/meta-schemas/core.yaml#

title: Azoteq IQS620A PWM Generator

maintainers:
  - Jeff LaBundy <jeff@labundy.com>

description: |
  The Azoteq IQS620A multi-function sensor generates a fixed-frequency PWM
  output represented by a "pwm" child node from the parent MFD driver. See
  Documentation/devicetree/bindings/mfd/iqs62x.yaml for further details as
  well as an example.

allOf:
  - $ref: pwm.yaml#

properties:
  compatible:
    enum:
      - azoteq,iqs620a-pwm

  "#pwm-cells":
    const: 2

required:
  - compatible

additionalProperties: false

...
```

## Documentation/devicetree/bindings/pwm/kontron,sl28cpld-pwm.yaml
```yaml
# SPDX-License-Identifier: (GPL-2.0-only OR BSD-2-Clause)
%YAML 1.2
---
$id: http://devicetree.org/schemas/pwm/kontron,sl28cpld-pwm.yaml#
$schema: http://devicetree.org/meta-schemas/core.yaml#

title: PWM driver for the sl28cpld board management controller

maintainers:
  - Michael Walle <michael@walle.cc>

description: |
  This module is part of the sl28cpld multi-function device. For more
  details see ../mfd/kontron,sl28cpld.yaml.

  The controller supports one PWM channel and supports only four distinct
  frequencies (250Hz, 500Hz, 1kHz, 2kHz).

allOf:
  - $ref: pwm.yaml#

properties:
  compatible:
    const: kontron,sl28cpld-pwm

  reg:
    maxItems: 1

  "#pwm-cells":
    const: 2

required:
  - compatible

additionalProperties: false
```

## Documentation/devicetree/bindings/pwm/loongson,ls7a-pwm.yaml
```yaml
# SPDX-License-Identifier: (GPL-2.0-only OR BSD-2-Clause)
%YAML 1.2
---
$id: http://devicetree.org/schemas/pwm/loongson,ls7a-pwm.yaml#
$schema: http://devicetree.org/meta-schemas/core.yaml#

title: Loongson PWM Controller

maintainers:
  - Binbin Zhou <zhoubinbin@loongson.cn>

description:
  The Loongson PWM has one pulse width output signal and one pulse input
  signal to be measured.
  It can be found on Loongson-2K series cpus and Loongson LS7A bridge chips.

allOf:
  - $ref: pwm.yaml#

properties:
  compatible:
    oneOf:
      - const: loongson,ls7a-pwm
      - items:
          - enum:
              - loongson,ls2k0500-pwm
              - loongson,ls2k1000-pwm
              - loongson,ls2k2000-pwm
          - const: loongson,ls7a-pwm

  reg:
    maxItems: 1

  interrupts:
    maxItems: 1

  clocks:
    maxItems: 1

  '#pwm-cells':
    description:
      The first cell must have a value of 0, which specifies the PWM output signal;
      The second cell is the period in nanoseconds;
      The third cell flag supported by this binding is PWM_POLARITY_INVERTED.
    const: 3

required:
  - compatible
  - reg
  - interrupts
  - clocks

additionalProperties: false

examples:
  - |
    #include <dt-bindings/interrupt-controller/irq.h>
    #include <dt-bindings/clock/loongson,ls2k-clk.h>

    pwm@1fe22000 {
        compatible = "loongson,ls2k1000-pwm", "loongson,ls7a-pwm";
        reg = <0x1fe22000 0x10>;
        interrupt-parent = <&liointc0>;
        interrupts = <24 IRQ_TYPE_LEVEL_HIGH>;
        clocks = <&clk LOONGSON2_APB_CLK>;
        #pwm-cells = <3>;
    };
```

## Documentation/devicetree/bindings/pwm/lpc1850-sct-pwm.txt
```
* NXP LPC18xx State Configurable Timer - Pulse Width Modulator driver

Required properties:
  - compatible: Should be "nxp,lpc1850-sct-pwm"
  - reg: Should contain physical base address and length of pwm registers.
  - clocks: Must contain an entry for each entry in clock-names.
    See ../clock/clock-bindings.txt for details.
  - clock-names: Must include the following entries.
    - pwm: PWM operating clock.
  - #pwm-cells: Should be 3. See pwm.yaml in this directory for the description
    of the cells format.

Example:
  pwm: pwm@40000000 {
    compatible = "nxp,lpc1850-sct-pwm";
    reg = <0x40000000 0x1000>;
    clocks =<&ccu1 CLK_CPU_SCT>;
    clock-names = "pwm";
    #pwm-cells = <3>;
  };
```

## Documentation/devicetree/bindings/pwm/lpc32xx-pwm.txt
```
LPC32XX PWM controller

Required properties:
- compatible: should be "nxp,lpc3220-pwm"
- reg: physical base address and length of the controller's registers

Examples:

pwm@4005c000 {
	compatible = "nxp,lpc3220-pwm";
	reg = <0x4005c000 0x4>;
};

pwm@4005c004 {
	compatible = "nxp,lpc3220-pwm";
	reg = <0x4005c004 0x4>;
};
```

## Documentation/devicetree/bindings/pwm/marvell,berlin-pwm.yaml
```yaml
# SPDX-License-Identifier: (GPL-2.0-only OR BSD-2-Clause)
%YAML 1.2
---
$id: http://devicetree.org/schemas/pwm/marvell,berlin-pwm.yaml#
$schema: http://devicetree.org/meta-schemas/core.yaml#

title: Berlin PWM controller

maintainers:
  - Jisheng Zhang <jszhang@kernel.org>
  - Sebastian Hesselbarth <sebastian.hesselbarth@gmail.com>

properties:
  compatible:
    const: marvell,berlin-pwm

  reg:
    maxItems: 1

  "#pwm-cells":
    const: 3

  clocks:
    maxItems: 1

required:
  - compatible
  - reg
  - clocks

allOf:
  - $ref: pwm.yaml#

unevaluatedProperties: false

examples:
  - |
    pwm@f7f20000 {
        compatible = "marvell,berlin-pwm";
        reg = <0xf7f20000 0x40>;
        clocks = <&chip_clk 12>;
        #pwm-cells = <3>;
    };
```

## Documentation/devicetree/bindings/pwm/marvell,pxa-pwm.yaml
```yaml
# SPDX-License-Identifier: (GPL-2.0-only OR BSD-2-Clause)
%YAML 1.2
---
$id: http://devicetree.org/schemas/pwm/marvell,pxa-pwm.yaml#
$schema: http://devicetree.org/meta-schemas/core.yaml#

title: Marvell PXA PWM

maintainers:
  - Duje Mihanović <duje.mihanovic@skole.hr>

allOf:
  - $ref: pwm.yaml#
  - if:
      properties:
        compatible:
          contains:
            enum:
              - spacemit,k1-pwm
              - spacemit,k3-pwm
    then:
      properties:
        "#pwm-cells":
          const: 3
    else:
      properties:
        "#pwm-cells":
          const: 1
          description: |
            Used for specifying the period length in nanoseconds.
  - if:
      properties:
        compatible:
          contains:
            enum:
              - spacemit,k3-pwm
    then:
      required:
        - clock-names
      properties:
        clocks:
          minItems: 2
        clock-names:
          minItems: 2
    else:
      properties:
        clocks:
          maxItems: 1
        clock-names:
          maxItems: 1

properties:
  compatible:
    oneOf:
      - enum:
          - marvell,pxa250-pwm
          - marvell,pxa270-pwm
          - marvell,pxa168-pwm
          - marvell,pxa910-pwm
      - items:
          - enum:
              - spacemit,k1-pwm
              - spacemit,k3-pwm
          - const: marvell,pxa910-pwm

  reg:
    # Length should be 0x10
    maxItems: 1

  "#pwm-cells":
    description: Number of cells in a pwm specifier.

  clocks:
    minItems: 1
    items:
      - description: The function clock
      - description: An optional bus clock

  clock-names:
    minItems: 1
    maxItems: 2
    oneOf:
      - items:
          - const: func
          - const: bus

  resets:
    maxItems: 1

required:
  - compatible
  - reg
  - clocks

additionalProperties: false

examples:
  - |
    #include <dt-bindings/clock/pxa-clock.h>

    pwm0: pwm@40b00000 {
      compatible = "marvell,pxa250-pwm";
      reg = <0x40b00000 0x10>;
      #pwm-cells = <1>;
      clocks = <&clks CLK_PWM0>;
    };
```

## Documentation/devicetree/bindings/pwm/mediatek,mt2712-pwm.yaml
```yaml
# SPDX-License-Identifier: (GPL-2.0-only OR BSD-2-Clause)
%YAML 1.2
---
$id: http://devicetree.org/schemas/pwm/mediatek,mt2712-pwm.yaml#
$schema: http://devicetree.org/meta-schemas/core.yaml#

title: MediaTek PWM Controller

maintainers:
  - John Crispin <john@phrozen.org>

allOf:
  - $ref: pwm.yaml#

properties:
  compatible:
    oneOf:
      - enum:
          - mediatek,mt2712-pwm
          - mediatek,mt6795-pwm
          - mediatek,mt7622-pwm
          - mediatek,mt7623-pwm
          - mediatek,mt7628-pwm
          - mediatek,mt7629-pwm
          - mediatek,mt7981-pwm
          - mediatek,mt7986-pwm
          - mediatek,mt7988-pwm
          - mediatek,mt8183-pwm
          - mediatek,mt8365-pwm
          - mediatek,mt8516-pwm
      - items:
          - enum:
              - mediatek,mt8195-pwm
          - const: mediatek,mt8183-pwm

  reg:
    maxItems: 1

  "#pwm-cells":
    const: 2

  interrupts:
    maxItems: 1

  clocks:
    minItems: 2
    maxItems: 10

  clock-names:
    description:
      This controller needs two input clocks for its core and one
      clock for each PWM output.
    minItems: 2
    items:
      - const: top
      - const: main
      - const: pwm1
      - const: pwm2
      - const: pwm3
      - const: pwm4
      - const: pwm5
      - const: pwm6
      - const: pwm7
      - const: pwm8

required:
  - compatible
  - reg
  - clocks
  - clock-names

additionalProperties: false

examples:
  - |
    #include <dt-bindings/interrupt-controller/arm-gic.h>
    #include <dt-bindings/clock/mt2712-clk.h>
    #include <dt-bindings/interrupt-controller/irq.h>

    pwm0: pwm@11006000 {
        compatible = "mediatek,mt2712-pwm";
        reg = <0x11006000 0x1000>;
        #pwm-cells = <2>;
        interrupts = <GIC_SPI 77 IRQ_TYPE_LEVEL_LOW>;
        clocks = <&topckgen CLK_TOP_PWM_SEL>, <&pericfg CLK_PERI_PWM>,
                 <&pericfg CLK_PERI_PWM0>, <&pericfg CLK_PERI_PWM1>,
                 <&pericfg CLK_PERI_PWM2>, <&pericfg CLK_PERI_PWM3>,
                 <&pericfg CLK_PERI_PWM4>, <&pericfg CLK_PERI_PWM5>,
                 <&pericfg CLK_PERI_PWM6>, <&pericfg CLK_PERI_PWM7>;
        clock-names = "top", "main",
                      "pwm1", "pwm2",
                      "pwm3", "pwm4",
                      "pwm5", "pwm6",
                      "pwm7", "pwm8";
    };
```

## Documentation/devicetree/bindings/pwm/mediatek,pwm-disp.yaml
```yaml
# SPDX-License-Identifier: (GPL-2.0-only OR BSD-2-Clause)
%YAML 1.2
---
$id: http://devicetree.org/schemas/pwm/mediatek,pwm-disp.yaml#
$schema: http://devicetree.org/meta-schemas/core.yaml#

title: MediaTek DISP_PWM Controller

maintainers:
  - Jitao Shi <jitao.shi@mediatek.com>
  - Xinlei Lee <xinlei.lee@mediatek.com>

allOf:
  - $ref: pwm.yaml#

properties:
  compatible:
    oneOf:
      - enum:
          - mediatek,mt2701-disp-pwm
          - mediatek,mt6595-disp-pwm
          - mediatek,mt8173-disp-pwm
          - mediatek,mt8183-disp-pwm
      - items:
          - const: mediatek,mt8167-disp-pwm
          - const: mediatek,mt8173-disp-pwm
      - items:
          - enum:
              - mediatek,mt8186-disp-pwm
              - mediatek,mt8192-disp-pwm
              - mediatek,mt8195-disp-pwm
          - const: mediatek,mt8183-disp-pwm

  reg:
    maxItems: 1

  "#pwm-cells":
    const: 2

  interrupts:
    maxItems: 1

  clocks:
    items:
      - description: Main Clock
      - description: Mm Clock

  clock-names:
    items:
      - const: main
      - const: mm

required:
  - compatible
  - reg
  - "#pwm-cells"
  - clocks
  - clock-names

additionalProperties: false

examples:
  - |
    #include <dt-bindings/interrupt-controller/arm-gic.h>
    #include <dt-bindings/clock/mt8173-clk.h>
    #include <dt-bindings/interrupt-controller/irq.h>

    pwm0: pwm@1401e000 {
        compatible = "mediatek,mt8173-disp-pwm";
        reg = <0x1401e000 0x1000>;
        #pwm-cells = <2>;
        clocks = <&mmsys CLK_MM_DISP_PWM026M>,
                 <&mmsys CLK_MM_DISP_PWM0MM>;
        clock-names = "main", "mm";
    };
```

## Documentation/devicetree/bindings/pwm/microchip,corepwm.yaml
```yaml
# SPDX-License-Identifier: (GPL-2.0-only OR BSD-2-Clause)

%YAML 1.2
---
$id: http://devicetree.org/schemas/pwm/microchip,corepwm.yaml#
$schema: http://devicetree.org/meta-schemas/core.yaml#

title: Microchip IP corePWM controller bindings

maintainers:
  - Conor Dooley <conor.dooley@microchip.com>

description: |
  corePWM is an 16 channel pulse width modulator FPGA IP

  https://www.microsemi.com/existing-parts/parts/152118

allOf:
  - $ref: pwm.yaml#

properties:
  compatible:
    items:
      - const: microchip,corepwm-rtl-v4

  reg:
    maxItems: 1

  clocks:
    maxItems: 1

  "#pwm-cells":
    enum: [2, 3]
    description:
      The only flag supported by the controller is PWM_POLARITY_INVERTED.

  microchip,sync-update-mask:
    description: |
      Depending on how the IP is instantiated, there are two modes of operation.
      In synchronous mode, all channels are updated at the beginning of the PWM period,
      and in asynchronous mode updates happen as the control registers are written.
      A 16 bit wide "SHADOW_REG_EN" parameter of the IP core controls whether synchronous
      mode is possible for each channel, and is set by the bitstream programmed to the
      FPGA. If the IP core is instantiated with SHADOW_REG_ENx=1, both registers that
      control the duty cycle for channel x have a second "shadow"/buffer reg synthesised.
      At runtime a bit wide register exposed to APB can be used to toggle on/off
      synchronised mode for all channels it has been synthesised for.
      Each bit of "microchip,sync-update-mask" corresponds to a PWM channel & represents
      whether synchronous mode is possible for the PWM channel.

    $ref: /schemas/types.yaml#/definitions/uint32
    default: 0

  microchip,dac-mode-mask:
    description: |
      Optional, per-channel Low Ripple DAC mode is possible on this IP core. It creates
      a minimum period pulse train whose High/Low average is that of the chosen duty
      cycle. This "DAC" will have far better bandwidth and ripple performance than the
      standard PWM algorithm can achieve. A 16 bit DAC_MODE module parameter of the IP
      core, set at instantiation and by the bitstream programmed to the FPGA, determines
      whether a given channel operates in regular PWM or DAC mode.
      Each bit corresponds to a PWM channel & represents whether DAC mode is enabled
      for that channel.

    $ref: /schemas/types.yaml#/definitions/uint32
    default: 0

required:
  - compatible
  - reg
  - clocks

additionalProperties: false

examples:
  - |
    pwm@41000000 {
      compatible = "microchip,corepwm-rtl-v4";
      microchip,sync-update-mask = /bits/ 32 <0>;
      clocks = <&clkcfg 30>;
      reg = <0x41000000 0xF0>;
      #pwm-cells = <2>;
    };
```

## Documentation/devicetree/bindings/pwm/mxs-pwm.txt
```
Freescale MXS PWM controller

Required properties:
- compatible: should be "fsl,imx23-pwm"
- reg: physical base address and length of the controller's registers
- #pwm-cells: should be 2. See pwm.txt in this directory for a description of
  the cells format.
- fsl,pwm-number: the number of PWM devices

Example:

pwm: pwm@80064000 {
	compatible = "fsl,imx28-pwm", "fsl,imx23-pwm";
	reg = <0x80064000 0x2000>;
	#pwm-cells = <2>;
	fsl,pwm-number = <8>;
};
```
