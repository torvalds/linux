## Documentation/devicetree/bindings/pwm/pwm-amlogic.yaml
```yaml
# SPDX-License-Identifier: (GPL-2.0-only OR BSD-2-Clause)
%YAML 1.2
---
$id: http://devicetree.org/schemas/pwm/pwm-amlogic.yaml#
$schema: http://devicetree.org/meta-schemas/core.yaml#

title: Amlogic PWM

maintainers:
  - Heiner Kallweit <hkallweit1@gmail.com>

properties:
  compatible:
    oneOf:
      - enum:
          - amlogic,meson8b-pwm
          - amlogic,meson-gxbb-pwm
          - amlogic,meson-gxbb-ao-pwm
          - amlogic,meson-axg-ee-pwm
          - amlogic,meson-axg-ao-pwm
          - amlogic,meson-g12a-ee-pwm
          - amlogic,meson-g12a-ao-pwm-ab
          - amlogic,meson-g12a-ao-pwm-cd
        deprecated: true
      - items:
          - const: amlogic,meson-gx-pwm
          - const: amlogic,meson-gxbb-pwm
        deprecated: true
      - items:
          - const: amlogic,meson-gx-ao-pwm
          - const: amlogic,meson-gxbb-ao-pwm
        deprecated: true
      - items:
          - const: amlogic,meson8-pwm
          - const: amlogic,meson8b-pwm
        deprecated: true
      - enum:
          - amlogic,meson8-pwm-v2
          - amlogic,meson-s4-pwm
      - items:
          - enum:
              - amlogic,meson-a1-pwm
          - const: amlogic,meson-s4-pwm
      - items:
          - enum:
              - amlogic,meson8b-pwm-v2
              - amlogic,meson-gxbb-pwm-v2
              - amlogic,meson-axg-pwm-v2
              - amlogic,meson-g12-pwm-v2
          - const: amlogic,meson8-pwm-v2

  reg:
    maxItems: 1

  clocks:
    minItems: 1
    maxItems: 4

  clock-names:
    minItems: 1
    maxItems: 2

  power-domains:
    maxItems: 1

  "#pwm-cells":
    const: 3

required:
  - compatible
  - reg

allOf:
  - $ref: pwm.yaml#

  - if:
      properties:
        compatible:
          contains:
            enum:
              - amlogic,meson8-pwm
              - amlogic,meson8b-pwm
              - amlogic,meson-gxbb-pwm
              - amlogic,meson-gxbb-ao-pwm
              - amlogic,meson-axg-ee-pwm
              - amlogic,meson-axg-ao-pwm
              - amlogic,meson-g12a-ee-pwm
              - amlogic,meson-g12a-ao-pwm-ab
              - amlogic,meson-g12a-ao-pwm-cd
    then:
      # Obsolete historic bindings tied to the driver implementation
      # The clocks provided here are meant to be matched with the input
      # known (hard-coded) in the driver and used to select pwm clock
      # source. Currently, the linux driver ignores this.
      # This is kept to maintain ABI backward compatibility.
      properties:
        clocks:
          maxItems: 2
        clock-names:
          oneOf:
            - items:
                - enum: [clkin0, clkin1]
            - items:
                - const: clkin0
                - const: clkin1

  # Newer binding where clock describe the actual clock inputs of the pwm
  # block. These are necessary but some inputs may be grounded.
  - if:
      properties:
        compatible:
          contains:
            enum:
              - amlogic,meson8-pwm-v2
    then:
      properties:
        clocks:
          minItems: 1
          items:
            - description: input clock 0 of the pwm block
            - description: input clock 1 of the pwm block
            - description: input clock 2 of the pwm block
            - description: input clock 3 of the pwm block
        clock-names: false
      required:
        - clocks

  # Newer IP block take a single input per channel, instead of 4 inputs
  # for both channels
  - if:
      properties:
        compatible:
          contains:
            enum:
              - amlogic,meson-s4-pwm
    then:
      properties:
        clocks:
          items:
            - description: input clock of PWM channel A
            - description: input clock of PWM channel B
        clock-names: false
      required:
        - clocks

  - if:
      properties:
        compatible:
          contains:
            enum:
              - amlogic,meson-a1-pwm
    then:
      required:
        - power-domains

additionalProperties: false

examples:
  - |
    pwm@8550 {
      compatible = "amlogic,meson-gxbb-pwm";
      reg = <0x08550 0x10>;
      clocks = <&xtal>, <&xtal>;
      clock-names = "clkin0", "clkin1";
      #pwm-cells = <3>;
    };
  - |
    pwm@2000 {
      compatible = "amlogic,meson8-pwm-v2";
      reg = <0x1000 0x10>;
      clocks = <&xtal>, <0>, <&fdiv4>, <&fdiv5>;
      #pwm-cells = <3>;
    };
  - |
    pwm@1000 {
      compatible = "amlogic,meson-s4-pwm";
      reg = <0x1000 0x10>;
      clocks = <&pwm_src_a>, <&pwm_src_b>;
      #pwm-cells = <3>;
    };
```

## Documentation/devicetree/bindings/pwm/pwm-bcm2835.txt
```
BCM2835 PWM controller (Raspberry Pi controller)

Required properties:
- compatible: should be "brcm,bcm2835-pwm"
- reg: physical base address and length of the controller's registers
- clocks: This clock defines the base clock frequency of the PWM hardware
  system, the period and the duty_cycle of the PWM signal is a multiple of
  the base period.
- #pwm-cells: Should be 3. See pwm.txt in this directory for a description of
  the cells format.

Examples:

pwm@2020c000 {
	compatible = "brcm,bcm2835-pwm";
	reg = <0x2020c000 0x28>;
	clocks = <&clk_pwm>;
	#pwm-cells = <3>;
};

clocks {
	....
		clk_pwm: pwm {
			compatible = "fixed-clock";
			reg = <3>;
			#clock-cells = <0>;
			clock-frequency = <9200000>;
		};
	....
};
```

## Documentation/devicetree/bindings/pwm/pwm-bcm2835.yaml
```yaml
# SPDX-License-Identifier: (GPL-2.0-only OR BSD-2-Clause)
%YAML 1.2
---
$id: http://devicetree.org/schemas/pwm/pwm-bcm2835.yaml#
$schema: http://devicetree.org/meta-schemas/core.yaml#

title: BCM2835 PWM controller (Raspberry Pi controller)

maintainers:
  - Stefan Wahren <stefan.wahren@i2se.com>

allOf:
  - $ref: pwm.yaml#

properties:
  compatible:
    const: brcm,bcm2835-pwm

  reg:
    maxItems: 1

  clocks:
    maxItems: 1

  "#pwm-cells":
    const: 3

required:
  - compatible
  - reg
  - clocks
  - "#pwm-cells"

additionalProperties: false

examples:
  - |
    pwm@2020c000 {
      compatible = "brcm,bcm2835-pwm";
      reg = <0x2020c000 0x28>;
      clocks = <&clk_pwm>;
      #pwm-cells = <3>;
    };
```

## Documentation/devicetree/bindings/pwm/pwm-berlin.txt
```
Berlin PWM controller

Required properties:
- compatible: should be "marvell,berlin-pwm"
- reg: physical base address and length of the controller's registers
- clocks: phandle to the input clock
- #pwm-cells: should be 3. See pwm.txt in this directory for a description of
  the cells format.

Example:

pwm: pwm@f7f20000 {
	compatible = "marvell,berlin-pwm";
	reg = <0xf7f20000 0x40>;
	clocks = <&chip_clk CLKID_CFG>;
	#pwm-cells = <3>;
}
```

## Documentation/devicetree/bindings/pwm/pwm-fsl-ftm.txt
```
Freescale FlexTimer Module (FTM) PWM controller

The same FTM PWM device can have a different endianness on different SoCs. The
device tree provides a property to describing this so that an operating system
device driver can handle all variants of the device. Refer to the table below
for the endianness of the FTM PWM block as integrated into the existing SoCs:

	SoC     | FTM-PWM endianness
	--------+-------------------
	Vybrid  | LE
	LS1     | BE
	LS2     | LE

Please see ../regmap/regmap.txt for more detail about how to specify endian
modes in device tree.


Required properties:
- compatible : should be "fsl,<soc>-ftm-pwm" and one of the following
   compatible strings:
  - "fsl,vf610-ftm-pwm" for PWM compatible with the one integrated on VF610
  - "fsl,imx8qm-ftm-pwm" for PWM compatible with the one integrated on i.MX8QM
- reg: Physical base address and length of the controller's registers
- #pwm-cells: Should be 3. See pwm.yaml in this directory for a description of
  the cells format.
- clock-names: Should include the following module clock source entries:
    "ftm_sys" (module clock, also can be used as counter clock),
    "ftm_ext" (external counter clock),
    "ftm_fix" (fixed counter clock),
    "ftm_cnt_clk_en" (external and fixed counter clock enable/disable).
- clocks: Must contain a phandle and clock specifier for each entry in
  clock-names, please see clock/clock-bindings.txt for details of the property
  values.
- pinctrl-names: Must contain a "default" entry.
- pinctrl-NNN: One property must exist for each entry in pinctrl-names.
  See pinctrl/pinctrl-bindings.txt for details of the property values.
- big-endian: Boolean property, required if the FTM PWM registers use a big-
  endian rather than little-endian layout.

Example:

pwm0: pwm@40038000 {
		compatible = "fsl,vf610-ftm-pwm";
		reg = <0x40038000 0x1000>;
		#pwm-cells = <3>;
		clock-names = "ftm_sys", "ftm_ext",
				"ftm_fix", "ftm_cnt_clk_en";
		clocks = <&clks VF610_CLK_FTM0>,
			<&clks VF610_CLK_FTM0_EXT_SEL>,
			<&clks VF610_CLK_FTM0_FIX_SEL>,
			<&clks VF610_CLK_FTM0_EXT_FIX_EN>;
		pinctrl-names = "default";
		pinctrl-0 = <&pinctrl_pwm0_1>;
		big-endian;
};
```
