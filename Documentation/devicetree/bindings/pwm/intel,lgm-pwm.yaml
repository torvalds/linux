## Documentation/devicetree/bindings/pwm/mxs-pwm.yaml
```yaml
# SPDX-License-Identifier: (GPL-2.0-only OR BSD-2-Clause)
%YAML 1.2
---
$id: http://devicetree.org/schemas/pwm/mxs-pwm.yaml#
$schema: http://devicetree.org/meta-schemas/core.yaml#

title: Freescale MXS PWM controller

maintainers:
  - Shawn Guo <shawnguo@kernel.org>
  - Anson Huang <anson.huang@nxp.com>

properties:
  compatible:
    enum:
      - fsl,imx23-pwm

  reg:
    maxItems: 1

  "#pwm-cells":
    const: 3

  fsl,pwm-number:
    $ref: '/schemas/types.yaml#/definitions/uint32'
    description: u32 value representing the number of PWM devices

required:
  - compatible
  - reg
  - "#pwm-cells"
  - fsl,pwm-number

additionalProperties: false

examples:
  - |
    pwm@80064000 {
        compatible = "fsl,imx23-pwm";
        reg = <0x80064000 0x2000>;
        #pwm-cells = <3>;
        fsl,pwm-number = <8>;
    };
```

## Documentation/devicetree/bindings/pwm/nvidia,tegra20-pwm.txt
```
Tegra SoC PWFM controller

Required properties:
- compatible: Must be:
  - "nvidia,tegra20-pwm": for Tegra20
  - "nvidia,tegra30-pwm", "nvidia,tegra20-pwm": for Tegra30
  - "nvidia,tegra114-pwm", "nvidia,tegra20-pwm": for Tegra114
  - "nvidia,tegra124-pwm", "nvidia,tegra20-pwm": for Tegra124
  - "nvidia,tegra132-pwm", "nvidia,tegra20-pwm": for Tegra132
  - "nvidia,tegra210-pwm", "nvidia,tegra20-pwm": for Tegra210
  - "nvidia,tegra186-pwm": for Tegra186
- reg: physical base address and length of the controller's registers
- #pwm-cells: should be 2. See pwm.txt in this directory for a description of
  the cells format.
- clocks: Must contain one entry, for the module clock.
  See ../clocks/clock-bindings.txt for details.
- resets: Must contain an entry for each entry in reset-names.
  See ../reset/reset.txt for details.
- reset-names: Must include the following entries:
  - pwm

Optional properties:
============================
In some of the interface like PWM based regulator device, it is required
to configure the pins differently in different states, especially in suspend
state of the system. The configuration of pin is provided via the pinctrl
DT node as detailed in the pinctrl DT binding document
	Documentation/devicetree/bindings/pinctrl/pinctrl-bindings.txt

The PWM node will have following optional properties.
pinctrl-names:	Pin state names. Must be "default" and "sleep".
pinctrl-0:	phandle for the default/active state of pin configurations.
pinctrl-1:	phandle for the sleep state of pin configurations.

Example:

	pwm: pwm@7000a000 {
		compatible = "nvidia,tegra20-pwm";
		reg = <0x7000a000 0x100>;
		#pwm-cells = <2>;
		clocks = <&tegra_car 17>;
		resets = <&tegra_car 17>;
		reset-names = "pwm";
	};


Example with the pin configuration for suspend and resume:
=========================================================
Suppose pin PE7 (On Tegra210) interfaced with the regulator device and
it requires PWM output to be tristated when system enters suspend.
Following will be DT binding to achieve this:

#include <dt-bindings/pinctrl/pinctrl-tegra.h>

	pinmux@700008d4 {
		pwm_active_state: pwm_active_state {
                        pe7 {
                                nvidia,pins = "pe7";
                                nvidia,tristate = <TEGRA_PIN_DISABLE>;
			};
		};

		pwm_sleep_state: pwm_sleep_state {
                        pe7 {
                                nvidia,pins = "pe7";
                                nvidia,tristate = <TEGRA_PIN_ENABLE>;
			};
		};
	};

	pwm@7000a000 {
		/* Mandatory PWM properties */
		pinctrl-names = "default", "sleep";
		pinctrl-0 = <&pwm_active_state>;
		pinctrl-1 = <&pwm_sleep_state>;
	};
```

## Documentation/devicetree/bindings/pwm/nvidia,tegra20-pwm.yaml
```yaml
# SPDX-License-Identifier: (GPL-2.0-only OR BSD-2-Clause)
%YAML 1.2
---
$id: http://devicetree.org/schemas/pwm/nvidia,tegra20-pwm.yaml#
$schema: http://devicetree.org/meta-schemas/core.yaml#

title: NVIDIA Tegra PWFM controller

maintainers:
  - Thierry Reding <thierry.reding@gmail.com>
  - Jon Hunter <jonathanh@nvidia.com>

properties:
  compatible:
    oneOf:
      - enum:
          - nvidia,tegra20-pwm
          - nvidia,tegra186-pwm

      - items:
          - enum:
              - nvidia,tegra30-pwm
              - nvidia,tegra114-pwm
              - nvidia,tegra124-pwm
              - nvidia,tegra132-pwm
              - nvidia,tegra210-pwm
          - enum:
              - nvidia,tegra20-pwm

      - items:
          - const: nvidia,tegra194-pwm
          - const: nvidia,tegra186-pwm

      - items:
          - const: nvidia,tegra234-pwm
          - const: nvidia,tegra194-pwm

  reg:
    maxItems: 1

  clocks:
    maxItems: 1

  resets:
    items:
      - description: module reset

  reset-names:
    items:
      - const: pwm

  "#pwm-cells":
    const: 2

  pinctrl-names:
    items:
      - const: default
      - const: sleep

  pinctrl-0:
    description: configuration for the default/active state

  pinctrl-1:
    description: configuration for the sleep state

  operating-points-v2: true

  power-domains:
    items:
      - description: phandle to the core power domain

allOf:
  - $ref: pwm.yaml

required:
  - compatible
  - reg
  - clocks
  - resets
  - reset-names

additionalProperties: false

examples:
  - |
    #include <dt-bindings/clock/tegra20-car.h>

    pwm: pwm@7000a000 {
        compatible = "nvidia,tegra20-pwm";
        reg = <0x7000a000 0x100>;
        #pwm-cells = <2>;
        clocks = <&tegra_car TEGRA20_CLK_PWM>;
        resets = <&tegra_car 17>;
        reset-names = "pwm";
    };
```

## Documentation/devicetree/bindings/pwm/nxp,lpc1850-sct-pwm.yaml
```yaml
# SPDX-License-Identifier: (GPL-2.0-only OR BSD-2-Clause)
%YAML 1.2
---
$id: http://devicetree.org/schemas/pwm/nxp,lpc1850-sct-pwm.yaml#
$schema: http://devicetree.org/meta-schemas/core.yaml#

title: NXP LPC18xx State Configurable Timer

maintainers:
  - Frank Li <Frank.Li@nxp.com>

properties:
  compatible:
    const: nxp,lpc1850-sct-pwm

  reg:
    maxItems: 1

  clocks:
    maxItems: 1

  clock-names:
    items:
      - const: pwm

  '#pwm-cells':
    const: 3

  resets:
    maxItems: 1

required:
  - compatible
  - reg
  - clocks
  - clock-names
  - '#pwm-cells'

allOf:
  - $ref: pwm.yaml#

unevaluatedProperties: false

examples:
  - |
    #include <dt-bindings/clock/lpc18xx-ccu.h>

    pwm@40000000 {
        compatible = "nxp,lpc1850-sct-pwm";
        reg = <0x40000000 0x1000>;
        clocks =<&ccu1 CLK_CPU_SCT>;
        clock-names = "pwm";
        #pwm-cells = <3>;
    };
```

## Documentation/devicetree/bindings/pwm/nxp,lpc3220-pwm.yaml
```yaml
# SPDX-License-Identifier: (GPL-2.0-only OR BSD-2-Clause)
%YAML 1.2
---
$id: http://devicetree.org/schemas/pwm/nxp,lpc3220-pwm.yaml#
$schema: http://devicetree.org/meta-schemas/core.yaml#

title: NXP LPC32XX PWM controller

maintainers:
  - Frank Li <Frank.Li@nxp.com>

properties:
  compatible:
    enum:
      - nxp,lpc3220-pwm
      - nxp,lpc3220-motor-pwm

  reg:
    maxItems: 1

  clocks:
    maxItems: 1

  '#pwm-cells':
    const: 3

required:
  - compatible
  - reg
  - '#pwm-cells'

allOf:
  - $ref: pwm.yaml#

unevaluatedProperties: false

examples:
  - |
    pwm@4005c000 {
        compatible = "nxp,lpc3220-pwm";
        reg = <0x4005c000 0x4>;
        #pwm-cells = <3>;
    };
```

## Documentation/devicetree/bindings/pwm/nxp,mc33xs2410.yaml
```yaml
# SPDX-License-Identifier: GPL-2.0-only OR BSD-2-Clause
%YAML 1.2
---
$id: http://devicetree.org/schemas/pwm/nxp,mc33xs2410.yaml#
$schema: http://devicetree.org/meta-schemas/core.yaml#

title: High-side switch MC33XS2410

maintainers:
  - Dimitri Fedrau <dima.fedrau@gmail.com>

allOf:
  - $ref: pwm.yaml#
  - $ref: /schemas/spi/spi-peripheral-props.yaml#

properties:
  compatible:
    const: nxp,mc33xs2410

  reg:
    maxItems: 1

  spi-max-frequency:
    maximum: 10000000

  spi-cpha: true

  spi-cs-setup-delay-ns:
    minimum: 100
    default: 100

  spi-cs-hold-delay-ns:
    minimum: 10
    default: 10

  spi-cs-inactive-delay-ns:
    minimum: 300
    default: 300

  reset-gpios:
    description:
      GPIO connected to the active low reset pin.
    maxItems: 1

  "#pwm-cells":
    const: 3

  pwm-names:
    items:
      - const: di0
      - const: di1
      - const: di2
      - const: di3

  pwms:
    description:
      Direct inputs(di0-3) are used to directly turn-on or turn-off the
      outputs.
    maxItems: 4

  interrupts:
    maxItems: 1

  clocks:
    description:
      The external clock can be used if the internal clock doesn't meet
      timing requirements over temperature and voltage operating range.
    maxItems: 1

  vdd-supply:
    description:
      Logic supply voltage

  vspi-supply:
    description:
      Supply voltage for SPI

  vpwr-supply:
    description:
      Power switch supply

required:
  - compatible
  - reg

unevaluatedProperties: false

examples:
  - |
    #include <dt-bindings/gpio/gpio.h>
    #include <dt-bindings/interrupt-controller/irq.h>
    spi {
        #address-cells = <1>;
        #size-cells = <0>;

       pwm@0 {
           compatible = "nxp,mc33xs2410";
           reg = <0x0>;
           spi-max-frequency = <4000000>;
           spi-cpha;
           spi-cs-setup-delay-ns = <100>;
           spi-cs-hold-delay-ns = <10>;
           spi-cs-inactive-delay-ns = <300>;
           reset-gpios = <&gpio3 22 GPIO_ACTIVE_LOW>;
           #pwm-cells = <3>;
           pwm-names = "di0", "di1", "di2", "di3";
           pwms = <&pwm0 0 1000000>,
                  <&pwm1 0 1000000>,
                  <&pwm2 0 1000000>,
                  <&pwm3 0 1000000>;
           interrupt-parent = <&gpio0>;
           interrupts = <31 IRQ_TYPE_LEVEL_LOW>;
           clocks = <&clk_ext_fixed>;
           vdd-supply = <&reg_3v3>;
           vspi-supply = <&reg_3v3>;
           vpwr-supply = <&reg_24v0>;
       };
    };
```

## Documentation/devicetree/bindings/pwm/nxp,pca9685-pwm.txt
```
NXP PCA9685 16-channel 12-bit PWM LED controller
================================================

Required properties:
  - compatible: "nxp,pca9685-pwm"
  - #pwm-cells: Should be 2. See pwm.yaml in this directory for a description of
    the cells format.
    The index 16 is the ALLCALL channel, that sets all PWM channels at the same
    time.

Optional properties:
  - invert (bool): boolean to enable inverted logic
  - open-drain (bool): boolean to configure outputs with open-drain structure;
		       if omitted use totem-pole structure

Example:

For LEDs that are directly connected to the PCA, the following setting is
applicable:

pca: pca@41 {
	compatible = "nxp,pca9685-pwm";
	#pwm-cells = <2>;
	reg = <0x41>;
	invert;
	open-drain;
};
```

## Documentation/devicetree/bindings/pwm/opencores,pwm.yaml
```yaml
# SPDX-License-Identifier: GPL-2.0-only OR BSD-2-Clause
%YAML 1.2
---
$id: http://devicetree.org/schemas/pwm/opencores,pwm.yaml#
$schema: http://devicetree.org/meta-schemas/core.yaml#

title: OpenCores PWM controller

maintainers:
  - William Qiu <william.qiu@starfivetech.com>

description:
  The OpenCores PTC ip core contains a PWM controller. When operating in PWM
  mode, the PTC core generates binary signal with user-programmable low and
  high periods. All PTC counters and registers are 32-bit.

allOf:
  - $ref: pwm.yaml#

properties:
  compatible:
    items:
      - enum:
          - starfive,jh7100-pwm
          - starfive,jh7110-pwm
          - starfive,jh8100-pwm
      - const: opencores,pwm-v1

  reg:
    maxItems: 1

  clocks:
    maxItems: 1

  resets:
    maxItems: 1

  "#pwm-cells":
    const: 3

required:
  - compatible
  - reg
  - clocks

additionalProperties: false

examples:
  - |
    pwm@12490000 {
        compatible = "starfive,jh7110-pwm", "opencores,pwm-v1";
        reg = <0x12490000 0x10000>;
        clocks = <&clkgen 181>;
        resets = <&rstgen 109>;
        #pwm-cells = <3>;
    };
```
