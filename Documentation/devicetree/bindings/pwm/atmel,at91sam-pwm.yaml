## Documentation/devicetree/bindings/pwm/google,cros-ec-pwm.yaml
```yaml
# SPDX-License-Identifier: GPL-2.0
%YAML 1.2
---
$id: http://devicetree.org/schemas/pwm/google,cros-ec-pwm.yaml#
$schema: http://devicetree.org/meta-schemas/core.yaml#

title: PWM controlled by ChromeOS EC

maintainers:
  - Thierry Reding <thierry.reding@gmail.com>
  - '"Uwe Kleine-König" <u.kleine-koenig@pengutronix.de>'

description: |
  Google's ChromeOS EC PWM is a simple PWM attached to the Embedded Controller
  (EC) and controlled via a host-command interface.
  An EC PWM node should be only found as a sub-node of the EC node (see
  Documentation/devicetree/bindings/mfd/google,cros-ec.yaml).

allOf:
  - $ref: pwm.yaml#

properties:
  compatible:
    oneOf:
      - description: PWM controlled using EC_PWM_TYPE_GENERIC channels.
        items:
          - const: google,cros-ec-pwm
      - description: PWM controlled using CROS_EC_PWM_DT_<...> types.
        items:
          - const: google,cros-ec-pwm-type

  "#pwm-cells":
    description: The cell specifies the PWM index.
    const: 1

required:
  - compatible

additionalProperties: false

examples:
  - |
    spi {
        #address-cells = <1>;
        #size-cells = <0>;

        cros-ec@0 {
            compatible = "google,cros-ec-spi";
            reg = <0>;
            interrupts = <101 0>;

            cros_ec_pwm: pwm {
                compatible = "google,cros-ec-pwm";
                #pwm-cells = <1>;
            };
        };
    };
```

## Documentation/devicetree/bindings/pwm/img-pwm.txt
```
*Imagination Technologies PWM DAC driver

Required properties:
  - compatible: Should be "img,pistachio-pwm"
  - reg: Should contain physical base address and length of pwm registers.
  - clocks: Must contain an entry for each entry in clock-names.
	See ../clock/clock-bindings.txt for details.
  - clock-names: Must include the following entries.
    - pwm: PWM operating clock.
    - sys: PWM system interface clock.
  - #pwm-cells: Should be 2. See pwm.yaml in this directory for the
	description of the cells format.
  - img,cr-periph: Must contain a phandle to the peripheral control
	syscon node which contains PWM control registers.

Example:
	pwm: pwm@18101300 {
		compatible = "img,pistachio-pwm";
		reg = <0x18101300 0x100>;
		clocks = <&pwm_clk>, <&system_clk>;
		clock-names = "pwm", "sys";
		#pwm-cells = <2>;
		img,cr-periph = <&cr_periph>;
	};
```

## Documentation/devicetree/bindings/pwm/imx-pwm.txt
```
Freescale i.MX PWM controller

Required properties:
- compatible : should be "fsl,<soc>-pwm" and one of the following
   compatible strings:
  - "fsl,imx1-pwm" for PWM compatible with the one integrated on i.MX1
  - "fsl,imx27-pwm" for PWM compatible with the one integrated on i.MX27
- reg: physical base address and length of the controller's registers
- #pwm-cells: 2 for i.MX1 and 3 for i.MX27 and newer SoCs. See pwm.txt
  in this directory for a description of the cells format.
- clocks : Clock specifiers for both ipg and per clocks.
- clock-names : Clock names should include both "ipg" and "per"
See the clock consumer binding,
	Documentation/devicetree/bindings/clock/clock-bindings.txt
- interrupts: The interrupt for the pwm controller

Example:

pwm1: pwm@53fb4000 {
	#pwm-cells = <3>;
	compatible = "fsl,imx53-pwm", "fsl,imx27-pwm";
	reg = <0x53fb4000 0x4000>;
	clocks = <&clks IMX5_CLK_PWM1_IPG_GATE>,
		 <&clks IMX5_CLK_PWM1_HF_GATE>;
	clock-names = "ipg", "per";
	interrupts = <61>;
};
```

## Documentation/devicetree/bindings/pwm/imx-pwm.yaml
```yaml
# SPDX-License-Identifier: (GPL-2.0-only OR BSD-2-Clause)
%YAML 1.2
---
$id: http://devicetree.org/schemas/pwm/imx-pwm.yaml#
$schema: http://devicetree.org/meta-schemas/core.yaml#

title: Freescale i.MX PWM controller

maintainers:
  - Philipp Zabel <p.zabel@pengutronix.de>

properties:
  "#pwm-cells":
    description: |
      Should be 2 for i.MX1 and 3 for i.MX27 and newer SoCs. See pwm.yaml
      in this directory for a description of the cells format.
    enum:
      - 2
      - 3

  compatible:
    oneOf:
      - enum:
          - fsl,imx1-pwm
          - fsl,imx27-pwm
      - items:
          - enum:
              - fsl,imx25-pwm
              - fsl,imx31-pwm
              - fsl,imx50-pwm
              - fsl,imx51-pwm
              - fsl,imx53-pwm
              - fsl,imx6q-pwm
              - fsl,imx6sl-pwm
              - fsl,imx6sll-pwm
              - fsl,imx6sx-pwm
              - fsl,imx6ul-pwm
              - fsl,imx7d-pwm
              - fsl,imx8mm-pwm
              - fsl,imx8mn-pwm
              - fsl,imx8mp-pwm
              - fsl,imx8mq-pwm
          - const: fsl,imx27-pwm

  reg:
    maxItems: 1

  clocks:
    items:
      - description: SoC PWM ipg clock
      - description: SoC PWM per clock

  clock-names:
    items:
      - const: ipg
      - const: per

  interrupts:
    maxItems: 1

required:
  - "#pwm-cells"
  - compatible
  - reg
  - clocks
  - clock-names
  - interrupts

additionalProperties: false

examples:
  - |
    #include <dt-bindings/clock/imx5-clock.h>

    pwm@53fb4000 {
        #pwm-cells = <3>;
        compatible = "fsl,imx27-pwm";
        reg = <0x53fb4000 0x4000>;
        clocks = <&clks IMX5_CLK_PWM1_IPG_GATE>,
                 <&clks IMX5_CLK_PWM1_HF_GATE>;
        clock-names = "ipg", "per";
        interrupts = <61>;
    };
```

## Documentation/devicetree/bindings/pwm/imx-tpm-pwm.txt
```
Freescale i.MX TPM PWM controller

Required properties:
- compatible : Should be "fsl,imx7ulp-pwm".
- reg: Physical base address and length of the controller's registers.
- #pwm-cells: Should be 3. See pwm.yaml in this directory for a description of the cells format.
- clocks : The clock provided by the SoC to drive the PWM.
- interrupts: The interrupt for the PWM controller.

Note: The TPM counter and period counter are shared between multiple channels, so all channels
should use same period setting.

Example:

tpm4: pwm@40250000 {
	compatible = "fsl,imx7ulp-pwm";
	reg = <0x40250000 0x1000>;
	assigned-clocks = <&pcc2 IMX7ULP_CLK_LPTPM4>;
	assigned-clock-parents = <&scg1 IMX7ULP_CLK_SOSC_BUS_CLK>;
	clocks = <&pcc2 IMX7ULP_CLK_LPTPM4>;
	#pwm-cells = <3>;
};
```

## Documentation/devicetree/bindings/pwm/imx-tpm-pwm.yaml
```yaml
# SPDX-License-Identifier: (GPL-2.0-only OR BSD-2-Clause)
%YAML 1.2
---
$id: http://devicetree.org/schemas/pwm/imx-tpm-pwm.yaml#
$schema: http://devicetree.org/meta-schemas/core.yaml#

title: Freescale i.MX TPM PWM controller

maintainers:
  - Shawn Guo <shawnguo@kernel.org>
  - Sascha Hauer <s.hauer@pengutronix.de>
  - Fabio Estevam <festevam@gmail.com>

description: |
  The TPM counter and period counter are shared between multiple
  channels, so all channels should use same period setting.

allOf:
  - $ref: pwm.yaml#

properties:
  "#pwm-cells":
    const: 3

  compatible:
    enum:
      - fsl,imx7ulp-pwm

  reg:
    maxItems: 1

  assigned-clocks:
    maxItems: 1

  assigned-clock-parents:
    maxItems: 1

  clocks:
    maxItems: 1

required:
  - compatible
  - reg
  - clocks

additionalProperties: false

examples:
  - |
    #include <dt-bindings/clock/imx7ulp-clock.h>

    pwm@40250000 {
        compatible = "fsl,imx7ulp-pwm";
        reg = <0x40250000 0x1000>;
        assigned-clocks = <&pcc2 IMX7ULP_CLK_LPTPM4>;
        assigned-clock-parents = <&scg1 IMX7ULP_CLK_SOSC_BUS_CLK>;
        clocks = <&pcc2 IMX7ULP_CLK_LPTPM4>;
        #pwm-cells = <3>;
    };
```

## Documentation/devicetree/bindings/pwm/ingenic,jz47xx-pwm.txt
```
Ingenic JZ47xx PWM Controller
=============================

Required properties:
- compatible: Should be "ingenic,jz4740-pwm"
- #pwm-cells: Should be 3. See pwm.txt in this directory for a description
  of the cells format.
- clocks : phandle to the external clock.
- clock-names : Should be "ext".


Example:

	pwm: pwm@10002000 {
		compatible = "ingenic,jz4740-pwm";
		reg = <0x10002000 0x1000>;

		#pwm-cells = <3>;

		clocks = <&ext>;
		clock-names = "ext";
	};
```

## Documentation/devicetree/bindings/pwm/intel,keembay-pwm.yaml
```yaml
# SPDX-License-Identifier: (GPL-2.0-only OR BSD-2-Clause)
# Copyright (C) 2020 Intel Corporation
%YAML 1.2
---
$id: http://devicetree.org/schemas/pwm/intel,keembay-pwm.yaml#
$schema: http://devicetree.org/meta-schemas/core.yaml#

title: Intel Keem Bay PWM

maintainers:
  - Vijayakannan Ayyathurai <vijayakannan.ayyathurai@intel.com>

allOf:
  - $ref: pwm.yaml#

properties:
  compatible:
    enum:
      - intel,keembay-pwm

  reg:
    maxItems: 1

  clocks:
    maxItems: 1

  "#pwm-cells":
    const: 2

required:
  - compatible
  - reg
  - clocks

additionalProperties: false

examples:
  - |
    #define KEEM_BAY_A53_GPIO

    pwm@203200a0 {
        compatible = "intel,keembay-pwm";
        reg = <0x203200a0 0xe8>;
        clocks = <&scmi_clk KEEM_BAY_A53_GPIO>;
        #pwm-cells = <2>;
    };
```
