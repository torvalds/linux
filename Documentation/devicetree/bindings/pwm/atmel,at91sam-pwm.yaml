## Documentation/devicetree/bindings/pwm/atmel,at91sam-pwm.yaml
```yaml
# SPDX-License-Identifier: (GPL-2.0-only OR BSD-2-Clause)
# Copyright (C) 2022 Microchip Technology, Inc. and its subsidiaries
%YAML 1.2
---
$id: http://devicetree.org/schemas/pwm/atmel,at91sam-pwm.yaml#
$schema: http://devicetree.org/meta-schemas/core.yaml#

title: Atmel/Microchip PWM controller

maintainers:
  - Claudiu Beznea <claudiu.beznea@microchip.com>

allOf:
  - $ref: pwm.yaml#

properties:
  compatible:
    oneOf:
      - items:
          - enum:
              - atmel,at91sam9rl-pwm
              - atmel,sama5d3-pwm
              - atmel,sama5d2-pwm
              - microchip,sam9x60-pwm
      - items:
          - const: microchip,sama7g5-pwm
          - const: atmel,sama5d2-pwm

  reg:
    maxItems: 1

  "#pwm-cells":
    const: 3

required:
  - compatible
  - reg

unevaluatedProperties: false

examples:
  - |
    pwm0: pwm@f8034000 {
        compatible = "atmel,at91sam9rl-pwm";
        reg = <0xf8034000 0x400>;
        #pwm-cells = <3>;
    };
```

## Documentation/devicetree/bindings/pwm/atmel,hlcdc-pwm.yaml
```yaml
# SPDX-License-Identifier: (GPL-2.0-only OR BSD-2-Clause)
%YAML 1.2
---
$id: http://devicetree.org/schemas/pwm/atmel,hlcdc-pwm.yaml#
$schema: http://devicetree.org/meta-schemas/core.yaml#

title: Atmel's HLCDC's PWM controller

maintainers:
  - Nicolas Ferre <nicolas.ferre@microchip.com>
  - Alexandre Belloni <alexandre.belloni@bootlin.com>
  - Claudiu Beznea <claudiu.beznea@tuxon.dev>

description:
  The LCDC integrates a Pulse Width Modulation (PWM) Controller. This block
  generates the LCD contrast control signal (LCD_PWM) that controls the
  display's contrast by software. LCDC_PWM is an 8-bit PWM signal that can be
  converted to an analog voltage with a simple passive filter. LCD display
  panels have different backlight specifications in terms of minimum/maximum
  values for PWM frequency. If the LCDC PWM frequency range does not match the
  LCD display panel, it is possible to use the standalone PWM Controller to
  drive the backlight.

properties:
  compatible:
    const: atmel,hlcdc-pwm

  "#pwm-cells":
    const: 3

required:
  - compatible
  - "#pwm-cells"

additionalProperties: false
```

## Documentation/devicetree/bindings/pwm/atmel-hlcdc-pwm.txt
```
Device-Tree bindings for Atmel's HLCDC (High-end LCD Controller) PWM driver

The Atmel HLCDC PWM is subdevice of the HLCDC MFD device.
See ../mfd/atmel-hlcdc.txt for more details.

Required properties:
 - compatible: value should be one of the following:
   "atmel,hlcdc-pwm"
 - pinctr-names: the pin control state names. Should contain "default".
 - pinctrl-0: should contain the pinctrl states described by pinctrl
   default.
 - #pwm-cells: should be set to 3. This PWM chip use the default 3 cells
   bindings defined in pwm.txt in this directory.

Example:

	hlcdc: hlcdc@f0030000 {
		compatible = "atmel,sama5d3-hlcdc";
		reg = <0xf0030000 0x2000>;
		clocks = <&lcdc_clk>, <&lcdck>, <&clk32k>;
		clock-names = "periph_clk","sys_clk", "slow_clk";

		hlcdc_pwm: hlcdc-pwm {
			compatible = "atmel,hlcdc-pwm";
			pinctrl-names = "default";
			pinctrl-0 = <&pinctrl_lcd_pwm>;
			#pwm-cells = <3>;
		};
	};
```

## Documentation/devicetree/bindings/pwm/atmel-pwm.txt
```
Atmel PWM controller

Required properties:
  - compatible: should be one of:
    - "atmel,at91sam9rl-pwm"
    - "atmel,sama5d3-pwm"
  - reg: physical base address and length of the controller's registers
  - #pwm-cells: Should be 3. See pwm.txt in this directory for a
    description of the cells format.

Example:

	pwm0: pwm@f8034000 {
		compatible = "atmel,at91sam9rl-pwm";
		reg = <0xf8034000 0x400>;
		#pwm-cells = <3>;
	};

	pwmleds {
		compatible = "pwm-leds";

		d1 {
			label = "d1";
			pwms = <&pwm0 3 5000 0>
			max-brightness = <255>;
		};

		d2 {
			label = "d2";
			pwms = <&pwm0 1 5000 1>
			max-brightness = <255>;
		};
	};
```

## Documentation/devicetree/bindings/pwm/atmel-tcb-pwm.txt
```
Atmel TCB PWM controller

Required properties:
- compatible: should be "atmel,tcb-pwm"
- #pwm-cells: should be 3. See pwm.yaml in this directory for a description of
  the cells format. The only third cell flag supported by this binding is
  PWM_POLARITY_INVERTED.
- tc-block: The Timer Counter block to use as a PWM chip.

Example:

pwm {
	compatible = "atmel,tcb-pwm";
	#pwm-cells = <3>;
	tc-block = <1>;
};
```

## Documentation/devicetree/bindings/pwm/bcm-kona-pwm.txt
```
Broadcom Kona PWM controller device tree bindings

This controller has 6 channels.

Required Properties :
- compatible: should be "brcm,kona-pwm"
- reg: physical base address and length of the controller's registers
- clocks: phandle + clock specifier pair for the external clock
- #pwm-cells: should be 3.  The first cell specifies the per-chip index
  of the PWM to use, the second cell is the period in nanoseconds, and
  the third cell is the flags.

Refer to pwm/pwm.txt for generic pwm controller node properties.

Refer to clocks/clock-bindings.txt for generic clock consumer properties.

Example:

pwm: pwm@3e01a000 {
	compatible = "brcm,bcm11351-pwm", "brcm,kona-pwm";
	reg = <0x3e01a000 0xc4>;
	clocks = <&pwm_clk>;
	#pwm-cells = <3>;
};
```

## Documentation/devicetree/bindings/pwm/brcm,bcm7038-pwm.txt
```
Broadcom BCM7038 PWM controller (BCM7xxx Set Top Box PWM controller)

Required properties:

- compatible: must be "brcm,bcm7038-pwm"
- reg: physical base address and length for this controller
- #pwm-cells: should be 2. See pwm.txt in this directory for a description
  of the cells format
- clocks: a phandle to the reference clock for this block which is fed through
  its internal variable clock frequency generator


Example:

	pwm: pwm@f0408000 {
		compatible = "brcm,bcm7038-pwm";
		reg = <0xf0408000 0x28>;
		#pwm-cells = <2>;
		clocks = <&upg_fixed>;
	};
```

## Documentation/devicetree/bindings/pwm/brcm,bcm7038-pwm.yaml
```yaml
# SPDX-License-Identifier: (GPL-2.0-only OR BSD-2-Clause)
%YAML 1.2
---
$id: http://devicetree.org/schemas/pwm/brcm,bcm7038-pwm.yaml#
$schema: http://devicetree.org/meta-schemas/core.yaml#

title: Broadcom BCM7038 PWM controller (BCM7xxx Set Top Box PWM controller)

maintainers:
  - Florian Fainelli <f.fainelli@gmail.com>

allOf:
  - $ref: pwm.yaml#

properties:
  compatible:
    const: brcm,bcm7038-pwm

  reg:
    maxItems: 1

  "#pwm-cells":
    const: 2

  clocks:
    maxItems: 1

required:
  - compatible
  - reg
  - clocks

additionalProperties: false

examples:
  - |
    pwm: pwm@f0408000 {
        compatible = "brcm,bcm7038-pwm";
        reg = <0xf0408000 0x28>;
        #pwm-cells = <2>;
        clocks = <&upg_fixed>;
    };
```

## Documentation/devicetree/bindings/pwm/brcm,iproc-pwm.txt
```
Broadcom iProc PWM controller device tree bindings

This controller has 4 channels.

Required Properties :
- compatible: must be "brcm,iproc-pwm"
- reg: physical base address and length of the controller's registers
- clocks: phandle + clock specifier pair for the external clock
- #pwm-cells: Should be 3. See pwm.yaml in this directory for a
  description of the cells format.

Refer to clocks/clock-bindings.txt for generic clock consumer properties.

Example:

pwm: pwm@18031000 {
	compatible = "brcm,iproc-pwm";
	reg = <0x18031000 0x28>;
	clocks = <&osc>;
	#pwm-cells = <3>;
};
```

## Documentation/devicetree/bindings/pwm/brcm,iproc-pwm.yaml
```yaml
# SPDX-License-Identifier: GPL-2.0-only OR BSD-2-Clause
%YAML 1.2
---
$id: http://devicetree.org/schemas/pwm/brcm,iproc-pwm.yaml#
$schema: http://devicetree.org/meta-schemas/core.yaml#

title: Broadcom iProc PWM controller

maintainers:
  - Rafał Miłecki <rafal@milecki.pl>

description:
  This controller has 4 channels.

allOf:
  - $ref: pwm.yaml#

properties:
  compatible:
    const: brcm,iproc-pwm

  reg:
    maxItems: 1

  clocks:
    description: external clock
    maxItems: 1

  "#pwm-cells":
    const: 3

unevaluatedProperties: false

required:
  - reg
  - clocks

examples:
  - |
    pwm@18031000 {
        compatible = "brcm,iproc-pwm";
        reg = <0x18031000 0x28>;
        clocks = <&osc>;
        #pwm-cells = <3>;
    };
```

## Documentation/devicetree/bindings/pwm/brcm,kona-pwm.txt
```
Broadcom Kona PWM controller device tree bindings

This controller has 6 channels.

Required Properties :
- compatible: should contain "brcm,kona-pwm"
- reg: physical base address and length of the controller's registers
- clocks: phandle + clock specifier pair for the external clock
- #pwm-cells: Should be 3. See pwm.txt in this directory for a
  description of the cells format.

Refer to clocks/clock-bindings.txt for generic clock consumer properties.

Example:

pwm: pwm@3e01a000 {
	compatible = "brcm,bcm11351-pwm", "brcm,kona-pwm";
	reg = <0x3e01a000 0xc4>;
	clocks = <&pwm_clk>;
	#pwm-cells = <3>;
};
```

## Documentation/devicetree/bindings/pwm/brcm,kona-pwm.yaml
```yaml
# SPDX-License-Identifier: GPL-2.0-only OR BSD-2-Clause
%YAML 1.2
---
$id: http://devicetree.org/schemas/pwm/brcm,kona-pwm.yaml#
$schema: http://devicetree.org/meta-schemas/core.yaml#

title: Broadcom Kona family PWM controller

description:
  This controller has 6 channels.

maintainers:
  - Florian Fainelli <f.fainelli@gmail.com>

allOf:
  - $ref: pwm.yaml#

properties:
  compatible:
    items:
      - enum:
          - brcm,bcm11351-pwm
      - const: brcm,kona-pwm

  reg:
    maxItems: 1

  clocks:
    maxItems: 1

  '#pwm-cells':
    const: 3

required:
  - compatible
  - reg
  - clocks

unevaluatedProperties: false

examples:
  - |
    #include <dt-bindings/clock/bcm281xx.h>

    pwm@3e01a000 {
       compatible = "brcm,bcm11351-pwm", "brcm,kona-pwm";
       reg = <0x3e01a000 0xcc>;
       clocks = <&slave_ccu BCM281XX_SLAVE_CCU_PWM>;
       #pwm-cells = <3>;
    };
...
```

## Documentation/devicetree/bindings/pwm/cirrus,clps711x-pwm.txt
```
* Cirris Logic CLPS711X PWM controller

Required properties:
- compatible: Shall contain "cirrus,clps711x-pwm".
- reg: Physical base address and length of the controller's registers.
- clocks: phandle + clock specifier pair of the PWM reference clock.
- #pwm-cells: Should be 1. The cell specifies the index of the channel.

Example:
	pwm: pwm@80000400 {
		compatible = "cirrus,ep7312-pwm",
			     "cirrus,clps711x-pwm";
		reg = <0x80000400 0x4>;
		clocks = <&clks 8>;
		#pwm-cells = <1>;
	};
```

## Documentation/devicetree/bindings/pwm/cirrus,ep9301-pwm.yaml
```yaml
# SPDX-License-Identifier: (GPL-2.0-only OR BSD-2-Clause)
%YAML 1.2
---
$id: http://devicetree.org/schemas/pwm/cirrus,ep9301-pwm.yaml#
$schema: http://devicetree.org/meta-schemas/core.yaml#

title: Cirrus Logic ep93xx PWM controller

maintainers:
  - Alexander Sverdlin <alexander.sverdlin@gmail.com>
  - Nikita Shubin <nikita.shubin@maquefel.me>

allOf:
  - $ref: pwm.yaml#

properties:
  compatible:
    oneOf:
      - const: cirrus,ep9301-pwm
      - items:
          - enum:
              - cirrus,ep9302-pwm
              - cirrus,ep9307-pwm
              - cirrus,ep9312-pwm
              - cirrus,ep9315-pwm
          - const: cirrus,ep9301-pwm

  reg:
    maxItems: 1

  clocks:
    items:
      - description: SoC PWM clock

  "#pwm-cells":
    const: 3

required:
  - compatible
  - reg
  - clocks

unevaluatedProperties: false

examples:
  - |
    #include <dt-bindings/clock/cirrus,ep9301-syscon.h>
    pwm@80910000 {
        compatible = "cirrus,ep9301-pwm";
        reg = <0x80910000 0x10>;
        clocks = <&syscon EP93XX_CLK_PWM>;
        #pwm-cells = <3>;
    };
```

## Documentation/devicetree/bindings/pwm/clk-pwm.yaml
```yaml
# SPDX-License-Identifier: GPL-2.0-only OR BSD-2-Clause
%YAML 1.2
---
$id: http://devicetree.org/schemas/pwm/clk-pwm.yaml#
$schema: http://devicetree.org/meta-schemas/core.yaml#

title: Clock based PWM controller

maintainers:
  - Nikita Travkin <nikita@trvn.ru>

description: |
  Some systems have clocks that can be exposed to external devices.
  (e.g. by muxing them to GPIO pins)
  It's often possible to control duty-cycle of such clocks which makes them
  suitable for generating PWM signal.

allOf:
  - $ref: pwm.yaml#

properties:
  compatible:
    const: clk-pwm

  clocks:
    description: Clock used to generate the signal.
    maxItems: 1

  "#pwm-cells":
    const: 2

unevaluatedProperties: false

required:
  - compatible
  - clocks

examples:
  - |
    pwm {
      compatible = "clk-pwm";
      #pwm-cells = <2>;
      clocks = <&gcc 0>;
      pinctrl-names = "default";
      pinctrl-0 = <&pwm_clk_flash_default>;
    };
```

## Documentation/devicetree/bindings/pwm/fsl,vf610-ftm-pwm.yaml
```yaml
# SPDX-License-Identifier: (GPL-2.0-only OR BSD-2-Clause)
%YAML 1.2
---
$id: http://devicetree.org/schemas/pwm/fsl,vf610-ftm-pwm.yaml#
$schema: http://devicetree.org/meta-schemas/core.yaml#

title: Freescale FlexTimer Module (FTM) PWM controller

description: |
  The same FTM PWM device can have a different endianness on different SoCs. The
  device tree provides a property to describing this so that an operating system
  device driver can handle all variants of the device. Refer to the table below
  for the endianness of the FTM PWM block as integrated into the existing SoCs:

  SoC     | FTM-PWM endianness
  --------+-------------------
  Vybrid  | LE
  LS1     | BE
  LS2     | LE

  Please see ../regmap/regmap.txt for more detail about how to specify endian
  modes in device tree.

maintainers:
  - Frank Li <Frank.Li@nxp.com>

properties:
  compatible:
    enum:
      - fsl,vf610-ftm-pwm
      - fsl,imx8qm-ftm-pwm

  reg:
    maxItems: 1

  "#pwm-cells":
    const: 3

  clocks:
    minItems: 4
    maxItems: 4

  clock-names:
    items:
      - const: ftm_sys
      - const: ftm_ext
      - const: ftm_fix
      - const: ftm_cnt_clk_en

  pinctrl-0: true
  pinctrl-1: true

  pinctrl-names:
    minItems: 1
    items:
      - const: default
      - const: sleep

  big-endian:
    $ref: /schemas/types.yaml#/definitions/flag
    description:
      Boolean property, required if the FTM PWM registers use a big-
      endian rather than little-endian layout.

required:
  - compatible
  - reg
  - clocks
  - clock-names

allOf:
  - $ref: pwm.yaml#

unevaluatedProperties: false

examples:
  - |
    #include <dt-bindings/clock/vf610-clock.h>

    pwm@40038000 {
        compatible = "fsl,vf610-ftm-pwm";
        reg = <0x40038000 0x1000>;
        #pwm-cells = <3>;
        clocks = <&clks VF610_CLK_FTM0>,
                 <&clks VF610_CLK_FTM0_EXT_SEL>,
                 <&clks VF610_CLK_FTM0_FIX_SEL>,
                 <&clks VF610_CLK_FTM0_EXT_FIX_EN>;
        clock-names = "ftm_sys", "ftm_ext", "ftm_fix", "ftm_cnt_clk_en";
        pinctrl-names = "default";
        pinctrl-0 = <&pinctrl_pwm0_1>;
        big-endian;
    };
```

## Documentation/devicetree/bindings/pwm/google,cros-ec-pwm.txt
```
* PWM controlled by ChromeOS EC

Google's ChromeOS EC PWM is a simple PWM attached to the Embedded Controller
(EC) and controlled via a host-command interface.

An EC PWM node should be only found as a sub-node of the EC node (see
Documentation/devicetree/bindings/mfd/cros-ec.txt).

Required properties:
- compatible: Must contain "google,cros-ec-pwm"
- #pwm-cells: Should be 1. The cell specifies the PWM index.

Example:
	cros-ec@0 {
		compatible = "google,cros-ec-spi";

		...

		cros_ec_pwm: ec-pwm {
			compatible = "google,cros-ec-pwm";
			#pwm-cells = <1>;
		};
	};
```
