## Documentation/devicetree/bindings/pwm/pwm-gpio.txt
```
Generic GPIO bit-banged PWM driver

Required properties:
  - compatible: should be "pwm-gpio"
  - #pwm-cells: should be 3, see pwm.txt in this directory for a general
    description of the cells format.
  - pwm-gpio: one gpio describing the used gpio, see the gpio bindings for the used gpio driver.

Example:
#include <dt-bindings/gpio/gpio.h>

	pwm-gpio {
		compatible = "pwm-gpio";
		#pwm-cells = <3>;
		pwm-gpio = <&pio 7 1 GPIO_ACTIVE_HIGH>;
	};
```

## Documentation/devicetree/bindings/pwm/pwm-gpio.yaml
```yaml
# SPDX-License-Identifier: (GPL-2.0-only OR BSD-2-Clause)
%YAML 1.2
---
$id: http://devicetree.org/schemas/pwm/pwm-gpio.yaml#
$schema: http://devicetree.org/meta-schemas/core.yaml#

title: Generic software PWM for modulating GPIOs

maintainers:
  - Stefan Wahren <wahrenst@gmx.net>

allOf:
  - $ref: pwm.yaml#

properties:
  compatible:
    const: pwm-gpio

  "#pwm-cells":
    const: 3
    description:
      See pwm.yaml in this directory for a description of the cells format.
      The first cell which represents the PWM instance number must always
      be zero.

  gpios:
    description:
      GPIO to be modulated
    maxItems: 1

required:
  - compatible
  - "#pwm-cells"
  - gpios

additionalProperties: false

examples:
  - |
    #include <dt-bindings/gpio/gpio.h>

    pwm {
        #pwm-cells = <3>;
        compatible = "pwm-gpio";
        gpios = <&gpio 1 GPIO_ACTIVE_HIGH>;
    };
```

## Documentation/devicetree/bindings/pwm/pwm-hibvt.txt
```
Hisilicon PWM controller

Required properties:
-compatible: should contain one SoC specific compatible string
 The SoC specific strings supported including:
	"hisilicon,hi3516cv300-pwm"
	"hisilicon,hi3519v100-pwm"
	"hisilicon,hi3559v100-shub-pwm"
	"hisilicon,hi3559v100-pwm
- reg: physical base address and length of the controller's registers.
- clocks: phandle and clock specifier of the PWM reference clock.
- resets: phandle and reset specifier for the PWM controller reset.
- #pwm-cells: Should be 3. See pwm.yaml in this directory for a description of
  the cells format.

Example:
	pwm: pwm@12130000 {
		compatible = "hisilicon,hi3516cv300-pwm";
		reg = <0x12130000 0x10000>;
		clocks = <&crg_ctrl HI3516CV300_PWM_CLK>;
		resets = <&crg_ctrl 0x38 0>;
		#pwm-cells = <3>;
	};
```

## Documentation/devicetree/bindings/pwm/pwm-lp3943.txt
```
TI/National Semiconductor LP3943 PWM controller

Required properties:
  - compatible: "ti,lp3943-pwm"
  - #pwm-cells: Should be 2. See pwm.yaml in this directory for a
                description of the cells format.
                Note that this hardware limits the period length to the
                range 6250~1600000.
  - ti,pwm0 or ti,pwm1: Output pin number(s) for PWM channel 0 or 1.
    0 = output 0
    1 = output 1
    .
    .
    15 = output 15

Example:
PWM 0 is for RGB LED brightness control
PWM 1 is for brightness control of LP8557 backlight device

&i2c3 {
	lp3943@60 {
		compatible = "ti,lp3943";
		reg = <0x60>;

		/*
		 * PWM 0 : output 8, 9 and 10
		 * PWM 1 : output 15
		 */
		pwm3943: pwm {
			compatible = "ti,lp3943-pwm";
			#pwm-cells = <2>;
			ti,pwm0 = <8 9 10>;
			ti,pwm1 = <15>;
		};
	};

};

/* LEDs control with PWM 0 of LP3943 */
pwmleds {
	compatible = "pwm-leds";
	rgb {
		label = "indi::rgb";
		pwms = <&pwm3943 0 10000>;
		max-brightness = <255>;
	};
};

&i2c4 {
	/* Backlight control with PWM 1 of LP3943 */
	backlight@2c {
		compatible = "ti,lp8557";
		reg = <0x2c>;

		pwms = <&pwm3943 1 10000>;
		pwm-names = "lp8557";
	};
};
```

## Documentation/devicetree/bindings/pwm/pwm-mediatek.txt
```
MediaTek PWM controller

Required properties:
 - compatible: should be "mediatek,<name>-pwm":
   - "mediatek,mt2712-pwm": found on mt2712 SoC.
   - "mediatek,mt7622-pwm": found on mt7622 SoC.
   - "mediatek,mt7623-pwm": found on mt7623 SoC.
   - "mediatek,mt7628-pwm": found on mt7628 SoC.
   - "mediatek,mt7629-pwm": found on mt7629 SoC.
   - "mediatek,mt8516-pwm": found on mt8516 SoC.
 - reg: physical base address and length of the controller's registers.
 - #pwm-cells: must be 2. See pwm.yaml in this directory for a description of
   the cell format.
 - clocks: phandle and clock specifier of the PWM reference clock.
 - clock-names: must contain the following, except for MT7628 which
                has no clocks
   - "top": the top clock generator
   - "main": clock used by the PWM core
   - "pwm1-8": the eight per PWM clocks for mt2712
   - "pwm1-6": the six per PWM clocks for mt7622
   - "pwm1-5": the five per PWM clocks for mt7623
 - pinctrl-names: Must contain a "default" entry.
 - pinctrl-0: One property must exist for each entry in pinctrl-names.
   See pinctrl/pinctrl-bindings.txt for details of the property values.

Example:
	pwm0: pwm@11006000 {
		compatible = "mediatek,mt7623-pwm";
		reg = <0 0x11006000 0 0x1000>;
		#pwm-cells = <2>;
		clocks = <&topckgen CLK_TOP_PWM_SEL>,
			 <&pericfg CLK_PERI_PWM>,
			 <&pericfg CLK_PERI_PWM1>,
			 <&pericfg CLK_PERI_PWM2>,
			 <&pericfg CLK_PERI_PWM3>,
			 <&pericfg CLK_PERI_PWM4>,
			 <&pericfg CLK_PERI_PWM5>;
		clock-names = "top", "main", "pwm1", "pwm2",
			      "pwm3", "pwm4", "pwm5";
		pinctrl-names = "default";
		pinctrl-0 = <&pwm0_pins>;
	};
```

## Documentation/devicetree/bindings/pwm/pwm-meson.txt
```
Amlogic Meson PWM Controller
============================

Required properties:
- compatible: Shall contain "amlogic,meson8b-pwm"
                         or "amlogic,meson-gxbb-pwm"
                         or "amlogic,meson-gxbb-ao-pwm"
                         or "amlogic,meson-axg-ee-pwm"
                         or "amlogic,meson-axg-ao-pwm"
                         or "amlogic,meson-g12a-ee-pwm"
                         or "amlogic,meson-g12a-ao-pwm-ab"
                         or "amlogic,meson-g12a-ao-pwm-cd"
- #pwm-cells: Should be 3. See pwm.yaml in this directory for a description of
  the cells format.

Optional properties:
- clocks: Could contain one or two parents clocks phandle for each of the two
  PWM channels.
- clock-names: Could contain at least the "clkin0" and/or "clkin1" names.

Example:

	pwm_ab: pwm@8550 {
		compatible = "amlogic,meson-gxbb-pwm";
		reg = <0x0 0x08550 0x0 0x10>;
		#pwm-cells = <3>;
		clocks = <&xtal>, <&xtal>;
		clock-names = "clkin0", "clkin1";
	}
```

## Documentation/devicetree/bindings/pwm/pwm-mtk-disp.txt
```
MediaTek display PWM controller

Required properties:
 - compatible: should be "mediatek,<name>-disp-pwm":
   - "mediatek,mt2701-disp-pwm": found on mt2701 SoC.
   - "mediatek,mt6595-disp-pwm": found on mt6595 SoC.
   - "mediatek,mt8173-disp-pwm": found on mt8173 SoC.
 - reg: physical base address and length of the controller's registers.
 - #pwm-cells: must be 2. See pwm.txt in this directory for a description of
   the cell format.
 - clocks: phandle and clock specifier of the PWM reference clock.
 - clock-names: must contain the following:
   - "main": clock used to generate PWM signals.
   - "mm": sync signals from the modules of mmsys.
 - pinctrl-names: Must contain a "default" entry.
 - pinctrl-0: One property must exist for each entry in pinctrl-names.
   See pinctrl/pinctrl-bindings.txt for details of the property values.

Example:
	pwm0: pwm@1401e000 {
		compatible = "mediatek,mt8173-disp-pwm",
			     "mediatek,mt6595-disp-pwm";
		reg = <0 0x1401e000 0 0x1000>;
		#pwm-cells = <2>;
		clocks = <&mmsys CLK_MM_DISP_PWM026M>,
			 <&mmsys CLK_MM_DISP_PWM0MM>;
		clock-names = "main", "mm";
		pinctrl-names = "default";
		pinctrl-0 = <&disp_pwm0_pins>;
	};

	backlight_lcd: backlight_lcd {
		compatible = "pwm-backlight";
		pwms = <&pwm0 0 1000000>;
		brightness-levels = <
			  0  16  32  48  64  80  96 112
			128 144 160 176 192 208 224 240
			255
		>;
		default-brightness-level = <9>;
		power-supply = <&mt6397_vio18_reg>;
		enable-gpios = <&pio 95 GPIO_ACTIVE_HIGH>;
	};
```

## Documentation/devicetree/bindings/pwm/pwm-nexus-node.yaml
```yaml
# SPDX-License-Identifier: (GPL-2.0-only OR BSD-2-Clause)
%YAML 1.2
---
$id: http://devicetree.org/schemas/pwm/pwm-nexus-node.yaml#
$schema: http://devicetree.org/meta-schemas/core.yaml#

title: PWM Nexus node properties

description: >
  Platforms can have a standardized connector/expansion slot that exposes PWMs
  signals to expansion boards.

  A nexus node allows to remap a phandle list in a consumer node through a
  connector node in a generic way. With this remapping, the consumer node needs
  to know only about the nexus node. Resources behind the nexus node are
  decoupled by the nexus node itself.

maintainers:
  - Herve Codina <herve.codina@bootlin.com>

select: true

properties:
  '#pwm-cells': true

  pwm-map:
    $ref: /schemas/types.yaml#/definitions/uint32-matrix

  pwm-map-mask:
    $ref: /schemas/types.yaml#/definitions/uint32-array

  pwm-map-pass-thru:
    $ref: /schemas/types.yaml#/definitions/uint32-array

dependentRequired:
  pwm-map: ['#pwm-cells']
  pwm-map-mask: [ pwm-map ]
  pwm-map-pass-thru: [ pwm-map ]

additionalProperties: true

examples:
  - |
        pwm1: pwm@100 {
            reg = <0x100 0x10>;
            #pwm-cells = <3>;
        };

        pwm2: pwm@200 {
            reg = <0x200 0x10>;
            #pwm-cells = <3>;
        };

        connector: connector {
            #pwm-cells = <3>;
            pwm-map = <0 0 0 &pwm1 1 0 0>,
                      <1 0 0 &pwm2 4 0 0>,
                      <2 0 0 &pwm1 3 0 0>;
            pwm-map-mask = <0xffffffff 0x0 0x0>;
            pwm-map-pass-thru = <0x0 0xffffffff 0xffffffff>;
        };

        device {
            pwms = <&connector 1 57000 0>;
        };
```

## Documentation/devicetree/bindings/pwm/pwm-omap-dmtimer.txt
```
* OMAP PWM for dual-mode timers

Required properties:
- compatible: Shall contain "ti,omap-dmtimer-pwm".
- ti,timers: phandle to PWM capable OMAP timer. See timer/ti,timer.txt for info
  about these timers.
- #pwm-cells: Should be 3. See pwm.yaml in this directory for a description of
  the cells format.

Optional properties:
- ti,prescaler: Should be a value between 0 and 7, see the timers datasheet
- ti,clock-source: Set dmtimer parent clock, values between 0 and 2:
  - 0x00 - high-frequency system clock (timer_sys_ck)
  - 0x01 - 32-kHz always-on clock (timer_32k_ck)
  - 0x02 - external clock (timer_ext_ck, OMAP2 only)

Example:
	pwm9: dmtimer-pwm@9 {
		compatible = "ti,omap-dmtimer-pwm";
		ti,timers = <&timer9>;
		#pwm-cells = <3>;
	};
```

## Documentation/devicetree/bindings/pwm/pwm-rockchip.txt
```
Rockchip PWM controller

Required properties:
 - compatible: should be "rockchip,<name>-pwm"
   "rockchip,rk2928-pwm": found on RK29XX,RK3066 and RK3188 SoCs
   "rockchip,rk3288-pwm": found on RK3288 SOC
   "rockchip,rv1108-pwm", "rockchip,rk3288-pwm": found on RV1108 SoC
   "rockchip,vop-pwm": found integrated in VOP on RK3288 SoC
 - reg: physical base address and length of the controller's registers
 - clocks: See ../clock/clock-bindings.txt
   - For older hardware (rk2928, rk3066, rk3188, rk3228, rk3288, rk3399):
     - There is one clock that's used both to derive the functional clock
       for the device and as the bus clock.
   - For newer hardware (rk3328 and future socs): specified by name
     - "pwm": This is used to derive the functional clock.
     - "pclk": This is the APB bus clock.
 - #pwm-cells: must be 2 (rk2928) or 3 (rk3288). See pwm.yaml in this directory
   for a description of the cell format.

Example:

	pwm0: pwm@20030000 {
		compatible = "rockchip,rk2928-pwm";
		reg = <0x20030000 0x10>;
		clocks = <&cru PCLK_PWM01>;
		#pwm-cells = <2>;
	};
```

## Documentation/devicetree/bindings/pwm/pwm-rockchip.yaml
```yaml
# SPDX-License-Identifier: GPL-2.0
%YAML 1.2
---
$id: http://devicetree.org/schemas/pwm/pwm-rockchip.yaml#
$schema: http://devicetree.org/meta-schemas/core.yaml#

title: Rockchip PWM controller

maintainers:
  - Heiko Stuebner <heiko@sntech.de>

properties:
  compatible:
    oneOf:
      - const: rockchip,rk2928-pwm
      - const: rockchip,rk3288-pwm
      - const: rockchip,rk3328-pwm
      - const: rockchip,vop-pwm
      - items:
          - const: rockchip,rk3036-pwm
          - const: rockchip,rk2928-pwm
      - items:
          - enum:
              - rockchip,rk3368-pwm
              - rockchip,rk3399-pwm
              - rockchip,rv1108-pwm
          - const: rockchip,rk3288-pwm
      - items:
          - enum:
              - rockchip,px30-pwm
              - rockchip,rk3308-pwm
              - rockchip,rk3568-pwm
          - const: rockchip,rk3328-pwm

  reg:
    maxItems: 1

  clocks:
    minItems: 1
    maxItems: 2

  clock-names:
    maxItems: 2

  "#pwm-cells":
    enum: [2, 3]
    description:
      Must be 2 (rk2928) or 3 (rk3288 and later).
      See pwm.yaml for a description of the cell format.

required:
  - compatible
  - reg
  - "#pwm-cells"

if:
  properties:
    compatible:
      contains:
        enum:
          - rockchip,rk3328-pwm
          - rockchip,rv1108-pwm

then:
  properties:
    clocks:
      items:
        - description: Used to derive the functional clock for the device.
        - description: Used as the APB bus clock.

    clock-names:
      items:
        - const: pwm
        - const: pclk

  required:
    - clocks
    - clock-names

else:
  properties:
    clocks:
      maxItems: 1
      description:
        Used both to derive the functional clock
        for the device and as the bus clock.

  required:
    - clocks

additionalProperties: false

examples:
  - |
    #include <dt-bindings/clock/rk3188-cru-common.h>
    pwm0: pwm@20030000 {
      compatible = "rockchip,rk2928-pwm";
      reg = <0x20030000 0x10>;
      clocks = <&cru PCLK_PWM01>;
      #pwm-cells = <2>;
    };
```
