## Documentation/devicetree/bindings/pwm/pwm-tiecap.txt
```
TI SOC ECAP based APWM controller

Required properties:
- compatible: Must be "ti,<soc>-ecap".
  for am33xx - compatible = "ti,am3352-ecap", "ti,am33xx-ecap";
  for am4372 - compatible = "ti,am4372-ecap", "ti,am3352-ecap", "ti,am33xx-ecap";
  for da850  - compatible = "ti,da850-ecap", "ti,am3352-ecap", "ti,am33xx-ecap";
  for dra746 - compatible = "ti,dra746-ecap", "ti,am3352-ecap";
  for 66ak2g - compatible = "ti,k2g-ecap", "ti,am3352-ecap";
- #pwm-cells: should be 3. See pwm.txt in this directory for a description of
  the cells format. The PWM channel index ranges from 0 to 4. The only third
  cell flag supported by this binding is PWM_POLARITY_INVERTED.
- reg: physical base address and size of the registers map.

Optional properties:
- clocks: Handle to the ECAP's functional clock.
- clock-names: Must be set to "fck".

Example:

ecap0: ecap@48300100 { /* ECAP on am33xx */
	compatible = "ti,am3352-ecap", "ti,am33xx-ecap";
	#pwm-cells = <3>;
	reg = <0x48300100 0x80>;
	clocks = <&l4ls_gclk>;
	clock-names = "fck";
};

ecap0: ecap@48300100 { /* ECAP on am4372 */
	compatible = "ti,am4372-ecap", "ti,am3352-ecap", "ti,am33xx-ecap";
	#pwm-cells = <3>;
	reg = <0x48300100 0x80>;
	ti,hwmods = "ecap0";
	clocks = <&l4ls_gclk>;
	clock-names = "fck";
};

ecap0: ecap@1f06000 { /* ECAP on da850 */
	compatible = "ti,da850-ecap", "ti,am3352-ecap", "ti,am33xx-ecap";
	#pwm-cells = <3>;
	reg = <0x1f06000 0x80>;
};

ecap0: ecap@4843e100 {
	compatible = "ti,dra746-ecap", "ti,am3352-ecap";
	#pwm-cells = <3>;
	reg = <0x4843e100 0x80>;
	clocks = <&l4_root_clk_div>;
	clock-names = "fck";
};
```

## Documentation/devicetree/bindings/pwm/pwm-tiecap.yaml
```yaml
# SPDX-License-Identifier: (GPL-2.0-only OR BSD-2-Clause)
%YAML 1.2
---
$id: http://devicetree.org/schemas/pwm/pwm-tiecap.yaml#
$schema: http://devicetree.org/meta-schemas/core.yaml#

title: TI SOC ECAP based APWM controller

maintainers:
  - Vignesh R <vigneshr@ti.com>

allOf:
  - $ref: pwm.yaml#

properties:
  compatible:
    oneOf:
      - const: ti,am3352-ecap
      - items:
          - enum:
              - ti,da850-ecap
              - ti,am4372-ecap
              - ti,dra746-ecap
              - ti,k2g-ecap
              - ti,am654-ecap
              - ti,am64-ecap
          - const: ti,am3352-ecap

  reg:
    maxItems: 1

  "#pwm-cells":
    const: 3
    description: |
      See pwm.yaml in this directory for a description of the cells format.
      The only third cell flag supported by this binding is PWM_POLARITY_INVERTED.

  clock-names:
    const: fck

  clocks:
    maxItems: 1

  power-domains:
    maxItems: 1

required:
  - compatible
  - reg
  - "#pwm-cells"
  - clocks
  - clock-names

additionalProperties: false

examples:
  - |
    ecap0: pwm@48300100 { /* ECAP on am33xx */
        compatible = "ti,am3352-ecap";
        #pwm-cells = <3>;
        reg = <0x48300100 0x80>;
        clocks = <&l4ls_gclk>;
        clock-names = "fck";
    };
```

## Documentation/devicetree/bindings/pwm/pwm-tiehrpwm.txt
```
TI SOC EHRPWM based PWM controller

Required properties:
- compatible: Must be "ti,<soc>-ehrpwm".
  for am33xx  - compatible = "ti,am3352-ehrpwm", "ti,am33xx-ehrpwm";
  for am4372  - compatible = "ti,am4372-ehrpwm", "ti-am3352-ehrpwm", "ti,am33xx-ehrpwm";
  for da850   - compatible = "ti,da850-ehrpwm", "ti-am3352-ehrpwm", "ti,am33xx-ehrpwm";
  for dra746 - compatible = "ti,dra746-ehrpwm", "ti-am3352-ehrpwm";
- #pwm-cells: should be 3. See pwm.txt in this directory for a description of
  the cells format. The only third cell flag supported by this binding is
  PWM_POLARITY_INVERTED.
- reg: physical base address and size of the registers map.

Optional properties:
- clocks: Handle to the PWM's time-base and functional clock.
- clock-names: Must be set to "tbclk" and "fck".

Example:

ehrpwm0: pwm@48300200 { /* EHRPWM on am33xx */
	compatible = "ti,am3352-ehrpwm", "ti,am33xx-ehrpwm";
	#pwm-cells = <3>;
	reg = <0x48300200 0x100>;
	clocks = <&ehrpwm0_tbclk>, <&l4ls_gclk>;
	clock-names = "tbclk", "fck";
};

ehrpwm0: pwm@48300200 { /* EHRPWM on am4372 */
	compatible = "ti,am4372-ehrpwm", "ti,am3352-ehrpwm", "ti,am33xx-ehrpwm";
	#pwm-cells = <3>;
	reg = <0x48300200 0x80>;
	clocks = <&ehrpwm0_tbclk>, <&l4ls_gclk>;
	clock-names = "tbclk", "fck";
	ti,hwmods = "ehrpwm0";
};

ehrpwm0: pwm@1f00000 { /* EHRPWM on da850 */
	compatible = "ti,da850-ehrpwm", "ti,am3352-ehrpwm", "ti,am33xx-ehrpwm";
	#pwm-cells = <3>;
	reg = <0x1f00000 0x2000>;
};

ehrpwm0: pwm@4843e200 { /* EHRPWM on dra746 */
	compatible = "ti,dra746-ehrpwm", "ti,am3352-ehrpwm";
	#pwm-cells = <3>;
	reg = <0x4843e200 0x80>;
	clocks = <&ehrpwm0_tbclk>, <&l4_root_clk_div>;
	clock-names = "tbclk", "fck";
};
```

## Documentation/devicetree/bindings/pwm/pwm-tiehrpwm.yaml
```yaml
# SPDX-License-Identifier: (GPL-2.0-only OR BSD-2-Clause)
%YAML 1.2
---
$id: http://devicetree.org/schemas/pwm/pwm-tiehrpwm.yaml#
$schema: http://devicetree.org/meta-schemas/core.yaml#

title: TI SOC EHRPWM based PWM controller

maintainers:
  - Vignesh R <vigneshr@ti.com>

allOf:
  - $ref: pwm.yaml#

properties:
  compatible:
    oneOf:
      - const: ti,am3352-ehrpwm
      - items:
          - enum:
              - ti,da850-ehrpwm
              - ti,am4372-ehrpwm
              - ti,dra746-ehrpwm
              - ti,am654-ehrpwm
              - ti,am64-epwm
          - const: ti,am3352-ehrpwm

  reg:
    maxItems: 1

  "#pwm-cells":
    const: 3
    description: |
      See pwm.yaml in this directory for a description of the cells format.
      The only third cell flag supported by this binding is PWM_POLARITY_INVERTED.

  clock-names:
    items:
      - const: tbclk
      - const: fck

  clocks:
    maxItems: 2

  power-domains:
    maxItems: 1

required:
  - compatible
  - reg
  - "#pwm-cells"
  - clocks
  - clock-names

additionalProperties: false

examples:
  - |
    ehrpwm0: pwm@48300200 { /* EHRPWM on am33xx */
        compatible = "ti,am3352-ehrpwm";
        #pwm-cells = <3>;
        reg = <0x48300200 0x100>;
        clocks = <&ehrpwm0_tbclk>, <&l4ls_gclk>;
        clock-names = "tbclk", "fck";
    };
```

## Documentation/devicetree/bindings/pwm/pwm-tipwmss.txt
```
TI SOC based PWM Subsystem

Required properties:
- compatible: Must be "ti,<soc>-pwmss".
  for am33xx  - compatible = "ti,am33xx-pwmss";
  for am4372  - compatible = "ti,am4372-pwmss","ti,am33xx-pwmss";
  for dra746 - compatible = "ti,dra746-pwmss", "ti,am33xx-pwmss"

- reg: physical base address and size of the registers map.
- address-cells: Specify the number of u32 entries needed in child nodes.
		  Should set to 1.
- size-cells: specify number of u32 entries needed to specify child nodes size
		in reg property. Should set to 1.
- ranges: describes the address mapping of a memory-mapped bus. Should set to
	   physical address map of child's base address, physical address within
	   parent's address  space and length of the address map. For am33xx,
	   3 set of child register maps present, ECAP register space, EQEP
	   register space, EHRPWM register space.

Also child nodes should also populated under PWMSS DT node.

Example:
epwmss0: epwmss@48300000 { /* PWMSS for am33xx */
	compatible = "ti,am33xx-pwmss";
	reg = <0x48300000 0x10>;
	ti,hwmods = "epwmss0";
	#address-cells = <1>;
	#size-cells = <1>;
	status = "disabled";
	ranges = <0x48300100 0x48300100 0x80   /* ECAP */
		  0x48300180 0x48300180 0x80   /* EQEP */
		  0x48300200 0x48300200 0x80>; /* EHRPWM */

	/* child nodes go here */
};

epwmss0: epwmss@48300000 { /* PWMSS for am4372 */
	compatible = "ti,am4372-pwmss","ti,am33xx-pwmss"
	reg = <0x48300000 0x10>;
	ti,hwmods = "epwmss0";
	#address-cells = <1>;
	#size-cells = <1>;
	status = "disabled";
	ranges = <0x48300100 0x48300100 0x80   /* ECAP */
		  0x48300180 0x48300180 0x80   /* EQEP */
		  0x48300200 0x48300200 0x80>; /* EHRPWM */

	/* child nodes go here */
};

epwmss0: epwmss@4843e000 { /* PWMSS for DRA7xx */
	compatible = "ti,dra746-pwmss", "ti,am33xx-pwmss";
	reg = <0x4843e000 0x30>;
	ti,hwmods = "epwmss0";
	#address-cells = <1>;
	#size-cells = <1>;
	ranges;

	/* child nodes go here */
};
```
