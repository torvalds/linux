## Documentation/devicetree/bindings/pwm/pwm-samsung.txt
```
* Samsung PWM timers

Samsung SoCs contain PWM timer blocks which can be used for system clock source
and clock event timers, as well as to drive SoC outputs with PWM signal. Each
PWM timer block provides 5 PWM channels (not all of them can drive physical
outputs - see SoC and board manual).

Be aware that the clocksource driver supports only uniprocessor systems.

Required properties:
- compatible : should be one of following:
    samsung,s3c2410-pwm - for 16-bit timers present on S3C24xx SoCs
    samsung,s3c6400-pwm - for 32-bit timers present on S3C64xx SoCs
    samsung,s5p6440-pwm - for 32-bit timers present on S5P64x0 SoCs
    samsung,s5pc100-pwm - for 32-bit timers present on S5PC100, S5PV210,
			  Exynos4210 rev0 SoCs
    samsung,exynos4210-pwm - for 32-bit timers present on Exynos4210,
                          Exynos4x12 and Exynos5250 SoCs
- reg: base address and size of register area
- interrupts: list of timer interrupts (one interrupt per timer, starting at
  timer 0)
- clock-names: should contain all following required clock names:
    - "timers" - PWM base clock used to generate PWM signals,
  and any subset of following optional clock names:
    - "pwm-tclk0" - first external PWM clock source,
    - "pwm-tclk1" - second external PWM clock source.
  Note that not all IP variants allow using all external clock sources.
  Refer to SoC documentation to learn which clock source configurations
  are available.
- clocks: should contain clock specifiers of all clocks, which input names
  have been specified in clock-names property, in same order.
- #pwm-cells: should be 3. See pwm.txt in this directory for a description of
  the cells format. The only third cell flag supported by this binding is
  PWM_POLARITY_INVERTED.

Optional properties:
- samsung,pwm-outputs: list of PWM channels used as PWM outputs on particular
    platform - an array of up to 5 elements being indices of PWM channels
    (from 0 to 4), the order does not matter.

Example:
	pwm@7f006000 {
		compatible = "samsung,s3c6400-pwm";
		reg = <0x7f006000 0x1000>;
		interrupt-parent = <&vic0>;
		interrupts = <23>, <24>, <25>, <27>, <28>;
		clocks = <&clock 67>;
		clock-names = "timers";
		samsung,pwm-outputs = <0>, <1>;
		#pwm-cells = <3>;
	}
```

## Documentation/devicetree/bindings/pwm/pwm-samsung.yaml
```yaml
# SPDX-License-Identifier: GPL-2.0
%YAML 1.2
---
$id: http://devicetree.org/schemas/pwm/pwm-samsung.yaml#
$schema: http://devicetree.org/meta-schemas/core.yaml#

title: Samsung SoC PWM timers

maintainers:
  - Thierry Reding <thierry.reding@gmail.com>
  - Krzysztof Kozlowski <krzk@kernel.org>

description: |+
  Samsung SoCs contain PWM timer blocks which can be used for system clock source
  and clock event timers, as well as to drive SoC outputs with PWM signal. Each
  PWM timer block provides 5 PWM channels (not all of them can drive physical
  outputs - see SoC and board manual).

  Be aware that the clocksource driver supports only uniprocessor systems.

properties:
  compatible:
    oneOf:
      - enum:
          - samsung,s3c2410-pwm             # 16-bit, S3C24xx
          - samsung,s3c6400-pwm             # 32-bit, S3C64xx
          - samsung,s5p6440-pwm             # 32-bit, S5P64x0
          - samsung,s5pc100-pwm             # 32-bit, S5PC100, S5PV210, Exynos4210 rev0 SoCs
          - samsung,exynos4210-pwm          # 32-bit, Exynos
      - items:
          - enum:
              - samsung,exynos5433-pwm
              - samsung,exynos7-pwm
              - samsung,exynosautov9-pwm
              - samsung,exynosautov920-pwm
              - tesla,fsd-pwm
          - const: samsung,exynos4210-pwm

  reg:
    maxItems: 1

  clocks:
    minItems: 1
    maxItems: 3

  clock-names:
    description: |
      Should contain all following required clock names:
      - "timers" - PWM base clock used to generate PWM signals,
      and any subset of following optional clock names:
      - "pwm-tclk0" - first external PWM clock source,
      - "pwm-tclk1" - second external PWM clock source.
      Note that not all IP variants allow using all external clock sources.
      Refer to SoC documentation to learn which clock source configurations
      are available.
    oneOf:
      - items:
          - const: timers
      - items:
          - const: timers
          - const: pwm-tclk0
      - items:
          - const: timers
          - const: pwm-tclk1
      - items:
          - const: timers
          - const: pwm-tclk0
          - const: pwm-tclk1

  interrupts:
    description:
      One interrupt per timer, starting at timer 0. Necessary only for SoCs which
      use PWM clocksource.
    minItems: 1
    maxItems: 5

  "#pwm-cells":
    description:
      The only third cell flag supported by this binding
      is PWM_POLARITY_INVERTED.
    const: 3

  samsung,pwm-outputs:
    description:
      A list of PWM channels used as PWM outputs on particular platform.
      It is an array of up to 5 elements being indices of PWM channels
      (from 0 to 4), the order does not matter.
    $ref: /schemas/types.yaml#/definitions/uint32-array
    uniqueItems: true
    items:
      minimum: 0
      maximum: 4

required:
  - clocks
  - clock-names
  - compatible
  - reg

additionalProperties: false

allOf:
  - $ref: pwm.yaml#

  - if:
      properties:
        compatible:
          contains:
            enum:
              - samsung,s3c2410-pwm
              - samsung,s3c6400-pwm
              - samsung,s5p6440-pwm
              - samsung,s5pc100-pwm
    then:
      required:
        - interrupts

examples:
  - |
    pwm@7f006000 {
        compatible = "samsung,s3c6400-pwm";
        reg = <0x7f006000 0x1000>;
        interrupt-parent = <&vic0>;
        interrupts = <23>, <24>, <25>, <27>, <28>;
        clocks = <&clock 67>;
        clock-names = "timers";
        samsung,pwm-outputs = <0>, <1>;
        #pwm-cells = <3>;
    };
```

## Documentation/devicetree/bindings/pwm/pwm-sifive.txt
```
SiFive PWM controller

Unlike most other PWM controllers, the SiFive PWM controller currently only
supports one period for all channels in the PWM. All PWMs need to run at
the same period. The period also has significant restrictions on the values
it can achieve, which the driver rounds to the nearest achievable period.
PWM RTL that corresponds to the IP block version numbers can be found
here:

https://github.com/sifive/sifive-blocks/tree/master/src/main/scala/devices/pwm

Required properties:
- compatible: Should be "sifive,<chip>-pwm" and "sifive,pwm<version>".
  Supported compatible strings are: "sifive,fu540-c000-pwm" for the SiFive
  PWM v0 as integrated onto the SiFive FU540 chip, and "sifive,pwm0" for the
  SiFive PWM v0 IP block with no chip integration tweaks.
  Please refer to sifive-blocks-ip-versioning.txt for details.
- reg: physical base address and length of the controller's registers
- clocks: Should contain a clock identifier for the PWM's parent clock.
- #pwm-cells: Should be 3. See pwm.txt in this directory
  for a description of the cell format.
- interrupts: one interrupt per PWM channel

Examples:

pwm:  pwm@10020000 {
	compatible = "sifive,fu540-c000-pwm", "sifive,pwm0";
	reg = <0x0 0x10020000 0x0 0x1000>;
	clocks = <&tlclk>;
	interrupt-parent = <&plic>;
	interrupts = <42 43 44 45>;
	#pwm-cells = <3>;
};
```

## Documentation/devicetree/bindings/pwm/pwm-sifive.yaml
```yaml
# SPDX-License-Identifier: (GPL-2.0-only OR BSD-2-Clause)
# Copyright (C) 2020 SiFive, Inc.
%YAML 1.2
---
$id: http://devicetree.org/schemas/pwm/pwm-sifive.yaml#
$schema: http://devicetree.org/meta-schemas/core.yaml#

title: SiFive PWM controller

maintainers:
  - Paul Walmsley <paul.walmsley@sifive.com>

description:
  Unlike most other PWM controllers, the SiFive PWM controller currently
  only supports one period for all channels in the PWM. All PWMs need to
  run at the same period. The period also has significant restrictions on
  the values it can achieve, which the driver rounds to the nearest
  achievable period. PWM RTL that corresponds to the IP block version
  numbers can be found here -

  https://github.com/sifive/sifive-blocks/tree/master/src/main/scala/devices/pwm

allOf:
  - $ref: pwm.yaml#

properties:
  compatible:
    items:
      - enum:
          - sifive,fu540-c000-pwm
          - sifive,fu740-c000-pwm
      - const: sifive,pwm0
    description:
      Should be "sifive,<chip>-pwm" and "sifive,pwm<version>". Supported
      compatible strings are "sifive,fu540-c000-pwm" and
      "sifive,fu740-c000-pwm" for the SiFive PWM v0 as integrated onto the
      SiFive FU540 and FU740 chip respectively, and "sifive,pwm0" for the
      SiFive PWM v0 IP block with no chip integration tweaks.
      Please refer to sifive-blocks-ip-versioning.txt for details.

  reg:
    maxItems: 1

  clocks:
    maxItems: 1

  "#pwm-cells":
    const: 3

  interrupts:
    maxItems: 4
    description:
      Each PWM instance in FU540-C000 has 4 comparators. One interrupt per comparator.

required:
  - compatible
  - reg
  - clocks
  - interrupts

additionalProperties: false

examples:
  - |
    pwm:  pwm@10020000 {
      compatible = "sifive,fu540-c000-pwm", "sifive,pwm0";
      reg = <0x10020000 0x1000>;
      clocks = <&tlclk>;
      interrupt-parent = <&plic>;
      interrupts = <42>, <43>, <44>, <45>;
      #pwm-cells = <3>;
    };
```

## Documentation/devicetree/bindings/pwm/pwm-sprd.txt
```
Spreadtrum PWM controller

Spreadtrum SoCs PWM controller provides 4 PWM channels.

Required properties:
- compatible : Should be "sprd,ums512-pwm".
- reg: Physical base address and length of the controller's registers.
- clocks: The phandle and specifier referencing the controller's clocks.
- clock-names: Should contain following entries:
  "pwmn": used to derive the functional clock for PWM channel n (n range: 0 ~ 3).
  "enablen": for PWM channel n enable clock (n range: 0 ~ 3).
- #pwm-cells: Should be 2. See pwm.txt in this directory for a description of
  the cells format.

Optional properties:
- assigned-clocks: Reference to the PWM clock entries.
- assigned-clock-parents: The phandle of the parent clock of PWM clock.

Example:
	pwms: pwm@32260000 {
		compatible = "sprd,ums512-pwm";
		reg = <0 0x32260000 0 0x10000>;
		clock-names = "pwm0", "enable0",
			"pwm1", "enable1",
			"pwm2", "enable2",
			"pwm3", "enable3";
		clocks = <&aon_clk CLK_PWM0>, <&aonapb_gate CLK_PWM0_EB>,
		       <&aon_clk CLK_PWM1>, <&aonapb_gate CLK_PWM1_EB>,
		       <&aon_clk CLK_PWM2>, <&aonapb_gate CLK_PWM2_EB>,
		       <&aon_clk CLK_PWM3>, <&aonapb_gate CLK_PWM3_EB>;
		assigned-clocks = <&aon_clk CLK_PWM0>,
			<&aon_clk CLK_PWM1>,
			<&aon_clk CLK_PWM2>,
			<&aon_clk CLK_PWM3>;
		assigned-clock-parents = <&ext_26m>,
			<&ext_26m>,
			<&ext_26m>,
			<&ext_26m>;
		#pwm-cells = <2>;
	};
```

## Documentation/devicetree/bindings/pwm/pwm-st.txt
```
STMicroelectronics PWM driver bindings
--------------------------------------

Required parameters:
- compatible :		"st,pwm"
- #pwm-cells : 		Number of cells used to specify a PWM. First cell
			specifies the per-chip index of the PWM to use and the
			second cell is the period in nanoseconds - fixed to 2
			for STiH41x.
- reg :			Physical base address and length of the controller's
			registers.
- pinctrl-names: 	Set to "default".
- pinctrl-0: 		List of phandles pointing to pin configuration nodes
			for PWM module.
			For Pinctrl properties, please refer to [1].
- clock-names: 		Set to "pwm".
- clocks: 		phandle of the clock used by the PWM module.
			For Clk properties, please refer to [2].

Optional properties:
- st,pwm-num-chan:	Number of available channels. If not passed, the driver
			will consider single channel by default.

[1] Documentation/devicetree/bindings/pinctrl/pinctrl-bindings.txt
[2] Documentation/devicetree/bindings/clock/clock-bindings.txt

Example:

pwm1: pwm@fe510000 {
	compatible = "st,pwm";
	reg = <0xfe510000 0x68>;
	#pwm-cells = <2>;
	pinctrl-names = "default";
	pinctrl-0 = <&pinctrl_pwm1_chan0_default
		     &pinctrl_pwm1_chan1_default
		     &pinctrl_pwm1_chan2_default
		     &pinctrl_pwm1_chan3_default>;
	clocks = <&clk_sysin>;
	clock-names = "pwm";
	st,pwm-num-chan = <4>;
};
```

## Documentation/devicetree/bindings/pwm/pwm-stm32-lp.txt
```
STMicroelectronics STM32 Low-Power Timer PWM

STM32 Low-Power Timer provides single channel PWM.

Must be a sub-node of an STM32 Low-Power Timer device tree node.
See ../mfd/stm32-lptimer.txt for details about the parent node.

Required parameters:
- compatible:		Must be "st,stm32-pwm-lp".
- #pwm-cells:		Should be set to 3. This PWM chip uses the default 3 cells
			bindings defined in pwm.txt.

Optional properties:
- pinctrl-names: 	Set to "default". An additional "sleep" state can be
			defined to set pins in sleep state when in low power.
- pinctrl-n: 		Phandle(s) pointing to pin configuration node for PWM,
			respectively for "default" and "sleep" states.

Example:
	timer@40002400 {
		compatible = "st,stm32-lptimer";
		...
		pwm {
			compatible = "st,stm32-pwm-lp";
			#pwm-cells = <3>;
			pinctrl-names = "default", "sleep";
			pinctrl-0 = <&lppwm1_pins>;
			pinctrl-1 = <&lppwm1_sleep_pins>;
		};
	};
```

## Documentation/devicetree/bindings/pwm/pwm-stm32.txt
```
STMicroelectronics STM32 Timers PWM bindings

Must be a sub-node of an STM32 Timers device tree node.
See ../mfd/stm32-timers.txt for details about the parent node.

Required parameters:
- compatible:		Must be "st,stm32-pwm".
- pinctrl-names: 	Set to "default".
- pinctrl-0: 		List of phandles pointing to pin configuration nodes for PWM module.
			For Pinctrl properties see ../pinctrl/pinctrl-bindings.txt

Optional parameters:
- st,breakinput:	One or two <index level filter> to describe break input configurations.
			"index" indicates on which break input (0 or 1) the configuration
			should be applied.
			"level" gives the active level (0=low or 1=high) of the input signal
			for this configuration.
			"filter" gives the filtering value to be applied.

Example:
	timers@40010000 {
		#address-cells = <1>;
		#size-cells = <0>;
		compatible = "st,stm32-timers";
		reg = <0x40010000 0x400>;
		clocks = <&rcc 0 160>;
		clock-names = "clk_int";

		pwm {
			compatible = "st,stm32-pwm";
			pinctrl-0	= <&pwm1_pins>;
			pinctrl-names	= "default";
			st,breakinput = <0 1 5>;
		};
	};
```

## Documentation/devicetree/bindings/pwm/pwm-sun4i.txt
```
Allwinner sun4i and sun7i SoC PWM controller

Required properties:
  - compatible: should be one of:
    - "allwinner,sun4i-a10-pwm"
    - "allwinner,sun5i-a10s-pwm"
    - "allwinner,sun5i-a13-pwm"
    - "allwinner,sun7i-a20-pwm"
    - "allwinner,sun8i-h3-pwm"
  - reg: physical base address and length of the controller's registers
  - #pwm-cells: should be 3. See pwm.txt in this directory for a description of
    the cells format.
  - clocks: From common clock binding, handle to the parent clock.

Example:

	pwm: pwm@1c20e00 {
		compatible = "allwinner,sun7i-a20-pwm";
		reg = <0x01c20e00 0xc>;
		clocks = <&osc24M>;
		#pwm-cells = <3>;
	};
```
