## Documentation/devicetree/bindings/remoteproc/qcom,rpm-proc.yaml
```yaml
# SPDX-License-Identifier: (GPL-2.0 OR BSD-2-Clause)
%YAML 1.2
---
$id: http://devicetree.org/schemas/remoteproc/qcom,rpm-proc.yaml#
$schema: http://devicetree.org/meta-schemas/core.yaml#

title: Qualcomm Resource Power Manager (RPM) Processor/Subsystem

maintainers:
  - Bjorn Andersson <andersson@kernel.org>
  - Konrad Dybcio <konrad.dybcio@linaro.org>
  - Stephan Gerhold <stephan@gerhold.net>

description: |
  Resource Power Manager (RPM) subsystem found in various Qualcomm platforms:

                  +--------------------------------------------+
                  |       RPM subsystem (qcom,rpm-proc)        |
                  |                                            |
            reset | +---------------+     +-----+  +-----+     |
          --------->|               |     | MPM |  | CPR | ... |
   IPC interrupts | | ARM Cortex-M3 |---  +-----+  +-----+     |
  ----------------->|               |  |     |        |        |
                  | +---------------+  |---------------------- |
                  | +---------------+  |                       |
                  | |   Code RAM    |--|  +------------------+ |
                  | +---------------+  |  |                  | |
                  | +---------------+  |--|   Message RAM    | |
                  | |   Data RAM    |--|  |                  | |
                  | +---------------+  |  +------------------+ |
                  +--------------------|-----------------------+
                                       v
                                      NoC

  The firmware running on the processor inside the RPM subsystem allows each
  component in the system to vote for state of the system resources, such as
  clocks, regulators and bus frequencies. It implements multiple separate
  communication interfaces that are described in subnodes, e.g. SMD and MPM:

             +------------------------------+
             |        ARM Cortex-M3         |
             |                              |   +------------------------------+
             | +--------------------------+ |   |          Message RAM         |
             | |  RPM firmware            | |   |                              |
   IPC IRQ 0 | | +----------------------+ | |   | +--------------------------+ |
  -------------->| SMD server           |<------->| SMD data structures      | |
             | | | +--------------+     | | |   | | +--------------+         | |
             | | | | rpm_requests | ... | | |   | | | rpm_requests |   ...   | |
             | | | +--------------+     | | |   | | +--------------+         | |
   IPC IRQ 1 | | +----------------------+ | |   | +--------------------------+ |
  -------------->| MPM virtualization   |<--------| MPM register copy (vMPM) | |
             | | +----------------------+ | |   | +--------------------------+ |
             | |           ...      |     | |   |              ...             |
             | +--------------------|-----+ |   +------------------------------+
             +----------------------|-------+
                                    v
                             +--------------+
                             | MPM Hardware |
                             +--------------+

  The services provided by the firmware are only available after the firmware
  has been loaded and the processor has been released from reset. Usually this
  happens early in the boot process before the operating system is started.

properties:
  compatible:
    items:
      - enum:
          - qcom,apq8084-rpm-proc
          - qcom,ipq6018-rpm-proc
          - qcom,ipq9574-rpm-proc
          - qcom,mdm9607-rpm-proc
          - qcom,msm8226-rpm-proc
          - qcom,msm8610-rpm-proc
          - qcom,msm8909-rpm-proc
          - qcom,msm8916-rpm-proc
          - qcom,msm8917-rpm-proc
          - qcom,msm8936-rpm-proc
          - qcom,msm8937-rpm-proc
          - qcom,msm8952-rpm-proc
          - qcom,msm8953-rpm-proc
          - qcom,msm8974-rpm-proc
          - qcom,msm8976-rpm-proc
          - qcom,msm8994-rpm-proc
          - qcom,msm8996-rpm-proc
          - qcom,msm8998-rpm-proc
          - qcom,qcm2290-rpm-proc
          - qcom,qcs404-rpm-proc
          - qcom,sdm660-rpm-proc
          - qcom,sm6115-rpm-proc
          - qcom,sm6125-rpm-proc
          - qcom,sm6375-rpm-proc
      - const: qcom,rpm-proc

  smd-edge:
    $ref: /schemas/remoteproc/qcom,smd-edge.yaml#
    description:
      Qualcomm Shared Memory subnode which represents communication edge,
      channels and devices related to the RPM subsystem.

  glink-edge:
    $ref: /schemas/remoteproc/qcom,glink-rpm-edge.yaml#
    description:
      Qualcomm G-Link subnode which represents communication edge,
      channels and devices related to the RPM subsystem.

  interrupt-controller:
    type: object
    $ref: /schemas/interrupt-controller/qcom,mpm.yaml#
    description:
      MSM Power Manager (MPM) interrupt controller that monitors interrupts
      when the system is asleep.

  master-stats:
    $ref: /schemas/soc/qcom/qcom,rpm-master-stats.yaml#
    description:
      Subsystem-level low-power mode statistics provided by RPM.

required:
  - compatible

oneOf:
  - required:
      - smd-edge
  - required:
      - glink-edge

additionalProperties: false

examples:
  # SMD
  - |
    #include <dt-bindings/interrupt-controller/arm-gic.h>
    #include <dt-bindings/interrupt-controller/irq.h>

    remoteproc {
      compatible = "qcom,msm8916-rpm-proc", "qcom,rpm-proc";

      smd-edge {
        interrupts = <GIC_SPI 168 IRQ_TYPE_EDGE_RISING>;
        qcom,ipc = <&apcs 8 0>;
        qcom,smd-edge = <15>;

        rpm-requests {
          compatible = "qcom,rpm-msm8916";
          qcom,smd-channels = "rpm_requests";
          /* ... */
        };
      };
    };
  # GLINK
  - |
    #include <dt-bindings/interrupt-controller/arm-gic.h>
    #include <dt-bindings/interrupt-controller/irq.h>

    remoteproc {
      compatible = "qcom,qcm2290-rpm-proc", "qcom,rpm-proc";

      glink-edge {
        compatible = "qcom,glink-rpm";
        interrupts = <GIC_SPI 194 IRQ_TYPE_EDGE_RISING>;
        qcom,rpm-msg-ram = <&rpm_msg_ram>;
        mboxes = <&apcs_glb 0>;

        rpm-requests {
          compatible = "qcom,rpm-qcm2290";
          qcom,glink-channels = "rpm_requests";
          /* ... */
        };
      };
    };
```

## Documentation/devicetree/bindings/remoteproc/qcom,sa8775p-pas.yaml
```yaml
# SPDX-License-Identifier: GPL-2.0 OR BSD-2-Clause
%YAML 1.2
---
$id: http://devicetree.org/schemas/remoteproc/qcom,sa8775p-pas.yaml#
$schema: http://devicetree.org/meta-schemas/core.yaml#

title: Qualcomm SA8775p Peripheral Authentication Service

maintainers:
  - Bartosz Golaszewski <bartosz.golaszewski@linaro.org>

description:
  Qualcomm SA8775p SoC Peripheral Authentication Service loads and boots firmware
  on the Qualcomm DSP Hexagon cores.

properties:
  compatible:
    oneOf:
      - items:
          - enum:
              - qcom,qcs8300-adsp-pas
          - const: qcom,sa8775p-adsp-pas
      - items:
          - enum:
              - qcom,qcs8300-cdsp-pas
          - const: qcom,sa8775p-cdsp0-pas
      - items:
          - enum:
              - qcom,qcs8300-gpdsp-pas
          - const: qcom,sa8775p-gpdsp0-pas
      - enum:
          - qcom,sa8775p-adsp-pas
          - qcom,sa8775p-cdsp0-pas
          - qcom,sa8775p-cdsp1-pas
          - qcom,sa8775p-gpdsp0-pas
          - qcom,sa8775p-gpdsp1-pas

  reg:
    maxItems: 1

  clocks:
    items:
      - description: XO clock

  clock-names:
    items:
      - const: xo

  qcom,qmp:
    $ref: /schemas/types.yaml#/definitions/phandle
    description: Reference to the AOSS side-channel message RAM.

  firmware-name:
    $ref: /schemas/types.yaml#/definitions/string-array
    items:
      - description: Firmware name of the Hexagon core

  memory-region:
    items:
      - description: Memory region for main Firmware authentication

  interrupts:
    maxItems: 5

  interrupt-names:
    maxItems: 5

required:
  - compatible
  - reg
  - memory-region

allOf:
  - $ref: /schemas/remoteproc/qcom,pas-common.yaml#

  - if:
      properties:
        compatible:
          contains:
            enum:
              - qcom,sa8775p-adsp-pas
    then:
      properties:
        power-domains:
          items:
            - description: LCX power domain
            - description: LMX power domain
        power-domain-names:
          items:
            - const: lcx
            - const: lmx

  - if:
      properties:
        compatible:
          contains:
            enum:
              - qcom,sa8775p-cdsp0-pas
              - qcom,sa8775p-cdsp1-pas
    then:
      properties:
        power-domains:
          items:
            - description: CX power domain
            - description: MXC power domain
            - description: NSP0 power domain
        power-domain-names:
          items:
            - const: cx
            - const: mxc
            - const: nsp

  - if:
      properties:
        compatible:
          contains:
            enum:
              - qcom,sa8775p-gpdsp0-pas
              - qcom,sa8775p-gpdsp1-pas
    then:
      properties:
        power-domains:
          items:
            - description: CX power domain
            - description: MXC power domain
        power-domain-names:
          items:
            - const: cx
            - const: mxc

unevaluatedProperties: false

examples:
  - |
    #include <dt-bindings/clock/qcom,rpmh.h>
    #include <dt-bindings/interconnect/qcom,sa8775p-rpmh.h>
    #include <dt-bindings/interrupt-controller/irq.h>
    #include <dt-bindings/mailbox/qcom-ipcc.h>
    #include <dt-bindings/power/qcom,rpmhpd.h>

    remoteproc@30000000 {
        compatible = "qcom,sa8775p-adsp-pas";
        reg = <0x30000000 0x100>;

        interrupts-extended = <&pdc 6 IRQ_TYPE_EDGE_RISING>,
                              <&smp2p_adsp_in 0 IRQ_TYPE_EDGE_RISING>,
                              <&smp2p_adsp_in 2 IRQ_TYPE_EDGE_RISING>,
                              <&smp2p_adsp_in 1 IRQ_TYPE_EDGE_RISING>,
                              <&smp2p_adsp_in 3 IRQ_TYPE_EDGE_RISING>;
        interrupt-names = "wdog", "fatal", "ready", "handover", "stop-ack";

        clocks = <&rpmhcc RPMH_CXO_CLK>;
        clock-names = "xo";

        power-domains = <&rpmhpd RPMHPD_LCX>, <&rpmhpd RPMHPD_LMX>;
        power-domain-names = "lcx", "lmx";

        interconnects = <&lpass_ag_noc MASTER_LPASS_PROC 0 &mc_virt SLAVE_EBI1 0>;

        memory-region = <&pil_adsp_mem>;

        qcom,qmp = <&aoss_qmp>;

        qcom,smem-states = <&smp2p_adsp_out 0>;
        qcom,smem-state-names = "stop";

        glink-edge {
            interrupts-extended = <&ipcc IPCC_CLIENT_LPASS
                                   IPCC_MPROC_SIGNAL_GLINK_QMP
                                   IRQ_TYPE_EDGE_RISING>;
            mboxes = <&ipcc IPCC_CLIENT_LPASS IPCC_MPROC_SIGNAL_GLINK_QMP>;

            label = "lpass";
            qcom,remote-pid = <2>;
        };
    };
```
