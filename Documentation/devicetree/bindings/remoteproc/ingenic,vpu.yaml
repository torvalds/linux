## Documentation/devicetree/bindings/remoteproc/qcom,hexagon-v56.txt
```
Qualcomm Technology Inc. Hexagon v56 Peripheral Image Loader

This document defines the binding for a component that loads and boots firmware
on the Qualcomm Technology Inc. Hexagon v56 core.

- compatible:
	Usage: required
	Value type: <string>
	Definition: must be one of:
		    "qcom,qcs404-cdsp-pil",
		    "qcom,sdm845-adsp-pil"

- reg:
	Usage: required
	Value type: <prop-encoded-array>
	Definition: must specify the base address and size of the qdsp6ss register

- interrupts-extended:
	Usage: required
	Value type: <prop-encoded-array>
	Definition: must list the watchdog, fatal IRQs ready, handover and
		    stop-ack IRQs

- interrupt-names:
	Usage: required
	Value type: <stringlist>
	Definition: must be "wdog", "fatal", "ready", "handover", "stop-ack"

- clocks:
	Usage: required
	Value type: <prop-encoded-array>
	Definition:  List of phandles and clock specifier pairs for the Hexagon,
		     per clock-names below.

- clock-names:
	Usage: required for SDM845 ADSP
	Value type: <stringlist>
	Definition: List of clock input name strings sorted in the same
		    order as the clocks property. Definition must have
		    "xo", "sway_cbcr", "lpass_ahbs_aon_cbcr",
		    "lpass_ahbm_aon_cbcr", "qdsp6ss_xo", "qdsp6ss_sleep"
		    and "qdsp6ss_core".

- clock-names:
	Usage: required for QCS404 CDSP
	Value type: <stringlist>
	Definition: List of clock input name strings sorted in the same
		    order as the clocks property. Definition must have
		    "xo", "sway", "tbu", "bimc", "ahb_aon", "q6ss_slave",
		    "q6ss_master", "q6_axim".

- power-domains:
	Usage: required
	Value type: <phandle>
	Definition: reference to cx power domain node.

- resets:
	Usage: required
	Value type: <phandle>
	Definition: reference to the list of resets for the Hexagon.

- reset-names:
        Usage: required for SDM845 ADSP
        Value type: <stringlist>
        Definition: must be "pdc_sync" and "cc_lpass"

- reset-names:
        Usage: required for QCS404 CDSP
        Value type: <stringlist>
        Definition: must be "restart"

- qcom,halt-regs:
	Usage: required
	Value type: <prop-encoded-array>
	Definition: a phandle reference to a syscon representing TCSR followed
		    by the offset within syscon for Hexagon halt register.

- memory-region:
	Usage: required
	Value type: <phandle>
	Definition: reference to the reserved-memory for the firmware

- qcom,smem-states:
	Usage: required
	Value type: <phandle>
	Definition: reference to the smem state for requesting the Hexagon to
		    shut down

- qcom,smem-state-names:
	Usage: required
	Value type: <stringlist>
	Definition: must be "stop"


= SUBNODES
The adsp node may have an subnode named "glink-edge" that describes the
communication edge, channels and devices related to the Hexagon.
See ../soc/qcom/qcom,glink.txt for details on how to describe these.

= EXAMPLE
The following example describes the resources needed to boot control the
ADSP, as it is found on SDM845 boards.

	remoteproc@17300000 {
		compatible = "qcom,sdm845-adsp-pil";
		reg = <0x17300000 0x40c>;

		interrupts-extended = <&intc GIC_SPI 162 IRQ_TYPE_EDGE_RISING>,
			<&adsp_smp2p_in 0 IRQ_TYPE_EDGE_RISING>,
			<&adsp_smp2p_in 1 IRQ_TYPE_EDGE_RISING>,
			<&adsp_smp2p_in 2 IRQ_TYPE_EDGE_RISING>,
			<&adsp_smp2p_in 3 IRQ_TYPE_EDGE_RISING>;
		interrupt-names = "wdog", "fatal", "ready",
			"handover", "stop-ack";

		clocks = <&rpmhcc RPMH_CXO_CLK>,
			<&gcc GCC_LPASS_SWAY_CLK>,
			<&lpasscc LPASS_Q6SS_AHBS_AON_CLK>,
			<&lpasscc LPASS_Q6SS_AHBM_AON_CLK>,
			<&lpasscc LPASS_QDSP6SS_XO_CLK>,
			<&lpasscc LPASS_QDSP6SS_SLEEP_CLK>,
			<&lpasscc LPASS_QDSP6SS_CORE_CLK>;
		clock-names = "xo", "sway_cbcr",
			"lpass_ahbs_aon_cbcr",
			"lpass_ahbm_aon_cbcr", "qdsp6ss_xo",
			"qdsp6ss_sleep", "qdsp6ss_core";

		power-domains = <&rpmhpd SDM845_CX>;

		resets = <&pdc_reset PDC_AUDIO_SYNC_RESET>,
			 <&aoss_reset AOSS_CC_LPASS_RESTART>;
		reset-names = "pdc_sync", "cc_lpass";

		qcom,halt-regs = <&tcsr_mutex_regs 0x22000>;

		memory-region = <&pil_adsp_mem>;

		qcom,smem-states = <&adsp_smp2p_out 0>;
		qcom,smem-state-names = "stop";
	};
```

## Documentation/devicetree/bindings/remoteproc/qcom,kaanapali-soccp-pas.yaml
```yaml
# SPDX-License-Identifier: GPL-2.0 OR BSD-2-Clause
%YAML 1.2
---
$id: http://devicetree.org/schemas/remoteproc/qcom,kaanapali-soccp-pas.yaml#
$schema: http://devicetree.org/meta-schemas/core.yaml#

title: Qualcomm Kaanapali SoCCP Peripheral Authentication Service

maintainers:
  - Jingyi Wang <jingyi.wang@oss.qualcomm.com>

description:
  The SoC Control Processor (SoCCP) is a small RISC-V MCU that controls USB
  Type-C, battery charging and various other functions on Qualcomm SoCs, somewhat
  analogous to traditional PC Embedded Controllers. This document describes
  the Peripheral Authentication Service that loads and boots firmware for SoCCP.

properties:
  compatible:
    oneOf:
      - items:
          - enum:
              - qcom,hawi-soccp-pas
              - qcom,maili-soccp-pas
          - const: qcom,kaanapali-soccp-pas
      - enum:
          - qcom,glymur-soccp-pas
          - qcom,kaanapali-soccp-pas

  reg:
    maxItems: 1

  clocks:
    items:
      - description: XO clock

  clock-names:
    items:
      - const: xo

  power-domains:
    items:
      - description: CX power domain
      - description: MX power domain

  power-domain-names:
    items:
      - const: cx
      - const: mx

  firmware-name:
    items:
      - description: Firmware name of the SoC Control Processor
      - description: Firmware name of the SoCCP Devicetree

  memory-region:
    items:
      - description: Memory region for main Firmware authentication
      - description: Memory region for Devicetree Firmware authentication

  interrupts:
    items:
      - description: Watchdog interrupt
      - description: Fatal interrupt
      - description: Ready interrupt
      - description: Handover interrupt
      - description: Stop acknowledge interrupt
      - description: Pong interrupt

  interrupt-names:
    items:
      - const: wdog
      - const: fatal
      - const: ready
      - const: handover
      - const: stop-ack
      - const: pong

  qcom,smem-states:
    minItems: 2
    description: States used by the AP to signal the SoC Control Processor

  qcom,smem-state-names:
    minItems: 2
    description: The names of the state bits used for SMP2P output

required:
  - compatible
  - reg
  - memory-region
  - power-domains
  - power-domain-names

allOf:
  - $ref: /schemas/remoteproc/qcom,pas-common.yaml#

unevaluatedProperties: false

examples:
  - |
    #include <dt-bindings/clock/qcom,rpmh.h>
    #include <dt-bindings/interrupt-controller/arm-gic.h>
    #include <dt-bindings/interrupt-controller/irq.h>
    #include <dt-bindings/mailbox/qcom-ipcc.h>
    #include <dt-bindings/power/qcom-rpmpd.h>
    #define IPCC_MPROC_SOCCP

    remoteproc@d00000 {
        compatible = "qcom,kaanapali-soccp-pas";
        reg = <0x00d00000 0x200000>;

        clocks = <&rpmhcc RPMH_CXO_CLK>;
        clock-names = "xo";

        interrupts-extended = <&intc GIC_SPI 167 IRQ_TYPE_EDGE_RISING>,
                              <&soccp_smp2p_in 0 IRQ_TYPE_EDGE_RISING>,
                              <&soccp_smp2p_in 1 IRQ_TYPE_EDGE_RISING>,
                              <&soccp_smp2p_in 2 IRQ_TYPE_EDGE_RISING>,
                              <&soccp_smp2p_in 3 IRQ_TYPE_EDGE_RISING>,
                              <&soccp_smp2p_in 9 IRQ_TYPE_EDGE_RISING>;
        interrupt-names = "wdog",
                          "fatal",
                          "ready",
                          "handover",
                          "stop-ack",
                          "pong";

        memory-region = <&soccp_mem>,
                        <&soccp_dtb_mem_mem>;

        firmware-name = "qcom/kaanapali/soccp.mbn",
                        "qcom/kaanapali/soccp_dtb.mbn";

        power-domains = <&rpmhpd RPMHPD_CX>,
                        <&rpmhpd RPMHPD_MX>;
        power-domain-names = "cx",
                             "mx";

        qcom,smem-states = <&soccp_smp2p_out 0>,
                           <&soccp_smp2p_out 8>;
        qcom,smem-state-names = "stop",
                                "ping";

        glink-edge {
            interrupts-extended = <&ipcc IPCC_MPROC_SOCCP
                                         IPCC_MPROC_SIGNAL_GLINK_QMP
                                         IRQ_TYPE_EDGE_RISING>;
            mboxes = <&ipcc IPCC_MPROC_SOCCP
                            IPCC_MPROC_SIGNAL_GLINK_QMP>;

            label = "soccp";
            qcom,remote-pid = <19>;

            /* ... */
        };
    };
```

## Documentation/devicetree/bindings/remoteproc/qcom,milos-pas.yaml
```yaml
# SPDX-License-Identifier: GPL-2.0 OR BSD-2-Clause
%YAML 1.2
---
$id: http://devicetree.org/schemas/remoteproc/qcom,milos-pas.yaml#
$schema: http://devicetree.org/meta-schemas/core.yaml#

title: Qualcomm Milos SoC Peripheral Authentication Service

maintainers:
  - Luca Weiss <luca.weiss@fairphone.com>

description:
  Qualcomm Milos SoC Peripheral Authentication Service loads and boots firmware
  on the Qualcomm DSP Hexagon cores.

properties:
  compatible:
    enum:
      - qcom,milos-adsp-pas
      - qcom,milos-cdsp-pas
      - qcom,milos-mpss-pas
      - qcom,milos-wpss-pas

  reg:
    maxItems: 1

  clocks:
    items:
      - description: XO clock

  clock-names:
    items:
      - const: xo

  interrupts:
    minItems: 6
    maxItems: 6

  interrupt-names:
    minItems: 6
    maxItems: 6

  qcom,qmp:
    $ref: /schemas/types.yaml#/definitions/phandle
    description: Reference to the AOSS side-channel message RAM.

  smd-edge: false

  firmware-name:
    minItems: 1
    items:
      - description: Firmware name of the Hexagon core
      - description: Firmware name of the Hexagon Devicetree

  memory-region:
    minItems: 1
    items:
      - description: Memory region for core Firmware authentication
      - description: Memory region for Devicetree Firmware authentication

required:
  - compatible
  - reg
  - memory-region

allOf:
  - $ref: /schemas/remoteproc/qcom,pas-common.yaml#
  - if:
      properties:
        compatible:
          enum:
            - qcom,milos-adsp-pas
            - qcom,milos-cdsp-pas
    then:
      properties:
        memory-region:
          minItems: 2
        firmware-name:
          minItems: 2
    else:
      properties:
        memory-region:
          maxItems: 1
        firmware-name:
          maxItems: 1

  - if:
      properties:
        compatible:
          contains:
            enum:
              - qcom,milos-adsp-pas
    then:
      properties:
        power-domains:
          items:
            - description: LCX power domain
            - description: LMX power domain
        power-domain-names:
          items:
            - const: lcx
            - const: lmx

  - if:
      properties:
        compatible:
          enum:
            - qcom,milos-cdsp-pas
            - qcom,milos-wpss-pas
    then:
      properties:
        power-domains:
          items:
            - description: CX power domain
            - description: MX power domain
        power-domain-names:
          items:
            - const: cx
            - const: mx

  - if:
      properties:
        compatible:
          enum:
            - qcom,milos-mpss-pas
    then:
      properties:
        power-domains:
          items:
            - description: CX power domain
            - description: MSS power domain
        power-domain-names:
          items:
            - const: cx
            - const: mss

unevaluatedProperties: false

examples:
  - |
    #include <dt-bindings/clock/qcom,rpmh.h>
    #include <dt-bindings/interconnect/qcom,icc.h>
    #include <dt-bindings/interconnect/qcom,milos-rpmh.h>
    #include <dt-bindings/interrupt-controller/irq.h>
    #include <dt-bindings/mailbox/qcom-ipcc.h>
    #include <dt-bindings/power/qcom,rpmhpd.h>

    remoteproc@3000000 {
        compatible = "qcom,milos-adsp-pas";
        reg = <0x03000000 0x10000>;

        interrupts-extended = <&pdc 6 IRQ_TYPE_EDGE_RISING>,
                              <&smp2p_adsp_in 0 IRQ_TYPE_EDGE_RISING>,
                              <&smp2p_adsp_in 1 IRQ_TYPE_EDGE_RISING>,
                              <&smp2p_adsp_in 2 IRQ_TYPE_EDGE_RISING>,
                              <&smp2p_adsp_in 3 IRQ_TYPE_EDGE_RISING>,
                              <&smp2p_adsp_in 7 IRQ_TYPE_EDGE_RISING>;
        interrupt-names = "wdog",
                          "fatal",
                          "ready",
                          "handover",
                          "stop-ack",
                          "shutdown-ack";

        clocks = <&rpmhcc RPMH_CXO_CLK>;
        clock-names = "xo";

        power-domains = <&rpmhpd RPMHPD_LCX>,
                        <&rpmhpd RPMHPD_LMX>;
        power-domain-names = "lcx",
                             "lmx";

        interconnects = <&lpass_ag_noc MASTER_LPASS_PROC QCOM_ICC_TAG_ALWAYS
                         &mc_virt SLAVE_EBI1 QCOM_ICC_TAG_ALWAYS>;

        memory-region = <&adspslpi_mem>, <&q6_adsp_dtb_mem>;

        firmware-name = "qcom/milos/vendor/device/adsp.mbn",
                        "qcom/milos/vendor/device/adsp_dtb.mbn";

        qcom,qmp = <&aoss_qmp>;

        qcom,smem-states = <&smp2p_adsp_out 0>;
        qcom,smem-state-names = "stop";

        glink-edge {
            interrupts-extended = <&ipcc IPCC_CLIENT_LPASS
                                         IPCC_MPROC_SIGNAL_GLINK_QMP
                                         IRQ_TYPE_EDGE_RISING>;
            mboxes = <&ipcc IPCC_CLIENT_LPASS
                            IPCC_MPROC_SIGNAL_GLINK_QMP>;

            label = "lpass";
            qcom,remote-pid = <2>;

            /* ... */
        };
    };
```
