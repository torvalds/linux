## Documentation/devicetree/bindings/remoteproc/st-rproc.txt
```
STMicroelectronics Co-Processor Bindings
----------------------------------------

This binding provides support for adjunct processors found on ST SoCs.

Co-processors can be controlled from the bootloader or the primary OS. If
the bootloader starts a co-processor, the primary OS must detect its state
and act accordingly.

Required properties:
- compatible		Should be one of:
				"st,st231-rproc"
				"st,st40-rproc"
- memory-region		Reserved memory (See: ../reserved-memory/reserved-memory.txt)
- resets		Reset lines (See: ../reset/reset.txt)
- reset-names		Must be "sw_reset" and "pwr_reset"
- clocks		Clock for co-processor (See: ../clock/clock-bindings.txt)
- clock-frequency	Clock frequency to set co-processor at if the bootloader
			hasn't already done so
- st,syscfg		System configuration register which holds the boot vector
			for the co-processor
				1st cell: Phandle to syscon block
				2nd cell: Boot vector register offset

Example:

	audio_reserved: rproc@42000000 {
		compatible = "shared-dma-pool";
		reg = <0x42000000 0x01000000>;
		no-map;
	};

	st231-audio {
		compatible	= "st,st231-rproc";
		memory-region	= <&audio_reserved>;
		resets		= <&softreset STIH407_ST231_AUD_SOFTRESET>;
		reset-names	= "sw_reset";
		clocks		= <&clk_s_c0_flexgen CLK_ST231_AUD_0>;
		clock-frequency	= <600000000>;
		st,syscfg	= <&syscfg_core 0x228>;
	};
```

## Documentation/devicetree/bindings/remoteproc/stm32-rproc.txt
```
STMicroelectronics STM32 Remoteproc
-----------------------------------
This document defines the binding for the remoteproc component that loads and
boots firmwares on the ST32MP family chipset.

Required properties:
- compatible:	Must be "st,stm32mp1-m4"
- reg:		Address ranges of the RETRAM and MCU SRAM memories used by the
		remote processor.
- resets:	Reference to a reset controller asserting the remote processor.
- st,syscfg-holdboot: Reference to the system configuration which holds the
		remote processor reset hold boot
	1st cell: phandle of syscon block
	2nd cell: register offset containing the hold boot setting
	3rd cell: register bitmask for the hold boot field
- st,syscfg-tz: Reference to the system configuration which holds the RCC trust
		zone mode
	1st cell: phandle to syscon block
	2nd cell: register offset containing the RCC trust zone mode setting
	3rd cell: register bitmask for the RCC trust zone mode bit

Optional properties:
- interrupts:	Should contain the watchdog interrupt
- mboxes:	This property is required only if the rpmsg/virtio functionality
		is used. List of phandle and mailbox channel specifiers:
		- a channel (a) used to communicate through virtqueues with the
		  remote proc.
		  Bi-directional channel:
		      - from local to remote = send message
		      - from remote to local = send message ack
		- a channel (b) working the opposite direction of channel (a)
		- a channel (c) used by the local proc to notify the remote proc
		  that it is about to be shut down.
		  Unidirectional channel:
		      - from local to remote, where ACK from the remote means
		        that it is ready for shutdown
- mbox-names:	This property is required if the mboxes property is used.
		- must be "vq0" for channel (a)
		- must be "vq1" for channel (b)
		- must be "shutdown" for channel (c)
- memory-region: List of phandles to the reserved memory regions associated with
		the remoteproc device. This is variable and describes the
		memories shared with the remote processor (eg: remoteproc
		firmware and carveouts, rpmsg vrings, ...).
		(see ../reserved-memory/reserved-memory.txt)
- st,syscfg-pdds: Reference to the system configuration which holds the remote
		processor deep sleep setting
	1st cell: phandle to syscon block
	2nd cell: register offset containing the deep sleep setting
	3rd cell: register bitmask for the deep sleep bit
- st,auto-boot:	If defined, when remoteproc is probed, it loads the default
		firmware and starts the remote processor.

Example:
	m4_rproc: m4@10000000 {
		compatible = "st,stm32mp1-m4";
		reg = <0x10000000 0x40000>,
		      <0x30000000 0x40000>,
		      <0x38000000 0x10000>;
		resets = <&rcc MCU_R>;
		st,syscfg-holdboot = <&rcc 0x10C 0x1>;
		st,syscfg-tz = <&rcc 0x000 0x1>;
	};
```

## Documentation/devicetree/bindings/remoteproc/ti,davinci-rproc.txt
```
TI Davinci DSP devices
=======================

Binding status: Unstable - Subject to changes for DT representation of clocks
			   and resets

The TI Davinci family of SoCs usually contains a TI DSP Core sub-system that
is used to offload some of the processor-intensive tasks or algorithms, for
achieving various system level goals.

The processor cores in the sub-system usually contain additional sub-modules
like L1 and/or L2 caches/SRAMs, an Interrupt Controller, an external memory
controller, a dedicated local power/sleep controller etc. The DSP processor
core used in Davinci SoCs is usually a C674x DSP CPU.

DSP Device Node:
================
Each DSP Core sub-system is represented as a single DT node.

Required properties:
--------------------
The following are the mandatory properties:

- compatible:		Should be one of the following,
			    "ti,da850-dsp" for DSPs on OMAP-L138 SoCs

- reg:			Should contain an entry for each value in 'reg-names'.
			Each entry should have the memory region's start address
			and the size of the region, the representation matching
			the parent node's '#address-cells' and '#size-cells' values.

- reg-names:		Should contain strings with the following names, each
			representing a specific internal memory region or a
			specific register space,
			     "l2sram", "l1pram", "l1dram", "host1cfg", "chipsig_base"

- interrupts: 		Should contain the interrupt number used to receive the
			interrupts from the DSP. The value should follow the
			interrupt-specifier format as dictated by the
			'interrupt-parent' node.

- memory-region:	phandle to the reserved memory node to be associated
			with the remoteproc device. The reserved memory node
			can be a CMA memory node, and should be defined as
			per the bindings in
			Documentation/devicetree/bindings/reserved-memory/reserved-memory.txt


Example:
--------

	/* DSP Reserved Memory node */
	reserved-memory {
		#address-cells = <1>;
		#size-cells = <1>;
		ranges;

		dsp_memory_region: dsp-memory@c3000000 {
			compatible = "shared-dma-pool";
			reg = <0xc3000000 0x1000000>;
			reusable;
		};
	};

	/* DSP node */
	{
		dsp: dsp@11800000 {
			compatible = "ti,da850-dsp";
			reg = <0x11800000 0x40000>,
			      <0x11e00000 0x8000>,
			      <0x11f00000 0x8000>,
			      <0x01c14044 0x4>,
			      <0x01c14174 0x8>;
			reg-names = "l2sram", "l1pram", "l1dram", "host1cfg",
				    "chipsig";
			interrupt-parent = <&intc>;
			interrupts = <28>;
			memory-region = <&dsp_memory_region>;
		};
	};
```

## Documentation/devicetree/bindings/remoteproc/ti,hsm-m4fss.yaml
```yaml
# SPDX-License-Identifier: (GPL-2.0-only OR BSD-2-Clause)
%YAML 1.2
---
$id: http://devicetree.org/schemas/remoteproc/ti,hsm-m4fss.yaml#
$schema: http://devicetree.org/meta-schemas/core.yaml#

title: TI K3 HSM M4F processor subsystems

maintainers:
  - Beleswar Padhi <b-padhi@ti.com>

description: |
  Some K3 family SoCs have a HSM (High Security Module) M4F core in the
  Wakeup Voltage Domain which could be used to run secure services like
  Authentication. Some of those are J721S2, J784S4, J722S, AM62X.

$ref: /schemas/arm/keystone/ti,k3-sci-common.yaml#

properties:
  compatible:
    enum:
      - ti,hsm-m4fss

  reg:
    items:
      - description: SRAM0_0 internal memory region
      - description: SRAM0_1 internal memory region
      - description: SRAM1 internal memory region

  reg-names:
    items:
      - const: sram0_0
      - const: sram0_1
      - const: sram1

  resets:
    maxItems: 1

  firmware-name:
    maxItems: 1

required:
  - compatible
  - reg
  - reg-names
  - resets
  - firmware-name
  - ti,sci
  - ti,sci-dev-id
  - ti,sci-proc-ids

unevaluatedProperties: false

examples:
  - |
    soc {
        #address-cells = <2>;
        #size-cells = <2>;

        remoteproc@43c00000 {
            compatible = "ti,hsm-m4fss";
            reg = <0x00 0x43c00000 0x00 0x20000>,
                  <0x00 0x43c20000 0x00 0x10000>,
                  <0x00 0x43c30000 0x00 0x10000>;
            reg-names = "sram0_0", "sram0_1", "sram1";
            resets = <&k3_reset 225 1>;
            firmware-name = "hsm.bin";
            ti,sci = <&sms>;
            ti,sci-dev-id = <225>;
            ti,sci-proc-ids = <0x80 0xff>;
        };
    };
```

## Documentation/devicetree/bindings/remoteproc/ti,k3-dsp-rproc.yaml
```yaml
# SPDX-License-Identifier: (GPL-2.0-only or BSD-2-Clause)
%YAML 1.2
---
$id: http://devicetree.org/schemas/remoteproc/ti,k3-dsp-rproc.yaml#
$schema: http://devicetree.org/meta-schemas/core.yaml#

title: TI K3 DSP devices

maintainers:
  - Suman Anna <s-anna@ti.com>

description: |
  The TI K3 family of SoCs usually have one or more TI DSP Core sub-systems
  that are used to offload some of the processor-intensive tasks or algorithms,
  for achieving various system level goals.

  These processor sub-systems usually contain additional sub-modules like
  L1 and/or L2 caches/SRAMs, an Interrupt Controller, an external memory
  controller, a dedicated local power/sleep controller etc. The DSP processor
  cores in the K3 SoCs are usually either a TMS320C66x CorePac processor or a
  TMS320C71x CorePac processor.

  Each DSP Core sub-system is represented as a single DT node. Each node has a
  number of required or optional properties that enable the OS running on the
  host processor (Arm CorePac) to perform the device management of the remote
  processor and to communicate with the remote processor.

allOf:
  - $ref: /schemas/arm/keystone/ti,k3-sci-common.yaml#

properties:
  compatible:
    enum:
      - ti,j721e-c66-dsp
      - ti,j721e-c71-dsp
    description:
      Use "ti,j721e-c66-dsp" for C66x DSPs on K3 J721E SoCs
      Use "ti,j721e-c71-dsp" for C71x DSPs on K3 J721E SoCs

  resets:
    description: |
      Should contain the phandle to the reset controller node managing the
      local resets for this device, and a reset specifier.
    maxItems: 1

  firmware-name:
    description: |
      Should contain the name of the default firmware image
      file located on the firmware search path

  mboxes:
    description: |
      OMAP Mailbox specifier denoting the sub-mailbox, to be used for
      communication with the remote processor. This property should match
      with the sub-mailbox node used in the firmware image.
    maxItems: 1

  memory-region:
    minItems: 2
    maxItems: 8
    description: |
      phandle to the reserved memory nodes to be associated with the remoteproc
      device. There should be at least two reserved memory nodes defined. The
      reserved memory nodes should be carveout nodes, and should be defined as
      per the bindings in
      Documentation/devicetree/bindings/reserved-memory/reserved-memory.txt
    items:
      - description: region used for dynamic DMA allocations like vrings and
                     vring buffers
      - description: region reserved for firmware image sections
    additionalItems: true

# Optional properties:
# --------------------

  sram:
    $ref: /schemas/types.yaml#/definitions/phandle-array
    minItems: 1
    maxItems: 4
    description: |
      phandles to one or more reserved on-chip SRAM regions. The regions
      should be defined as child nodes of the respective SRAM node, and
      should be defined as per the generic bindings in,
      Documentation/devicetree/bindings/sram/sram.yaml

if:
  properties:
    compatible:
      enum:
        - ti,j721e-c66-dsp
then:
  properties:
    reg:
      items:
        - description: Address and Size of the L2 SRAM internal memory region
        - description: Address and Size of the L1 PRAM internal memory region
        - description: Address and Size of the L1 DRAM internal memory region
    reg-names:
      items:
        - const: l2sram
        - const: l1pram
        - const: l1dram
else:
  if:
    properties:
      compatible:
        enum:
          - ti,j721e-c71-dsp
  then:
    properties:
      reg:
        items:
          - description: Address and Size of the L2 SRAM internal memory region
          - description: Address and Size of the L1 DRAM internal memory region
      reg-names:
        items:
          - const: l2sram
          - const: l1dram

required:
  - compatible
  - reg
  - reg-names
  - ti,sci
  - ti,sci-dev-id
  - ti,sci-proc-ids
  - resets
  - firmware-name
  - mboxes
  - memory-region

unevaluatedProperties: false

examples:
  - |
    / {
        model = "Texas Instruments K3 J721E SoC";
        compatible = "ti,j721e";
        #address-cells = <2>;
        #size-cells = <2>;

        bus@100000 {
            compatible = "simple-bus";
            #address-cells = <2>;
            #size-cells = <2>;
            ranges = <0x00 0x00100000 0x00 0x00100000 0x00 0x00020000>, /* ctrl mmr */
                     <0x00 0x64800000 0x00 0x64800000 0x00 0x00800000>, /* C71_0 */
                     <0x4d 0x80800000 0x4d 0x80800000 0x00 0x00800000>, /* C66_0 */
                     <0x4d 0x81800000 0x4d 0x81800000 0x00 0x00800000>; /* C66_1 */

            /* J721E C66_0 DSP node */
            dsp@4d80800000 {
                compatible = "ti,j721e-c66-dsp";
                reg = <0x4d 0x80800000 0x00 0x00048000>,
                      <0x4d 0x80e00000 0x00 0x00008000>,
                      <0x4d 0x80f00000 0x00 0x00008000>;
                reg-names = "l2sram", "l1pram", "l1dram";
                ti,sci = <&dmsc>;
                ti,sci-dev-id = <142>;
                ti,sci-proc-ids = <0x03 0xFF>;
                resets = <&k3_reset 142 1>;
                firmware-name = "j7-c66_0-fw";
                memory-region = <&c66_0_dma_memory_region>,
                                <&c66_0_memory_region>;
                mboxes = <&mailbox0_cluster3 &mbox_c66_0>;
            };

            /* J721E C71_0 DSP node */
            c71_0: dsp@64800000 {
                compatible = "ti,j721e-c71-dsp";
                reg = <0x00 0x64800000 0x00 0x00080000>,
                      <0x00 0x64e00000 0x00 0x0000c000>;
                reg-names = "l2sram", "l1dram";
                ti,sci = <&dmsc>;
                ti,sci-dev-id = <15>;
                ti,sci-proc-ids = <0x30 0xFF>;
                resets = <&k3_reset 15 1>;
                firmware-name = "j7-c71_0-fw";
                memory-region = <&c71_0_dma_memory_region>,
                                <&c71_0_memory_region>;
                mboxes = <&mailbox0_cluster4 &mbox_c71_0>;
            };
        };
    };
```
