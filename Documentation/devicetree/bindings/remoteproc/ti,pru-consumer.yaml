## Documentation/devicetree/bindings/reserved-memory/ramoops.yaml
```yaml
# SPDX-License-Identifier: (GPL-2.0 OR BSD-2-Clause)
%YAML 1.2
---
$id: http://devicetree.org/schemas/reserved-memory/ramoops.yaml#
$schema: http://devicetree.org/meta-schemas/core.yaml#

title: Ramoops oops/panic logger

description: |
  ramoops provides persistent RAM storage for oops and panics, so they can be
  recovered after a reboot. This is a child-node of "/reserved-memory", and
  is named "ramoops" after the backend, rather than "pstore" which is the
  subsystem.

  Parts of this storage may be set aside for other persistent log buffers, such
  as kernel log messages, or for optional ECC error-correction data.  The total
  size of these optional buffers must fit in the reserved region.

  Any remaining space will be used for a circular buffer of oops and panic
  records.  These records have a configurable size, with a size of 0 indicating
  that they should be disabled.

  At least one of "record-size", "console-size", "ftrace-size", or "pmsg-size"
  must be set non-zero, but are otherwise optional as listed below.

maintainers:
  - Kees Cook <keescook@chromium.org>

allOf:
  - $ref: reserved-memory.yaml

properties:
  compatible:
    const: ramoops

  reg:
    description: region of memory that is preserved between reboots

  ecc-size:
    $ref: /schemas/types.yaml#/definitions/uint32
    description: enables ECC support and specifies ECC buffer size in bytes
    default: 0 # no ECC

  record-size:
    $ref: /schemas/types.yaml#/definitions/uint32
    description: maximum size in bytes of each kmsg dump
    default: 0

  console-size:
    $ref: /schemas/types.yaml#/definitions/uint32
    description: size in bytes of log buffer reserved for kernel messages
    default: 0

  ftrace-size:
    $ref: /schemas/types.yaml#/definitions/uint32
    description: size in bytes of log buffer reserved for function tracing and profiling
    default: 0

  pmsg-size:
    $ref: /schemas/types.yaml#/definitions/uint32
    description: size in bytes of log buffer reserved for userspace messages
    default: 0

  mem-type:
    $ref: /schemas/types.yaml#/definitions/uint32
    description: if present, sets the type of mapping is to be used to map the reserved region.
    default: 0
    oneOf:
      - const: 0
        description: write-combined
      - const: 1
        description: unbuffered
      - const: 2
        description: cached

  max-reason:
    $ref: /schemas/types.yaml#/definitions/uint32
    default: 2 # log oopses and panics
    maximum: 0x7fffffff
    description: |
      If present, sets maximum type of kmsg dump reasons to store.
      This can be set to INT_MAX to store all kmsg dumps.
      See include/linux/kmsg_dump.h KMSG_DUMP_* for other kmsg dump reason values.
      Setting this to 0 (KMSG_DUMP_UNDEF), means the reason filtering will be
      controlled by the printk.always_kmsg_dump boot param.
      If unset, it will be 2 (KMSG_DUMP_OOPS), otherwise 5 (KMSG_DUMP_MAX).

  flags:
    $ref: /schemas/types.yaml#/definitions/uint32
    default: 0
    description: |
      If present, pass ramoops behavioral flags
      (see include/linux/pstore_ram.h RAMOOPS_FLAG_* for flag values).

  no-dump-oops:
    deprecated: true
    type: boolean
    description: |
      Use max_reason instead. If present, and max_reason is not specified,
      it is equivalent to max_reason = 1 (KMSG_DUMP_PANIC).

  unbuffered:
    deprecated: true
    type: boolean
    description: |
      Use mem_type instead. If present, and mem_type is not specified,
      it is equivalent to mem_type = 1 and uses unbuffered mappings to map
      the reserved region (defaults to buffered mappings mem_type = 0).
      If both are specified -- "mem_type" overrides "unbuffered".

unevaluatedProperties: false

required:
  - compatible
  - reg

anyOf:
  - required: [record-size]
  - required: [console-size]
  - required: [ftrace-size]
  - required: [pmsg-size]

examples:
  - |
    / {
        compatible = "foo";
        model = "foo";
        #address-cells = <1>;
        #size-cells = <1>;

        reserved-memory {
            #address-cells = <1>;
            #size-cells = <1>;
            ranges;

            ramoops@bfdf0000 {
                compatible = "ramoops";
                reg = <0xbfdf0000 0x10000>; /* 64kB */
                console-size = <0x8000>;    /* 32kB */
                record-size = <0x400>;      /*  1kB */
                ecc-size = <16>;
            };
        };
    };
```

## Documentation/devicetree/bindings/reserved-memory/reserved-memory.yaml
```yaml
# SPDX-License-Identifier: (GPL-2.0 OR BSD-2-Clause)
%YAML 1.2
---
$id: http://devicetree.org/schemas/reserved-memory/reserved-memory.yaml#
$schema: http://devicetree.org/meta-schemas/core.yaml#

title: /reserved-memory Child Node Common

maintainers:
  - devicetree-spec@vger.kernel.org

description: >
  Reserved memory is specified as a node under the /reserved-memory node. The
  operating system shall exclude reserved memory from normal usage one can
  create child nodes describing particular reserved (excluded from normal use)
  memory regions. Such memory regions are usually designed for the special
  usage by various device drivers.

  Each child of the reserved-memory node specifies one or more regions
  of reserved memory. Each child node may either use a 'reg' property to
  specify a specific range of reserved memory, or a 'size' property with
  optional constraints to request a dynamically allocated block of
  memory.

  Following the generic-names recommended practice, node names should
  reflect the purpose of the node (ie. "framebuffer" or "dma-pool").
  Unit address (@<address>) should be appended to the name if the node
  is a static allocation.

properties:
  reg: true

  size:
    oneOf:
      - $ref: /schemas/types.yaml#/definitions/uint32
      - $ref: /schemas/types.yaml#/definitions/uint64
    description: >
      Length based on parent's \#size-cells. Size in bytes of memory to
      reserve.

  alignment:
    oneOf:
      - $ref: /schemas/types.yaml#/definitions/uint32
      - $ref: /schemas/types.yaml#/definitions/uint64
    description: >
      Length based on parent's \#size-cells. Address boundary for
      alignment of allocation.

  alloc-ranges:
    $ref: /schemas/types.yaml#/definitions/uint32-array
    description: >
      Address and Length pairs. Specifies regions of memory that are
      acceptable to allocate from.

  iommu-addresses:
    $ref: /schemas/types.yaml#/definitions/phandle-array
    description: >
      A list of phandle and specifier pairs that describe static IO virtual
      address space mappings and carveouts associated with a given reserved
      memory region. The phandle in the first cell refers to the device for
      which the mapping or carveout is to be created.

      The specifier consists of an address/size pair and denotes the IO
      virtual address range of the region for the given device. The exact
      format depends on the values of the "#address-cells" and "#size-cells"
      properties of the device referenced via the phandle.

      When used in combination with a "reg" property, an IOVA mapping is to
      be established for this memory region. One example where this can be
      useful is to create an identity mapping for physical memory that the
      firmware has configured some hardware to access (such as a bootsplash
      framebuffer).

      If no "reg" property is specified, the "iommu-addresses" property
      defines carveout regions in the IOVA space for the given device. This
      can be useful if a certain memory region should not be mapped through
      the IOMMU.

  no-map:
    type: boolean
    description: >
      Indicates the operating system must not create a virtual mapping
      of the region as part of its standard mapping of system memory,
      nor permit speculative access to it under any circumstances other
      than under the control of the device driver using the region.

  reusable:
    type: boolean
    description: >
      The operating system can use the memory in this region with the
      limitation that the device driver(s) owning the region need to be
      able to reclaim it back. Typically that means that the operating
      system can use that region to store volatile or cached data that
      can be otherwise regenerated or migrated elsewhere.

allOf:
  - if:
      required:
        - no-map

    then:
      not:
        required:
          - reusable

  - if:
      required:
        - reusable

    then:
      not:
        required:
          - no-map

oneOf:
  - oneOf:
      - required:
          - reg

      - required:
          - size

  - oneOf:
      # IOMMU reservations
      - required:
          - iommu-addresses

      # IOMMU mappings
      - required:
          - reg
          - iommu-addresses

additionalProperties: true

examples:
  - |
    / {
      compatible = "foo";
      model = "foo";

      #address-cells = <2>;
      #size-cells = <2>;

      reserved-memory {
        #address-cells = <2>;
        #size-cells = <2>;
        ranges;

        adsp_resv: reservation-adsp {
          /*
           * Restrict IOVA mappings for ADSP buffers to the 512 MiB region
           * from 0x40000000 - 0x5fffffff. Anything outside is reserved by
           * the ADSP for I/O memory and private memory allocations.
           */
          iommu-addresses = <&adsp 0x0 0x00000000 0x00 0x40000000>,
                            <&adsp 0x0 0x60000000 0xff 0xa0000000>;
        };

        fb: framebuffer@90000000 {
          reg = <0x0 0x90000000 0x0 0x00800000>;
          iommu-addresses = <&dc0 0x0 0x90000000 0x0 0x00800000>;
        };
      };

      bus@0 {
        #address-cells = <1>;
        #size-cells = <1>;
        ranges = <0x0 0x0 0x0 0x40000000>;

        adsp: adsp@2990000 {
          reg = <0x2990000 0x2000>;
          memory-region = <&adsp_resv>;
        };

        dc0: display@15200000 {
          reg = <0x15200000 0x10000>;
          memory-region = <&fb>;
        };
      };
    };
...
```

## Documentation/devicetree/bindings/reserved-memory/shared-dma-pool.yaml
```yaml
# SPDX-License-Identifier: (GPL-2.0 OR BSD-2-Clause)
%YAML 1.2
---
$id: http://devicetree.org/schemas/reserved-memory/shared-dma-pool.yaml#
$schema: http://devicetree.org/meta-schemas/core.yaml#

title: /reserved-memory DMA pool

maintainers:
  - devicetree-spec@vger.kernel.org

allOf:
  - $ref: "reserved-memory.yaml"

properties:
  compatible:
    oneOf:
      - const: shared-dma-pool
        description: >
          This indicates a region of memory meant to be used as a shared
          pool of DMA buffers for a set of devices. It can be used by an
          operating system to instantiate the necessary pool management
          subsystem if necessary.

      - const: restricted-dma-pool
        description: >
          This indicates a region of memory meant to be used as a pool
          of restricted DMA buffers for a set of devices. The memory
          region would be the only region accessible to those devices.
          When using this, the no-map and reusable properties must not
          be set, so the operating system can create a virtual mapping
          that will be used for synchronization. The main purpose for
          restricted DMA is to mitigate the lack of DMA access control
          on systems without an IOMMU, which could result in the DMA
          accessing the system memory at unexpected times and/or
          unexpected addresses, possibly leading to data leakage or
          corruption. The feature on its own provides a basic level of
          protection against the DMA overwriting buffer contents at
          unexpected times. However, to protect against general data
          leakage and system memory corruption, the system needs to
          provide way to lock down the memory access, e.g., MPU. Note
          that since coherent allocation needs remapping, one must set
          up another device coherent pool by shared-dma-pool and use
          dma_alloc_from_dev_coherent instead for atomic coherent
          allocation.

  linux,cma-default:
    type: boolean
    description: >
      If this property is present, then Linux will use the region for
      the default pool of the contiguous memory allocator.

  linux,dma-default:
    type: boolean
    description: >
      If this property is present, then Linux will use the region for
      the default pool of the consistent DMA allocator.

if:
  properties:
    compatible:
      contains:
        const: restricted-dma-pool
then:
  properties:
    no-map: false
    reusable: false

unevaluatedProperties: false

examples:
  - |
      reserved-memory {
          #address-cells = <1>;
          #size-cells = <1>;
          ranges;

          /* global autoconfigured region for contiguous allocations */
          linux,cma {
              compatible = "shared-dma-pool";
              reusable;
              size = <0x4000000>;
              alignment = <0x2000>;
              linux,cma-default;
          };

          display_reserved: framebuffer@78000000 {
              reg = <0x78000000 0x800000>;
          };

          restricted_dma_reserved: restricted-dma-pool@50000000 {
              compatible = "restricted-dma-pool";
              reg = <0x50000000 0x4000000>;
          };
      };

...
```

## Documentation/devicetree/bindings/reserved-memory/xen,shared-memory.txt
```
* Xen hypervisor reserved-memory binding

Expose one or more memory regions as reserved-memory to the guest
virtual machine. Typically, a region is configured at VM creation time
to be a shared memory area across multiple virtual machines for
communication among them.

For each of these pre-shared memory regions, a range is exposed under
the /reserved-memory node as a child node. Each range sub-node is named
xen-shmem@<address> and has the following properties:

- compatible:
	compatible = "xen,shared-memory-v1"

- reg:
	the base guest physical address and size of the shared memory region

- xen,offset: (borrower VMs only)
	64 bit integer offset within the owner virtual machine's shared
	memory region used for the mapping in the borrower VM.

- xen,id:
	a string that identifies the shared memory region as specified in
	the VM config file
```

## Documentation/devicetree/bindings/reset/allwinner,sun6i-a31-clock-reset.yaml
```yaml
# SPDX-License-Identifier: GPL-2.0
%YAML 1.2
---
$id: http://devicetree.org/schemas/reset/allwinner,sun6i-a31-clock-reset.yaml#
$schema: http://devicetree.org/meta-schemas/core.yaml#

title: Allwinner A31 Peripheral Reset Controller Device Tree Bindings

maintainers:
  - Chen-Yu Tsai <wens@csie.org>
  - Maxime Ripard <mripard@kernel.org>

deprecated: true

select:
  properties:
    compatible:
      contains:
        enum:
          - allwinner,sun6i-a31-ahb1-reset
          - allwinner,sun6i-a31-clock-reset

  # The PRCM on the A31 and A23 will have the reg property missing,
  # since it's set at the upper level node, and will be validated by
  # PRCM's schema. Make sure we only validate standalone nodes.
  required:
    - compatible
    - reg

properties:
  "#reset-cells":
    const: 1
    description: >
      This additional argument passed to that reset controller is the
      offset of the bit controlling this particular reset line in the
      register.

  compatible:
    enum:
      - allwinner,sun6i-a31-ahb1-reset
      - allwinner,sun6i-a31-clock-reset

  reg:
    maxItems: 1

required:
  - "#reset-cells"
  - compatible
  - reg

additionalProperties: false

examples:
  - |
    ahb1_rst: reset@1c202c0 {
        #reset-cells = <1>;
        compatible = "allwinner,sun6i-a31-ahb1-reset";
        reg = <0x01c202c0 0xc>;
    };

  - |
    apbs_rst: reset@80014b0 {
        #reset-cells = <1>;
        compatible = "allwinner,sun6i-a31-clock-reset";
        reg = <0x080014b0 0x4>;
    };

...
```
