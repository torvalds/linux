## Documentation/devicetree/bindings/reserved-memory/intel,wakeup-mailbox.yaml
```yaml
# SPDX-License-Identifier: GPL-2.0-only OR BSD-2-Clause
%YAML 1.2
---
$id: http://devicetree.org/schemas/reserved-memory/intel,wakeup-mailbox.yaml#
$schema: http://devicetree.org/meta-schemas/core.yaml#

title: Wakeup Mailbox for Intel processors

description: |
  The Wakeup Mailbox provides a mechanism for the operating system to wake up
  secondary CPUs on Intel processors. It is an alternative to the INIT-!INIT-
  SIPI sequence used on most x86 systems.

  The structure and operation of the mailbox is described in the Multiprocessor
  Wakeup Structure of the ACPI specification version 6.6 section 5.2.12.19 [1].

  The implementation of the mailbox in platform firmware is described in the
  Intel TDX Virtual Firmware Design Guide section 4.3.5 [2].

  1: https://uefi.org/specs/ACPI/6.6/05_ACPI_Software_Programming_Model.html#multiprocessor-wakeup-structure
  2: https://www.intel.com/content/www/us/en/content-details/733585/intel-tdx-virtual-firmware-design-guide.html

maintainers:
  - Ricardo Neri <ricardo.neri-calderon@linux.intel.com>

allOf:
  - $ref: reserved-memory.yaml

properties:
  compatible:
    const: intel,wakeup-mailbox

required:
  - compatible
  - reg

unevaluatedProperties: false

examples:
  - |
    reserved-memory {
        #address-cells = <2>;
        #size-cells = <1>;

        wakeup-mailbox@ffff0000 {
            compatible = "intel,wakeup-mailbox";
            reg = <0x0 0xffff0000 0x1000>;
        };
    };
```

## Documentation/devicetree/bindings/reserved-memory/memory-region.yaml
```yaml
# SPDX-License-Identifier: (GPL-2.0 OR BSD-2-Clause)
%YAML 1.2
---
$id: http://devicetree.org/schemas/reserved-memory/memory-region.yaml#
$schema: http://devicetree.org/meta-schemas/core.yaml#

title: Reserved Memory Region

maintainers:
  - devicetree-spec@vger.kernel.org

description: |
  Regions in the /reserved-memory node may be referenced by other device
  nodes by adding a memory-region property to the device node.

select: true

properties:
  memory-region:
    $ref: /schemas/types.yaml#/definitions/phandle-array
    description: >
      Phandle to a /reserved-memory child node assigned to the device.

  memory-region-names:
    $ref: /schemas/types.yaml#/definitions/string-array
    description: >
      A list of names, one for each corresponding entry in the
      memory-region property

additionalProperties: true

examples:
  - |
    fb0: video@12300000 {
        /* ... */
        reg = <0x12300000 0x1000>;
        memory-region = <&display_reserved>;
    };

...
```

## Documentation/devicetree/bindings/reserved-memory/nvidia,tegra210-emc-table.yaml
```yaml
# SPDX-License-Identifier: (GPL-2.0 OR BSD-2-Clause)
%YAML 1.2
---
$id: http://devicetree.org/schemas/reserved-memory/nvidia,tegra210-emc-table.yaml#
$schema: http://devicetree.org/meta-schemas/core.yaml#

title: NVIDIA Tegra210 EMC Frequency Table

maintainers:
  - Thierry Reding <thierry.reding@gmail.com>
  - Jon Hunter <jonathanh@nvidia.com>

description: On Tegra210, firmware passes a binary representation of the
  EMC frequency table via a reserved memory region.

allOf:
  - $ref: reserved-memory.yaml

properties:
  compatible:
    const: nvidia,tegra210-emc-table

  reg:
    description: region of memory reserved by firmware to pass the EMC
      frequency table

unevaluatedProperties: false

required:
  - compatible
  - reg
```

## Documentation/devicetree/bindings/reserved-memory/nvidia,tegra264-bpmp-shmem.yaml
```yaml
# SPDX-License-Identifier: (GPL-2.0-only OR BSD-2-Clause)
%YAML 1.2
---
$id: http://devicetree.org/schemas/reserved-memory/nvidia,tegra264-bpmp-shmem.yaml#
$schema: http://devicetree.org/meta-schemas/core.yaml#

title: Tegra CPU-NS - BPMP IPC reserved memory

maintainers:
  - Peter De Schrijver <pdeschrijver@nvidia.com>

description: |
  Define a memory region used for communication between CPU-NS and BPMP.
  Typically this node is created by the bootloader as the physical address
  has to be known to both CPU-NS and BPMP for correct IPC operation.
  The memory region is defined using a child node under /reserved-memory.
  The sub-node is named shmem@<address>.

allOf:
  - $ref: reserved-memory.yaml

properties:
  compatible:
    const: nvidia,tegra264-bpmp-shmem

  reg:
    description: The physical address and size of the shared SDRAM region

unevaluatedProperties: false

required:
  - compatible
  - reg
  - no-map

examples:
  - |
    reserved-memory {
       #address-cells = <2>;
       #size-cells = <2>;
       dram_cpu_bpmp_mail: shmem@f1be0000 {
           compatible = "nvidia,tegra264-bpmp-shmem";
           reg = <0x0 0xf1be0000 0x0 0x2000>;
           no-map;
       };
    };
...
```

## Documentation/devicetree/bindings/reserved-memory/phram.yaml
```yaml
# SPDX-License-Identifier: GPL-2.0-only OR BSD-2-Clause
%YAML 1.2
---
$id: http://devicetree.org/schemas/reserved-memory/phram.yaml#
$schema: http://devicetree.org/meta-schemas/core.yaml#

title: MTD/block device in RAM

description: |
  Specifies that the reserved memory region can be used as an MTD or block
  device.

  The "phram" node is named after the "MTD in PHysical RAM" driver which
  provides an implementation of this functionality in Linux.

maintainers:
  - Vincent Whitchurch <vincent.whitchurch@axis.com>

allOf:
  - $ref: "reserved-memory.yaml"
  - $ref: "/schemas/mtd/mtd.yaml"

properties:
  compatible:
    const: phram

  reg:
    description: region of memory that can be used as an MTD/block device

required:
  - compatible
  - reg

unevaluatedProperties: false

examples:
  - |
    reserved-memory {
        #address-cells = <1>;
        #size-cells = <1>;

        phram: flash@12340000 {
            compatible = "phram";
            label = "rootfs";
            reg = <0x12340000 0x00800000>;
        };
    };
```

## Documentation/devicetree/bindings/reserved-memory/qcom,cmd-db.txt
```
Command DB
---------

Command DB is a database that provides a mapping between resource key and the
resource address for a system resource managed by a remote processor. The data
is stored in a shared memory region and is loaded by the remote processor.

Some of the Qualcomm Technologies Inc SoC's have hardware accelerators for
controlling shared resources. Depending on the board configuration the shared
resource properties may change. These properties are dynamically probed by the
remote processor and made available in the shared memory.

The bindings for Command DB is specified in the reserved-memory section in
devicetree. The devicetree representation of the command DB driver should be:

Properties:
- compatible:
	Usage: required
	Value type: <string>
	Definition: Should be "qcom,cmd-db"

- reg:
	Usage: required
	Value type: <prop encoded array>
	Definition: The register address that points to the actual location of
		    the Command DB in memory.

Example:

	reserved-memory {
		[...]
		reserved-memory@85fe0000 {
			reg = <0x0 0x85fe0000 0x0 0x20000>;
			compatible = "qcom,cmd-db";
			no-map;
		};
	};
```

## Documentation/devicetree/bindings/reserved-memory/qcom,cmd-db.yaml
```yaml
# SPDX-License-Identifier: (GPL-2.0-only OR BSD-2-Clause)
%YAML 1.2
---
$id: "http://devicetree.org/schemas/reserved-memory/qcom,cmd-db.yaml#"
$schema: "http://devicetree.org/meta-schemas/core.yaml#"

title: Qualcomm Command DB

description: |
  Command DB is a database that provides a mapping between resource key and the
  resource address for a system resource managed by a remote processor. The data
  is stored in a shared memory region and is loaded by the remote processor.

  Some of the Qualcomm Technologies Inc SoC's have hardware accelerators for
  controlling shared resources. Depending on the board configuration the shared
  resource properties may change. These properties are dynamically probed by the
  remote processor and made available in the shared memory.

maintainers:
  - Bjorn Andersson <bjorn.andersson@linaro.org>

allOf:
  - $ref: "reserved-memory.yaml"

properties:
  compatible:
    const: qcom,cmd-db

required:
  - reg

unevaluatedProperties: false

examples:
  - |
    reserved-memory {
        #address-cells = <1>;
        #size-cells = <1>;
        ranges;

        reserved-memory@85fe0000 {
            reg = <0x85fe0000 0x20000>;
            compatible = "qcom,cmd-db";
            no-map;
        };
    };
```

## Documentation/devicetree/bindings/reserved-memory/qcom,rmtfs-mem.txt
```
Qualcomm Remote File System Memory binding

This binding describes the Qualcomm remote filesystem memory, which serves the
purpose of describing the shared memory region used for remote processors to
access block device data using the Remote Filesystem protocol.

- compatible:
	Usage: required
	Value type: <stringlist>
	Definition: must be:
		    "qcom,rmtfs-mem"

- reg:
	Usage: required for static allocation
	Value type: <prop-encoded-array>
	Definition: must specify base address and size of the memory region,
		    as described in reserved-memory.txt

- size:
	Usage: required for dynamic allocation
	Value type: <prop-encoded-array>
	Definition: must specify a size of the memory region, as described in
		    reserved-memory.txt

- qcom,client-id:
	Usage: required
	Value type: <u32>
	Definition: identifier of the client to use this region for buffers.

- qcom,vmid:
	Usage: optional
	Value type: <u32>
	Definition: vmid of the remote processor, to set up memory protection.

= EXAMPLE
The following example shows the remote filesystem memory setup for APQ8016,
with the rmtfs region for the Hexagon DSP (id #1) located at 0x86700000.

	reserved-memory {
		#address-cells = <2>;
		#size-cells = <2>;
		ranges;

		rmtfs@86700000 {
			compatible = "qcom,rmtfs-mem";
			reg = <0x0 0x86700000 0x0 0xe0000>;
			no-map;

			qcom,client-id = <1>;
		};
	};
```

## Documentation/devicetree/bindings/reserved-memory/qcom,rmtfs-mem.yaml
```yaml
# SPDX-License-Identifier: (GPL-2.0-only OR BSD-2-Clause)
%YAML 1.2
---
$id: http://devicetree.org/schemas/reserved-memory/qcom,rmtfs-mem.yaml#
$schema: http://devicetree.org/meta-schemas/core.yaml#

title: Qualcomm Remote File System Memory

description: |
  This binding describes the Qualcomm remote filesystem memory, which serves the
  purpose of describing the shared memory region used for remote processors to
  access block device data using the Remote Filesystem protocol.

maintainers:
  - Bjorn Andersson <bjorn.andersson@linaro.org>

allOf:
  - $ref: reserved-memory.yaml

properties:
  compatible:
    const: qcom,rmtfs-mem

  qcom,client-id:
    $ref: /schemas/types.yaml#/definitions/uint32
    description: >
      identifier of the client to use this region for buffers

  qcom,vmid:
    $ref: /schemas/types.yaml#/definitions/uint32-array
    description: >
      Array of vmids of the remote processors, to set up memory protection
    minItems: 1
    maxItems: 2

required:
  - qcom,client-id

unevaluatedProperties: false

examples:
  - |
    reserved-memory {
        #address-cells = <1>;
        #size-cells = <1>;
        ranges;

        rmtfs@86700000 {
            compatible = "qcom,rmtfs-mem";
            reg = <0x86700000 0xe0000>;
            no-map;

            qcom,client-id = <1>;
        };
    };
```

## Documentation/devicetree/bindings/reserved-memory/ramoops.txt
```
Ramoops oops/panic logger
=========================

ramoops provides persistent RAM storage for oops and panics, so they can be
recovered after a reboot. This is a child-node of "/reserved-memory", and
is named "ramoops" after the backend, rather than "pstore" which is the
subsystem.

Parts of this storage may be set aside for other persistent log buffers, such
as kernel log messages, or for optional ECC error-correction data.  The total
size of these optional buffers must fit in the reserved region.

Any remaining space will be used for a circular buffer of oops and panic
records.  These records have a configurable size, with a size of 0 indicating
that they should be disabled.

At least one of "record-size", "console-size", "ftrace-size", or "pmsg-size"
must be set non-zero, but are otherwise optional as listed below.


Required properties:

- compatible: must be "ramoops"

- reg: region of memory that is preserved between reboots


Optional properties:

- ecc-size: enables ECC support and specifies ECC buffer size in bytes
  (defaults to 0: no ECC)

- record-size: maximum size in bytes of each kmsg dump.
  (defaults to 0: disabled)

- console-size: size in bytes of log buffer reserved for kernel messages
  (defaults to 0: disabled)

- ftrace-size: size in bytes of log buffer reserved for function tracing and
  profiling (defaults to 0: disabled)

- pmsg-size: size in bytes of log buffer reserved for userspace messages
  (defaults to 0: disabled)

- mem-type: if present, sets the type of mapping is to be used to map the
  reserved region. mem-type: 0 = write-combined (default), 1 = unbuffered,
  2 = cached.

- unbuffered: deprecated, use mem_type instead. If present, and mem_type is
  not specified, it is equivalent to mem_type = 1 and uses unbuffered mappings
  to map the reserved region (defaults to buffered mappings mem_type = 0). If
  both are specified -- "mem_type" overrides "unbuffered".

- max-reason: if present, sets maximum type of kmsg dump reasons to store
  (defaults to 2: log Oopses and Panics). This can be set to INT_MAX to
  store all kmsg dumps. See include/linux/kmsg_dump.h KMSG_DUMP_* for other
  kmsg dump reason values. Setting this to 0 (KMSG_DUMP_UNDEF), means the
  reason filtering will be controlled by the printk.always_kmsg_dump boot
  param: if unset, it will be KMSG_DUMP_OOPS, otherwise KMSG_DUMP_MAX.

- no-dump-oops: deprecated, use max_reason instead. If present, and
  max_reason is not specified, it is equivalent to max_reason = 1
  (KMSG_DUMP_PANIC).

- flags: if present, pass ramoops behavioral flags (defaults to 0,
  see include/linux/pstore_ram.h RAMOOPS_FLAG_* for flag values).
```
