## Documentation/devicetree/bindings/reset/allwinner,sunxi-clock-reset.txt
```
Allwinner sunxi Peripheral Reset Controller
===========================================

Please also refer to reset.txt in this directory for common reset
controller binding usage.

Required properties:
- compatible: Should be one of the following:
  "allwinner,sun6i-a31-ahb1-reset"
  "allwinner,sun6i-a31-clock-reset"
- reg: should be register base and length as documented in the
  datasheet
- #reset-cells: 1, see below

example:

ahb1_rst: reset@01c202c0 {
	#reset-cells = <1>;
	compatible = "allwinner,sun6i-a31-ahb1-reset";
	reg = <0x01c202c0 0xc>;
};
```

## Documentation/devicetree/bindings/reset/altr,rst-mgr.yaml
```yaml
# SPDX-License-Identifier: (GPL-2.0-only OR BSD-2-Clause)
%YAML 1.2
---
$id: http://devicetree.org/schemas/reset/altr,rst-mgr.yaml#
$schema: http://devicetree.org/meta-schemas/core.yaml#

title: Altera SOCFPGA Reset Manager

maintainers:
  - Dinh Nguyen <dinguyen@altera.com>

properties:
  compatible:
    oneOf:
      - description: Cyclone5/Arria5/Arria10
        const: altr,rst-mgr
      - description: Stratix10 ARM64 SoC
        items:
          - const: altr,stratix10-rst-mgr
          - const: altr,rst-mgr

  reg:
    maxItems: 1

  altr,modrst-offset:
    $ref: /schemas/types.yaml#/definitions/uint32
    description: Offset of the first modrst register

  '#reset-cells':
    const: 1

required:
  - compatible
  - reg
  - altr,modrst-offset
  - '#reset-cells'

additionalProperties: false

examples:
  - |
    rstmgr@ffd05000 {
        compatible = "altr,rst-mgr";
        reg = <0xffd05000 0x1000>;
        altr,modrst-offset = <0x10>;
        #reset-cells = <1>;
    };
```
