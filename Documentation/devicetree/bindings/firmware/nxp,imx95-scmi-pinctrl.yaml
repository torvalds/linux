## Documentation/devicetree/bindings/firmware/xilinx/xlnx,zynqmp-firmware.txt
```
-----------------------------------------------------------------
Device Tree Bindings for the Xilinx Zynq MPSoC Firmware Interface
-----------------------------------------------------------------

The zynqmp-firmware node describes the interface to platform firmware.
ZynqMP has an interface to communicate with secure firmware. Firmware
driver provides an interface to firmware APIs. Interface APIs can be
used by any driver to communicate to PMUFW(Platform Management Unit).
These requests include clock management, pin control, device control,
power management service, FPGA service and other platform management
services.

Required properties:
 - compatible:	Must contain any of below:
		"xlnx,zynqmp-firmware" for Zynq Ultrascale+ MPSoC
		"xlnx,versal-firmware" for Versal
 - method:	The method of calling the PM-API firmware layer.
		Permitted values are:
		  - "smc" : SMC #0, following the SMCCC
		  - "hvc" : HVC #0, following the SMCCC

-------
Example
-------

Zynq Ultrascale+ MPSoC
----------------------
firmware {
	zynqmp_firmware: zynqmp-firmware {
		compatible = "xlnx,zynqmp-firmware";
		method = "smc";
		...
	};
};

Versal
------
firmware {
	versal_firmware: versal-firmware {
		compatible = "xlnx,versal-firmware";
		method = "smc";
		...
	};
};
```

## Documentation/devicetree/bindings/firmware/xilinx/xlnx,zynqmp-firmware.yaml
```yaml
# SPDX-License-Identifier: (GPL-2.0-only OR BSD-2-Clause)
%YAML 1.2
---
$id: http://devicetree.org/schemas/firmware/xilinx/xlnx,zynqmp-firmware.yaml#
$schema: http://devicetree.org/meta-schemas/core.yaml#

title: Xilinx firmware driver

maintainers:
  - Nava kishore Manne <nava.manne@xilinx.com>

description: The zynqmp-firmware node describes the interface to platform
  firmware. ZynqMP has an interface to communicate with secure firmware.
  Firmware driver provides an interface to firmware APIs. Interface APIs
  can be used by any driver to communicate to PMUFW(Platform Management Unit).
  These requests include clock management, pin control, device control,
  power management service, FPGA service and other platform management
  services.

properties:
  compatible:
    oneOf:
      - description: For implementations complying for Zynq Ultrascale+ MPSoC.
        const: xlnx,zynqmp-firmware

      - description: For implementations complying for Versal.
        const: xlnx,versal-firmware

  method:
    description: |
                 The method of calling the PM-API firmware layer.
                 Permitted values are.
                 - "smc" : SMC #0, following the SMCCC
                 - "hvc" : HVC #0, following the SMCCC

    $ref: /schemas/types.yaml#/definitions/string-array
    enum:
      - smc
      - hvc

  versal_fpga:
    $ref: /schemas/fpga/xlnx,versal-fpga.yaml#
    description: Compatible of the FPGA device.
    type: object

  zynqmp-aes:
    $ref: /schemas/crypto/xlnx,zynqmp-aes.yaml#
    description: The ZynqMP AES-GCM hardened cryptographic accelerator is
      used to encrypt or decrypt the data with provided key and initialization
      vector.
    type: object

  clock-controller:
    $ref: /schemas/clock/xlnx,versal-clk.yaml#
    description: The clock controller is a hardware block of Xilinx versal
      clock tree. It reads required input clock frequencies from the devicetree
      and acts as clock provider for all clock consumers of PS clocks.list of
      clock specifiers which are external input clocks to the given clock
      controller.
    type: object

required:
  - compatible

additionalProperties: false

examples:
  - |
    versal-firmware {
      compatible = "xlnx,versal-firmware";
      method = "smc";

      versal_fpga: versal_fpga {
        compatible = "xlnx,versal-fpga";
      };

      xlnx_aes: zynqmp-aes {
        compatible = "xlnx,zynqmp-aes";
      };

      versal_clk: clock-controller {
        #clock-cells = <1>;
        compatible = "xlnx,versal-clk";
        clocks = <&ref>, <&alt_ref>, <&pl_alt_ref>;
        clock-names = "ref", "alt_ref", "pl_alt_ref";
      };
    };

...
```

## Documentation/devicetree/bindings/fpga/altera-fpga-bridge.txt
```
Altera FPGA Bridge Driver

Required properties:

  - compatible : should be "<manufacturer>,<type>"
                 "altr,socfpga-fpga2sdram-bridge"
		 "altr,socfpga-hps2fpga-bridge"
		 "altr,socfpga-lwhps2fpga-bridge"
		 "altr,socfpga-fpga2hps-bridge"

Required for fpga2sdram bridge only:
  - read-port  : which read port is used for this bridge (0-3)
  - write-port : which write port is used for this bridge (0-3)
  - control-ports : which conrtol port(s) are used for this bridge.
                    index 0 is first port # (0-5)
		    index 1 is number of ports used (1-2)

Optional properties:
  - label      : name that you want this bridge to show up as under /sys
                 Default is br<device#> if this is not specified

  - enable     : If 'enable' is specified, the bridge will be enabled or
                 disabled upon load, depending on the value of this parameter.
		 if 'enable' is not specified, the driver will not enable
		 or disable the bridge by default.

Example:
	hps_fpgabridge0: fpgabridge@0 {
		compatible = "altr,socfpga-hps2fpga-bridge";
		label = "hps2fpga";
		enable = <1>;
	};

	hps_fpgabridge1: fpgabridge@1 {
		compatible = "altr,socfpga-lwhps2fpga-bridge";
		label = "lwhps2fpga";
	};

	hps_fpgabridge2: fpgabridge@2 {
		compatible = "altr,socfpga-fpga2hps-bridge";
		label = "fpga2hps";
	};

	hps_fpgabridge3: fpgabridge@3 {
		compatible = "altr,socfpga-fpga2sdram-bridge";
		label = "fpga2sdram0";
		read-port = <0>;
		write-port = <0>;
		control-ports = <0 2>; /* ports 0 and 1 */
		enable = <1>;
	};

	hps_fpgabridge4: fpgabridge@4 {
		compatible = "altr,socfpga-fpga2sdram-bridge";
		label = "fpga2sdram1";
		read-port = <1>;
		write-port = <1>;
		control-ports = <2 1>; /* port 2 only */
	};

	hps_fpgabridge5: fpgabridge@5 {
		compatible = "altr,socfpga-fpga2sdram-bridge";
		label = "fpga2sdram2";
		read-port = <2>;
		write-port = <2>;
		control-ports = <3 1>; /* port 3 only */
	};

	hps_fpgabridge6: fpgabridge@6 {
		compatible = "altr,socfpga-fpga2sdram-bridge";
		label = "fpga2sdram3";
		read-port = <3>;
		write-port = <3>;
		control-ports = <4 2>; /* ports 4 and 5 */
	};
```

## Documentation/devicetree/bindings/fpga/altera-fpga-mgr.txt
```
Altera FPGA Manager

Required properties:

  - compatible : should be "<manufacturer>,<type>"
                 "altr,fpga-mgr-1.0", "altr,fpga-mgr";

  - transport  : the interface for register and configuration data.
                 Currently only memory mapped io is supported, so must be "mmio"

  - reg        : base address for memory mapped io.
                  - The first index is for FPGA manager register access.
                  - The second index is for writing FPGA configuration data.

  - interrupts : interrupts for the FPGA Manager device.

Example:

	hps_0_fpgamgr: fpgamgr@0xff706000 {
		compatible = "altr,fpga-mgr-1.0", "altr,fpga-mgr";
		transport = "mmio";
		reg = <0xFF706000 0x1000
		       0xFFB90000 0x1000>;
		interrupts = <0 175 4>;
	};
```

## Documentation/devicetree/bindings/fpga/altera-fpga2sdram-bridge.txt
```
Altera FPGA To SDRAM Bridge Driver

Required properties:
- compatible		: Should contain "altr,socfpga-fpga2sdram-bridge"

See Documentation/devicetree/bindings/fpga/fpga-bridge.txt for generic bindings.

Example:
	fpga_bridge3: fpga-bridge@ffc25080 {
		compatible = "altr,socfpga-fpga2sdram-bridge";
		reg = <0xffc25080 0x4>;
		bridge-enable = <0>;
	};
```

## Documentation/devicetree/bindings/fpga/altera-freeze-bridge.txt
```
Altera Freeze Bridge Controller Driver

The Altera Freeze Bridge Controller manages one or more freeze bridges.
The controller can freeze/disable the bridges which prevents signal
changes from passing through the bridge.  The controller can also
unfreeze/enable the bridges which allows traffic to pass through the
bridge normally.

Required properties:
- compatible		: Should contain "altr,freeze-bridge-controller"
- regs			: base address and size for freeze bridge module

See Documentation/devicetree/bindings/fpga/fpga-bridge.txt for generic bindings.

Example:
	freeze-controller@100000450 {
		compatible = "altr,freeze-bridge-controller";
		regs = <0x1000 0x10>;
		bridge-enable = <0>;
	};
```

## Documentation/devicetree/bindings/fpga/altera-hps2fpga-bridge.txt
```
Altera FPGA/HPS Bridge Driver

Required properties:
- regs		: base address and size for AXI bridge module
- compatible	: Should contain one of:
		  "altr,socfpga-lwhps2fpga-bridge",
		  "altr,socfpga-hps2fpga-bridge", or
		  "altr,socfpga-fpga2hps-bridge"
- resets	: Phandle and reset specifier for this bridge's reset
- clocks	: Clocks used by this module.

See Documentation/devicetree/bindings/fpga/fpga-bridge.txt for generic bindings.

Example:
	fpga_bridge0: fpga-bridge@ff400000 {
		compatible = "altr,socfpga-lwhps2fpga-bridge";
		reg = <0xff400000 0x100000>;
		resets = <&rst LWHPS2FPGA_RESET>;
		clocks = <&l4_main_clk>;
		bridge-enable = <0>;
	};

	fpga_bridge1: fpga-bridge@ff500000 {
		compatible = "altr,socfpga-hps2fpga-bridge";
		reg = <0xff500000 0x10000>;
		resets = <&rst HPS2FPGA_RESET>;
		clocks = <&l4_main_clk>;
		bridge-enable = <1>;
	};

	fpga_bridge2: fpga-bridge@ff600000 {
		compatible = "altr,socfpga-fpga2hps-bridge";
		reg = <0xff600000 0x100000>;
		resets = <&rst FPGA2HPS_RESET>;
		clocks = <&l4_main_clk>;
	};
```

## Documentation/devicetree/bindings/fpga/altera-passive-serial.txt
```
Altera Passive Serial SPI FPGA Manager

Altera FPGAs support a method of loading the bitstream over what is
referred to as "passive serial".
The passive serial link is not technically SPI, and might require extra
circuits in order to play nicely with other SPI slaves on the same bus.

See https://www.altera.com/literature/hb/cyc/cyc_c51013.pdf

Required properties:
- compatible: Must be one of the following:
	"altr,fpga-passive-serial",
	"altr,fpga-arria10-passive-serial"
- reg: SPI chip select of the FPGA
- nconfig-gpios: config pin (referred to as nCONFIG in the manual)
- nstat-gpios: status pin (referred to as nSTATUS in the manual)

Optional properties:
- confd-gpios: confd pin (referred to as CONF_DONE in the manual)

Example:
	fpga: fpga@0 {
		compatible = "altr,fpga-passive-serial";
		spi-max-frequency = <20000000>;
		reg = <0>;
		nconfig-gpios = <&gpio4 9 GPIO_ACTIVE_LOW>;
		nstat-gpios = <&gpio4 11 GPIO_ACTIVE_LOW>;
		confd-gpios = <&gpio4 12 GPIO_ACTIVE_LOW>;
	};
```

## Documentation/devicetree/bindings/fpga/altera-pr-ip.txt
```
Altera Arria10 Partial Reconfiguration IP

Required properties:
- compatible : should contain "altr,a10-pr-ip"
- reg        : base address and size for memory mapped io.

Example:

	fpga_mgr: fpga-mgr@ff20c000 {
		compatible = "altr,a10-pr-ip";
		reg = <0xff20c000 0x10>;
	};
```

## Documentation/devicetree/bindings/fpga/altera-socfpga-a10-fpga-mgr.txt
```
Altera SOCFPGA Arria10 FPGA Manager

Required properties:
- compatible : should contain "altr,socfpga-a10-fpga-mgr"
- reg        : base address and size for memory mapped io.
               - The first index is for FPGA manager register access.
               - The second index is for writing FPGA configuration data.
- resets     : Phandle and reset specifier for the device's reset.
- clocks     : Clocks used by the device.

Example:

	fpga_mgr: fpga-mgr@ffd03000 {
		compatible = "altr,socfpga-a10-fpga-mgr";
		reg = <0xffd03000 0x100
		       0xffcfe400 0x20>;
		clocks = <&l4_mp_clk>;
		resets = <&rst FPGAMGR_RESET>;
	};
```

## Documentation/devicetree/bindings/fpga/altera-socfpga-fpga-mgr.txt
```
Altera SOCFPGA FPGA Manager

Required properties:
- compatible : should contain "altr,socfpga-fpga-mgr"
- reg        : base address and size for memory mapped io.
               - The first index is for FPGA manager register access.
               - The second index is for writing FPGA configuration data.
- interrupts : interrupt for the FPGA Manager device.

Example:

	hps_0_fpgamgr: fpgamgr@ff706000 {
		compatible = "altr,socfpga-fpga-mgr";
		reg = <0xFF706000 0x1000
		       0xFFB90000 0x1000>;
		interrupts = <0 175 4>;
	};
```

## Documentation/devicetree/bindings/fpga/altr,a10-pr-ip.yaml
```yaml
# SPDX-License-Identifier: (GPL-2.0-only OR BSD-2-Clause)
%YAML 1.2
---
$id: http://devicetree.org/schemas/fpga/altr,a10-pr-ip.yaml#
$schema: http://devicetree.org/meta-schemas/core.yaml#

title: Altera Arria10 Partial Reconfiguration IP

maintainers:
  - Matthew Gerlach <matthew.gerlach@linux.intel.com>

description:
  The Altera Arria 10 Partial Reconfiguration IP core allows the host
  processor to perform partial reconfiguration of the FPGA fabric.

properties:
  compatible:
    const: altr,a10-pr-ip

  reg:
    maxItems: 1

required:
  - compatible
  - reg

additionalProperties: false

examples:
  - |
    fpga-mgr@ff20c000 {
        compatible = "altr,a10-pr-ip";
        reg = <0xff20c000 0x10>;
    };
```

## Documentation/devicetree/bindings/fpga/altr,fpga-passive-serial.yaml
```yaml
# SPDX-License-Identifier: (GPL-2.0-only OR BSD-2-Clause)
%YAML 1.2
---
$id: http://devicetree.org/schemas/fpga/altr,fpga-passive-serial.yaml#
$schema: http://devicetree.org/meta-schemas/core.yaml#

title: Altera Passive Serial SPI FPGA Manager

maintainers:
  - Fabio Estevam <festevam@denx.de>

description: |
  Altera FPGAs support a method of loading the bitstream over what is
  referred to as "passive serial".
  The passive serial link is not technically SPI, and might require extra
  circuits in order to play nicely with other SPI slaves on the same bus.

  See https://www.altera.com/literature/hb/cyc/cyc_c51013.pdf

allOf:
  - $ref: /schemas/spi/spi-peripheral-props.yaml#

properties:
  compatible:
    enum:
      - altr,fpga-passive-serial
      - altr,fpga-arria10-passive-serial

  spi-max-frequency:
    maximum: 20000000

  reg:
    maxItems: 1

  nconfig-gpios:
    description:
      Config pin (referred to as nCONFIG in the manual).
    maxItems: 1

  nstat-gpios:
    description:
      Status pin (referred to as nSTATUS in the manual).
    maxItems: 1

  confd-gpios:
    description:
      confd pin (referred to as CONF_DONE in the manual)
    maxItems: 1

required:
  - compatible
  - reg
  - nconfig-gpios
  - nstat-gpios

additionalProperties: false

examples:
  - |
    #include <dt-bindings/gpio/gpio.h>

    spi {
      #address-cells = <1>;
      #size-cells = <0>;

      fpga@0 {
        compatible = "altr,fpga-passive-serial";
        reg = <0>;
        nconfig-gpios = <&gpio4 18 GPIO_ACTIVE_LOW>;
        nstat-gpios = <&gpio4 19 GPIO_ACTIVE_LOW>;
        confd-gpios = <&gpio1 6 GPIO_ACTIVE_HIGH>;
      };
    };
...
```

## Documentation/devicetree/bindings/fpga/altr,freeze-bridge-controller.yaml
```yaml
# SPDX-License-Identifier: (GPL-2.0-only OR BSD-2-Clause)
%YAML 1.2
---
$id: http://devicetree.org/schemas/fpga/altr,freeze-bridge-controller.yaml#
$schema: http://devicetree.org/meta-schemas/core.yaml#

title: Altera Freeze Bridge Controller

description:
  The Altera Freeze Bridge Controller manages one or more freeze bridges.
  The controller can freeze/disable the bridges which prevents signal
  changes from passing through the bridge. The controller can also
  unfreeze/enable the bridges which allows traffic to pass through the bridge
  normally.

maintainers:
  - Xu Yilun <yilun.xu@intel.com>

allOf:
  - $ref: fpga-bridge.yaml#

properties:
  compatible:
    const: altr,freeze-bridge-controller

  reg:
    maxItems: 1

required:
  - compatible
  - reg

unevaluatedProperties: false

examples:
  - |
    fpga-bridge@100000450 {
        compatible = "altr,freeze-bridge-controller";
        reg = <0x1000 0x10>;
        bridge-enable = <0>;
    };
```
