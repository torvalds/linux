## Documentation/devicetree/bindings/fpga/altr,socfpga-fpga-mgr.yaml
```yaml
# SPDX-License-Identifier: (GPL-2.0-only OR BSD-2-Clause)
%YAML 1.2
---
$id: http://devicetree.org/schemas/fpga/altr,socfpga-fpga-mgr.yaml#
$schema: http://devicetree.org/meta-schemas/core.yaml#

title: Altera SOCFPGA FPGA Manager

maintainers:
  - Steffen Trumtrar <s.trumtrar@pengutronix.de>

properties:
  compatible:
    const: altr,socfpga-fpga-mgr

  reg:
    items:
      - description: FPGA manager register access
      - description: Writing FPGA configuration data

  interrupts:
    maxItems: 1

required:
  - compatible
  - reg
  - interrupts

additionalProperties: false

examples:
  - |
    fpgamgr@ff706000 {
        compatible = "altr,socfpga-fpga-mgr";
        reg = <0xff706000 0x1000>,
              <0xffb90000 0x1000>;
        interrupts = <0 175 4>;
    };
```

## Documentation/devicetree/bindings/fpga/altr,socfpga-fpga2sdram-bridge.yaml
```yaml
# SPDX-License-Identifier: (GPL-2.0-only OR BSD-2-Clause)
%YAML 1.2
---
$id: http://devicetree.org/schemas/fpga/altr,socfpga-fpga2sdram-bridge.yaml#
$schema: http://devicetree.org/meta-schemas/core.yaml#

title: Altera FPGA To SDRAM Bridge

maintainers:
  - Xu Yilun <yilun.xu@intel.com>

allOf:
  - $ref: fpga-bridge.yaml#

properties:
  compatible:
    const: altr,socfpga-fpga2sdram-bridge

  reg:
    maxItems: 1

required:
  - compatible

unevaluatedProperties: false

examples:
  - |
    fpga-bridge@ffc25080 {
        compatible = "altr,socfpga-fpga2sdram-bridge";
        reg = <0xffc25080 0x4>;
        bridge-enable = <0>;
    };
```

## Documentation/devicetree/bindings/fpga/altr,socfpga-hps2fpga-bridge.yaml
```yaml
# SPDX-License-Identifier: (GPL-2.0-only OR BSD-2-Clause)
%YAML 1.2
---
$id: http://devicetree.org/schemas/fpga/altr,socfpga-hps2fpga-bridge.yaml#
$schema: http://devicetree.org/meta-schemas/core.yaml#

title: Altera FPGA/HPS Bridge

maintainers:
  - Xu Yilun <yilun.xu@intel.com>

allOf:
  - $ref: fpga-bridge.yaml#

properties:
  compatible:
    enum:
      - altr,socfpga-lwhps2fpga-bridge
      - altr,socfpga-hps2fpga-bridge
      - altr,socfpga-fpga2hps-bridge

  reg:
    maxItems: 1

  resets:
    maxItems: 1

  clocks:
    maxItems: 1

required:
  - compatible
  - reg
  - clocks
  - resets

unevaluatedProperties: false

examples:
  - |
    #include <dt-bindings/reset/altr,rst-mgr.h>

    fpga-bridge@ff400000 {
      compatible = "altr,socfpga-lwhps2fpga-bridge";
      reg = <0xff400000 0x100000>;
      bridge-enable = <0>;
      clocks = <&l4_main_clk>;
      resets = <&rst LWHPS2FPGA_RESET>;
    };
```

## Documentation/devicetree/bindings/fpga/efinix,trion-config.yaml
```yaml
# SPDX-License-Identifier: (GPL-2.0-only OR BSD-2-Clause)
%YAML 1.2
---
$id: http://devicetree.org/schemas/fpga/efinix,trion-config.yaml#
$schema: http://devicetree.org/meta-schemas/core.yaml#

title: Efinix SPI FPGA Manager

maintainers:
  - Ian Dannapel <iansdannapel@gmail.com>

description: |
  Efinix FPGAs (Trion, Topaz, and Titanium families) support loading bitstreams
  through "SPI Passive Mode".
  Additional pin hogs for bus width configuration should be set
  elsewhere, if necessary.

  References:
  - https://www.efinixinc.com/docs/an006-configuring-trion-fpgas-v6.3.pdf
  - https://www.efinixinc.com/docs/an033-configuring-titanium-fpgas-v2.8.pdf
  - https://www.efinixinc.com/docs/an061-configuring-topaz-fpgas-v1.1.pdf

allOf:
  - $ref: /schemas/spi/spi-peripheral-props.yaml#

properties:
  compatible:
    oneOf:
      - items:
          - enum:
              - efinix,titanium-config
              - efinix,topaz-config
          - const: efinix,trion-config
      - const: efinix,trion-config

  spi-cpha: true

  spi-cpol: true

  spi-max-frequency:
    maximum: 25000000

  reg:
    maxItems: 1

  reset-gpios:
    description:
      reset and re-configuration trigger pin (low active)
    maxItems: 1

  cdone-gpios:
    description:
      optional configuration done status pin (high active)
    maxItems: 1

required:
  - compatible
  - reg
  - reset-gpios
  - spi-cpha
  - spi-cpol

unevaluatedProperties: false

examples:
  - |
    #include <dt-bindings/gpio/gpio.h>
    spi {
      #address-cells = <1>;
      #size-cells = <0>;
      cs-gpios = <&gpio5 13 GPIO_ACTIVE_LOW>;
      fpga-mgr@0 {
        compatible = "efinix,trion-config";
        reg = <0>;
        spi-max-frequency = <25000000>;
        spi-cpha;
        spi-cpol;
        reset-gpios = <&gpio4 17 GPIO_ACTIVE_LOW>;
        cdone-gpios = <&gpio0 9 GPIO_ACTIVE_HIGH>;
      };
    };
  - |
    #include <dt-bindings/gpio/gpio.h>
    spi {
      #address-cells = <1>;
      #size-cells = <0>;
      cs-gpios = <&gpio5 13 GPIO_ACTIVE_LOW>;
      fpga-mgr@0 {
        compatible = "efinix,titanium-config", "efinix,trion-config";
        reg = <0>;
        spi-max-frequency = <25000000>;
        spi-cpha;
        spi-cpol;
        reset-gpios = <&gpio4 17 GPIO_ACTIVE_LOW>;
        cdone-gpios = <&gpio0 9 GPIO_ACTIVE_HIGH>;
      };
    };
...
```

## Documentation/devicetree/bindings/fpga/fpga-bridge.txt
```
FPGA Bridge Device Tree Binding

Optional properties:
- bridge-enable		: 0 if driver should disable bridge at startup
			  1 if driver should enable bridge at startup
			  Default is to leave bridge in current state.

Example:
	fpga_bridge3: fpga-bridge@ffc25080 {
		compatible = "altr,socfpga-fpga2sdram-bridge";
		reg = <0xffc25080 0x4>;
		bridge-enable = <0>;
	};
```
