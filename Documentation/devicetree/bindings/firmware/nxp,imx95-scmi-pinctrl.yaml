## Documentation/devicetree/bindings/firmware/nxp,imx95-scmi-pinctrl.yaml
```yaml
# SPDX-License-Identifier: (GPL-2.0 OR BSD-2-Clause)
# Copyright 2024 NXP
%YAML 1.2
---
$id: http://devicetree.org/schemas/firmware/nxp,imx95-scmi-pinctrl.yaml#
$schema: http://devicetree.org/meta-schemas/core.yaml#

title: i.MX System Control and Management Interface (SCMI) Pinctrl Protocol

maintainers:
  - Peng Fan <peng.fan@nxp.com>

allOf:
  - $ref: /schemas/pinctrl/pinctrl.yaml

patternProperties:
  'grp$':
    type: object
    description:
      Pinctrl node's client devices use subnodes for desired pin configuration.
      Client device subnodes use below standard properties.

    unevaluatedProperties: false

    properties:
      fsl,pins:
        description:
          each entry consists of 6 integers and represents the mux and config
          setting for one pin. The first 5 integers <mux_reg conf_reg input_reg
          mux_val input_val> are specified using a PIN_FUNC_ID macro, which can
          be found in <arch/arm64/boot/dts/freescale/imx95-pinfunc.h>. The last
          integer CONFIG is the pad setting value like pull-up on this pin.
          Please refer to i.MX95 Reference Manual for detailed CONFIG settings.
        $ref: /schemas/types.yaml#/definitions/uint32-matrix
        items:
          items:
            - description: |
                "mux_reg" indicates the offset of mux register.
            - description: |
                "conf_reg" indicates the offset of pad configuration register.
            - description: |
                "input_reg" indicates the offset of select input register.
            - description: |
                "mux_val" indicates the mux value to be applied.
            - description: |
                "input_val" indicates the select input value to be applied.
            - description: |
                "pad_setting" indicates the pad configuration value to be applied.

    required:
      - fsl,pins

additionalProperties: true
```

## Documentation/devicetree/bindings/firmware/nxp,imx95-scmi.yaml
```yaml
# SPDX-License-Identifier: (GPL-2.0 OR BSD-2-Clause)
# Copyright 2024 NXP
%YAML 1.2
---
$id: http://devicetree.org/schemas/firmware/nxp,imx95-scmi.yaml#
$schema: http://devicetree.org/meta-schemas/core.yaml#

title: i.MX95 System Control and Management Interface(SCMI) Vendor Protocols Extension

maintainers:
  - Peng Fan <peng.fan@nxp.com>

properties:
  protocol@80:
    description:
      SCMI LMM protocol which is for boot, shutdown, and reset of other logical
      machines (LM). It is usually used to allow one LM to manage another used
      as an offload or accelerator engine.
    $ref: '/schemas/firmware/arm,scmi.yaml#/$defs/protocol-node'
    unevaluatedProperties: false

    properties:
      reg:
        const: 0x80

  protocol@81:
    type: object
    allOf:
      - $ref: '/schemas/firmware/arm,scmi.yaml#/$defs/protocol-node'
      - $ref: /schemas/input/input.yaml#
    additionalProperties: false

    properties:
      reg:
        const: 0x81

      linux,code:
        default: 116  # KEY_POWER

  protocol@82:
    description:
      SCMI CPU Protocol which allows an agent to start or stop a CPU. It is
      used to manage auxiliary CPUs in a LM.
    $ref: '/schemas/firmware/arm,scmi.yaml#/$defs/protocol-node'
    unevaluatedProperties: false

    properties:
      reg:
        const: 0x82

  protocol@84:
    $ref: '/schemas/firmware/arm,scmi.yaml#/$defs/protocol-node'
    unevaluatedProperties: false

    properties:
      reg:
        const: 0x84

      nxp,ctrl-ids:
        description:
          Each entry consists of 2 integers, represents the ctrl id and the value
        items:
          items:
            - description: the ctrl id index
              enum: [0, 1, 2, 3, 4, 5, 6, 7, 0x8000, 0x8001, 0x8002, 0x8003,
                     0x8004, 0x8005, 0x8006, 0x8007]
            - description: the value assigned to the ctrl id
        minItems: 1
        maxItems: 16
        $ref: /schemas/types.yaml#/definitions/uint32-matrix

additionalProperties: true
```

## Documentation/devicetree/bindings/firmware/qcom,scm.txt
```
QCOM Secure Channel Manager (SCM)

Qualcomm processors include an interface to communicate to the secure firmware.
This interface allows for clients to request different types of actions.  These
can include CPU power up/down, HDCP requests, loading of firmware, and other
assorted actions.

Required properties:
- compatible: must contain one of the following:
 * "qcom,scm-apq8064"
 * "qcom,scm-apq8084"
 * "qcom,scm-ipq4019"
 * "qcom,scm-ipq806x"
 * "qcom,scm-ipq8074"
 * "qcom,scm-mdm9607"
 * "qcom,scm-msm8226"
 * "qcom,scm-msm8660"
 * "qcom,scm-msm8916"
 * "qcom,scm-msm8953"
 * "qcom,scm-msm8960"
 * "qcom,scm-msm8974"
 * "qcom,scm-msm8976"
 * "qcom,scm-msm8994"
 * "qcom,scm-msm8996"
 * "qcom,scm-msm8998"
 * "qcom,scm-sc7180"
 * "qcom,scm-sc7280"
 * "qcom,scm-sdm845"
 * "qcom,scm-sdx55"
 * "qcom,scm-sm6350"
 * "qcom,scm-sm8150"
 * "qcom,scm-sm8250"
 * "qcom,scm-sm8350"
 * "qcom,scm-sm8450"
 and:
 * "qcom,scm"
- clocks: Specifies clocks needed by the SCM interface, if any:
 * core clock required for "qcom,scm-apq8064", "qcom,scm-msm8660" and
   "qcom,scm-msm8960"
 * core, iface and bus clocks required for "qcom,scm-apq8084",
   "qcom,scm-msm8916", "qcom,scm-msm8953", "qcom,scm-msm8974" and "qcom,scm-msm8976"
- clock-names: Must contain "core" for the core clock, "iface" for the interface
  clock and "bus" for the bus clock per the requirements of the compatible.
- qcom,dload-mode: phandle to the TCSR hardware block and offset of the
		   download mode control register (optional)

Example for MSM8916:

	firmware {
		scm {
			compatible = "qcom,msm8916", "qcom,scm";
			clocks = <&gcc GCC_CRYPTO_CLK> ,
				 <&gcc GCC_CRYPTO_AXI_CLK>,
				 <&gcc GCC_CRYPTO_AHB_CLK>;
			clock-names = "core", "bus", "iface";
		};
	};
```

## Documentation/devicetree/bindings/firmware/qcom,scm.yaml
```yaml
# SPDX-License-Identifier: (GPL-2.0-only OR BSD-2-Clause)
%YAML 1.2
---
$id: http://devicetree.org/schemas/firmware/qcom,scm.yaml#
$schema: http://devicetree.org/meta-schemas/core.yaml#

title: QCOM Secure Channel Manager (SCM)

description: |
  Qualcomm processors include an interface to communicate to the secure firmware.
  This interface allows for clients to request different types of actions.
  These can include CPU power up/down, HDCP requests, loading of firmware,
  and other assorted actions.

maintainers:
  - Bjorn Andersson <bjorn.andersson@linaro.org>
  - Robert Marko <robimarko@gmail.com>
  - Guru Das Srinagesh <quic_gurus@quicinc.com>

properties:
  compatible:
    items:
      - enum:
          - qcom,scm-apq8064
          - qcom,scm-apq8084
          - qcom,scm-ipq4019
          - qcom,scm-ipq5018
          - qcom,scm-ipq5332
          - qcom,scm-ipq5424
          - qcom,scm-ipq6018
          - qcom,scm-ipq806x
          - qcom,scm-ipq8074
          - qcom,scm-ipq9574
          - qcom,scm-mdm9607
          - qcom,scm-milos
          - qcom,scm-msm8226
          - qcom,scm-msm8660
          - qcom,scm-msm8916
          - qcom,scm-msm8937
          - qcom,scm-msm8953
          - qcom,scm-msm8960
          - qcom,scm-msm8974
          - qcom,scm-msm8976
          - qcom,scm-msm8994
          - qcom,scm-msm8996
          - qcom,scm-msm8998
          - qcom,scm-qcm2290
          - qcom,scm-qcs615
          - qcom,scm-qcs8300
          - qcom,scm-qdu1000
          - qcom,scm-sa8255p
          - qcom,scm-sa8775p
          - qcom,scm-sar2130p
          - qcom,scm-sc7180
          - qcom,scm-sc7280
          - qcom,scm-sc8180x
          - qcom,scm-sc8280xp
          - qcom,scm-sdm670
          - qcom,scm-sdm845
          - qcom,scm-sdx55
          - qcom,scm-sdx65
          - qcom,scm-sdx75
          - qcom,scm-sm6115
          - qcom,scm-sm6125
          - qcom,scm-sm6350
          - qcom,scm-sm6375
          - qcom,scm-sm7150
          - qcom,scm-sm8150
          - qcom,scm-sm8250
          - qcom,scm-sm8350
          - qcom,scm-sm8450
          - qcom,scm-sm8550
          - qcom,scm-sm8650
          - qcom,scm-sm8750
          - qcom,scm-qcs404
          - qcom,scm-x1e80100
      - const: qcom,scm

  clocks:
    minItems: 1
    maxItems: 3

  clock-names:
    minItems: 1
    maxItems: 3

  dma-coherent: true

  interconnects:
    maxItems: 1

  interconnect-names:
    maxItems: 1

  '#reset-cells':
    const: 1

  interrupts:
    description:
      The wait-queue interrupt that firmware raises as part of handshake
      protocol to handle sleeping SCM calls.
    maxItems: 1

  memory-region:
    description:
      Phandle to the memory region reserved for the shared memory bridge to TZ.
    maxItems: 1

  qcom,sdi-enabled:
    description:
      Indicates that the SDI (Secure Debug Image) has been enabled by TZ
      by default and it needs to be disabled.
      If not disabled WDT assertion or reboot will cause the board to hang
      in the debug mode.
    type: boolean

  qcom,dload-mode:
    $ref: /schemas/types.yaml#/definitions/phandle-array
    items:
      - items:
          - description: phandle to TCSR hardware block
          - description: offset of the download mode control register
    description: TCSR hardware block

allOf:
  # Clocks
  - if:
      properties:
        compatible:
          contains:
            enum:
              - qcom,scm-apq8064
              - qcom,scm-apq8084
              - qcom,scm-mdm9607
              - qcom,scm-msm8226
              - qcom,scm-msm8660
              - qcom,scm-msm8916
              - qcom,scm-msm8937
              - qcom,scm-msm8953
              - qcom,scm-msm8960
              - qcom,scm-msm8974
              - qcom,scm-msm8976
              - qcom,scm-qcm2290
              - qcom,scm-sm6375
    then:
      required:
        - clocks
        - clock-names
    else:
      properties:
        clock-names: false
        clocks: false

  - if:
      properties:
        compatible:
          contains:
            enum:
              - qcom,scm-apq8064
              - qcom,scm-msm8660
              - qcom,scm-msm8960
              - qcom,scm-qcm2290
              - qcom,scm-sm6375
    then:
      properties:
        clock-names:
          items:
            - const: core

        clocks:
          maxItems: 1

  - if:
      properties:
        compatible:
          contains:
            enum:
              - qcom,scm-apq8084
              - qcom,scm-mdm9607
              - qcom,scm-msm8226
              - qcom,scm-msm8916
              - qcom,scm-msm8937
              - qcom,scm-msm8953
              - qcom,scm-msm8974
              - qcom,scm-msm8976
    then:
      properties:
        clock-names:
          items:
            - const: core
            - const: bus
            - const: iface

        clocks:
          minItems: 3
          maxItems: 3

  # Interrupts
  - if:
      not:
        properties:
          compatible:
            contains:
              enum:
                - qcom,scm-milos
                - qcom,scm-sm8450
                - qcom,scm-sm8550
                - qcom,scm-sm8650
                - qcom,scm-sm8750
    then:
      properties:
        interrupts: false
  - if:
      not:
        properties:
          compatible:
            contains:
              enum:
                - qcom,scm-sa8255p
                - qcom,scm-sa8775p
    then:
      properties:
        memory-region: false

required:
  - compatible

additionalProperties: false

examples:
  - |
    #include <dt-bindings/clock/qcom,gcc-msm8916.h>

    firmware {
        scm {
            compatible = "qcom,scm-msm8916", "qcom,scm";
            clocks = <&gcc GCC_CRYPTO_CLK>,
                     <&gcc GCC_CRYPTO_AXI_CLK>,
                     <&gcc GCC_CRYPTO_AHB_CLK>;
            clock-names = "core", "bus", "iface";
        };
    };
```

## Documentation/devicetree/bindings/firmware/qemu,fw-cfg-mmio.yaml
```yaml
# SPDX-License-Identifier: GPL-2.0
%YAML 1.2
---
$id: http://devicetree.org/schemas/firmware/qemu,fw-cfg-mmio.yaml#
$schema: http://devicetree.org/meta-schemas/core.yaml#

title: QEMU Firmware Configuration bindings

maintainers:
  - Rob Herring <robh@kernel.org>

description: |
  Various QEMU emulation / virtualization targets provide the following
  Firmware Configuration interface on the "virt" machine type:

  - A write-only, 16-bit wide selector (or control) register,
  - a read-write, 64-bit wide data register.

  QEMU exposes the control and data register to guests as memory mapped
  registers; their location is communicated to the guest's UEFI firmware in the
  DTB that QEMU places at the bottom of the guest's DRAM.

  The authoritative guest-side hardware interface documentation to the fw_cfg
  device can be found in "docs/specs/fw_cfg.txt" in the QEMU source tree.


properties:
  compatible:
    const: qemu,fw-cfg-mmio

  reg:
    maxItems: 1
    description: |
      * Bytes 0x0 to 0x7 cover the data register.
      * Bytes 0x8 to 0x9 cover the selector register.
      * Further registers may be appended to the region in case of future interface
        revisions / feature bits.

  dma-coherent: true

required:
  - compatible
  - reg

additionalProperties: false

examples:
  - |

    fw-cfg@9020000 {
        compatible = "qemu,fw-cfg-mmio";
        reg = <0x9020000 0xa>;
    };
...
```

## Documentation/devicetree/bindings/firmware/thead,th1520-aon.yaml
```yaml
# SPDX-License-Identifier: (GPL-2.0-only OR BSD-2-Clause)
%YAML 1.2
---
$id: http://devicetree.org/schemas/firmware/thead,th1520-aon.yaml#
$schema: http://devicetree.org/meta-schemas/core.yaml#

title: T-HEAD TH1520 AON (Always-On) Firmware

description: |
  The Always-On (AON) subsystem in the TH1520 SoC is responsible for managing
  low-power states, system wakeup events, and power management tasks. It is
  designed to operate independently in a dedicated power domain, allowing it to
  remain functional even during the SoC's deep sleep states.

  At the heart of the AON subsystem is the E902, a low-power core that executes
  firmware responsible for coordinating tasks such as power domain control,
  clock management, and system wakeup signaling. Communication between the main
  SoC and the AON subsystem is handled through a mailbox interface, which
  enables message-based interactions with the AON firmware.

maintainers:
  - Michal Wilczynski <m.wilczynski@samsung.com>

properties:
  compatible:
    const: thead,th1520-aon

  mboxes:
    maxItems: 1

  mbox-names:
    items:
      - const: aon

  resets:
    maxItems: 1

  reset-names:
    items:
      - const: gpu-clkgen

  "#power-domain-cells":
    const: 1

required:
  - compatible
  - mboxes
  - mbox-names
  - "#power-domain-cells"

additionalProperties: false

examples:
  - |
    aon: aon {
        compatible = "thead,th1520-aon";
        mboxes = <&mbox_910t 1>;
        mbox-names = "aon";
        #power-domain-cells = <1>;
    };
```
