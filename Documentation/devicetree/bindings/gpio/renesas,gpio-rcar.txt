## Documentation/devicetree/bindings/gpio/spear_spics.txt
```
=== ST Microelectronics SPEAr SPI CS Driver ===

SPEAr platform provides a provision to control chipselects of ARM PL022 Prime
Cell spi controller through its system registers, which otherwise remains under
PL022 control. If chipselect remain under PL022 control then they would be
released as soon as transfer is over and TxFIFO becomes empty. This is not
desired by some of the device protocols above spi which expect (multiple)
transfers without releasing their chipselects.

Chipselects can be controlled by software by turning them as GPIOs. SPEAr
provides another interface through system registers through which software can
directly control each PL022 chipselect. Hence, it is natural for SPEAr to export
the control of this interface as gpio.

Required properties:

  * compatible: should be defined as "st,spear-spics-gpio"
  * reg: mentioning address range of spics controller
  * st-spics,peripcfg-reg: peripheral configuration register offset
  * st-spics,sw-enable-bit: bit offset to enable sw control
  * st-spics,cs-value-bit: bit offset to drive chipselect low or high
  * st-spics,cs-enable-mask: chip select number bit mask
  * st-spics,cs-enable-shift: chip select number program offset
  * gpio-controller: Marks the device node as gpio controller
  * #gpio-cells: should be 1 and will mention chip select number

All the above bit offsets are within peripcfg register.

Example:
-------
spics: spics@e0700000{
        compatible = "st,spear-spics-gpio";
        reg = <0xe0700000 0x1000>;
        st-spics,peripcfg-reg = <0x3b0>;
        st-spics,sw-enable-bit = <12>;
        st-spics,cs-value-bit = <11>;
        st-spics,cs-enable-mask = <3>;
        st-spics,cs-enable-shift = <8>;
        gpio-controller;
        #gpio-cells = <2>;
};


spi0: spi@e0100000 {
        status = "okay";
        num-cs = <3>;
        cs-gpios = <&gpio1 7 0>, <&spics 0>,
                   <&spics 1>;
	...
}
```

## Documentation/devicetree/bindings/gpio/sprd,gpio-eic.yaml
```yaml
# SPDX-License-Identifier: (GPL-2.0-only OR BSD-2-Clause)
# Copyright 2022 Unisoc Inc.
%YAML 1.2
---
$id: http://devicetree.org/schemas/gpio/sprd,gpio-eic.yaml#
$schema: http://devicetree.org/meta-schemas/core.yaml#

title: Unisoc EIC controller

maintainers:
  - Orson Zhai <orsonzhai@gmail.com>
  - Baolin Wang <baolin.wang7@gmail.com>
  - Chunyan Zhang <zhang.lyra@gmail.com>

description: |
  The EIC is the abbreviation of external interrupt controller, which can
  be used only in input mode. The Spreadtrum platform has 2 EIC controllers,
  one is in digital chip, and another one is in PMIC. The digital chip EIC
  controller contains 4 sub-modules, i.e. EIC-debounce, EIC-latch, EIC-async and
  EIC-sync. But the PMIC EIC controller contains only one EIC-debounce sub-
  module.

  The EIC-debounce sub-module provides up to 8 source input signal
  connections. A debounce mechanism is used to capture the input signals'
  stable status (millisecond resolution) and a single-trigger mechanism
  is introduced into this sub-module to enhance the input event detection
  reliability. In addition, this sub-module's clock can be shut off
  automatically to reduce power dissipation. Moreover the debounce range
  is from 1ms to 4s with a step size of 1ms. The input signal will be
  ignored if it is asserted for less than 1 ms.

  The EIC-latch sub-module is used to latch some special power down signals
  and generate interrupts, since the EIC-latch does not depend on the APB
  clock to capture signals.

  The EIC-async sub-module uses a 32kHz clock to capture the short signals
  (microsecond resolution) to generate interrupts by level or edge trigger.

  The EIC-sync is similar with GPIO's input function, which is a synchronized
  signal input register. It can generate interrupts by level or edge trigger
  when detecting input signals.

properties:
  compatible:
    oneOf:
      - enum:
          - sprd,sc9860-eic-debounce
          - sprd,sc9860-eic-latch
          - sprd,sc9860-eic-async
          - sprd,sc9860-eic-sync
          - sprd,sc2731-eic
      - items:
          - enum:
              - sprd,ums512-eic-debounce
          - const: sprd,sc9860-eic-debounce
      - items:
          - enum:
              - sprd,ums512-eic-latch
          - const: sprd,sc9860-eic-latch
      - items:
          - enum:
              - sprd,ums512-eic-async
          - const: sprd,sc9860-eic-async
      - items:
          - enum:
              - sprd,ums512-eic-sync
          - const: sprd,sc9860-eic-sync
      - items:
          - enum:
              - sprd,sc2730-eic
          - const: sprd,sc2731-eic

  reg:
    minItems: 1
    maxItems: 3
    description:
      EIC controller can support maximum 3 banks which has its own
      address base.

  gpio-controller: true

  "#gpio-cells":
    const: 2

  interrupt-controller: true

  "#interrupt-cells":
    const: 2

  interrupts:
    maxItems: 1
    description:
      The interrupt shared by all GPIO lines for this controller.

required:
  - compatible
  - reg
  - gpio-controller
  - "#gpio-cells"
  - interrupt-controller
  - "#interrupt-cells"
  - interrupts

additionalProperties: false

examples:
  - |
    #include <dt-bindings/interrupt-controller/arm-gic.h>

    soc {
        #address-cells = <2>;
        #size-cells = <2>;

        eic_debounce: gpio@40210000 {
            compatible = "sprd,sc9860-eic-debounce";
            reg = <0 0x40210000 0 0x80>;
            gpio-controller;
            #gpio-cells = <2>;
            interrupt-controller;
            #interrupt-cells = <2>;
            interrupts = <GIC_SPI 52 IRQ_TYPE_LEVEL_HIGH>;
        };
    };
...
```

## Documentation/devicetree/bindings/gpio/sprd,gpio.yaml
```yaml
# SPDX-License-Identifier: (GPL-2.0-only OR BSD-2-Clause)
# Copyright 2022 Unisoc Inc.
%YAML 1.2
---
$id: http://devicetree.org/schemas/gpio/sprd,gpio.yaml#
$schema: http://devicetree.org/meta-schemas/core.yaml#

title: Unisoc GPIO controller

maintainers:
  - Orson Zhai <orsonzhai@gmail.com>
  - Baolin Wang <baolin.wang7@gmail.com>
  - Chunyan Zhang <zhang.lyra@gmail.com>

description: |
  The controller's registers are organized as sets of sixteen 16-bit
  registers with each set controlling a bank of up to 16 pins. A single
  interrupt is shared for all of the banks handled by the controller.

properties:
  compatible:
    oneOf:
      - const: sprd,sc9860-gpio
      - items:
          - enum:
              - sprd,ums512-gpio
          - const: sprd,sc9860-gpio

  reg:
    maxItems: 1

  gpio-controller: true

  "#gpio-cells":
    const: 2

  interrupt-controller: true

  "#interrupt-cells":
    const: 2

  interrupts:
    maxItems: 1
    description: The interrupt shared by all GPIO lines for this controller.

required:
  - compatible
  - reg
  - gpio-controller
  - "#gpio-cells"
  - interrupt-controller
  - "#interrupt-cells"
  - interrupts

additionalProperties: false

examples:
  - |
    #include <dt-bindings/interrupt-controller/arm-gic.h>

    soc {
        #address-cells = <2>;
        #size-cells = <2>;

        ap_gpio: gpio@40280000 {
            compatible = "sprd,sc9860-gpio";
            reg = <0 0x40280000 0 0x1000>;
            gpio-controller;
            #gpio-cells = <2>;
            interrupt-controller;
            #interrupt-cells = <2>;
            interrupts = <GIC_SPI 50 IRQ_TYPE_LEVEL_HIGH>;
        };
    };
...
```

## Documentation/devicetree/bindings/gpio/st,nomadik-gpio.yaml
```yaml
# SPDX-License-Identifier: (GPL-2.0-only OR BSD-2-Clause)
%YAML 1.2
---
$id: http://devicetree.org/schemas/gpio/st,nomadik-gpio.yaml#
$schema: http://devicetree.org/meta-schemas/core.yaml#

title: Nomadik GPIO controller

description:
  The Nomadik GPIO driver handles Nomadik SoC GPIO blocks. This block has also
  been called ST STA2X11. On the Nomadik platform, this driver is intertwined
  with pinctrl-nomadik.

maintainers:
  - Linus Walleij <linus.walleij@linaro.org>

properties:
  $nodename:
    pattern: "^gpio@[0-9a-f]+$"

  compatible:
    enum:
      - st,nomadik-gpio
      - mobileye,eyeq5-gpio

  reg:
    maxItems: 1

  interrupts:
    maxItems: 1

  "#gpio-cells":
    const: 2

  gpio-controller: true

  interrupt-controller: true

  "#interrupt-cells":
    const: 2

  gpio-bank:
    description: System-wide GPIO bank index.
    $ref: /schemas/types.yaml#/definitions/uint32

  st,supports-sleepmode:
    description: Whether the controller can sleep or not.
    $ref: /schemas/types.yaml#/definitions/flag

  clocks:
    maxItems: 1

  gpio-ranges:
    maxItems: 1

  ngpios:
    minimum: 0
    maximum: 32

  resets:
    maxItems: 1

required:
  - compatible
  - reg
  - interrupts
  - "#gpio-cells"
  - gpio-controller
  - interrupt-controller
  - gpio-bank

unevaluatedProperties: false

allOf:
  - if:
      properties:
        compatible:
          contains:
            const: mobileye,eyeq5-gpio
    then:
      properties:
        st,supports-sleepmode: false

examples:
  - |
    gpio@8012e080 {
        compatible = "st,nomadik-gpio";
        reg =  <0x8012e080 0x80>;
        interrupts = <0 120 0x4>;
        #gpio-cells = <2>;
        gpio-controller;
        #interrupt-cells = <2>;
        interrupt-controller;
        st,supports-sleepmode;
        gpio-bank = <1>;
    };
```

## Documentation/devicetree/bindings/gpio/st,spear-spics-gpio.yaml
```yaml
# SPDX-License-Identifier: (GPL-2.0-only OR BSD-2-Clause)
%YAML 1.2
---
$id: http://devicetree.org/schemas/gpio/st,spear-spics-gpio.yaml#
$schema: http://devicetree.org/meta-schemas/core.yaml#

title: ST Microelectronics SPEAr SPI CS GPIO Controller

maintainers:
  - Viresh Kumar <vireshk@kernel.org>

description: >
  SPEAr platform provides a provision to control chipselects of ARM PL022 Prime
  Cell spi controller through its system registers, which otherwise remains
  under PL022 control. If chipselect remain under PL022 control then they would
  be released as soon as transfer is over and TxFIFO becomes empty. This is not
  desired by some of the device protocols above spi which expect (multiple)
  transfers without releasing their chipselects.

  Chipselects can be controlled by software by turning them as GPIOs. SPEAr
  provides another interface through system registers through which software can
  directly control each PL022 chipselect. Hence, it is natural for SPEAr to
  export the control of this interface as gpio.

properties:
  compatible:
    const: st,spear-spics-gpio

  reg:
    maxItems: 1

  gpio-controller: true

  '#gpio-cells':
    const: 2

  st-spics,peripcfg-reg:
    description: Offset of the peripcfg register.
    $ref: /schemas/types.yaml#/definitions/uint32

  st-spics,sw-enable-bit:
    description: Bit offset to enable software chipselect control.
    $ref: /schemas/types.yaml#/definitions/uint32

  st-spics,cs-value-bit:
    description: Bit offset to drive chipselect low or high.
    $ref: /schemas/types.yaml#/definitions/uint32

  st-spics,cs-enable-mask:
    description: Bitmask selecting which chipselects to enable.
    $ref: /schemas/types.yaml#/definitions/uint32

  st-spics,cs-enable-shift:
    description: Bit shift for programming chipselect number.
    $ref: /schemas/types.yaml#/definitions/uint32

required:
  - compatible
  - reg
  - gpio-controller
  - '#gpio-cells'
  - st-spics,peripcfg-reg
  - st-spics,sw-enable-bit
  - st-spics,cs-value-bit
  - st-spics,cs-enable-mask
  - st-spics,cs-enable-shift

additionalProperties: false

examples:
  - |
    gpio@e0700000 {
        compatible = "st,spear-spics-gpio";
        reg = <0xe0700000 0x1000>;
        st-spics,peripcfg-reg = <0x3b0>;
        st-spics,sw-enable-bit = <12>;
        st-spics,cs-value-bit = <11>;
        st-spics,cs-enable-mask = <3>;
        st-spics,cs-enable-shift = <8>;
        gpio-controller;
        #gpio-cells = <2>;
    };
```

## Documentation/devicetree/bindings/gpio/st,stmpe-gpio.yaml
```yaml
# SPDX-License-Identifier: (GPL-2.0-only OR BSD-2-Clause)
%YAML 1.2
---
$id: http://devicetree.org/schemas/gpio/st,stmpe-gpio.yaml#
$schema: http://devicetree.org/meta-schemas/core.yaml#

title: STMicroelectonics Port Expander (STMPE) GPIO Block

description:
  STMicroelectronics Port Expander (STMPE) is a series of slow
  bus controllers for various expanded peripherals such as GPIO, keypad,
  touchscreen, ADC, PWM or rotator. It can contain one or several different
  peripherals connected to SPI or I2C. These bindings pertain to the
  GPIO portions of these expanders.

maintainers:
  - Linus Walleij <linus.walleij@linaro.org>

properties:
  compatible:
    const: st,stmpe-gpio

  "#gpio-cells":
    const: 2

  "#interrupt-cells":
    const: 2

  gpio-controller: true

  interrupt-controller: true

  st,norequest-mask:
    description:
      A bitmask of GPIO lines that cannot be requested because for
      for example not being connected to anything on the system
    $ref: /schemas/types.yaml#/definitions/uint32

patternProperties:
  "^.+-hog(-[0-9]+)?$":
    type: object

    required:
      - gpio-hog

additionalProperties: false

required:
  - compatible
  - "#gpio-cells"
  - "#interrupt-cells"
  - gpio-controller
  - interrupt-controller
```

## Documentation/devicetree/bindings/gpio/ti,7416374.yaml
```yaml
# SPDX-License-Identifier: (GPL-2.0-only OR BSD-2-Clause)
%YAML 1.2
---
$id: http://devicetree.org/schemas/gpio/ti,7416374.yaml#
$schema: http://devicetree.org/meta-schemas/core.yaml#

title: TI 74XX MMIO GPIO

maintainers:
  - Frank Li <Frank.Li@nxp.com>

properties:
  compatible:
    enum:
      - ti,741g125 # for 741G125 (1-bit Input),
      - ti,741g174 # for 741G74 (1-bit Output),
      - ti,742g125 # for 742G125 (2-bit Input),
      - ti,7474    # for 7474 (2-bit Output),
      - ti,74125   # for 74125 (4-bit Input),
      - ti,74175   # for 74175 (4-bit Output),
      - ti,74365   # for 74365 (6-bit Input),
      - ti,74174   # for 74174 (6-bit Output),
      - ti,74244   # for 74244 (8-bit Input),
      - ti,74273   # for 74273 (8-bit Output),
      - ti,741624  # for 741624 (16-bit Input),
      - ti,7416374 # for 7416374 (16-bit Output).

  reg:
    maxItems: 1

  gpio-controller: true

  '#gpio-cells':
    const: 2
    description: |
      The first cell is the pin number and
      the second cell is used to specify the GPIO polarity:
        0 = Active High,
        1 = Active Low.

required:
  - compatible
  - reg
  - gpio-controller
  - '#gpio-cells'

additionalProperties: false

examples:
  - |
    gpio@30008004 {
        compatible = "ti,74174";
        reg = <0x30008004 0x1>;
        gpio-controller;
        #gpio-cells = <2>;
    };
```
