## Documentation/devicetree/bindings/gpio/ti,keystone-dsp-gpio.yaml
```yaml
# SPDX-License-Identifier: (GPL-2.0-only OR BSD-2-Clause)
%YAML 1.2
---
$id: http://devicetree.org/schemas/gpio/ti,keystone-dsp-gpio.yaml#
$schema: http://devicetree.org/meta-schemas/core.yaml#

title: Keystone 2 DSP GPIO controller

maintainers:
  - Grygorii Strashko <grygorii.strashko@ti.com>

description: |
  HOST OS userland running on ARM can send interrupts to DSP cores using
  the DSP GPIO controller IP. It provides 28 IRQ signals per each DSP core.
  This is one of the component used by the IPC mechanism used on Keystone SOCs.

  For example TCI6638K2K SoC has 8 DSP GPIO controllers:
   - 8 for C66x CorePacx CPUs 0-7

  Keystone 2 DSP GPIO controller has specific features:
  - each GPIO can be configured only as output pin;
  - setting GPIO value to 1 causes IRQ generation on target DSP core;
  - reading pin value returns 0 - if IRQ was handled or 1 - IRQ is still
    pending.

properties:
  compatible:
    const: ti,keystone-dsp-gpio

  reg:
    maxItems: 1

  gpio-controller: true

  '#gpio-cells':
    const: 2

  gpio,syscon-dev:
    description:
      Phandle and offset of device's specific registers within the syscon state
      control registers
    $ref: /schemas/types.yaml#/definitions/phandle-array
    items:
      - items:
          - description: phandle to syscon
          - description: register offset within state control registers

required:
  - compatible
  - reg
  - gpio-controller
  - '#gpio-cells'
  - gpio,syscon-dev

additionalProperties: false

examples:
  - |
    gpio@240 {
        compatible = "ti,keystone-dsp-gpio";
        reg = <0x240 0x4>;
        gpio-controller;
        #gpio-cells = <2>;
        gpio,syscon-dev = <&devctrl 0x240>;
    };
```

## Documentation/devicetree/bindings/gpio/ti,omap-gpio.yaml
```yaml
# SPDX-License-Identifier: (GPL-2.0 OR BSD-2-Clause)
%YAML 1.2
---
$id: http://devicetree.org/schemas/gpio/ti,omap-gpio.yaml#
$schema: http://devicetree.org/meta-schemas/core.yaml#

title: OMAP GPIO controller

maintainers:
  - Grygorii Strashko <grygorii.strashko@ti.com>

description: |
  The general-purpose interface combines general-purpose input/output (GPIO) banks.
  Each GPIO banks provides up to 32 dedicated general-purpose pins with input
  and output capabilities; interrupt generation in active mode and wake-up
  request generation in idle mode upon the detection of external events.

properties:
  compatible:
    oneOf:
      - enum:
          - ti,omap2-gpio
          - ti,omap3-gpio
          - ti,omap4-gpio
      - items:
          - const: ti,am4372-gpio
          - const: ti,omap4-gpio

  reg:
    maxItems: 1

  gpio-controller: true

  '#gpio-cells':
    const: 2

  interrupt-controller: true

  '#interrupt-cells':
    const: 2

  interrupts:
    maxItems: 1

  gpio-ranges: true

  gpio-line-names:
    minItems: 1
    maxItems: 32

  ti,gpio-always-on:
    $ref: /schemas/types.yaml#/definitions/flag
    description:
      Indicates if a GPIO bank is always powered and will never lose its logic state.

  ti,hwmods:
    $ref: /schemas/types.yaml#/definitions/string
    deprecated: true
    description:
      Name of the hwmod associated with the GPIO. Needed on some legacy OMAP
      SoCs which have not been converted to the ti,sysc interconnect hierarchy.

  ti,no-reset-on-init:
    $ref: /schemas/types.yaml#/definitions/flag
    deprecated: true
    description:
      Do not reset on init. Used with ti,hwmods on some legacy OMAP SoCs which
      have not been converted to the ti,sysc interconnect hierarchy.

patternProperties:
  "^(.+-hog(-[0-9]+)?)$":
    type: object

    required:
      - gpio-hog

required:
  - compatible
  - reg
  - gpio-controller
  - "#gpio-cells"
  - interrupt-controller
  - "#interrupt-cells"
  - interrupts

additionalProperties: false

examples:
  - |
    #include <dt-bindings/gpio/gpio.h>

    gpio0: gpio@0 {
        compatible = "ti,omap4-gpio";
        reg = <0x0 0x1000>;
        gpio-controller;
        #gpio-cells = <2>;
        interrupt-controller;
        #interrupt-cells = <2>;
        interrupts = <96>;
        ti,gpio-always-on;

        ls-buf-en-hog {
            gpio-hog;
            gpios = <10 GPIO_ACTIVE_HIGH>;
            output-high;
            line-name = "LS_BUF_EN";
        };
    };
```

## Documentation/devicetree/bindings/gpio/ti,twl4030-gpio.yaml
```yaml
# SPDX-License-Identifier: (GPL-2.0-only OR BSD-2-Clause)
%YAML 1.2
---
$id: http://devicetree.org/schemas/gpio/ti,twl4030-gpio.yaml#
$schema: http://devicetree.org/meta-schemas/core.yaml#

title: TI TWL4030 GPIO controller

maintainers:
  - Aaro Koskinen <aaro.koskinen@iki.fi>
  - Andreas Kemnade <andreas@kemnade.info>
  - Kevin Hilman <khilman@baylibre.com>
  - Roger Quadros <rogerq@kernel.org>
  - Tony Lindgren <tony@atomide.com>

properties:
  compatible:
    const: ti,twl4030-gpio

  '#gpio-cells':
    const: 2

  gpio-controller: true

  '#interrupt-cells':
    const: 1

  interrupt-controller: true

  ti,debounce:
    description: Debounce control bits. Each bit corresponds to a GPIO pin.
    $ref: /schemas/types.yaml#/definitions/uint32

  ti,mmc-cd:
    description: MMC card detect control bits. Each bit corresponds to a GPIO pin for VMMC(n+1).
    $ref: /schemas/types.yaml#/definitions/uint32

  ti,pullups:
    description: Pull-up control bits. Each bit corresponds to a GPIO pin.
    $ref: /schemas/types.yaml#/definitions/uint32

  ti,pulldowns:
    description: Pull-down control bits. Each bit corresponds to a GPIO pin.
    $ref: /schemas/types.yaml#/definitions/uint32

  ti,use-leds:
    type: boolean
    description: Enables LEDA and LEDB outputs if set

additionalProperties: false

examples:
  - |
    gpio {
        compatible = "ti,twl4030-gpio";
        #gpio-cells = <2>;
        gpio-controller;
        #interrupt-cells = <1>;
        interrupt-controller;
        ti,use-leds;
    };
```

## Documentation/devicetree/bindings/gpio/toshiba,gpio-visconti.yaml
```yaml
# SPDX-License-Identifier: (GPL-2.0 OR BSD-2-Clause)
%YAML 1.2
---
$id: http://devicetree.org/schemas/gpio/toshiba,gpio-visconti.yaml#
$schema: http://devicetree.org/meta-schemas/core.yaml#

title: Toshiba Visconti ARM SoCs GPIO controller

maintainers:
  - Nobuhiro Iwamatsu <nobuhiro1.iwamatsu@toshiba.co.jp>

properties:
  compatible:
    items:
      - const: toshiba,gpio-tmpv7708

  reg:
    maxItems: 1

  "#gpio-cells":
    const: 2

  gpio-ranges: true

  gpio-controller: true

  interrupt-controller: true

  "#interrupt-cells":
    const: 2

  interrupts:
    description:
      interrupt mapping one per GPIO.
    minItems: 16
    maxItems: 16

required:
  - compatible
  - reg
  - "#gpio-cells"
  - gpio-ranges
  - gpio-controller
  - interrupt-controller
  - "#interrupt-cells"

additionalProperties: false

examples:
  - |
    #include <dt-bindings/interrupt-controller/irq.h>
    #include <dt-bindings/interrupt-controller/arm-gic.h>

    soc {
        #address-cells = <2>;
        #size-cells = <2>;

        gpio: gpio@28020000 {
            compatible = "toshiba,gpio-tmpv7708";
            reg = <0 0x28020000 0 0x1000>;
            #gpio-cells = <0x2>;
            gpio-ranges = <&pmux 0 0 32>;
            gpio-controller;
            interrupt-controller;
            #interrupt-cells = <2>;
            interrupt-parent = <&gic>;
        };
    };
...
```

## Documentation/devicetree/bindings/gpio/trivial-gpio.yaml
```yaml
# SPDX-License-Identifier: (GPL-2.0-only OR BSD-2-Clause)
%YAML 1.2
---
$id: http://devicetree.org/schemas/gpio/trivial-gpio.yaml#
$schema: http://devicetree.org/meta-schemas/core.yaml#

title: Trivial 2-cell GPIO controllers

maintainers:
  - Bartosz Golaszewski <brgl@bgdev.pl>

properties:
  compatible:
    oneOf:
      - items:
          - enum:
              - cirrus,ep7312-gpio
          - const: cirrus,ep7209-gpio
      - enum:
          - apm,xgene-gpio
          - cirrus,ep7209-gpio
          - cznic,moxtet-gpio
          - dlg,slg7xl45106
          - fcs,fxl6408
          - gateworks,pld-gpio
          - ibm,ppc4xx-gpio
          - loongson,ls1x-gpio
          - maxim,max77620
          - nintendo,hollywood-gpio
          - nxp,pca9570
          - nxp,pca9571
          - rockchip,rk3328-grf-gpio
          - snps,creg-gpio-hsdk
          - technologic,ts4800-gpio
          - technologic,ts4900-gpio
          - technologic,ts7970-gpio
          - ti,741g125 # for 741G125 (1-bit Input),
          - ti,741g174 # for 741G74 (1-bit Output),
          - ti,742g125 # for 742G125 (2-bit Input),
          - ti,7474    # for 7474 (2-bit Output),
          - ti,74125   # for 74125 (4-bit Input),
          - ti,74175   # for 74175 (4-bit Output),
          - ti,74365   # for 74365 (6-bit Input),
          - ti,74174   # for 74174 (6-bit Output),
          - ti,74244   # for 74244 (8-bit Input),
          - ti,74273   # for 74273 (8-bit Output),
          - ti,741624  # for 741624 (16-bit Input),
          - ti,7416374 # for 7416374 (16-bit Output).
          - ti,lp3943-gpio
          - ti,palmas-gpio
          - ti,tpic2810
          - ti,tps80036-gpio
          - ti,tps65913-gpio
          - ti,tps65914-gpio

  reg:
    maxItems: 1

  '#gpio-cells':
    const: 2

  gpio-controller: true

  gpio-line-names: true

  ngpios: true

  # Don't add more properties

patternProperties:
  "^(hog-[0-9]+|.+-hog(-[0-9]+)?)$":
    type: object
    required:
      - gpio-hog

required:
  - compatible
  - '#gpio-cells'
  - gpio-controller

allOf:
  - if:
      properties:
        compatible:
          contains:
            enum:
              - maxim,max77620
              - rockchip,rk3328-grf-gpio
              - ti,lp3943-gpio
              - ti,palmas-gpio
              - ti,tps80036-gpio
              - ti,tps65913-gpio
              - ti,tps65914-gpio
    then:
      properties:
        reg: false
    else:
      required:
        - reg

additionalProperties: false

examples:
  - |
    gpio@1701c000 {
        compatible = "apm,xgene-gpio";
        reg = <0x1701c000 0x40>;
        gpio-controller;
        #gpio-cells = <2>;
    };
```
