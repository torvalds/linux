## Documentation/devicetree/bindings/gpio/sifive,gpio.yaml
```yaml
# SPDX-License-Identifier: (GPL-2.0 OR BSD-2-Clause)
%YAML 1.2
---
$id: http://devicetree.org/schemas/gpio/sifive,gpio.yaml#
$schema: http://devicetree.org/meta-schemas/core.yaml#

title: SiFive GPIO controller

maintainers:
  - Paul Walmsley <paul.walmsley@sifive.com>

properties:
  compatible:
    items:
      - enum:
          - sifive,fu540-c000-gpio
          - sifive,fu740-c000-gpio
          - canaan,k210-gpiohs
      - const: sifive,gpio0

  reg:
    maxItems: 1

  interrupts:
    description:
      Interrupt mapping, one per GPIO. Maximum 32 GPIOs.
    minItems: 1
    maxItems: 32

  interrupt-controller: true

  "#interrupt-cells":
    const: 2

  clocks:
    maxItems: 1

  "#gpio-cells":
    const: 2

  ngpios:
    description:
      The number of GPIOs available on the controller implementation.
      It is 16 for the SiFive SoCs and 32 for the Canaan K210.
    minimum: 1
    maximum: 32
    default: 16

  gpio-line-names:
    minItems: 1
    maxItems: 32

  gpio-controller: true

required:
  - compatible
  - reg
  - interrupts
  - interrupt-controller
  - "#interrupt-cells"
  - "#gpio-cells"
  - gpio-controller

if:
  properties:
    compatible:
      contains:
        enum:
          - sifive,fu540-c000-gpio
          - sifive,fu740-c000-gpio
then:
  required:
    - clocks

additionalProperties: false

examples:
  - |
    #include <dt-bindings/clock/sifive-fu540-prci.h>
    gpio@10060000 {
        compatible = "sifive,fu540-c000-gpio", "sifive,gpio0";
        interrupt-parent = <&plic>;
        interrupts = <7>, <8>, <9>, <10>, <11>, <12>, <13>, <14>, <15>, <16>,
                     <17>, <18>, <19>, <20>, <21>, <22>;
        reg = <0x10060000 0x1000>;
        clocks = <&tlclk FU540_PRCI_CLK_TLCLK>;
        gpio-controller;
        #gpio-cells = <2>;
        interrupt-controller;
        #interrupt-cells = <2>;
    };

...
```

## Documentation/devicetree/bindings/gpio/snps,creg-gpio.txt
```
Synopsys GPIO via CREG (Control REGisters) driver

Required properties:
- compatible : "snps,creg-gpio-hsdk" or "snps,creg-gpio-axs10x".
- reg : Exactly one register range with length 0x4.
- #gpio-cells : Since the generic GPIO binding is used, the
  amount of cells must be specified as 2. The first cell is the
  pin number, the second cell is used to specify optional parameters:
  See "gpio-specifier" in .../devicetree/bindings/gpio/gpio.txt.
- gpio-controller : Marks the device node as a GPIO controller.
- ngpios: Number of GPIO pins.

Example:

gpio: gpio@f00014b0 {
	compatible = "snps,creg-gpio-hsdk";
	reg = <0xf00014b0 0x4>;
	gpio-controller;
	#gpio-cells = <2>;
	ngpios = <2>;
};
```

## Documentation/devicetree/bindings/gpio/snps,dw-apb-gpio.yaml
```yaml
# SPDX-License-Identifier: (GPL-2.0 OR BSD-2-Clause)
%YAML 1.2
---
$id: http://devicetree.org/schemas/gpio/snps,dw-apb-gpio.yaml#
$schema: http://devicetree.org/meta-schemas/core.yaml#

title: Synopsys DesignWare APB GPIO controller

description: |
  Synopsys DesignWare GPIO controllers have a configurable number of ports,
  each of which are intended to be represented as child nodes with the generic
  GPIO-controller properties as desribed in this bindings file.

maintainers:
  - Hoan Tran <hoan@os.amperecomputing.com>
  - Serge Semin <fancer.lancer@gmail.com>

properties:
  $nodename:
    pattern: "^gpio@[0-9a-f]+$"

  compatible:
    const: snps,dw-apb-gpio

  "#address-cells":
    const: 1

  "#size-cells":
    const: 0

  reg:
    maxItems: 1

  clocks:
    minItems: 1
    items:
      - description: APB interface clock source
      - description: DW GPIO debounce reference clock source

  clock-names:
    minItems: 1
    items:
      - const: bus
      - const: db

  resets:
    maxItems: 1

patternProperties:
  "^gpio-(port|controller)@[0-9a-f]+$":
    type: object
    properties:
      compatible:
        const: snps,dw-apb-gpio-port

      reg:
        maxItems: 1

      gpio-controller: true

      '#gpio-cells':
        const: 2

      gpio-line-names:
        minItems: 1
        maxItems: 32

      ngpios:
        default: 32
        minimum: 1
        maximum: 32

      snps,nr-gpios:
        description: The number of GPIO pins exported by the port.
        deprecated: true
        $ref: /schemas/types.yaml#/definitions/uint32
        default: 32
        minimum: 1
        maximum: 32

      interrupts:
        description: |
          The interrupts to the parent controller raised when GPIOs generate
          the interrupts. If the controller provides one combined interrupt
          for all GPIOs, specify a single interrupt. If the controller provides
          one interrupt for each GPIO, provide a list of interrupts that
          correspond to each of the GPIO pins.
        minItems: 1
        maxItems: 32

      interrupt-controller: true

      '#interrupt-cells':
        const: 2

    required:
      - compatible
      - reg
      - gpio-controller
      - '#gpio-cells'

    dependencies:
      interrupt-controller: [ interrupts ]

    additionalProperties: false

additionalProperties: false

required:
  - compatible
  - reg
  - "#address-cells"
  - "#size-cells"

examples:
  - |
    gpio: gpio@20000 {
      compatible = "snps,dw-apb-gpio";
      reg = <0x20000 0x1000>;
      #address-cells = <1>;
      #size-cells = <0>;

      porta: gpio-port@0 {
        compatible = "snps,dw-apb-gpio-port";
        reg = <0>;
        gpio-controller;
        #gpio-cells = <2>;
        snps,nr-gpios = <8>;
        interrupt-controller;
        #interrupt-cells = <2>;
        interrupt-parent = <&vic1>;
        interrupts = <0>;
      };

      portb: gpio-port@1 {
        compatible = "snps,dw-apb-gpio-port";
        reg = <1>;
        gpio-controller;
        #gpio-cells = <2>;
        snps,nr-gpios = <8>;
      };
    };
...
```

## Documentation/devicetree/bindings/gpio/snps-dwapb-gpio.txt
```
* Synopsys DesignWare APB GPIO controller

Required properties:
- compatible : Should contain "snps,dw-apb-gpio"
- reg : Address and length of the register set for the device.
- #address-cells : should be 1 (for addressing port subnodes).
- #size-cells : should be 0 (port subnodes).

The GPIO controller has a configurable number of ports, each of which are
represented as child nodes with the following properties:

Required properties:
- compatible : "snps,dw-apb-gpio-port"
- gpio-controller : Marks the device node as a gpio controller.
- #gpio-cells : Should be two.  The first cell is the pin number and
  the second cell is used to specify the gpio polarity:
      0 = active high
      1 = active low
- reg : The integer port index of the port, a single cell.

Optional properties:
- interrupt-controller : The first port may be configured to be an interrupt
controller.
- #interrupt-cells : Specifies the number of cells needed to encode an
  interrupt.  Shall be set to 2.  The first cell defines the interrupt number,
  the second encodes the triger flags encoded as described in
  Documentation/devicetree/bindings/interrupt-controller/interrupts.txt
- interrupts : The interrupts to the parent controller raised when GPIOs
  generate the interrupts. If the controller provides one combined interrupt
  for all GPIOs, specify a single interrupt. If the controller provides one
  interrupt for each GPIO, provide a list of interrupts that correspond to each
  of the GPIO pins. When specifying multiple interrupts, if any are unconnected,
  use the interrupts-extended property to specify the interrupts and set the
  interrupt controller handle for unused interrupts to 0.
- snps,nr-gpios : The number of pins in the port, a single cell.
- resets : Reset line for the controller.

Example:

gpio: gpio@20000 {
	compatible = "snps,dw-apb-gpio";
	reg = <0x20000 0x1000>;
	#address-cells = <1>;
	#size-cells = <0>;

	porta: gpio@0 {
		compatible = "snps,dw-apb-gpio-port";
		gpio-controller;
		#gpio-cells = <2>;
		snps,nr-gpios = <8>;
		reg = <0>;
		interrupt-controller;
		#interrupt-cells = <2>;
		interrupt-parent = <&vic1>;
		interrupts = <0>;
	};

	portb: gpio@1 {
		compatible = "snps,dw-apb-gpio-port";
		gpio-controller;
		#gpio-cells = <2>;
		snps,nr-gpios = <8>;
		reg = <1>;
	};
};
```

## Documentation/devicetree/bindings/gpio/socionext,uniphier-gpio.yaml
```yaml
# SPDX-License-Identifier: GPL-2.0-only OR BSD-2-Clause
%YAML 1.2
---
$id: http://devicetree.org/schemas/gpio/socionext,uniphier-gpio.yaml#
$schema: http://devicetree.org/meta-schemas/core.yaml#

title: UniPhier GPIO controller

maintainers:
  - Masahiro Yamada <yamada.masahiro@socionext.com>

properties:
  $nodename:
    pattern: "^gpio@[0-9a-f]+$"

  compatible:
    const: socionext,uniphier-gpio

  reg:
    maxItems: 1

  gpio-controller: true

  "#gpio-cells":
    const: 2

  interrupt-controller: true

  "#interrupt-cells":
    description: |
      The first cell defines the interrupt number.
      The second cell bits[3:0] is used to specify trigger type as follows:
        1 = low-to-high edge triggered
        2 = high-to-low edge triggered
        4 = active high level-sensitive
        8 = active low level-sensitive
      Valid combinations are 1, 2, 3, 4, 8.
    const: 2

  ngpios:
    minimum: 0
    maximum: 512

  gpio-ranges: true

  gpio-ranges-group-names:
    $ref: /schemas/types.yaml#/definitions/string-array

  socionext,interrupt-ranges:
    description: |
      Specifies an interrupt number mapping between this GPIO controller and
      its interrupt parent, in the form of arbitrary number of
      <child-interrupt-base parent-interrupt-base length> triplets.
    $ref: /schemas/types.yaml#/definitions/uint32-matrix

required:
  - compatible
  - reg
  - gpio-controller
  - "#gpio-cells"
  - interrupt-controller
  - "#interrupt-cells"
  - ngpios
  - gpio-ranges
  - socionext,interrupt-ranges

additionalProperties: false

examples:
  - |
    #include <dt-bindings/gpio/gpio.h>
    #include <dt-bindings/gpio/uniphier-gpio.h>

    gpio: gpio@55000000 {
        compatible = "socionext,uniphier-gpio";
        reg = <0x55000000 0x200>;
        interrupt-parent = <&aidet>;
        interrupt-controller;
        #interrupt-cells = <2>;
        gpio-controller;
        #gpio-cells = <2>;
        gpio-ranges = <&pinctrl 0 0 0>;
        gpio-ranges-group-names = "gpio_range";
        ngpios = <248>;
        socionext,interrupt-ranges = <0 48 16>, <16 154 5>, <21 217 3>;
    };

    // Consumer:
    // Please note UNIPHIER_GPIO_PORT(29, 4) represents PORT294 in the SoC
    // document. Unfortunately, only the one's place is octal in the port
    // numbering. (That is, PORT 8, 9, 18, 19, 28, 29, ... do not exist.)
    // UNIPHIER_GPIO_PORT() is a helper macro to calculate 29 * 8 + 4.
    sdhci0_pwrseq {
        compatible = "mmc-pwrseq-emmc";
        reset-gpios = <&gpio UNIPHIER_GPIO_PORT(29, 4) GPIO_ACTIVE_LOW>;
    };
```

## Documentation/devicetree/bindings/gpio/sodaville.txt
```
GPIO controller on CE4100 / Sodaville SoCs
==========================================

The bindings for CE4100's GPIO controller match the generic description
which is covered by the gpio.txt file in this folder.

The only additional property is the intel,muxctl property which holds the
value which is written into the MUXCNTL register.

There is no compatible property for now because the driver is probed via
PCI id (vendor 0x8086 device 0x2e67).

The interrupt specifier consists of two cells encoded as follows:
 - <1st cell>: The interrupt-number that identifies the interrupt source.
 - <2nd cell>: The level-sense information, encoded as follows:
		4 - active high level-sensitive
		8 - active low level-sensitive

Example of the GPIO device and one user:

	pcigpio: gpio@b,1 {
			/* two cells for GPIO and interrupt */
			#gpio-cells = <2>;
			#interrupt-cells = <2>;
			compatible = "pci8086,2e67.2",
					   "pci8086,2e67",
					   "pciclassff0000",
					   "pciclassff00";

			reg = <0x15900 0x0 0x0 0x0 0x0>;
			/* Interrupt line of the gpio device */
			interrupts = <15 1>;
			/* It is an interrupt and GPIO controller itself */
			interrupt-controller;
			gpio-controller;
			intel,muxctl = <0>;
	};

	testuser@20 {
			compatible = "example,testuser";
			/* User the 11th GPIO line as an active high triggered
			 * level interrupt
			 */
			interrupts = <11 8>;
			interrupt-parent = <&pcigpio>;
			/* Use this GPIO also with the gpio functions */
			gpios = <&pcigpio 11 0>;
	};
```

## Documentation/devicetree/bindings/gpio/spacemit,k1-gpio.yaml
```yaml
# SPDX-License-Identifier: (GPL-2.0-only OR BSD-2-Clause)
%YAML 1.2
---
$id: http://devicetree.org/schemas/gpio/spacemit,k1-gpio.yaml#
$schema: http://devicetree.org/meta-schemas/core.yaml#

title: SpacemiT K1 GPIO controller

maintainers:
  - Yixun Lan <dlan@gentoo.org>

description:
  The controller's registers are organized as sets of eight 32-bit
  registers with each set of port controlling 32 pins.  A single
  interrupt line is shared for all of the pins by the controller.

properties:
  $nodename:
    pattern: "^gpio@[0-9a-f]+$"

  compatible:
    const: spacemit,k1-gpio

  reg:
    maxItems: 1

  clocks:
    items:
      - description: GPIO Core Clock
      - description: GPIO Bus Clock

  clock-names:
    items:
      - const: core
      - const: bus

  resets:
    maxItems: 1

  gpio-controller: true

  "#gpio-cells":
    const: 3
    description:
      The first two cells are the GPIO bank index and offset inside the bank,
      the third cell should specify GPIO flag.

  gpio-ranges: true

  interrupts:
    maxItems: 1

  interrupt-controller: true

  "#interrupt-cells":
    const: 3
    description:
      The first two cells are the GPIO bank index and offset inside the bank,
      the third cell should specify interrupt flag. The controller does not
      support level interrupts, so flags of IRQ_TYPE_LEVEL_HIGH,
      IRQ_TYPE_LEVEL_LOW should not be used.
      Refer <dt-bindings/interrupt-controller/irq.h> for valid flags.

required:
  - compatible
  - reg
  - clocks
  - clock-names
  - gpio-controller
  - "#gpio-cells"
  - interrupts
  - interrupt-controller
  - "#interrupt-cells"
  - gpio-ranges

additionalProperties: false

examples:
  - |
    gpio@d4019000 {
      compatible = "spacemit,k1-gpio";
      reg = <0xd4019000 0x800>;
      clocks = <&ccu 9>, <&ccu 61>;
      clock-names = "core", "bus";
      gpio-controller;
      #gpio-cells = <3>;
      interrupts = <58>;
      interrupt-controller;
      interrupt-parent = <&plic>;
      #interrupt-cells = <3>;
      gpio-ranges = <&pinctrl 0 0 0 32>,
                    <&pinctrl 1 0 32 32>,
                    <&pinctrl 2 0 64 32>,
                    <&pinctrl 3 0 96 32>;
    };
...
```
