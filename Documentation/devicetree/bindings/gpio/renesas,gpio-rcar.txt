## Documentation/devicetree/bindings/gpio/renesas,gpio-rcar.txt
```
* Renesas R-Car GPIO Controller

Required Properties:

  - compatible: should contain one or more of the following:
    - "renesas,gpio-r8a7743": for R8A7743 (RZ/G1M) compatible GPIO controller.
    - "renesas,gpio-r8a7744": for R8A7744 (RZ/G1N) compatible GPIO controller.
    - "renesas,gpio-r8a7745": for R8A7745 (RZ/G1E) compatible GPIO controller.
    - "renesas,gpio-r8a77470": for R8A77470 (RZ/G1C) compatible GPIO controller.
    - "renesas,gpio-r8a774a1": for R8A774A1 (RZ/G2M) compatible GPIO controller.
    - "renesas,gpio-r8a774b1": for R8A774B1 (RZ/G2N) compatible GPIO controller.
    - "renesas,gpio-r8a774c0": for R8A774C0 (RZ/G2E) compatible GPIO controller.
    - "renesas,gpio-r8a7778": for R8A7778 (R-Car M1) compatible GPIO controller.
    - "renesas,gpio-r8a7779": for R8A7779 (R-Car H1) compatible GPIO controller.
    - "renesas,gpio-r8a7790": for R8A7790 (R-Car H2) compatible GPIO controller.
    - "renesas,gpio-r8a7791": for R8A7791 (R-Car M2-W) compatible GPIO controller.
    - "renesas,gpio-r8a7792": for R8A7792 (R-Car V2H) compatible GPIO controller.
    - "renesas,gpio-r8a7793": for R8A7793 (R-Car M2-N) compatible GPIO controller.
    - "renesas,gpio-r8a7794": for R8A7794 (R-Car E2) compatible GPIO controller.
    - "renesas,gpio-r8a7795": for R8A7795 (R-Car H3) compatible GPIO controller.
    - "renesas,gpio-r8a7796": for R8A7796 (R-Car M3-W) compatible GPIO controller.
    - "renesas,gpio-r8a77965": for R8A77965 (R-Car M3-N) compatible GPIO controller.
    - "renesas,gpio-r8a77970": for R8A77970 (R-Car V3M) compatible GPIO controller.
    - "renesas,gpio-r8a77980": for R8A77980 (R-Car V3H) compatible GPIO controller.
    - "renesas,gpio-r8a77990": for R8A77990 (R-Car E3) compatible GPIO controller.
    - "renesas,gpio-r8a77995": for R8A77995 (R-Car D3) compatible GPIO controller.
    - "renesas,rcar-gen1-gpio": for a generic R-Car Gen1 GPIO controller.
    - "renesas,rcar-gen2-gpio": for a generic R-Car Gen2 or RZ/G1 GPIO controller.
    - "renesas,rcar-gen3-gpio": for a generic R-Car Gen3 or RZ/G2 GPIO controller.
    - "renesas,gpio-rcar": deprecated.

    When compatible with the generic version nodes must list the
    SoC-specific version corresponding to the platform first followed by
    the generic version.

  - reg: Base address and length of each memory resource used by the GPIO
    controller hardware module.

  - interrupts: Interrupt specifier for the controllers interrupt.

  - gpio-controller: Marks the device node as a gpio controller.
  - #gpio-cells: Should be 2. The first cell is the GPIO number and the second
    cell specifies GPIO flags, as defined in <dt-bindings/gpio/gpio.h>. Only the
    GPIO_ACTIVE_HIGH and GPIO_ACTIVE_LOW flags are supported.
  - gpio-ranges: See gpio.txt.

Optional properties:

  - clocks: Must contain a reference to the functional clock.  The property is
    mandatory if the hardware implements a controllable functional clock for
    the GPIO instance.

  - gpio-reserved-ranges: See gpio.txt.

Please refer to gpio.txt in this directory for the common GPIO bindings used by
client devices.

The GPIO controller also acts as an interrupt controller. It uses the default
two cells specifier as described in Documentation/devicetree/bindings/
interrupt-controller/interrupts.txt.

Example: R8A77470 (RZ/G1C) GPIO controller nodes

       gpio0: gpio@e6050000 {
                compatible = "renesas,gpio-r8a77470",
                             "renesas,rcar-gen2-gpio";
                reg = <0 0xe6050000 0 0x50>;
                interrupts = <GIC_SPI 4 IRQ_TYPE_LEVEL_HIGH>;
                #gpio-cells = <2>;
                gpio-controller;
                gpio-ranges = <&pfc 0 0 23>;
                #interrupt-cells = <2>;
                interrupt-controller;
                clocks = <&cpg CPG_MOD 912>;
                power-domains = <&sysc R8A77470_PD_ALWAYS_ON>;
                resets = <&cpg 912>;
        };
	...
       gpio3: gpio@e6053000 {
                compatible = "renesas,gpio-r8a77470",
                             "renesas,rcar-gen2-gpio";
                reg = <0 0xe6053000 0 0x50>;
                interrupts = <GIC_SPI 7 IRQ_TYPE_LEVEL_HIGH>;
                #gpio-cells = <2>;
                gpio-controller;
                gpio-ranges = <&pfc 0 96 30>;
                gpio-reserved-ranges = <17 10>;
                #interrupt-cells = <2>;
                interrupt-controller;
                clocks = <&cpg CPG_MOD 909>;
                power-domains = <&sysc R8A77470_PD_ALWAYS_ON>;
                resets = <&cpg 909>;
        };
```

## Documentation/devicetree/bindings/gpio/renesas,rcar-gpio.yaml
```yaml
# SPDX-License-Identifier: (GPL-2.0-only OR BSD-2-Clause)
%YAML 1.2
---
$id: http://devicetree.org/schemas/gpio/renesas,rcar-gpio.yaml#
$schema: http://devicetree.org/meta-schemas/core.yaml#

title: Renesas R-Car General-Purpose Input/Output Ports (GPIO)

maintainers:
  - Geert Uytterhoeven <geert+renesas@glider.be>

properties:
  compatible:
    oneOf:
      - items:
          - enum:
              - renesas,gpio-r8a7778      # R-Car M1
              - renesas,gpio-r8a7779      # R-Car H1
          - const: renesas,rcar-gen1-gpio # R-Car Gen1

      - items:
          - enum:
              - renesas,gpio-r8a7742      # RZ/G1H
              - renesas,gpio-r8a7743      # RZ/G1M
              - renesas,gpio-r8a7744      # RZ/G1N
              - renesas,gpio-r8a7745      # RZ/G1E
              - renesas,gpio-r8a77470     # RZ/G1C
              - renesas,gpio-r8a7790      # R-Car H2
              - renesas,gpio-r8a7791      # R-Car M2-W
              - renesas,gpio-r8a7792      # R-Car V2H
              - renesas,gpio-r8a7793      # R-Car M2-N
              - renesas,gpio-r8a7794      # R-Car E2
          - const: renesas,rcar-gen2-gpio # R-Car Gen2 or RZ/G1

      - items:
          - enum:
              - renesas,gpio-r8a774a1     # RZ/G2M
              - renesas,gpio-r8a774b1     # RZ/G2N
              - renesas,gpio-r8a774c0     # RZ/G2E
              - renesas,gpio-r8a774e1     # RZ/G2H
              - renesas,gpio-r8a7795      # R-Car H3
              - renesas,gpio-r8a7796      # R-Car M3-W
              - renesas,gpio-r8a77961     # R-Car M3-W+
              - renesas,gpio-r8a77965     # R-Car M3-N
              - renesas,gpio-r8a77970     # R-Car V3M
              - renesas,gpio-r8a77980     # R-Car V3H
              - renesas,gpio-r8a77990     # R-Car E3
              - renesas,gpio-r8a77995     # R-Car D3
          - const: renesas,rcar-gen3-gpio # R-Car Gen3 or RZ/G2

      - items:
          - enum:
              - renesas,gpio-r8a779a0     # R-Car V3U
              - renesas,gpio-r8a779f0     # R-Car S4-8
              - renesas,gpio-r8a779g0     # R-Car V4H
              - renesas,gpio-r8a779h0     # R-Car V4M
          - const: renesas,rcar-gen4-gpio # R-Car Gen4

  reg:
    maxItems: 1

  interrupts:
    maxItems: 1

  clocks:
    maxItems: 1

  power-domains:
    maxItems: 1

  resets:
    maxItems: 1

  gpio-controller: true

  '#gpio-cells':
    const: 2

  interrupt-controller: true

  '#interrupt-cells':
    const: 2

  gpio-ranges:
    maxItems: 1

  gpio-reserved-ranges:
    minItems: 1
    maxItems: 8

patternProperties:
  "^.*$":
    if:
      type: object
    then:
      properties:
        gpio-hog: true
        gpios: true
        input: true
        output-high: true
        output-low: true
        line-name: true

      required:
        - gpio-hog
        - gpios

      additionalProperties: false

required:
  - compatible
  - reg
  - interrupts
  - gpio-controller
  - '#gpio-cells'
  - gpio-ranges
  - interrupt-controller
  - '#interrupt-cells'

if:
  not:
    properties:
      compatible:
        contains:
          enum:
            - renesas,rcar-gen1-gpio
then:
  required:
    - clocks
    - power-domains
    - resets

additionalProperties: false

examples:
  - |
    #include <dt-bindings/clock/r8a77470-cpg-mssr.h>
    #include <dt-bindings/interrupt-controller/arm-gic.h>
    #include <dt-bindings/power/r8a77470-sysc.h>
    gpio3: gpio@e6053000 {
            compatible = "renesas,gpio-r8a77470", "renesas,rcar-gen2-gpio";
            reg = <0xe6053000 0x50>;
            interrupts = <GIC_SPI 7 IRQ_TYPE_LEVEL_HIGH>;
            clocks = <&cpg CPG_MOD 909>;
            power-domains = <&sysc R8A77470_PD_ALWAYS_ON>;
            resets = <&cpg 909>;
            gpio-controller;
            #gpio-cells = <2>;
            gpio-ranges = <&pfc 0 96 30>;
            gpio-reserved-ranges = <17 10>;
            interrupt-controller;
            #interrupt-cells = <2>;
     };
```

## Documentation/devicetree/bindings/gpio/rockchip,gpio-bank.yaml
```yaml
# SPDX-License-Identifier: GPL-2.0
%YAML 1.2
---
$id: http://devicetree.org/schemas/gpio/rockchip,gpio-bank.yaml#
$schema: http://devicetree.org/meta-schemas/core.yaml#

title: Rockchip GPIO bank

maintainers:
  - Heiko Stuebner <heiko@sntech.de>

properties:
  compatible:
    enum:
      - rockchip,gpio-bank
      - rockchip,rk3188-gpio-bank0

  reg:
    maxItems: 1

  interrupts:
    maxItems: 1

  clocks:
    minItems: 1
    items:
      - description: APB interface clock source
      - description: GPIO debounce reference clock source

  gpio-controller: true

  "#gpio-cells":
    const: 2

  interrupt-controller: true

  "#interrupt-cells":
    const: 2

required:
  - compatible
  - reg
  - interrupts
  - clocks
  - gpio-controller
  - "#gpio-cells"
  - interrupt-controller
  - "#interrupt-cells"

additionalProperties: false

examples:
  - |
    #include <dt-bindings/interrupt-controller/arm-gic.h>
    pinctrl: pinctrl {
      #address-cells = <1>;
      #size-cells = <1>;
      ranges;

      gpio0: gpio@2000a000 {
        compatible = "rockchip,rk3188-gpio-bank0";
        reg = <0x2000a000 0x100>;
        interrupts = <GIC_SPI 54 IRQ_TYPE_LEVEL_HIGH>;
        clocks = <&clk_gates8 9>;

        gpio-controller;
        #gpio-cells = <2>;

        interrupt-controller;
        #interrupt-cells = <2>;
      };

      gpio1: gpio@2003c000 {
        compatible = "rockchip,gpio-bank";
        reg = <0x2003c000 0x100>;
        interrupts = <GIC_SPI 55 IRQ_TYPE_LEVEL_HIGH>;
        clocks = <&clk_gates8 10>;

        gpio-controller;
        #gpio-cells = <2>;

        interrupt-controller;
        #interrupt-cells = <2>;
      };
    };
```

## Documentation/devicetree/bindings/gpio/rockchip,rk3328-grf-gpio.txt
```
Rockchip RK3328 GRF (General Register Files) GPIO controller.

In Rockchip RK3328, the output only GPIO_MUTE pin, originally for codec mute
control, can also be used for general purpose. It is manipulated by the
GRF_SOC_CON10 register in GRF. Aside from the GPIO_MUTE pin, the HDMI pins can
also be set in the same way.

Currently this GPIO controller only supports the mute pin. If needed in the
future, the HDMI pins support can also be added.

Required properties:
- compatible: Should contain "rockchip,rk3328-grf-gpio".
- gpio-controller: Marks the device node as a gpio controller.
- #gpio-cells: Should be 2. The first cell is the pin number and
  the second cell is used to specify the gpio polarity:
    0 = Active high,
    1 = Active low.

Example:

	grf: syscon@ff100000 {
		compatible = "rockchip,rk3328-grf", "syscon", "simple-mfd";

		grf_gpio: grf-gpio {
			compatible = "rockchip,rk3328-grf-gpio";
			gpio-controller;
			#gpio-cells = <2>;
		};
	};

Note: The grf_gpio node should be declared as the child of the GRF (General
Register File) node. The GPIO_MUTE pin is referred to as <&grf_gpio 0>.
```

## Documentation/devicetree/bindings/gpio/rockchip,rk3328-grf-gpio.yaml
```yaml
# SPDX-License-Identifier: GPL-2.0
%YAML 1.2
---
$id: http://devicetree.org/schemas/gpio/rockchip,rk3328-grf-gpio.yaml#
$schema: http://devicetree.org/meta-schemas/core.yaml#

title: Rockchip RK3328 General Register Files GPIO controller

description:
  The Rockchip RK3328 General Register File (GRF) outputs only the
  GPIO_MUTE pin, originally for codec mute control, but it can also be used
  for general purpose. It is manipulated by the GRF_SOC_CON10 register.
  If needed in the future support for the HDMI pins can also be added.
  The GPIO node should be declared as the child of the GRF node.

  The GPIO_MUTE pin is referred to in the format

  <&grf_gpio 0 GPIO_ACTIVE_LOW>

  The first cell is the pin number and
  the second cell is used to specify the GPIO polarity
    0 = Active high
    1 = Active low

maintainers:
  - Heiko Stuebner <heiko@sntech.de>

properties:
  compatible:
    const: rockchip,rk3328-grf-gpio

  gpio-controller: true

  "#gpio-cells":
    const: 2

required:
  - compatible
  - gpio-controller
  - "#gpio-cells"

additionalProperties: false

examples:
  - |
    grf_gpio: gpio {
      compatible = "rockchip,rk3328-grf-gpio";
      gpio-controller;
      #gpio-cells = <2>;
    };
```

## Documentation/devicetree/bindings/gpio/sgpio-aspeed.txt
```
Aspeed SGPIO controller Device Tree Bindings
--------------------------------------------

This SGPIO controller is for ASPEED AST2500 SoC, it supports up to 80 full
featured Serial GPIOs. Each of the Serial GPIO pins can be programmed to
support the following options:
- Support interrupt option for each input port and various interrupt
  sensitivity option (level-high, level-low, edge-high, edge-low)
- Support reset tolerance option for each output port
- Directly connected to APB bus and its shift clock is from APB bus clock
  divided by a programmable value.
- Co-work with external signal-chained TTL components (74LV165/74LV595)

Required properties:

- compatible : Should be one of
  "aspeed,ast2400-sgpio", "aspeed,ast2500-sgpio"
- #gpio-cells : Should be 2, see gpio.txt
- reg : Address and length of the register set for the device
- gpio-controller : Marks the device node as a GPIO controller
- interrupts : Interrupt specifier, see interrupt-controller/interrupts.txt
- interrupt-controller : Mark the GPIO controller as an interrupt-controller
- ngpios : number of GPIO lines, see gpio.txt
  (should be multiple of 8, up to 80 pins)
- clocks : A phandle to the APB clock for SGPM clock division
- bus-frequency : SGPM CLK frequency

The sgpio and interrupt properties are further described in their respective
bindings documentation:

- Documentation/devicetree/bindings/gpio/gpio.txt
- Documentation/devicetree/bindings/interrupt-controller/interrupts.txt

  Example:
	sgpio: sgpio@1e780200 {
		#gpio-cells = <2>;
		compatible = "aspeed,ast2500-sgpio";
		gpio-controller;
		interrupts = <40>;
		reg = <0x1e780200 0x0100>;
		clocks = <&syscon ASPEED_CLK_APB>;
		interrupt-controller;
		ngpios = <8>;
		bus-frequency = <12000000>;
	};
```
