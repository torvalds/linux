## Documentation/devicetree/bindings/gpu/arm,mali-utgard.txt
```
ARM Mali Utgard GPU
===================

Required properties:
  - compatible
    * Must be one of the following:
      + "arm,mali-300"
      + "arm,mali-400"
      + "arm,mali-450"
    * And, optionally, one of the vendor specific compatible:
      + allwinner,sun4i-a10-mali
      + allwinner,sun7i-a20-mali
      + allwinner,sun8i-h3-mali
      + allwinner,sun50i-h5-mali
      + amlogic,meson-gxbb-mali
      + amlogic,meson-gxl-mali
      + rockchip,rk3036-mali
      + rockchip,rk3066-mali
      + rockchip,rk3188-mali
      + rockchip,rk3228-mali
      + rockchip,rk3328-mali
      + stericsson,db8500-mali

  - reg: Physical base address and length of the GPU registers

  - interrupts: an entry for each entry in interrupt-names.
    See ../interrupt-controller/interrupts.txt for details.

  - interrupt-names:
    * ppX: Pixel Processor X interrupt (X from 0 to 7)
    * ppmmuX: Pixel Processor X MMU interrupt (X from 0 to 7)
    * pp: Pixel Processor broadcast interrupt (mali-450 only)
    * gp: Geometry Processor interrupt
    * gpmmu: Geometry Processor MMU interrupt

  - clocks: an entry for each entry in clock-names
  - clock-names:
    * bus: bus clock for the GPU
    * core: clock driving the GPU itself

Optional properties:
  - interrupt-names and interrupts:
    * pmu: Power Management Unit interrupt, if implemented in hardware

  - memory-region:
    Memory region to allocate from, as defined in
    Documentation/devicetree/bindings/reserved-memory/reserved-memory.txt

  - mali-supply:
    Phandle to regulator for the Mali device, as defined in
    Documentation/devicetree/bindings/regulator/regulator.txt for details.

  - operating-points-v2:
    Operating Points for the GPU, as defined in
    Documentation/devicetree/bindings/opp/opp.txt

  - power-domains:
    A power domain consumer specifier as defined in
    Documentation/devicetree/bindings/power/power_domain.txt

Vendor-specific bindings
------------------------

The Mali GPU is integrated very differently from one SoC to
another. In order to accomodate those differences, you have the option
to specify one more vendor-specific compatible, among:

  - allwinner,sun4i-a10-mali
    Required properties:
      * resets: phandle to the reset line for the GPU

  - allwinner,sun7i-a20-mali
    Required properties:
      * resets: phandle to the reset line for the GPU

  - allwinner,sun50i-h5-mali
    Required properties:
      * resets: phandle to the reset line for the GPU

  - Rockchip variants:
    Required properties:
      * resets: phandle to the reset line for the GPU

  - stericsson,db8500-mali
    Required properties:
      * interrupt-names and interrupts:
        + combined: combined interrupt of all of the above lines

Example:

mali: gpu@1c40000 {
	compatible = "allwinner,sun7i-a20-mali", "arm,mali-400";
	reg = <0x01c40000 0x10000>;
	interrupts = <GIC_SPI 97 IRQ_TYPE_LEVEL_HIGH>,
		     <GIC_SPI 98 IRQ_TYPE_LEVEL_HIGH>,
		     <GIC_SPI 99 IRQ_TYPE_LEVEL_HIGH>,
		     <GIC_SPI 100 IRQ_TYPE_LEVEL_HIGH>,
		     <GIC_SPI 102 IRQ_TYPE_LEVEL_HIGH>,
		     <GIC_SPI 103 IRQ_TYPE_LEVEL_HIGH>,
		     <GIC_SPI 101 IRQ_TYPE_LEVEL_HIGH>;
	interrupt-names = "gp",
			  "gpmmu",
			  "pp0",
			  "ppmmu0",
			  "pp1",
			  "ppmmu1",
			  "pmu";
	clocks = <&ccu CLK_BUS_GPU>, <&ccu CLK_GPU>;
	clock-names = "bus", "core";
	resets = <&ccu RST_BUS_GPU>;
};
```

## Documentation/devicetree/bindings/gpu/arm,mali-utgard.yaml
```yaml
# SPDX-License-Identifier: GPL-2.0-only
%YAML 1.2
---
$id: http://devicetree.org/schemas/gpu/arm,mali-utgard.yaml#
$schema: http://devicetree.org/meta-schemas/core.yaml#

title: ARM Mali Utgard GPU

maintainers:
  - Rob Herring <robh@kernel.org>
  - Maxime Ripard <maxime.ripard@free-electrons.com>
  - Heiko Stuebner <heiko@sntech.de>

properties:
  $nodename:
    pattern: '^gpu@[a-f0-9]+$'
  compatible:
    oneOf:
      - items:
          - const: allwinner,sun8i-a23-mali
          - const: allwinner,sun7i-a20-mali
          - const: arm,mali-400
      - items:
          - enum:
              - allwinner,sun4i-a10-mali
              - allwinner,sun7i-a20-mali
              - allwinner,sun8i-h3-mali
              - allwinner,sun50i-a64-mali
              - rockchip,rk3036-mali
              - rockchip,rk3066-mali
              - rockchip,rk3188-mali
              - rockchip,rk3228-mali
              - samsung,exynos4210-mali
              - stericsson,db8500-mali
          - const: arm,mali-400
      - items:
          - enum:
              - allwinner,sun50i-h5-mali
              - amlogic,meson8-mali
              - amlogic,meson8b-mali
              - amlogic,meson-gxbb-mali
              - amlogic,meson-gxl-mali
              - hisilicon,hi6220-mali
              - rockchip,rk3328-mali
          - const: arm,mali-450

      # "arm,mali-300"

  reg:
    maxItems: 1

  interrupts:
    minItems: 4
    maxItems: 20

  interrupt-names:
    allOf:
      - additionalItems: true
        minItems: 4
        maxItems: 20
        items:
          # At least enforce the first 2 interrupts
          - const: gp
          - const: gpmmu
      - items:
          # Not ideal as any order and combination are allowed
          enum:
            - gp        # Geometry Processor interrupt
            - gpmmu     # Geometry Processor MMU interrupt
            - pp        # Pixel Processor broadcast interrupt (mali-450 only)
            - pp0       # Pixel Processor X interrupt (X from 0 to 7)
            - ppmmu0    # Pixel Processor X MMU interrupt (X from 0 to 7)
            - pp1
            - ppmmu1
            - pp2
            - ppmmu2
            - pp3
            - ppmmu3
            - pp4
            - ppmmu4
            - pp5
            - ppmmu5
            - pp6
            - ppmmu6
            - pp7
            - ppmmu7
            - pmu       # Power Management Unit interrupt (optional)
            - combined  # stericsson,db8500-mali only

  clocks:
    maxItems: 2

  clock-names:
    items:
      - const: bus
      - const: core

  memory-region: true

  mali-supply: true

  power-domains:
    maxItems: 1

  resets:
    maxItems: 1

  operating-points-v2: true

  "#cooling-cells":
    const: 2

required:
  - compatible
  - reg
  - interrupts
  - interrupt-names
  - clocks
  - clock-names

additionalProperties: false

allOf:
  - if:
      properties:
        compatible:
          contains:
            enum:
              - allwinner,sun4i-a10-mali
              - allwinner,sun7i-a20-mali
              - allwinner,sun50i-a64-mali
              - allwinner,sun50i-h5-mali
              - amlogic,meson8-mali
              - amlogic,meson8b-mali
              - hisilicon,hi6220-mali
              - rockchip,rk3036-mali
              - rockchip,rk3066-mali
              - rockchip,rk3188-mali
              - rockchip,rk3228-mali
              - rockchip,rk3328-mali
    then:
      required:
        - resets

examples:
  - |
    #include <dt-bindings/interrupt-controller/irq.h>
    #include <dt-bindings/interrupt-controller/arm-gic.h>

    mali: gpu@1c40000 {
      compatible = "allwinner,sun7i-a20-mali", "arm,mali-400";
      reg = <0x01c40000 0x10000>;
      interrupts = <GIC_SPI 97 IRQ_TYPE_LEVEL_HIGH>,
             <GIC_SPI 98 IRQ_TYPE_LEVEL_HIGH>,
             <GIC_SPI 99 IRQ_TYPE_LEVEL_HIGH>,
             <GIC_SPI 100 IRQ_TYPE_LEVEL_HIGH>,
             <GIC_SPI 102 IRQ_TYPE_LEVEL_HIGH>,
             <GIC_SPI 103 IRQ_TYPE_LEVEL_HIGH>,
             <GIC_SPI 101 IRQ_TYPE_LEVEL_HIGH>;
      interrupt-names = "gp",
            "gpmmu",
            "pp0",
            "ppmmu0",
            "pp1",
            "ppmmu1",
            "pmu";
      clocks = <&ccu 1>, <&ccu 2>;
      clock-names = "bus", "core";
      resets = <&ccu 1>;
      #cooling-cells = <2>;
    };

...
```

## Documentation/devicetree/bindings/gpu/arm,mali-valhall-csf.yaml
```yaml
# SPDX-License-Identifier: GPL-2.0-only OR BSD-2-Clause
%YAML 1.2
---
$id: http://devicetree.org/schemas/gpu/arm,mali-valhall-csf.yaml#
$schema: http://devicetree.org/meta-schemas/core.yaml#

title: ARM Mali Valhall GPU

maintainers:
  - Liviu Dudau <liviu.dudau@arm.com>
  - Boris Brezillon <boris.brezillon@collabora.com>

properties:
  $nodename:
    pattern: '^gpu@[a-f0-9]+$'

  compatible:
    oneOf:
      - items:
          - enum:
              - rockchip,rk3588-mali
          - const: arm,mali-valhall-csf   # Mali Valhall GPU model/revision is fully discoverable

  reg:
    maxItems: 1

  interrupts:
    items:
      - description: Job interrupt
      - description: MMU interrupt
      - description: GPU interrupt

  interrupt-names:
    items:
      - const: job
      - const: mmu
      - const: gpu

  clocks:
    minItems: 1
    maxItems: 3

  clock-names:
    minItems: 1
    items:
      - const: core
      - const: coregroup
      - const: stacks

  mali-supply: true

  operating-points-v2: true
  opp-table:
    type: object

  power-domains:
    minItems: 1
    maxItems: 5

  power-domain-names:
    minItems: 1
    maxItems: 5

  sram-supply: true

  "#cooling-cells":
    const: 2

  dynamic-power-coefficient:
    $ref: /schemas/types.yaml#/definitions/uint32
    description:
      A u32 value that represents the running time dynamic
      power coefficient in units of uW/MHz/V^2. The
      coefficient can either be calculated from power
      measurements or derived by analysis.

      The dynamic power consumption of the GPU is
      proportional to the square of the Voltage (V) and
      the clock frequency (f). The coefficient is used to
      calculate the dynamic power as below -

      Pdyn = dynamic-power-coefficient * V^2 * f

      where voltage is in V, frequency is in MHz.

  dma-coherent: true

required:
  - compatible
  - reg
  - interrupts
  - interrupt-names
  - clocks
  - mali-supply

additionalProperties: false

allOf:
  - if:
      properties:
        compatible:
          contains:
            const: rockchip,rk3588-mali
    then:
      properties:
        clocks:
          minItems: 3
        power-domains:
          maxItems: 1
        power-domain-names: false

examples:
  - |
    #include <dt-bindings/clock/rockchip,rk3588-cru.h>
    #include <dt-bindings/interrupt-controller/irq.h>
    #include <dt-bindings/interrupt-controller/arm-gic.h>
    #include <dt-bindings/power/rk3588-power.h>

    gpu: gpu@fb000000 {
        compatible = "rockchip,rk3588-mali", "arm,mali-valhall-csf";
        reg = <0xfb000000 0x200000>;
        interrupts = <GIC_SPI 92 IRQ_TYPE_LEVEL_HIGH 0>,
                     <GIC_SPI 93 IRQ_TYPE_LEVEL_HIGH 0>,
                     <GIC_SPI 94 IRQ_TYPE_LEVEL_HIGH 0>;
        interrupt-names = "job", "mmu", "gpu";
        clock-names = "core", "coregroup", "stacks";
        clocks = <&cru CLK_GPU>, <&cru CLK_GPU_COREGROUP>,
                 <&cru CLK_GPU_STACKS>;
        power-domains = <&power RK3588_PD_GPU>;
        operating-points-v2 = <&gpu_opp_table>;
        mali-supply = <&vdd_gpu_s0>;
        sram-supply = <&vdd_gpu_mem_s0>;

        gpu_opp_table: opp-table {
            compatible = "operating-points-v2";
            opp-300000000 {
                opp-hz = /bits/ 64 <300000000>;
                opp-microvolt = <675000 675000 850000>;
            };
            opp-400000000 {
                opp-hz = /bits/ 64 <400000000>;
                opp-microvolt = <675000 675000 850000>;
            };
        };
    };

...
```

## Documentation/devicetree/bindings/gpu/aspeed,ast2400-gfx.yaml
```yaml
# SPDX-License-Identifier: (GPL-2.0-only OR BSD-2-Clause)
%YAML 1.2
---
$id: http://devicetree.org/schemas/gpu/aspeed,ast2400-gfx.yaml#
$schema: http://devicetree.org/meta-schemas/core.yaml#

title: ASPEED GFX Display Controller

maintainers:
  - Joel Stanley <joel@jms.id.au>

properties:
  compatible:
    items:
      - enum:
          - aspeed,ast2400-gfx
          - aspeed,ast2500-gfx
          - aspeed,ast2600-gfx
      - const: syscon

  reg:
    maxItems: 1

  clocks:
    maxItems: 1

  resets:
    maxItems: 1

  interrupts:
    maxItems: 1

  memory-region:
    maxItems: 1
    description:
      a reserved-memory region to use for the framebuffer.

  syscon:
    $ref: /schemas/types.yaml#/definitions/phandle
    description: Phandle to SCU

required:
  - compatible
  - reg
  - interrupts
  - clocks
  - resets
  - memory-region

additionalProperties: false

examples:
  - |
    #include <dt-bindings/clock/aspeed-clock.h>

    display@1e6e6000 {
        compatible = "aspeed,ast2500-gfx", "syscon";
        reg = <0x1e6e6000 0x1000>;
        clocks = <&syscon ASPEED_CLK_GATE_D1CLK>;
        resets = <&syscon ASPEED_RESET_CRT1>;
        interrupts = <0x19>;
        memory-region = <&gfx_memory>;
    };
```

## Documentation/devicetree/bindings/gpu/aspeed-gfx.txt
```
Device tree configuration for the GFX display device on the ASPEED SoCs

Required properties:
  - compatible
    * Must be one of the following:
      + aspeed,ast2500-gfx
      + aspeed,ast2400-gfx
    * In addition, the ASPEED pinctrl bindings require the 'syscon' property to
      be present

  - reg: Physical base address and length of the GFX registers

  - interrupts: interrupt number for the GFX device

  - clocks: clock number used to generate the pixel clock

  - resets: reset line that must be released to use the GFX device

  - memory-region:
    Phandle to a memory region to allocate from, as defined in
    Documentation/devicetree/bindings/reserved-memory/reserved-memory.txt


Example:

gfx: display@1e6e6000 {
	compatible = "aspeed,ast2500-gfx", "syscon";
	reg = <0x1e6e6000 0x1000>;
	reg-io-width = <4>;
	clocks = <&syscon ASPEED_CLK_GATE_D1CLK>;
	resets = <&syscon ASPEED_RESET_CRT1>;
	interrupts = <0x19>;
	memory-region = <&gfx_memory>;
};

gfx_memory: framebuffer {
	size = <0x01000000>;
	alignment = <0x01000000>;
	compatible = "shared-dma-pool";
	reusable;
};
```

## Documentation/devicetree/bindings/gpu/brcm,bcm-v3d.txt
```
Broadcom V3D GPU

Only the Broadcom V3D 3.x and newer GPUs are covered by this binding.
For V3D 2.x, see brcm,bcm-vc4.txt.

Required properties:
- compatible:	Should be "brcm,7268-v3d" or "brcm,7278-v3d"
- reg:		Physical base addresses and lengths of the register areas
- reg-names:	Names for the register areas.  The "hub" and "core0"
		  register areas are always required.  The "gca" register area
		  is required if the GCA cache controller is present.  The
		  "bridge" register area is required if an external reset
		  controller is not present.
- interrupts:	The interrupt numbers.  The first interrupt is for the hub,
		  while the following interrupts are separate interrupt lines
		  for the cores (if they don't share the hub's interrupt).
		  See bindings/interrupt-controller/interrupts.txt

Optional properties:
- clocks:	The core clock the unit runs on
- resets:	The reset line for v3d, if not using a mapping of the bridge
		  See bindings/reset/reset.txt

v3d {
	compatible = "brcm,7268-v3d";
	reg = <0xf1204000 0x100>,
	      <0xf1200000 0x4000>,
	      <0xf1208000 0x4000>,
	      <0xf1204100 0x100>;
	reg-names = "bridge", "hub", "core0", "gca";
	interrupts = <0 78 4>,
		     <0 77 4>;
};
```
