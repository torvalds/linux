## Documentation/devicetree/bindings/gpio/waveshare,dsi-touch-gpio.yaml
```yaml
# SPDX-License-Identifier: (GPL-2.0 OR BSD-2-Clause)
%YAML 1.2
---
$id: http://devicetree.org/schemas/gpio/waveshare,dsi-touch-gpio.yaml#
$schema: http://devicetree.org/meta-schemas/core.yaml#

title: Waveshare GPIO controller on DSI TOUCH panels

maintainers:
  - Dmitry Baryshkov <dmitry.baryshkov@oss.qualcomm.com>

description:
  Waveshare DSI TOUCH panel kits contain separate GPIO controller for toggling
  power supplies and panel / touchscreen resets.

properties:
  compatible:
    const: waveshare,dsi-touch-gpio

  reg:
    maxItems: 1

  gpio-controller: true

  '#gpio-cells':
    const: 2

required:
  - compatible
  - reg
  - gpio-controller
  - "#gpio-cells"

additionalProperties: false

examples:
  - |
    #include <dt-bindings/gpio/gpio.h>

    i2c {
        #address-cells = <1>;
        #size-cells = <0>;

        wsgpio: gpio@45 {
            compatible = "waveshare,dsi-touch-gpio";
            reg = <0x45>;
            gpio-controller;
            #gpio-cells = <2>;
        };
    };

    panel_avdd: regulator-panel-avdd {
        compatible = "regulator-fixed";
        regulator-name = "panel-avdd";
        gpios = <&wsgpio 0 GPIO_ACTIVE_HIGH>;
        enable-active-high;
    };

    panel_iovcc: regulator-panel-iovcc {
        compatible = "regulator-fixed";
        regulator-name = "panel-iovcc";
        gpios = <&wsgpio 4 GPIO_ACTIVE_HIGH>;
        enable-active-high;
    };

    panel_vcc: regulator-panel-vcc {
        compatible = "regulator-fixed";
        regulator-name = "panel-vcc";
        gpios = <&wsgpio 8 GPIO_ACTIVE_HIGH>;
        enable-active-high;
        regulator-always-on;
    };
...
```

## Documentation/devicetree/bindings/gpio/wd,mbl-gpio.txt
```
Bindings for the Western Digital's MyBook Live memory-mapped GPIO controllers.

The Western Digital MyBook Live has two memory-mapped GPIO controllers.
Both GPIO controller only have a single 8-bit data register, where GPIO
state can be read and/or written.

Required properties:
	- compatible: should be "wd,mbl-gpio"
	- reg-names: must contain
		"dat" - data register
	- reg: address + size pairs describing the GPIO register sets;
		order must correspond with the order of entries in reg-names
	- #gpio-cells: must be set to 2. The first cell is the pin number and
			the second cell is used to specify the gpio polarity:
			0 = active high
			1 = active low
	- gpio-controller: Marks the device node as a gpio controller.

Optional properties:
	- no-output: GPIOs are read-only.

Examples:
	gpio0: gpio0@e0000000 {
		compatible = "wd,mbl-gpio";
		reg-names = "dat";
		reg = <0xe0000000 0x1>;
		#gpio-cells = <2>;
		gpio-controller;
	};

	gpio1: gpio1@e0100000 {
		compatible = "wd,mbl-gpio";
		reg-names = "dat";
		reg = <0xe0100000 0x1>;
		#gpio-cells = <2>;
		gpio-controller;
		no-output;
	};
```

## Documentation/devicetree/bindings/gpio/x-powers,axp209-gpio.yaml
```yaml
# SPDX-License-Identifier: GPL-2.0
%YAML 1.2
---
$id: "http://devicetree.org/schemas/gpio/x-powers,axp209-gpio.yaml#"
$schema: "http://devicetree.org/meta-schemas/core.yaml#"

title: X-Powers AXP209 GPIO Device Tree Bindings

maintainers:
  - Chen-Yu Tsai <wens@csie.org>

properties:
  "#gpio-cells":
    const: 2
    description: >
      The first cell is the pin number and the second is the GPIO flags.

  compatible:
    oneOf:
      - enum:
          - x-powers,axp209-gpio
          - x-powers,axp813-gpio
      - items:
          - const: x-powers,axp803-gpio
          - const: x-powers,axp813-gpio

  gpio-controller: true

patternProperties:
  "^.*-pins?$":
    $ref: /schemas/pinctrl/pinmux-node.yaml#

    properties:
      pins:
        items:
          enum:
            - GPIO0
            - GPIO1
            - GPIO2

      function:
        enum:
          - adc
          - ldo
          - gpio_in
          - gpio_out

required:
  - compatible
  - "#gpio-cells"
  - gpio-controller

additionalProperties: false

...
```

## Documentation/devicetree/bindings/gpio/xlnx,gpio-xilinx.yaml
```yaml
# SPDX-License-Identifier: (GPL-2.0 OR BSD-2-Clause)
%YAML 1.2
---
$id: http://devicetree.org/schemas/gpio/xlnx,gpio-xilinx.yaml#
$schema: http://devicetree.org/meta-schemas/core.yaml#

title: Xilinx AXI GPIO controller

maintainers:
  - Neeli Srinivas <srinivas.neeli@amd.com>

description:
  The AXI GPIO design provides a general purpose input/output interface
  to an AXI4-Lite interface. The AXI GPIO can be configured as either
  a single or a dual-channel device. The width of each channel is
  independently configurable. The channels can be configured to
  generate an interrupt when a transition on any of their inputs occurs.

properties:
  compatible:
    enum:
      - xlnx,xps-gpio-1.00.a

  reg:
    maxItems: 1

  "#gpio-cells":
    const: 2

  interrupts:
    maxItems: 1

  gpio-controller: true

  gpio-line-names:
    description: strings describing the names of each gpio line
    minItems: 1
    maxItems: 64

  interrupt-controller: true

  "#interrupt-cells":
    const: 2

  clocks:
    maxItems: 1

  interrupt-names: true

  xlnx,all-inputs:
    $ref: /schemas/types.yaml#/definitions/uint32
    description: This option sets this GPIO channel1 bits in input mode.

  xlnx,all-inputs-2:
    $ref: /schemas/types.yaml#/definitions/uint32
    description: This option sets this GPIO channel2 bits in input mode.

  xlnx,all-outputs:
    $ref: /schemas/types.yaml#/definitions/uint32
    description: This option sets this GPIO channel1 bits in output mode.

  xlnx,all-outputs-2:
    $ref: /schemas/types.yaml#/definitions/uint32
    description: This option sets this GPIO channel2 bits in output mode.

  xlnx,dout-default:
    $ref: /schemas/types.yaml#/definitions/uint32
    description: Sets the default value of all the enabled bits of
                 channel1.
    default: 0

  xlnx,dout-default-2:
    $ref: /schemas/types.yaml#/definitions/uint32
    description: Sets the default value of all the enabled bits of
                 channel2.
    default: 0

  xlnx,gpio-width:
    $ref: /schemas/types.yaml#/definitions/uint32
    description: The value defines the bit width of the GPIO channel1.
    minimum: 1
    maximum: 32
    default: 32

  xlnx,gpio2-width:
    $ref: /schemas/types.yaml#/definitions/uint32
    description: The value defines the bit width of the GPIO channel2.
    minimum: 1
    maximum: 32
    default: 32

  xlnx,interrupt-present:
    $ref: /schemas/types.yaml#/definitions/uint32
    description: This parameter enables interrupt control logic
                 and interrupt registers in GPIO module.
    minimum: 0
    maximum: 1
    default: 0

  xlnx,is-dual:
    $ref: /schemas/types.yaml#/definitions/uint32
    description: This parameter enables a second GPIO channel (GPIO2).
    minimum: 0
    maximum: 1
    default: 0

  xlnx,tri-default:
    $ref: /schemas/types.yaml#/definitions/uint32
    description: This value configures the input or output mode
                 of each bit of GPIO channel1.

  xlnx,tri-default-2:
    $ref: /schemas/types.yaml#/definitions/uint32
    description: This value configures the input or output mode
                 of each bit of GPIO channel2.

required:
  - reg
  - compatible
  - gpio-controller
  - "#gpio-cells"

unevaluatedProperties: false

examples:
  - |
    #include <dt-bindings/interrupt-controller/arm-gic.h>

        gpio@a0020000 {
            compatible = "xlnx,xps-gpio-1.00.a";
            reg = <0xa0020000 0x10000>;
            #gpio-cells = <2>;
            #interrupt-cells = <0x2>;
            clocks = <&zynqmp_clk 71>;
            gpio-controller;
            interrupt-controller;
            interrupt-names = "ip2intc_irpt";
            interrupt-parent = <&gic>;
            interrupts = <0 89 4>;
            xlnx,all-inputs = <0x0>;
            xlnx,all-inputs-2 = <0x0>;
            xlnx,all-outputs = <0x0>;
            xlnx,all-outputs-2 = <0x0>;
            xlnx,dout-default = <0x0>;
            xlnx,dout-default-2 = <0x0>;
            xlnx,gpio-width = <0x20>;
            xlnx,gpio2-width = <0x20>;
            xlnx,interrupt-present = <0x1>;
            xlnx,is-dual = <0x1>;
            xlnx,tri-default = <0xFFFFFFFF>;
            xlnx,tri-default-2 = <0xFFFFFFFF>;
        };

...
```

## Documentation/devicetree/bindings/gpio/xlnx,zynqmp-gpio-modepin.yaml
```yaml
# SPDX-License-Identifier: (GPL-2.0-only OR BSD-2-Clause)
%YAML 1.2
---
$id: http://devicetree.org/schemas/gpio/xlnx,zynqmp-gpio-modepin.yaml#
$schema: http://devicetree.org/meta-schemas/core.yaml#

title: ZynqMP Mode Pin GPIO controller

description:
  PS_MODE is 4-bits boot mode pins sampled on POR deassertion. Mode Pin
  GPIO controller with configurable from numbers of pins (from 0 to 3 per
  PS_MODE). Every pin can be configured as input/output.

maintainers:
  - Mubin Sayyed <mubin.sayyed@amd.com>
  - Radhey Shyam Pandey <radhey.shyam.pandey@amd.com>

properties:
  compatible:
    const: xlnx,zynqmp-gpio-modepin

  gpio-controller: true

  "#gpio-cells":
    const: 2

  label: true

required:
  - compatible
  - gpio-controller
  - "#gpio-cells"

additionalProperties: false

examples:
  - |
    zynqmp-firmware {
        gpio {
            compatible = "xlnx,zynqmp-gpio-modepin";
            gpio-controller;
            #gpio-cells = <2>;
            label = "modepin";
        };
    };

...
```

## Documentation/devicetree/bindings/gpio/xylon,logicvc-gpio.yaml
```yaml
# SPDX-License-Identifier: (GPL-2.0 OR BSD-2-Clause)
# Copyright 2019 Bootlin
%YAML 1.2
---
$id: http://devicetree.org/schemas/gpio/xylon,logicvc-gpio.yaml#
$schema: http://devicetree.org/meta-schemas/core.yaml#

title: Xylon LogiCVC GPIO controller

maintainers:
  - Paul Kocialkowski <paul.kocialkowski@bootlin.com>

description: |
  The LogiCVC GPIO describes the GPIO block included in the LogiCVC display
  controller. These are meant to be used for controlling display-related
  signals.

  The controller exposes GPIOs from the display and power control registers,
  which are mapped by the driver as follows:
  - GPIO[4:0] (display control) mapped to index 0-4
  - EN_BLIGHT (power control) mapped to index 5
  - EN_VDD (power control) mapped to index 6
  - EN_VEE (power control) mapped to index 7
  - V_EN (power control) mapped to index 8

properties:
  $nodename:
    pattern: "^gpio@[0-9a-f]+$"

  compatible:
    enum:
      - xylon,logicvc-3.02.a-gpio

  reg:
    maxItems: 1

  "#gpio-cells":
    const: 2

  gpio-controller: true

  gpio-line-names:
    minItems: 1
    maxItems: 9

required:
  - compatible
  - reg
  - "#gpio-cells"
  - gpio-controller

additionalProperties: false

examples:
  - |
    logicvc: logicvc@43c00000 {
      compatible = "xylon,logicvc-3.02.a", "syscon", "simple-mfd";
      reg = <0x43c00000 0x6000>;

      #address-cells = <1>;
      #size-cells = <1>;

      logicvc_gpio: gpio@40 {
        compatible = "xylon,logicvc-3.02.a-gpio";
        reg = <0x40 0x40>;
        gpio-controller;
        #gpio-cells = <2>;
        gpio-line-names = "GPIO0", "GPIO1", "GPIO2", "GPIO3", "GPIO4",
               "EN_BLIGHT", "EN_VDD", "EN_VEE", "V_EN";
      };
    };
```

## Documentation/devicetree/bindings/gpio/zx296702-gpio.txt
```
ZTE ZX296702 GPIO controller

Required properties:
- compatible : "zte,zx296702-gpio"
- #gpio-cells : Should be two. The first cell is the pin number and the
  second cell is used to specify optional parameters:
  - bit 0 specifies polarity (0 for normal, 1 for inverted)
- gpio-controller : Marks the device node as a GPIO controller.
- interrupts : Interrupt mapping for GPIO IRQ.
- gpio-ranges : Interaction with the PINCTRL subsystem.

gpio1: gpio@b008040 {
	compatible = "zte,zx296702-gpio";
	reg = <0xb008040 0x40>;
	gpio-controller;
	#gpio-cells = <2>;
	gpio-ranges = < &pmx0 0 54 2 &pmx0 2 59 14>;
	interrupts = <GIC_SPI 26 IRQ_TYPE_LEVEL_HIGH>;
	interrupt-parent = <&intc>;
	interrupt-controller;
	#interrupt-cells = <2>;
	clock-names = "gpio_pclk";
	clocks = <&lsp0clk ZX296702_GPIO_CLK>;
};
```

## Documentation/devicetree/bindings/gpu/apple,agx.yaml
```yaml
# SPDX-License-Identifier: (GPL-2.0 OR BSD-2-Clause)
%YAML 1.2
---
$id: http://devicetree.org/schemas/gpu/apple,agx.yaml#
$schema: http://devicetree.org/meta-schemas/core.yaml#

title: Apple SoC GPU

maintainers:
  - Sasha Finkelstein <fnkl.kernel@gmail.com>

properties:
  compatible:
    oneOf:
      - enum:
          - apple,agx-g13g
          - apple,agx-g13s
          - apple,agx-g14g
          - apple,agx-g14s
      - items:
          - enum:
              - apple,agx-g13c
              - apple,agx-g13d
          - const: apple,agx-g13s
      - items:
          - enum:
              - apple,agx-g14c
              - apple,agx-g14d
          - const: apple,agx-g14s

  reg:
    items:
      - description: GPU coprocessor control registers
      - description: GPU block MMIO registers

  reg-names:
    items:
      - const: asc
      - const: sgx

  power-domains:
    maxItems: 1

  mboxes:
    maxItems: 1

  memory-region:
    items:
      - description: Region containing GPU MMU TTBs
      - description: Region containing GPU MMU page tables
      - description:
          Region containing a shared handoff structure for VM
          management coordination
      - description: Calibration blob. Mostly power-related configuration
      - description: Calibration blob. Mostly GPU-related configuration
      - description: Shared global variables with GPU firmware

  memory-region-names:
    items:
      - const: ttbs
      - const: pagetables
      - const: handoff
      - const: hw-cal-a
      - const: hw-cal-b
      - const: globals

  apple,firmware-abi:
    $ref: /schemas/types.yaml#/definitions/uint32-array
    minItems: 3
    description:
      macOS version the current firmware is paired with, used to pick
      the version of firmware ABI to be used.
      Bootloader will overwrite this

required:
  - compatible
  - reg
  - mboxes
  - memory-region
  - apple,firmware-abi

additionalProperties: false

examples:
  - |
    gpu@6400000 {
        compatible = "apple,agx-g13g";
        reg = <0x6400000 0x40000>,
              <0x4000000 0x1000000>;
        reg-names = "asc", "sgx";
        mboxes = <&agx_mbox>;
        power-domains = <&ps_gfx>;
        memory-region = <&uat_ttbs>, <&uat_pagetables>, <&uat_handoff>,
                        <&gpu_hw_cal_a>, <&gpu_hw_cal_b>, <&gpu_globals>;
        memory-region-names = "ttbs", "pagetables", "handoff",
                              "hw-cal-a", "hw-cal-b", "globals";

        apple,firmware-abi = <0 0 0>;
    };
...
```
