## Documentation/devicetree/bindings/gpio/fsl,qoriq-gpio.yaml
```yaml
# SPDX-License-Identifier: (GPL-2.0-only OR BSD-2-Clause)
%YAML 1.2
---
$id: http://devicetree.org/schemas/gpio/fsl,qoriq-gpio.yaml#
$schema: http://devicetree.org/meta-schemas/core.yaml#

title: Freescale MPC512x/MPC8xxx/QorIQ/Layerscape GPIO controller

maintainers:
  - Frank Li <Frank.Li@nxp.com>

properties:
  compatible:
    oneOf:
      - enum:
          - fsl,mpc5121-gpio
          - fsl,mpc5125-gpio
          - fsl,mpc8349-gpio
          - fsl,mpc8572-gpio
          - fsl,mpc8610-gpio
          - fsl,pq3-gpio
      - items:
          - enum:
              - fsl,ls1021a-gpio
              - fsl,ls1028a-gpio
              - fsl,ls1043a-gpio
              - fsl,ls1046a-gpio
              - fsl,ls1088a-gpio
              - fsl,ls2080a-gpio
          - const: fsl,qoriq-gpio

  reg:
    maxItems: 1

  interrupts:
    maxItems: 1

  "#gpio-cells":
    const: 2

  gpio-controller: true

  interrupt-controller: true

  "#interrupt-cells":
    const: 2

  gpio-line-names:
    minItems: 1
    maxItems: 32

  little-endian:
    $ref: /schemas/types.yaml#/definitions/flag
    description:
      GPIO registers are used as little endian. If not
      present registers are used as big endian by default.

required:
  - compatible
  - reg
  - interrupts
  - "#gpio-cells"

additionalProperties: false

examples:
  - |
    gpio@1100 {
        compatible = "fsl,mpc5125-gpio";
        reg = <0x1100 0x080>;
        interrupts = <78 0x8>;
        gpio-controller;
        #gpio-cells = <2>;
    };

  - |
    #include <dt-bindings/interrupt-controller/arm-gic.h>
    gpio@2300000 {
        compatible = "fsl,ls2080a-gpio", "fsl,qoriq-gpio";
        reg = <0x2300000 0x10000>;
        interrupts = <GIC_SPI 36 IRQ_TYPE_LEVEL_HIGH>;
        little-endian;
        gpio-controller;
        #gpio-cells = <2>;
        interrupt-controller;
        #interrupt-cells = <2>;
    };
```

## Documentation/devicetree/bindings/gpio/fsl-imx-gpio.txt
```
* Freescale i.MX/MXC GPIO controller

Required properties:
- compatible : Should be "fsl,<soc>-gpio"
- reg : Address and length of the register set for the device
- interrupts : Should be the port interrupt shared by all 32 pins, if
  one number.  If two numbers, the first one is the interrupt shared
  by low 16 pins and the second one is for high 16 pins.
- gpio-controller : Marks the device node as a gpio controller.
- #gpio-cells : Should be two.  The first cell is the pin number and
  the second cell is used to specify the gpio polarity:
      0 = active high
      1 = active low
- interrupt-controller: Marks the device node as an interrupt controller.
- #interrupt-cells : Should be 2.  The first cell is the GPIO number.
  The second cell bits[3:0] is used to specify trigger type and level flags:
      1 = low-to-high edge triggered.
      2 = high-to-low edge triggered.
      4 = active high level-sensitive.
      8 = active low level-sensitive.

Optional properties:
- clocks: the clock for clocking the GPIO silicon

Example:

gpio0: gpio@73f84000 {
	compatible = "fsl,imx51-gpio", "fsl,imx35-gpio";
	reg = <0x73f84000 0x4000>;
	interrupts = <50 51>;
	gpio-controller;
	#gpio-cells = <2>;
	interrupt-controller;
	#interrupt-cells = <2>;
};
```

## Documentation/devicetree/bindings/gpio/fsl-imx-gpio.yaml
```yaml
# SPDX-License-Identifier: GPL-2.0
%YAML 1.2
---
$id: http://devicetree.org/schemas/gpio/fsl-imx-gpio.yaml#
$schema: http://devicetree.org/meta-schemas/core.yaml#

title: Freescale i.MX/MXC GPIO controller

maintainers:
  - Shawn Guo <shawnguo@kernel.org>
  - Sascha Hauer <s.hauer@pengutronix.de>
  - Fabio Estevam <festevam@gmail.com>

properties:
  compatible:
    oneOf:
      - enum:
          - fsl,imx1-gpio
          - fsl,imx21-gpio
          - fsl,imx31-gpio
          - fsl,imx35-gpio
          - fsl,imx7d-gpio
      - items:
          - enum:
              - fsl,imx27-gpio
          - const: fsl,imx21-gpio
      - items:
          - const: fsl,imx35-gpio
          - const: fsl,imx31-gpio
      - items:
          - enum:
              - fsl,imx25-gpio
          - const: fsl,imx35-gpio
      - items:
          - enum:
              - fsl,imx50-gpio
              - fsl,imx51-gpio
              - fsl,imx53-gpio
              - fsl,imx6q-gpio
              - fsl,imx6sl-gpio
              - fsl,imx6sll-gpio
              - fsl,imx6sx-gpio
              - fsl,imx6ul-gpio
              - fsl,imx7d-gpio
              - fsl,imx8dxl-gpio
              - fsl,imx8mm-gpio
              - fsl,imx8mn-gpio
              - fsl,imx8mp-gpio
              - fsl,imx8mq-gpio
              - fsl,imx8qm-gpio
              - fsl,imx8qxp-gpio
              - fsl,imxrt1050-gpio
              - fsl,imxrt1170-gpio
          - const: fsl,imx35-gpio

  reg:
    maxItems: 1

  interrupts:
    description: |
      Should be the port interrupt shared by all 32 pins, if one number.
      If two numbers, the first one is the interrupt shared by low 16 pins
      and the second one is for high 16 pins.
    minItems: 1
    maxItems: 2

  interrupt-controller: true

  "#interrupt-cells":
    const: 2

  clocks:
    maxItems: 1

  "#gpio-cells":
    const: 2

  gpio-controller: true
  gpio-line-names: true
  gpio-ranges: true

  power-domains:
    maxItems: 1

patternProperties:
  "^(hog-[0-9]+|.+-hog(-[0-9]+)?)$":
    type: object
    required:
      - gpio-hog

required:
  - compatible
  - reg
  - interrupts
  - interrupt-controller
  - "#interrupt-cells"
  - "#gpio-cells"
  - gpio-controller

additionalProperties: false

examples:
  - |
    gpio0: gpio@73f84000 {
        compatible = "fsl,imx35-gpio";
        reg = <0x73f84000 0x4000>;
        interrupts = <50 51>;
        gpio-controller;
        #gpio-cells = <2>;
        interrupt-controller;
        #interrupt-cells = <2>;
    };

...
```

## Documentation/devicetree/bindings/gpio/fujitsu,mb86s70-gpio.txt
```
Fujitsu MB86S7x GPIO Controller
-------------------------------

Required properties:
- compatible: Should be "fujitsu,mb86s70-gpio"
- reg: Base address and length of register space
- clocks: Specify the clock
- gpio-controller: Marks the device node as a gpio controller.
- #gpio-cells: Should be <2>. The first cell is the pin number and the
  second cell is used to specify optional parameters:
   - bit 0 specifies polarity (0 for normal, 1 for inverted).

Examples:
	gpio0: gpio@31000000 {
		compatible = "fujitsu,mb86s70-gpio";
		reg = <0 0x31000000 0x10000>;
		gpio-controller;
		#gpio-cells = <2>;
		clocks = <&clk 0 2 1>;
	};
```

## Documentation/devicetree/bindings/gpio/fujitsu,mb86s70-gpio.yaml
```yaml
# SPDX-License-Identifier: (GPL-2.0-only OR BSD-2-Clause)
%YAML 1.2
---
$id: http://devicetree.org/schemas/gpio/fujitsu,mb86s70-gpio.yaml#
$schema: http://devicetree.org/meta-schemas/core.yaml#

title: Fujitsu MB86S7x GPIO Controller

maintainers:
  - Jassi Brar <jaswinder.singh@linaro.org>

properties:
  compatible:
    oneOf:
      - items:
          - const: socionext,synquacer-gpio
          - const: fujitsu,mb86s70-gpio
      - const: fujitsu,mb86s70-gpio

  reg:
    maxItems: 1

  '#gpio-cells':
    const: 2

  gpio-controller: true
  gpio-line-names: true

  clocks:
    maxItems: 1

required:
  - compatible
  - reg
  - '#gpio-cells'
  - gpio-controller
  - clocks

additionalProperties: false

examples:
  - |
    gpio@31000000 {
        compatible = "fujitsu,mb86s70-gpio";
        reg = <0x31000000 0x10000>;
        gpio-controller;
        #gpio-cells = <2>;
        clocks = <&clk 0 2 1>;
    };
...
```

## Documentation/devicetree/bindings/gpio/gateworks,pld-gpio.txt
```
Gateworks PLD GPIO controller bindings

The GPIO controller should be a child node on an I2C bus.

Required properties:
- compatible: Should be "gateworks,pld-gpio"
- reg: I2C slave address
- gpio-controller: Marks the device node as a GPIO controller.
- #gpio-cells: Should be <2>. The first cell is the gpio number and
  the second cell is used to specify optional parameters.

Example:

pld@56 {
	compatible = "gateworks,pld-gpio";
	reg = <0x56>;
	gpio-controller;
	#gpio-cells = <2>;
};
```

## Documentation/devicetree/bindings/gpio/gpio-74x164.txt
```
* Generic 8-bits shift register GPIO driver

Required properties:
- compatible : Should be "fairchild,74hc595"
- reg : chip select number
- gpio-controller : Marks the device node as a gpio controller.
- #gpio-cells : Should be two.  The first cell is the pin number and
  the second cell is used to specify the gpio polarity:
      0 = active high
      1 = active low
- registers-number: Number of daisy-chained shift registers

Example:

gpio5: gpio5@0 {
	compatible = "fairchild,74hc595";
	reg = <0>;
	gpio-controller;
	#gpio-cells = <2>;
	registers-number = <4>;
	spi-max-frequency = <100000>;
};
```

## Documentation/devicetree/bindings/gpio/gpio-74xx-mmio.txt
```
* 74XX MMIO GPIO driver

Required properties:
- compatible: Should contain one of the following:
   "ti,741g125": for 741G125 (1-bit Input),
   "ti,741g174": for 741G74 (1-bit Output),
   "ti,742g125": for 742G125 (2-bit Input),
   "ti,7474"   : for 7474 (2-bit Output),
   "ti,74125"  : for 74125 (4-bit Input),
   "ti,74175"  : for 74175 (4-bit Output),
   "ti,74365"  : for 74365 (6-bit Input),
   "ti,74174"  : for 74174 (6-bit Output),
   "ti,74244"  : for 74244 (8-bit Input),
   "ti,74273"  : for 74273 (8-bit Output),
   "ti,741624" : for 741624 (16-bit Input),
   "ti,7416374": for 7416374 (16-bit Output).
- reg: Physical base address and length where IC resides.
- gpio-controller: Marks the device node as a gpio controller.
- #gpio-cells: Should be two. The first cell is the pin number and
   the second cell is used to specify the GPIO polarity:
    0 = Active High,
    1 = Active Low.

Example:
	ctrl: gpio@30008004 {
		compatible = "ti,74174";
		reg = <0x30008004 0x1>;
		gpio-controller;
		#gpio-cells = <2>;
	};
```

## Documentation/devicetree/bindings/gpio/gpio-adnp.txt
```
Avionic Design N-bit GPIO expander bindings

Required properties:
- compatible: should be "ad,gpio-adnp"
- reg: The I2C slave address for this device.
- interrupts: Interrupt specifier for the controllers interrupt.
- #gpio-cells: Should be 2. The first cell is the GPIO number and the
  second cell is used to specify optional parameters:
  - bit 0: polarity (0: normal, 1: inverted)
- gpio-controller: Marks the device as a GPIO controller
- nr-gpios: The number of pins supported by the controller.

The GPIO expander can optionally be used as an interrupt controller, in
which case it uses the default two cell specifier as described in
Documentation/devicetree/bindings/interrupt-controller/interrupts.txt.

Example:

	gpioext: gpio-controller@41 {
		compatible = "ad,gpio-adnp";
		reg = <0x41>;

		interrupt-parent = <&gpio>;
		interrupts = <160 1>;

		gpio-controller;
		#gpio-cells = <2>;

		interrupt-controller;
		#interrupt-cells = <2>;

		nr-gpios = <64>;
	};
```

## Documentation/devicetree/bindings/gpio/gpio-altera.txt
```
Altera GPIO controller bindings

Required properties:
- compatible:
  - "altr,pio-1.0"
- reg: Physical base address and length of the controller's registers.
- #gpio-cells : Should be 1
  - The first cell is the gpio offset number
- gpio-controller : Marks the device node as a GPIO controller.
- #interrupt-cells : Should be 1.
  - The first cell is the GPIO offset number within the GPIO controller.
- interrupts: Specify the interrupt.
- interrupt-controller: Mark the device node as an interrupt controller

Altera GPIO specific required properties:
- altr,interrupt_trigger: Specifies the interrupt trigger type the GPIO
  hardware is synthesized. This field is required if the Altera GPIO controller
  used has IRQ enabled as the interrupt type is not software controlled,
  but hardware synthesized. Required if GPIO is used as an interrupt
  controller. The value is defined in <dt-bindings/interrupt-controller/irq.h>
  Only the following flags are supported:
    IRQ_TYPE_EDGE_RISING
    IRQ_TYPE_EDGE_FALLING
    IRQ_TYPE_EDGE_BOTH
    IRQ_TYPE_LEVEL_HIGH

Altera GPIO specific optional properties:
- altr,gpio-bank-width: Width of the GPIO bank. This defines how many pins the
  GPIO device has. Ranges between 1-32. Optional and defaults to 32 is not
  specified.

Example:

gpio_altr: gpio@40000 {
    compatible = "altr,pio-1.0";
    reg = <0xff200000 0x10>;
    interrupts = <0 45 4>;
    altr,gpio-bank-width = <32>;
    altr,interrupt_trigger = <IRQ_TYPE_EDGE_RISING>;
    #gpio-cells = <1>;
    gpio-controller;
    #interrupt-cells = <1>;
    interrupt-controller;
};
```

## Documentation/devicetree/bindings/gpio/gpio-aspeed.txt
```
Aspeed GPIO controller Device Tree Bindings
-------------------------------------------

Required properties:
- compatible		: Either "aspeed,ast2400-gpio" or "aspeed,ast2500-gpio"

- #gpio-cells 		: Should be two
			  - First cell is the GPIO line number
			  - Second cell is used to specify optional
			    parameters (unused)

- reg			: Address and length of the register set for the device
- gpio-controller	: Marks the device node as a GPIO controller.
- interrupts		: Interrupt specifier (see interrupt bindings for
			  details)
- interrupt-controller	: Mark the GPIO controller as an interrupt-controller

Optional properties:

- interrupt-parent     : The parent interrupt controller, optional if inherited

The gpio and interrupt properties are further described in their respective
bindings documentation:

- Documentation/devicetree/bindings/gpio/gpio.txt
- Documentation/devicetree/bindings/interrupt-controller/interrupts.txt

  Example:
	gpio@1e780000 {
		#gpio-cells = <2>;
		compatible = "aspeed,ast2400-gpio";
		gpio-controller;
		interrupts = <20>;
		reg = <0x1e780000 0x1000>;
		interrupt-controller;
	};
```

## Documentation/devicetree/bindings/gpio/gpio-ath79.txt
```
Binding for Qualcomm Atheros AR7xxx/AR9xxx GPIO controller

Required properties:
- compatible: has to be "qca,<soctype>-gpio" and one of the following
  fallbacks:
  - "qca,ar7100-gpio"
  - "qca,ar9340-gpio"
- reg: Base address and size of the controllers memory area
- gpio-controller : Marks the device node as a GPIO controller.
- #gpio-cells : Should be two. The first cell is the pin number and the
  second cell is used to specify optional parameters.
- ngpios: Should be set to the number of GPIOs available on the SoC.

Optional properties:
- interrupts: Interrupt specifier for the controllers interrupt.
- interrupt-controller : Identifies the node as an interrupt controller
- #interrupt-cells : Specifies the number of cells needed to encode interrupt
		     source, should be 2

Please refer to interrupts.txt in this directory for details of the common
Interrupt Controllers bindings used by client devices.

Example:

	gpio@18040000 {
		compatible = "qca,ar9132-gpio", "qca,ar7100-gpio";
		reg = <0x18040000 0x30>;
		interrupts = <2>;

		ngpios = <22>;

		gpio-controller;
		#gpio-cells = <2>;

		interrupt-controller;
		#interrupt-cells = <2>;
	};
```
