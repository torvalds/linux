## Documentation/devicetree/bindings/gpio/gpio-atlas7.txt
```
CSR SiRFatlas7 GPIO controller bindings

Required properties:
- compatible	: "sirf,atlas7-gpio"
- reg		: Address range of the pinctrl registers
- interrupts	: Interrupts used by every GPIO group
- gpio-banks	: How many gpio banks on this controller
- gpio-controller : Indicates this device is a GPIO controller
- interrupt-controller  : Marks the device node as an interrupt controller

The GPIO controller also acts as an interrupt controller. It uses the default
two cells specifier as described in Documentation/devicetree/bindings/
interrupt-controller/interrupts.txt.

Example:

	gpio_0: gpio_mediam@17040000 {
		compatible = "sirf,atlas7-gpio";
		reg = <0x17040000 0x1000>;
		interrupts = <0 13 0>, <0 14 0>;

		#gpio-cells = <2>;
		#interrupt-cells = <2>;

		gpio-controller;
		interrupt-controller;

		gpio-banks = <2>;
		gpio-ranges = <&pinctrl 0 0 0>,
				<&pinctrl 32 0 0>;
		gpio-ranges-group-names = "lvds_gpio_grp",
					"uart_nand_gpio_grp";
	};

	leds {
		compatible = "gpio-leds";

		led1 {
			gpios = <&gpio_1 15 0>;
			...
		};

		led2 {
			gpios = <&gpio_2 34 0>;
			...
		};
	};

Please refer to gpio.txt in this directory for details of the common
gpio properties used by devices.
```

## Documentation/devicetree/bindings/gpio/gpio-axp209.txt
```
AXP209 GPIO & pinctrl controller

This driver follows the usual GPIO bindings found in
Documentation/devicetree/bindings/gpio/gpio.txt

This driver follows the usual pinctrl bindings found in
Documentation/devicetree/bindings/pinctrl/pinctrl-bindings.txt

This driver employs the per-pin muxing pattern.

Required properties:
- compatible: Should be one of:
	- "x-powers,axp209-gpio"
	- "x-powers,axp813-gpio"
- #gpio-cells: Should be two. The first cell is the pin number and the
  second is the GPIO flags.
- gpio-controller: Marks the device node as a GPIO controller.

This node must be a subnode of the axp20x PMIC, documented in
Documentation/devicetree/bindings/mfd/axp20x.txt

Example:

axp209: pmic@34 {
	compatible = "x-powers,axp209";
	reg = <0x34>;
	interrupt-parent = <&nmi_intc>;
	interrupts = <0 IRQ_TYPE_LEVEL_LOW>;
	interrupt-controller;
	#interrupt-cells = <1>;

	axp_gpio: gpio {
		compatible = "x-powers,axp209-gpio";
		gpio-controller;
		#gpio-cells = <2>;
	};
};

The GPIOs can be muxed to other functions and therefore, must be a subnode of
axp_gpio.

Example:

&axp_gpio {
	gpio0_adc: gpio0-adc {
		pins = "GPIO0";
		function = "adc";
	};
};

&example_node {
	pinctrl-names = "default";
	pinctrl-0 = <&gpio0_adc>;
};

GPIOs and their functions
-------------------------

Each GPIO is independent from the other (i.e. GPIO0 in gpio_in function does
not force GPIO1 and GPIO2 to be in gpio_in function as well).

axp209
------
GPIO	|	Functions
------------------------
GPIO0	|	gpio_in, gpio_out, ldo, adc
GPIO1	|	gpio_in, gpio_out, ldo, adc
GPIO2	|	gpio_in, gpio_out

axp813
------
GPIO	|	Functions
------------------------
GPIO0	|	gpio_in, gpio_out, ldo, adc
GPIO1	|	gpio_in, gpio_out, ldo
```
