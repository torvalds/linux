## Documentation/devicetree/bindings/gpio/cdns,gpio.txt
```
Cadence GPIO controller bindings

Required properties:
- compatible: should be "cdns,gpio-r1p02".
- reg: the register base address and size.
- #gpio-cells: should be 2.
	* first cell is the GPIO number.
	* second cell specifies the GPIO flags, as defined in
		<dt-bindings/gpio/gpio.h>. Only the GPIO_ACTIVE_HIGH
		and GPIO_ACTIVE_LOW flags are supported.
- gpio-controller: marks the device as a GPIO controller.
- clocks: should contain one entry referencing the peripheral clock driving
	the GPIO controller.

Optional properties:
- ngpios: integer number of gpio lines supported by this controller, up to 32.
- interrupts: interrupt specifier for the controllers interrupt.
- interrupt-controller: marks the device as an interrupt controller. When
	defined, interrupts, interrupt-parent and #interrupt-cells
	are required.
- interrupt-cells: should be 2.
	* first cell is the GPIO number you want to use as an IRQ source.
	* second cell specifies the IRQ type, as defined in
		<dt-bindings/interrupt-controller/irq.h>.
		Currently only level sensitive IRQs are supported.


Example:
	gpio0: gpio-controller@fd060000 {
		compatible = "cdns,gpio-r1p02";
		reg =<0xfd060000 0x1000>;

		clocks = <&gpio_clk>;

		interrupt-parent = <&gic>;
		interrupts = <0 5 IRQ_TYPE_LEVEL_HIGH>;

		gpio-controller;
		#gpio-cells = <2>;

		interrupt-controller;
		#interrupt-cells = <2>;
	};
```

## Documentation/devicetree/bindings/gpio/cdns,gpio.yaml
```yaml
# SPDX-License-Identifier: (GPL-2.0 OR BSD-2-Clause)
%YAML 1.2
---
$id: http://devicetree.org/schemas/gpio/cdns,gpio.yaml#
$schema: http://devicetree.org/meta-schemas/core.yaml#

title: Cadence GPIO Controller

maintainers:
  - Jan Kotas <jank@cadence.com>

properties:
  compatible:
    oneOf:
      - const: cdns,gpio-r1p02
      - items:
          - enum:
              - axiado,ax3000-gpio
          - const: cdns,gpio-r1p02

  reg:
    maxItems: 1

  clocks:
    maxItems: 1

  ngpios:
    minimum: 1
    maximum: 32

  gpio-controller: true

  "#gpio-cells":
    const: 2
    description: |
      - First cell is the GPIO line number.
      - Second cell is flags as defined in <dt-bindings/gpio/gpio.h>,
        only GPIO_ACTIVE_HIGH and GPIO_ACTIVE_LOW supported.

  interrupt-controller: true

  "#interrupt-cells":
    const: 2
    description: |
      - First cell is the GPIO line number used as IRQ.
      - Second cell is the trigger type, as defined in
        <dt-bindings/interrupt-controller/irq.h>.

  interrupts:
    maxItems: 1

required:
  - compatible
  - reg
  - clocks
  - gpio-controller
  - "#gpio-cells"

if:
  required: [interrupt-controller]
then:
  required:
    - interrupts

additionalProperties: false

examples:
  - |
    #include <dt-bindings/interrupt-controller/arm-gic.h>
    #include <dt-bindings/interrupt-controller/irq.h>
    gpio0: gpio-controller@fd060000 {
        compatible = "cdns,gpio-r1p02";
        reg = <0xfd060000 0x1000>;
        clocks = <&gpio_clk>;

        interrupt-parent = <&gic>;
        interrupts = <GIC_SPI 5 IRQ_TYPE_LEVEL_HIGH>;

        gpio-controller;
        #gpio-cells = <2>;

        interrupt-controller;
        #interrupt-cells = <2>;
    };
```

## Documentation/devicetree/bindings/gpio/cirrus,clps711x-mctrl-gpio.txt
```
* ARM Cirrus Logic CLPS711X SYSFLG1 MCTRL GPIOs

Required properties:
- compatible: Should contain "cirrus,ep7209-mctrl-gpio".
- gpio-controller: Marks the device node as a gpio controller.
- #gpio-cells: Should be two. The first cell is the pin number and
  the second cell is used to specify the gpio polarity:
    0 = Active high,
    1 = Active low.

Example:
	sysgpio: sysgpio {
		compatible = "cirrus,ep7312-mctrl-gpio",
			     "cirrus,ep7209-mctrl-gpio";
		gpio-controller;
		#gpio-cells = <2>;
	};
```

## Documentation/devicetree/bindings/gpio/cirrus,clps711x-mctrl-gpio.yaml
```yaml
# SPDX-License-Identifier: (GPL-2.0-only OR BSD-2-Clause)
%YAML 1.2
---
$id: http://devicetree.org/schemas/gpio/cirrus,clps711x-mctrl-gpio.yaml#
$schema: http://devicetree.org/meta-schemas/core.yaml#

title: ARM Cirrus Logic CLPS711X SYSFLG1 MCTRL GPIOs

maintainers:
  - Alexander Shiyan <shc_work@mail.ru>

properties:
  compatible:
    oneOf:
      - items:
          - const: cirrus,ep7312-mctrl-gpio
          - const: cirrus,ep7209-mctrl-gpio
      - const: cirrus,ep7209-mctrl-gpio

  gpio-controller: true

  '#gpio-cells':
    const: 2

  gpio,syscon-dev:
    description:
      Phandle and offset of device's specific registers within the syscon state
      control registers
    $ref: /schemas/types.yaml#/definitions/phandle-array
    items:
      - items:
          - description: phandle to syscon
          - description: register offset within state control registers

required:
  - compatible
  - gpio-controller
  - '#gpio-cells'

additionalProperties: false

examples:
  - |
    sysgpio: sysgpio {
        compatible = "cirrus,ep7312-mctrl-gpio",
                     "cirrus,ep7209-mctrl-gpio";
        gpio-controller;
        #gpio-cells = <2>;
    };
```

## Documentation/devicetree/bindings/gpio/delta,tn48m-gpio.yaml
```yaml
# SPDX-License-Identifier: (GPL-2.0-only OR BSD-2-Clause)
%YAML 1.2
---
$id: http://devicetree.org/schemas/gpio/delta,tn48m-gpio.yaml#
$schema: http://devicetree.org/meta-schemas/core.yaml#

title: Delta Networks TN48M CPLD GPIO controller

maintainers:
  - Robert Marko <robert.marko@sartura.hr>

description: |
  This module is part of the Delta TN48M multi-function device. For more
  details see ../mfd/delta,tn48m-cpld.yaml.

  Delta TN48M has an onboard Lattice CPLD that is used as an GPIO expander.
  It provides 12 pins in total, they are input-only or ouput-only type.

properties:
  compatible:
    enum:
      - delta,tn48m-gpo
      - delta,tn48m-gpi

  reg:
    maxItems: 1

  "#gpio-cells":
    const: 2

  gpio-controller: true

required:
  - compatible
  - reg
  - "#gpio-cells"
  - gpio-controller

additionalProperties: false
```

## Documentation/devicetree/bindings/gpio/exar,xra1403.yaml
```yaml
# SPDX-License-Identifier: (GPL-2.0-only OR BSD-2-Clause)
%YAML 1.2
---
$id: http://devicetree.org/schemas/gpio/exar,xra1403.yaml#
$schema: http://devicetree.org/meta-schemas/core.yaml#

title: XRA1403 16-bit GPIO Expander with Reset Input

maintainers:
  - Nandor Han <nandor.han@ge.com>

description: >
  The XRA1403 is an 16-bit GPIO expander with an SPI interface. Features
  available:

    - Individually programmable inputs:
        - Internal pull-up resistors
        - Polarity inversion
        - Individual interrupt enable
        - Rising edge and/or Falling edge interrupt
        - Input filter
    - Individually programmable outputs:
        - Output Level Control
        - Output Three-State Control

properties:
  compatible:
    const: exar,xra1403

  reg:
    maxItems: 1

  gpio-controller: true

  '#gpio-cells':
    const: 2

  interrupt-controller: true

  '#interrupt-cells':
    const: 2

  reset-gpios:
    description: Control line for the device reset.

required:
  - compatible
  - reg
  - gpio-controller
  - '#gpio-cells'

allOf:
  - $ref: /schemas/spi/spi-peripheral-props.yaml#

unevaluatedProperties: false

examples:
  - |
    #include <dt-bindings/gpio/gpio.h>

    spi {
        #address-cells = <1>;
        #size-cells = <0>;

        gpio@2 {
            compatible = "exar,xra1403";
            reg = <2>;
            spi-max-frequency = <1000000>;
            gpio-controller;
            #gpio-cells = <2>;
            interrupt-controller;
            #interrupt-cells = <2>;
            reset-gpios = <&gpio3 6 GPIO_ACTIVE_LOW>;
        };
    };
```

## Documentation/devicetree/bindings/gpio/fairchild,74hc595.yaml
```yaml
# SPDX-License-Identifier: (GPL-2.0-only OR BSD-2-Clause)
%YAML 1.2
---
$id: http://devicetree.org/schemas/gpio/fairchild,74hc595.yaml#
$schema: http://devicetree.org/meta-schemas/core.yaml#

title: Generic 8-bit shift register

description: |
  NOTE: These chips nominally don't have a chip select pin. They do however
  have a rising-edge triggered latch clock (or storage register clock) pin,
  which behaves like an active-low chip select.

  After the bits are shifted into the shift register, CS# is driven high, which
  the 74HC595 sees as a rising edge on the latch clock that results in a
  transfer of the bits from the shift register to the storage register and thus
  to the output pins.
                      _   _       _   _
  shift clock    ____| |_| |_..._| |_| |_________

  latch clock                           * trigger
                 ___                     ________
  chip select#      |___________________|


maintainers:
  - Maxime Ripard <mripard@kernel.org>

properties:
  compatible:
    enum:
      - fairchild,74hc595
      - nxp,74lvc594

  reg:
    maxItems: 1

  gpio-controller: true

  '#gpio-cells':
    description:
      The second cell is only used to specify the GPIO polarity.
    const: 2

  registers-number:
    $ref: /schemas/types.yaml#/definitions/uint32
    description: Number of daisy-chained shift registers

  enable-gpios:
    description: GPIO connected to the OE (Output Enable) pin.
    maxItems: 1

patternProperties:
  "^(hog-[0-9]+|.+-hog(-[0-9]+)?)$":
    type: object
    required:
      - gpio-hog

required:
  - compatible
  - reg
  - gpio-controller
  - '#gpio-cells'
  - registers-number

allOf:
  - $ref: /schemas/spi/spi-peripheral-props.yaml#

unevaluatedProperties: false

examples:
  - |
    spi {
            #address-cells = <1>;
            #size-cells = <0>;

            gpio5: gpio5@0 {
                    compatible = "fairchild,74hc595";
                    reg = <0>;
                    gpio-controller;
                    #gpio-cells = <2>;
                    registers-number = <4>;
                    spi-max-frequency = <100000>;
            };
    };
```

## Documentation/devicetree/bindings/gpio/faraday,ftgpio010.txt
```
Faraday Technology FTGPIO010 GPIO Controller

Required properties:

- compatible : Should be one of
  "cortina,gemini-gpio", "faraday,ftgpio010"
  "moxa,moxart-gpio", "faraday,ftgpio010"
  "faraday,ftgpio010"
- reg : Should contain registers location and length
- interrupts : Should contain the interrupt line for the GPIO block
- gpio-controller : marks this as a GPIO controller
- #gpio-cells : Should be 2, see gpio/gpio.txt
- interrupt-controller : marks this as an interrupt controller
- #interrupt-cells : a standard two-cell interrupt flag, see
  interrupt-controller/interrupts.txt

Example:

gpio@4d000000 {
	compatible = "cortina,gemini-gpio", "faraday,ftgpio010";
	reg = <0x4d000000 0x100>;
	interrupts = <22 IRQ_TYPE_LEVEL_HIGH>;
	gpio-controller;
	#gpio-cells = <2>;
	interrupt-controller;
	#interrupt-cells = <2>;
};
```

## Documentation/devicetree/bindings/gpio/faraday,ftgpio010.yaml
```yaml
# SPDX-License-Identifier: (GPL-2.0-only OR BSD-2-Clause)
%YAML 1.2
---
$id: http://devicetree.org/schemas/gpio/faraday,ftgpio010.yaml#
$schema: http://devicetree.org/meta-schemas/core.yaml#

title: Faraday Technology FTGPIO010 GPIO Controller

maintainers:
  - Linus Walleij <linus.walleij@linaro.org>

properties:
  compatible:
    oneOf:
      - items:
          - const: cortina,gemini-gpio
          - const: faraday,ftgpio010
      - items:
          - const: moxa,moxart-gpio
          - const: faraday,ftgpio010
      - const: faraday,ftgpio010

  reg:
    maxItems: 1

  resets:
    maxItems: 1

  clocks:
    maxItems: 1

  interrupts:
    maxItems: 1
    description: Should contain the interrupt line for the GPIO block

  gpio-controller: true
  "#gpio-cells":
    const: 2

  interrupt-controller: true
  "#interrupt-cells":
    const: 2

required:
  - compatible
  - reg
  - interrupts
  - "#gpio-cells"
  - interrupt-controller
  - "#interrupt-cells"

additionalProperties: false

examples:
  - |
    #include <dt-bindings/interrupt-controller/irq.h>
    gpio@4d000000 {
      compatible = "cortina,gemini-gpio", "faraday,ftgpio010";
      reg = <0x4d000000 0x100>;
      interrupts = <22 IRQ_TYPE_LEVEL_HIGH>;
      gpio-controller;
      #gpio-cells = <2>;
      interrupt-controller;
      #interrupt-cells = <2>;
    };
```

## Documentation/devicetree/bindings/gpio/fcs,fxl6408.yaml
```yaml
# SPDX-License-Identifier: (GPL-2.0-only OR BSD-2-Clause)
%YAML 1.2
---
$id: http://devicetree.org/schemas/gpio/fcs,fxl6408.yaml#
$schema: http://devicetree.org/meta-schemas/core.yaml#

title: Fairchild FXL6408 I2C GPIO Expander

maintainers:
  - Emanuele Ghidoli <emanuele.ghidoli@toradex.com>

properties:
  compatible:
    enum:
      - fcs,fxl6408

  reg:
    maxItems: 1

  "#gpio-cells":
    const: 2

  gpio-controller: true

  gpio-line-names:
    minItems: 1
    maxItems: 8

patternProperties:
  "^(hog-[0-9]+|.+-hog(-[0-9]+)?)$":
    type: object
    required:
      - gpio-hog

required:
  - compatible
  - reg
  - gpio-controller
  - "#gpio-cells"

additionalProperties: false

examples:
  - |
    i2c {
        #address-cells = <1>;
        #size-cells = <0>;

        gpio_expander_43: gpio-expander@43 {
            compatible = "fcs,fxl6408";
            reg = <0x43>;
            gpio-controller;
            #gpio-cells = <2>;
            gpio-line-names = "Wi-Fi_W_DISABLE", "Wi-Fi_WKUP_WLAN",
                              "PWR_EN_+V3.3_WiFi_N", "PCIe_REF_CLK_EN",
                              "USB_RESET_N", "USB_BYPASS_N", "Wi-Fi_PDn",
                              "Wi-Fi_WKUP_BT";
        };
    };
```

## Documentation/devicetree/bindings/gpio/fsl,imx8qxp-sc-gpio.yaml
```yaml
# SPDX-License-Identifier: (GPL-2.0-only OR BSD-2-Clause)
%YAML 1.2
---
$id: http://devicetree.org/schemas/gpio/fsl,imx8qxp-sc-gpio.yaml#
$schema: http://devicetree.org/meta-schemas/core.yaml#

title: GPIO driver over IMX SCU firmware API

maintainers:
  - Shenwei Wang <shenwei.wang@nxp.com>

description: |
  This module provides the standard interface to control the
  resource pins in SCU domain on i.MX8 platforms.

properties:
  compatible:
    enum:
      - fsl,imx8qxp-sc-gpio

  "#gpio-cells":
    const: 2

  gpio-controller: true

required:
  - compatible
  - "#gpio-cells"
  - gpio-controller

additionalProperties: false

examples:
  - |
    gpio0: gpio {
        compatible = "fsl,imx8qxp-sc-gpio";
        gpio-controller;
        #gpio-cells = <2>;
    };
```
