## Documentation/devicetree/bindings/gpio/gpio-latch.yaml
```yaml
# SPDX-License-Identifier: (GPL-2.0-only OR BSD-2-Clause)
%YAML 1.2
---
$id: http://devicetree.org/schemas/gpio/gpio-latch.yaml#
$schema: http://devicetree.org/meta-schemas/core.yaml#

title: GPIO latch controller

maintainers:
  - Sascha Hauer <s.hauer@pengutronix.de>

description: |
  This binding describes a GPIO multiplexer based on latches connected to
  other GPIOs, like this:

  CLK0 ----------------------.        ,--------.
  CLK1 -------------------.  `--------|>    #0 |
                          |           |        |
  OUT0 ----------------+--|-----------|D0    Q0|-----|<
  OUT1 --------------+-|--|-----------|D1    Q1|-----|<
  OUT2 ------------+-|-|--|-----------|D2    Q2|-----|<
  OUT3 ----------+-|-|-|--|-----------|D3    Q3|-----|<
  OUT4 --------+-|-|-|-|--|-----------|D4    Q4|-----|<
  OUT5 ------+-|-|-|-|-|--|-----------|D5    Q5|-----|<
  OUT6 ----+-|-|-|-|-|-|--|-----------|D6    Q6|-----|<
  OUT7 --+-|-|-|-|-|-|-|--|-----------|D7    Q7|-----|<
         | | | | | | | |  |           `--------'
         | | | | | | | |  |
         | | | | | | | |  |           ,--------.
         | | | | | | | |  `-----------|>    #1 |
         | | | | | | | |              |        |
         | | | | | | | `--------------|D0    Q0|-----|<
         | | | | | | `----------------|D1    Q1|-----|<
         | | | | | `------------------|D2    Q2|-----|<
         | | | | `--------------------|D3    Q3|-----|<
         | | | `----------------------|D4    Q4|-----|<
         | | `------------------------|D5    Q5|-----|<
         | `--------------------------|D6    Q6|-----|<
         `----------------------------|D7    Q7|-----|<
                                      `--------'

  The number of clk-gpios and latched-gpios is not fixed. The actual number
  of number of latches and the number of inputs per latch is derived from
  the number of GPIOs given in the corresponding device tree properties.

properties:
  compatible:
    const: gpio-latch
  "#gpio-cells":
    const: 2

  clk-gpios:
    description: Array of GPIOs to be used to clock a latch

  latched-gpios:
    description: Array of GPIOs to be used as inputs per latch

  setup-duration-ns:
    description: Delay in nanoseconds to wait after the latch inputs have been
      set up

  clock-duration-ns:
    description: Delay in nanoseconds to wait between clock output changes

  gpio-controller: true

  gpio-line-names: true

required:
  - compatible
  - "#gpio-cells"
  - gpio-controller
  - clk-gpios
  - latched-gpios

additionalProperties: false

examples:
  - |
    gpio-latch {
        #gpio-cells = <2>;
        pinctrl-names = "default";
        pinctrl-0 = <&pinctrl_di_do_leds>;
        compatible = "gpio-latch";
        gpio-controller;
        setup-duration-ns = <100>;
        clock-duration-ns = <100>;

        clk-gpios = <&gpio3 7 0>, <&gpio3 8 0>;
        latched-gpios = <&gpio3 21 0>, <&gpio3 22 0>,
                       <&gpio3 23 0>, <&gpio3 24 0>,
                       <&gpio3 25 0>, <&gpio3 26 0>,
                       <&gpio3 27 0>, <&gpio3 28 0>;
    };
```

## Documentation/devicetree/bindings/gpio/gpio-line-mux.yaml
```yaml
# SPDX-License-Identifier: (GPL-2.0-only OR BSD-2-Clause)
%YAML 1.2
---
$id: http://devicetree.org/schemas/gpio/gpio-line-mux.yaml#
$schema: http://devicetree.org/meta-schemas/core.yaml#

title: GPIO line mux

maintainers:
  - Jonas Jelonek <jelonek.jonas@gmail.com>

description: |
  A GPIO controller to provide virtual GPIOs for a 1-to-many input-only mapping
  backed by a single shared GPIO and a multiplexer. A simple illustrated
  example is:

            +----- A
    IN     /
    <-----o------- B
        / |\
        | | +----- C
        | |  \
        | |   +--- D
        | |
       M1 M0

    MUX CONTROL

     M1 M0   IN
      0  0   A
      0  1   B
      1  0   C
      1  1   D

  This can be used in case a real GPIO is connected to multiple inputs and
  controlled by a multiplexer, and another subsystem/driver does not work
  directly with the multiplexer subsystem.

properties:
  compatible:
    const: gpio-line-mux

  gpio-controller: true

  "#gpio-cells":
    const: 2

  gpio-line-mux-states:
    description: Mux states corresponding to the virtual GPIOs.
    $ref: /schemas/types.yaml#/definitions/uint32-array

  gpio-line-names: true

  mux-controls:
    maxItems: 1
    description:
      Phandle to the multiplexer to control access to the GPIOs.

  ngpios: false

  muxed-gpios:
    maxItems: 1
    description:
      GPIO which is the '1' in 1-to-many and is shared by the virtual GPIOs
      and controlled via the mux.

required:
  - compatible
  - gpio-controller
  - gpio-line-mux-states
  - mux-controls
  - muxed-gpios

additionalProperties: false

examples:
  - |
    #include <dt-bindings/gpio/gpio.h>
    #include <dt-bindings/mux/mux.h>

    sfp_gpio_mux: mux-controller-1 {
        compatible = "gpio-mux";
        mux-gpios = <&gpio0 0 GPIO_ACTIVE_HIGH>,
                    <&gpio0 1 GPIO_ACTIVE_HIGH>;
        #mux-control-cells = <0>;
        idle-state = <MUX_IDLE_AS_IS>;
    };

    sfp1_gpio: sfp-gpio-1 {
        compatible = "gpio-line-mux";
        gpio-controller;
        #gpio-cells = <2>;

        mux-controls = <&sfp_gpio_mux>;
        muxed-gpios = <&gpio0 2 GPIO_ACTIVE_HIGH>;

        gpio-line-mux-states = <0>, <1>, <3>;
    };

    sfp1: sfp-p1 {
        compatible = "sff,sfp";

        i2c-bus = <&sfp1_i2c>;
        los-gpios = <&sfp1_gpio 0 GPIO_ACTIVE_HIGH>;
        mod-def0-gpios = <&sfp1_gpio 1 GPIO_ACTIVE_LOW>;
        tx-fault-gpios = <&sfp1_gpio 2 GPIO_ACTIVE_HIGH>;
    };
```

## Documentation/devicetree/bindings/gpio/gpio-lp3943.txt
```
TI/National Semiconductor LP3943 GPIO controller

Required properties:
  - compatible: "ti,lp3943-gpio"
  - gpio-controller: Marks the device node as a GPIO controller.
  - #gpio-cells: Should be 2. See gpio.txt in this directory for a
                 description of the cells format.

Example:
Simple LED controls with LP3943 GPIO controller

&i2c4 {
	lp3943@60 {
		compatible = "ti,lp3943";
		reg = <0x60>;

		gpioex: gpio {
			compatible = "ti,lp3943-gpio";
			gpio-controller;
			#gpio-cells = <2>;
		};
	};
};

leds {
	compatible = "gpio-leds";
	indicator1 {
		label = "indi1";
		gpios = <&gpioex 9 GPIO_ACTIVE_LOW>;
	};

	indicator2 {
		label = "indi2";
		gpios = <&gpioex 10 GPIO_ACTIVE_LOW>;
		default-state = "off";
	};
};
```

## Documentation/devicetree/bindings/gpio/gpio-max3191x.txt
```
GPIO driver for Maxim MAX3191x industrial serializer

Required properties:
 - compatible:		Must be one of:
			"maxim,max31910"
			"maxim,max31911"
			"maxim,max31912"
			"maxim,max31913"
			"maxim,max31953"
			"maxim,max31963"
 - reg: 		Chip select number.
 - gpio-controller:	Marks the device node as a GPIO controller.
 - #gpio-cells: 	Should be two. For consumer use see gpio.txt.

Optional properties:
 - #daisy-chained-devices:
			Number of chips in the daisy-chain (default is 1).
 - maxim,modesel-gpios: GPIO pins to configure modesel of each chip.
			The number of GPIOs must equal "#daisy-chained-devices"
			(if each chip is driven by a separate pin) or 1
			(if all chips are wired to the same pin).
 - maxim,fault-gpios: 	GPIO pins to read fault of each chip.
			The number of GPIOs must equal "#daisy-chained-devices"
			or 1.
 - maxim,db0-gpios:	GPIO pins to configure debounce of each chip.
			The number of GPIOs must equal "#daisy-chained-devices"
			or 1.
 - maxim,db1-gpios:	GPIO pins to configure debounce of each chip.
			The number of GPIOs must equal "maxim,db0-gpios".
 - maxim,modesel-8bit:	Boolean whether the modesel pin of the chips is
			pulled high (8-bit mode).  Use this if the modesel pin
			is hardwired and consequently "maxim,modesel-gpios"
			cannot be specified.  By default if neither this nor
			"maxim,modesel-gpios" is given, the driver assumes
			that modesel is pulled low (16-bit mode).
 - maxim,ignore-undervoltage:
			Boolean whether to ignore undervoltage alarms signaled
			by the "maxim,fault-gpios" or by the status byte
			(in 16-bit mode).  Use this if the chips are powered
			through 5VOUT instead of VCC24V, in which case they
			will constantly signal undervoltage.

For other required and optional properties of SPI slave nodes please refer to
../spi/spi-bus.txt.

Example:
	gpio@0 {
		compatible = "maxim,max31913";
		reg = <0>;
		gpio-controller;
		#gpio-cells = <2>;

		maxim,modesel-gpios = <&gpio2 23>;
		maxim,fault-gpios   = <&gpio2 24 GPIO_ACTIVE_LOW>;
		maxim,db0-gpios     = <&gpio2 25>;
		maxim,db1-gpios     = <&gpio2 26>;

		spi-max-frequency = <25000000>;
	};
```

## Documentation/devicetree/bindings/gpio/gpio-max732x.txt
```
* MAX732x-compatible I/O expanders

Required properties:
  - compatible: Should be one of the following:
    - "maxim,max7319": For the Maxim MAX7319
    - "maxim,max7320": For the Maxim MAX7320
    - "maxim,max7321": For the Maxim MAX7321
    - "maxim,max7322": For the Maxim MAX7322
    - "maxim,max7323": For the Maxim MAX7323
    - "maxim,max7324": For the Maxim MAX7324
    - "maxim,max7325": For the Maxim MAX7325
    - "maxim,max7326": For the Maxim MAX7326
    - "maxim,max7327": For the Maxim MAX7327
  - reg: I2C slave address for this device.
  - gpio-controller: Marks the device node as a GPIO controller.
  - #gpio-cells: Should be 2.
    - first cell is the GPIO number
    - second cell specifies GPIO flags, as defined in <dt-bindings/gpio/gpio.h>.
      Only the GPIO_ACTIVE_HIGH and GPIO_ACTIVE_LOW flags are supported.

Optional properties:

  The I/O expander can detect input state changes, and thus optionally act as
  an interrupt controller. When the expander interrupt line is connected all the
  following properties must be set. For more information please see the
  interrupt controller device tree bindings documentation available at
  Documentation/devicetree/bindings/interrupt-controller/interrupts.txt.

  - interrupt-controller: Identifies the node as an interrupt controller.
  - #interrupt-cells: Number of cells to encode an interrupt source, shall be 2.
    - first cell is the pin number
    - second cell is used to specify flags
  - interrupts: Interrupt specifier for the controllers interrupt.

Please refer to gpio.txt in this directory for details of the common GPIO
bindings used by client devices.

Example 1. MAX7325 with interrupt support enabled (CONFIG_GPIO_MAX732X_IRQ=y):

	expander: max7325@6d {
		compatible = "maxim,max7325";
		reg = <0x6d>;
		gpio-controller;
		#gpio-cells = <2>;
		interrupt-controller;
		#interrupt-cells = <2>;
		interrupt-parent = <&gpio4>;
		interrupts = <29 IRQ_TYPE_EDGE_FALLING>;
	};

Example 2. MAX7325 with interrupt support disabled (CONFIG_GPIO_MAX732X_IRQ=n):

	expander: max7325@6d {
		compatible = "maxim,max7325";
		reg = <0x6d>;
		gpio-controller;
		#gpio-cells = <2>;
	};
```

## Documentation/devicetree/bindings/gpio/gpio-max77620.txt
```
GPIO driver for MAX77620 Power management IC from Maxim Semiconductor.

Device has 8 GPIO pins which can be configured as GPIO as well as the
special IO functions.

Required properties:
-------------------
- gpio-controller : 	Marks the device node as a gpio controller.
- #gpio-cells : 	Should be two.  The first cell is the pin number and
			the second cell is used to specify the gpio polarity:
				0 = active high
				1 = active low
For more details, please refer generic GPIO DT binding document
<devicetree/bindings/gpio/gpio.txt>.

Example:
--------
#include <dt-bindings/mfd/max77620.h>
...
max77620@3c {
	compatible = "maxim,max77620";

	gpio-controller;
	#gpio-cells = <2>;
};
```

## Documentation/devicetree/bindings/gpio/gpio-mcp23s08.txt
```
Microchip MCP2308/MCP23S08/MCP23017/MCP23S17 driver for
8-/16-bit I/O expander with serial interface (I2C/SPI)

Required properties:
- compatible : Should be
    - "mcp,mcp23s08" (DEPRECATED) for  8 GPIO SPI version
    - "mcp,mcp23s17" (DEPRECATED) for 16 GPIO SPI version
    - "mcp,mcp23008" (DEPRECATED) for  8 GPIO I2C version or
    - "mcp,mcp23017" (DEPRECATED) for 16 GPIO I2C version of the chip

    - "microchip,mcp23s08" for  8 GPIO SPI version
    - "microchip,mcp23s17" for 16 GPIO SPI version
    - "microchip,mcp23008" for  8 GPIO I2C version or
    - "microchip,mcp23017" for 16 GPIO I2C version of the chip
    NOTE: Do not use the old mcp prefix any more. It is deprecated and will be
    removed.
- #gpio-cells : Should be two.
  - first cell is the pin number
  - second cell is used to specify flags. Flags are currently unused.
- gpio-controller : Marks the device node as a GPIO controller.
- reg : For an address on its bus. I2C uses this a the I2C address of the chip.
        SPI uses this to specify the chipselect line which the chip is
        connected to. The driver and the SPI variant of the chip support
        multiple chips on the same chipselect. Have a look at
        microchip,spi-present-mask below.

Required device specific properties (only for SPI chips):
- mcp,spi-present-mask (DEPRECATED)
- microchip,spi-present-mask : This is a present flag, that makes only sense for SPI
        chips - as the name suggests. Multiple SPI chips can share the same
        SPI chipselect. Set a bit in bit0-7 in this mask to 1 if there is a
        chip connected with the corresponding spi address set. For example if
        you have a chip with address 3 connected, you have to set bit3 to 1,
        which is 0x08. mcp23s08 chip variant only supports bits 0-3. It is not
        possible to mix mcp23s08 and mcp23s17 on the same chipselect. Set at
        least one bit to 1 for SPI chips.
    NOTE: Do not use the old mcp prefix any more. It is deprecated and will be
    removed.
- spi-max-frequency = The maximum frequency this chip is able to handle

Optional properties:
- #interrupt-cells : Should be two.
  - first cell is the pin number
  - second cell is used to specify flags.
- interrupt-controller: Marks the device node as a interrupt controller.
NOTE: The interrupt functionality is only supported for i2c versions of the
chips. The spi chips can also do the interrupts, but this is not supported by
the linux driver yet.

Optional device specific properties:
- microchip,irq-mirror: Sets the mirror flag in the IOCON register. Devices
        with two interrupt outputs (these are the devices ending with 17 and
        those that have 16 IOs) have two IO banks: IO 0-7 form bank 1 and
        IO 8-15 are bank 2. These chips have two different interrupt outputs:
        One for bank 1 and another for bank 2. If irq-mirror is set, both
        interrupts are generated regardless of the bank that an input change
        occured on. If it is not set, the interrupt are only generated for the
        bank they belong to.
        On devices with only one interrupt output this property is useless.

Example I2C (with interrupt):
gpiom1: gpio@20 {
        compatible = "microchip,mcp23017";
        gpio-controller;
        #gpio-cells = <2>;
        reg = <0x20>;

        interrupt-parent = <&gpio1>;
        interrupts = <17 IRQ_TYPE_LEVEL_LOW>;
        interrupt-controller;
        #interrupt-cells=<2>;
        microchip,irq-mirror;
};

Example SPI:
gpiom1: gpio@0 {
        compatible = "microchip,mcp23s17";
        gpio-controller;
        #gpio-cells = <2>;
        spi-present-mask = <0x01>;
        reg = <0>;
        spi-max-frequency = <1000000>;
};
```
