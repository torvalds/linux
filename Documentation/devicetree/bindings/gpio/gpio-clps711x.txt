## Documentation/devicetree/bindings/gpio/gpio-mm-lantiq.txt
```
Lantiq SoC External Bus memory mapped GPIO controller

By attaching hardware latches to the EBU it is possible to create output
only gpios. This driver configures a special memory address, which when
written to outputs 16 bit to the latches.

The node describing the memory mapped GPIOs needs to be a child of the node
describing the "lantiq,localbus".

Required properties:
- compatible : Should be "lantiq,gpio-mm-lantiq"
- reg : Address and length of the register set for the device
- #gpio-cells : Should be two.  The first cell is the pin number and
  the second cell is used to specify optional parameters (currently
  unused).
- gpio-controller : Marks the device node as a gpio controller.

Optional properties:
- lantiq,shadow : The default value that we shall assume as already set on the
  shift register cascade.

Example:

localbus@0 {
	#address-cells = <2>;
	#size-cells = <1>;
	ranges = <0 0 0x0 0x3ffffff /* addrsel0 */
		1 0 0x4000000 0x4000010>; /* addsel1 */
	compatible = "lantiq,localbus", "simple-bus";

	gpio_mm0: gpio@4000000 {
		compatible = "lantiq,gpio-mm";
		reg = <1 0x0 0x10>;
		gpio-controller;
		#gpio-cells = <2>;
		lantiq,shadow = <0x77f>
	};
}
```

## Documentation/devicetree/bindings/gpio/gpio-mmio.yaml
```yaml
# SPDX-License-Identifier: (GPL-2.0-only OR BSD-2-Clause)
%YAML 1.2
---
$id: http://devicetree.org/schemas/gpio/gpio-mmio.yaml#
$schema: http://devicetree.org/meta-schemas/core.yaml#

title: Generic MMIO GPIO

maintainers:
  - Linus Walleij <linus.walleij@linaro.org>
  - Bartosz Golaszewski <brgl@bgdev.pl>

description:
  Some simple GPIO controllers may consist of a single data register or a pair
  of set/clear-bit registers. Such controllers are common for glue logic in
  FPGAs or ASICs. Commonly, these controllers are accessed over memory-mapped
  NAND-style parallel busses.

properties:
  compatible:
    enum:
      - brcm,bcm6345-gpio
      - ni,169445-nand-gpio
      - wd,mbl-gpio # Western Digital MyBook Live memory-mapped GPIO controller

  big-endian: true

  '#gpio-cells':
    const: 2

  gpio-controller: true

  little-endian: true

  reg:
    minItems: 1
    description:
      A list of registers in the controller. The width of each register is
      determined by its size. All registers must have the same width. The number
      of GPIOs is set by the width, with bit 0 corresponding to GPIO 0.
    items:
      - description:
          Register to READ the value of the GPIO lines. If GPIO line is high,
          the bit will be set. If the GPIO line is low, the bit will be cleared.
          This register may also be used to drive GPIOs if the SET register is
          omitted.
      - description:
          Register to SET the value of the GPIO lines. Setting a bit in this
          register will drive the GPIO line high.
      - description:
          Register to CLEAR the value of the GPIO lines. Setting a bit in this
          register will drive the GPIO line low. If this register is omitted,
          the SET register will be used to clear the GPIO lines as well, by
          actively writing the line with 0.
      - description:
          Register to set the line as OUTPUT. Setting a bit in this register
          will turn that line into an output line. Conversely, clearing a bit
          will turn that line into an input.
      - description:
          Register to set this line as INPUT. Setting a bit in this register
          will turn that line into an input line. Conversely, clearing a bit
          will turn that line into an output.

  reg-names:
    minItems: 1
    maxItems: 5
    items:
      enum:
        - dat
        - set
        - clr
        - dirout
        - dirin

  native-endian: true

  no-output:
    $ref: /schemas/types.yaml#/definitions/flag
    description:
      If this property is present, the controller cannot drive the GPIO lines.

required:
  - compatible
  - reg
  - reg-names
  - '#gpio-cells'
  - gpio-controller

additionalProperties: false

examples:
  - |
    gpio@1f300010 {
      compatible = "ni,169445-nand-gpio";
      reg = <0x1f300010 0x4>;
      reg-names = "dat";
      gpio-controller;
      #gpio-cells = <2>;
    };

    gpio@e0100000 {
      compatible = "wd,mbl-gpio";
      reg-names = "dat";
      reg = <0xe0100000 0x1>;
      #gpio-cells = <2>;
      gpio-controller;
      no-output;
    };

    gpio@fffe0406 {
      compatible = "brcm,bcm6345-gpio";
      reg-names = "dirout", "dat";
      reg = <0xfffe0406 2>, <0xfffe040a 2>;
      native-endian;
      gpio-controller;
      #gpio-cells = <2>;
    };
```

## Documentation/devicetree/bindings/gpio/gpio-moxtet.txt
```
Turris Mox Moxtet GPIO expander via Moxtet bus

Required properties:
 - compatible		: Should be "cznic,moxtet-gpio".
 - gpio-controller	: Marks the device node as a GPIO controller.
 - #gpio-cells		: Should be two. For consumer use see gpio.txt.

Other properties are required for a Moxtet bus device, please refer to
Documentation/devicetree/bindings/bus/moxtet.txt.

Example:

	moxtet_sfp: gpio@0 {
		compatible = "cznic,moxtet-gpio";
		gpio-controller;
		#gpio-cells = <2>;
		reg = <0>;
	}
```

## Documentation/devicetree/bindings/gpio/gpio-mpc8xxx.txt
```
* Freescale MPC512x/MPC8xxx/QorIQ/Layerscape GPIO controller

Required properties:
- compatible : Should be "fsl,<soc>-gpio"
  The following <soc>s are known to be supported:
	mpc5121, mpc5125, mpc8349, mpc8572, mpc8610, pq3, qoriq,
	ls1021a, ls1043a, ls2080a.
- reg : Address and length of the register set for the device
- interrupts : Should be the port interrupt shared by all 32 pins.
- #gpio-cells : Should be two.  The first cell is the pin number and
  the second cell is used to specify the gpio polarity:
      0 = active high
      1 = active low

Optional properties:
- little-endian : GPIO registers are used as little endian. If not
                  present registers are used as big endian by default.

Example of gpio-controller node for a mpc5125 SoC:

gpio0: gpio@1100 {
	compatible = "fsl,mpc5125-gpio";
	#gpio-cells = <2>;
	reg = <0x1100 0x080>;
	interrupts = <78 0x8>;
};

Example of gpio-controller node for a ls2080a SoC:

gpio0: gpio@2300000 {
	compatible = "fsl,ls2080a-gpio", "fsl,qoriq-gpio";
	reg = <0x0 0x2300000 0x0 0x10000>;
	interrupts = <0 36 0x4>; /* Level high type */
	gpio-controller;
	little-endian;
	#gpio-cells = <2>;
	interrupt-controller;
	#interrupt-cells = <2>;
};
```
