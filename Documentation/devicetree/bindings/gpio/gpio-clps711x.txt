## Documentation/devicetree/bindings/gpio/gpio-detection.txt
```
Required properties:
- compatible: should be "gpio-detection"
- status:
- pinctrl-0 : phandle referencing pin configuration of the gpio controller
- pinctrl-names : a pinctrl state named "default" must be defined
- car-reverse : a describtion to show the gpio will be use to car reverse
- car-acc : a describtion to show the gpio will be use to car accelerate
- gpios : The GPIO to set high/low, see "gpios property" in
  Documentation/devicetree/bindings/gpio/gpio.txt. If the pin should be
  low to power down the board set it to "Active Low", otherwise set
  gpio to "Active High".
- linux,debounce-ms: interrupt debounce time. (u32)
- label : The label / name for this partition.  If omitted, the label is taken
- gpio,wakeup : To enable the wakeup comparator in probe

Example:

	gpio_det: gpio-det {
		compatible = "gpio-detection";
		status = "okay";

		pinctrl-0 = <&gpio3_b1 &gpio3_b2>;
		pinctrl-names = "default";
		car-reverse {
			car-reverse-gpios = <&gpio3 10 GPIO_ACTIVE_HIGH>;
			linux,debounce-ms = <5>;
			label = "car-reverse";
			gpio,wakeup;
		};

		car-acc {
			car-acc-gpios = <&gpio3 9 GPIO_ACTIVE_HIGH>;
			linux,debounce-ms = <5>;
			label = "car-acc";
			gpio,wakeup;
		};
	};
```

## Documentation/devicetree/bindings/gpio/gpio-dsp-keystone.txt
```
Keystone 2 DSP GPIO controller bindings

HOST OS userland running on ARM can send interrupts to DSP cores using
the DSP GPIO controller IP. It provides 28 IRQ signals per each DSP core.
This is one of the component used by the IPC mechanism used on Keystone SOCs.

For example TCI6638K2K SoC has 8 DSP GPIO controllers:
 - 8 for C66x CorePacx CPUs 0-7

Keystone 2 DSP GPIO controller has specific features:
- each GPIO can be configured only as output pin;
- setting GPIO value to 1 causes IRQ generation on target DSP core;
- reading pin value returns 0 - if IRQ was handled or 1 - IRQ is still
  pending.

Required Properties:
- compatible: should be "ti,keystone-dsp-gpio"
- ti,syscon-dev: phandle/offset pair. The phandle to syscon used to
  access device state control registers and the offset of device's specific
  registers within device state control registers range.
- gpio-controller: Marks the device node as a gpio controller.
- #gpio-cells: Should be 2.

Please refer to gpio.txt in this directory for details of the common GPIO
bindings used by client devices.

Example:
	dspgpio0: keystone_dsp_gpio@2620240 {
		compatible = "ti,keystone-dsp-gpio";
		ti,syscon-dev = <&devctrl 0x240>;
		gpio-controller;
		#gpio-cells = <2>;
	};

	dsp0: dsp0 {
		compatible = "linux,rproc-user";
		...
		kick-gpio = <&dspgpio0 27>;
	};
```

## Documentation/devicetree/bindings/gpio/gpio-dw.txt
```
Synopsis DesignWare GPIO controller bindings

Required properties:
- compatible:
  - "snps,dw-gpio"
- reg: Physical base address and length of the controller's registers.
- gpio-controller : Marks the device node as a GPIO controller.
- #gpio-cells : Should be two.
  - first cell is the pin number
  - second cell is used to specify optional parameters (unused)
- clocks
  - Clock source

Optional properties:
- width
  - Number of gpio lines.  Defaults to 32.
- resetvalue
  - Reset value of gpios for the saved shadow value.

Example:
	gpio0: gpio@ff708000 {
		compatible = "snps,dw-gpio";
		reg = <0xff708000 0x1000>;
		width = <29>;
		gpio-controller;
		#gpio-cells = <2>;
		clocks = <&per_base_clk>;
	};
```

## Documentation/devicetree/bindings/gpio/gpio-eic-sprd.txt
```
Spreadtrum EIC controller bindings

The EIC is the abbreviation of external interrupt controller, which can
be used only in input mode. The Spreadtrum platform has 2 EIC controllers,
one is in digital chip, and another one is in PMIC. The digital chip EIC
controller contains 4 sub-modules: EIC-debounce, EIC-latch, EIC-async and
EIC-sync. But the PMIC EIC controller contains only one EIC-debounce sub-
module.

The EIC-debounce sub-module provides up to 8 source input signal
connections. A debounce mechanism is used to capture the input signals'
stable status (millisecond resolution) and a single-trigger mechanism
is introduced into this sub-module to enhance the input event detection
reliability. In addition, this sub-module's clock can be shut off
automatically to reduce power dissipation. Moreover the debounce range
is from 1ms to 4s with a step size of 1ms. The input signal will be
ignored if it is asserted for less than 1 ms.

The EIC-latch sub-module is used to latch some special power down signals
and generate interrupts, since the EIC-latch does not depend on the APB
clock to capture signals.

The EIC-async sub-module uses a 32kHz clock to capture the short signals
(microsecond resolution) to generate interrupts by level or edge trigger.

The EIC-sync is similar with GPIO's input function, which is a synchronized
signal input register. It can generate interrupts by level or edge trigger
when detecting input signals.

Required properties:
- compatible: Should be one of the following:
  "sprd,sc9860-eic-debounce",
  "sprd,sc9860-eic-latch",
  "sprd,sc9860-eic-async",
  "sprd,sc9860-eic-sync",
  "sprd,sc2731-eic".
- reg: Define the base and range of the I/O address space containing
  the GPIO controller registers.
- gpio-controller: Marks the device node as a GPIO controller.
- #gpio-cells: Should be <2>. The first cell is the gpio number and
  the second cell is used to specify optional parameters.
- interrupt-controller: Marks the device node as an interrupt controller.
- #interrupt-cells: Should be <2>. Specifies the number of cells needed
  to encode interrupt source.
- interrupts: Should be the port interrupt shared by all the gpios.

Example:
	eic_debounce: gpio@40210000 {
		compatible = "sprd,sc9860-eic-debounce";
		reg = <0 0x40210000 0 0x80>;
		gpio-controller;
		#gpio-cells = <2>;
		interrupt-controller;
		#interrupt-cells = <2>;
		interrupts = <GIC_SPI 52 IRQ_TYPE_LEVEL_HIGH>;
	};

	eic_latch: gpio@40210080 {
		compatible = "sprd,sc9860-eic-latch";
		reg = <0 0x40210080 0 0x20>;
		gpio-controller;
		#gpio-cells = <2>;
		interrupt-controller;
		#interrupt-cells = <2>;
		interrupts = <GIC_SPI 52 IRQ_TYPE_LEVEL_HIGH>;
	};

	eic_async: gpio@402100a0 {
		compatible = "sprd,sc9860-eic-async";
		reg = <0 0x402100a0 0 0x20>;
		gpio-controller;
		#gpio-cells = <2>;
		interrupt-controller;
		#interrupt-cells = <2>;
		interrupts = <GIC_SPI 52 IRQ_TYPE_LEVEL_HIGH>;
	};

	eic_sync: gpio@402100c0 {
		compatible = "sprd,sc9860-eic-sync";
		reg = <0 0x402100c0 0 0x20>;
		gpio-controller;
		#gpio-cells = <2>;
		interrupt-controller;
		#interrupt-cells = <2>;
		interrupts = <GIC_SPI 52 IRQ_TYPE_LEVEL_HIGH>;
	};

	pmic_eic: gpio@300 {
		compatible = "sprd,sc2731-eic";
		reg = <0x300>;
		interrupt-parent = <&sc2731_pmic>;
		interrupts = <5 IRQ_TYPE_LEVEL_HIGH>;
		gpio-controller;
		#gpio-cells = <2>;
		interrupt-controller;
		#interrupt-cells = <2>;
	};
```

## Documentation/devicetree/bindings/gpio/gpio-ep9301.yaml
```yaml
# SPDX-License-Identifier: (GPL-2.0 OR BSD-2-Clause)
%YAML 1.2
---
$id: http://devicetree.org/schemas/gpio/gpio-ep9301.yaml#
$schema: http://devicetree.org/meta-schemas/core.yaml#

title: EP93xx GPIO controller

maintainers:
  - Linus Walleij <linus.walleij@linaro.org>
  - Bartosz Golaszewski <brgl@bgdev.pl>
  - Nikita Shubin <nikita.shubin@maquefel.me>

properties:
  compatible:
    oneOf:
      - const: cirrus,ep9301-gpio
      - items:
          - enum:
              - cirrus,ep9302-gpio
              - cirrus,ep9307-gpio
              - cirrus,ep9312-gpio
              - cirrus,ep9315-gpio
          - const: cirrus,ep9301-gpio

  reg:
    minItems: 2
    items:
      - description: data register
      - description: direction register
      - description: interrupt registers base

  reg-names:
    minItems: 2
    items:
      - const: data
      - const: dir
      - const: intr

  gpio-controller: true

  gpio-ranges: true

  "#gpio-cells":
    const: 2

  interrupt-controller: true

  "#interrupt-cells":
    const: 2

  interrupts:
    oneOf:
      - maxItems: 1
      - description: port F has dedicated irq line for each gpio line
        maxItems: 8

required:
  - compatible
  - reg
  - gpio-controller
  - "#gpio-cells"

additionalProperties: false

examples:
  - |
    gpio@80840000 {
      compatible = "cirrus,ep9301-gpio";
      reg = <0x80840000 0x04>,
            <0x80840010 0x04>,
            <0x80840090 0x1c>;
      reg-names = "data", "dir", "intr";
      gpio-controller;
      #gpio-cells = <2>;
      interrupt-controller;
      #interrupt-cells = <2>;
      interrupt-parent = <&vic1>;
      interrupts = <27>;
    };

    gpio@80840004 {
      compatible = "cirrus,ep9301-gpio";
      reg = <0x80840004 0x04>,
            <0x80840014 0x04>,
            <0x808400ac 0x1c>;
      reg-names = "data", "dir", "intr";
      gpio-controller;
      #gpio-cells = <2>;
      interrupt-controller;
      #interrupt-cells = <2>;
      interrupt-parent = <&vic1>;
      interrupts = <27>;
    };

    gpio@80840008 {
      compatible = "cirrus,ep9301-gpio";
      reg = <0x80840008 0x04>,
            <0x80840018 0x04>;
      reg-names = "data", "dir";
      gpio-controller;
      #gpio-cells = <2>;
    };

    gpio@8084000c {
      compatible = "cirrus,ep9301-gpio";
      reg = <0x8084000c 0x04>,
            <0x8084001c 0x04>;
      reg-names = "data", "dir";
      gpio-controller;
      #gpio-cells = <2>;
    };

    gpio@80840020 {
      compatible = "cirrus,ep9301-gpio";
      reg = <0x80840020 0x04>,
            <0x80840024 0x04>;
      reg-names = "data", "dir";
      gpio-controller;
      #gpio-cells = <2>;
    };

    gpio@80840030 {
      compatible = "cirrus,ep9301-gpio";
      reg = <0x80840030 0x04>,
            <0x80840034 0x04>,
            <0x8084004c 0x1c>;
      reg-names = "data", "dir", "intr";
      gpio-controller;
      #gpio-cells = <2>;
      interrupt-controller;
      #interrupt-cells = <2>;
      interrupts-extended = <&vic0 19>, <&vic0 20>,
                            <&vic0 21>, <&vic0 22>,
                            <&vic1 15>, <&vic1 16>,
                            <&vic1 17>, <&vic1 18>;
    };

    gpio@80840038 {
      compatible = "cirrus,ep9301-gpio";
      reg = <0x80840038 0x04>,
            <0x8084003c 0x04>;
      reg-names = "data", "dir";
      gpio-controller;
      #gpio-cells = <2>;
    };

    gpio@80840040 {
      compatible = "cirrus,ep9301-gpio";
      reg = <0x80840040 0x04>,
            <0x80840044 0x04>;
      reg-names = "data", "dir";
      gpio-controller;
      #gpio-cells = <2>;
    };

...
```

## Documentation/devicetree/bindings/gpio/gpio-etraxfs.txt
```
Axis ETRAX FS General I/O controller bindings

Required properties:

- compatible:
  - "axis,etraxfs-gio"
- reg: Physical base address and length of the controller's registers.
- #gpio-cells: Should be 3
  - The first cell is the gpio offset number.
  - The second cell is reserved and is currently unused.
  - The third cell is the port number (hex).
- gpio-controller: Marks the device node as a GPIO controller.

Example:

	gio: gpio@b001a000 {
		compatible = "axis,etraxfs-gio";
		reg = <0xb001a000 0x1000>;
		gpio-controller;
		#gpio-cells = <3>;
	};
```

## Documentation/devicetree/bindings/gpio/gpio-exar.txt
```
Exportable MPIO interface of Exar UART chips

Required properties of the device:
 - exar,first-pin: first exportable pins (0..15)
 - ngpios: number of exportable pins (1..16)
```

## Documentation/devicetree/bindings/gpio/gpio-fan.txt
```
Bindings for fan connected to GPIO lines

Required properties:
- compatible : "gpio-fan"
- gpios: Specifies the pins that map to bits in the control value,
  ordered MSB-->LSB.
- gpio-fan,speed-map: A mapping of possible fan RPM speeds and the
  control value that should be set to achieve them. This array
  must have the RPM values in ascending order.

Optional properties:
- alarm-gpios: This pin going active indicates something is wrong with
  the fan, and a udev event will be fired.

Examples:

	gpio_fan {
		compatible = "gpio-fan";
		gpios = <&gpio1 14 1
			 &gpio1 13 1>;
		gpio-fan,speed-map = <0    0
				      3000 1
				      6000 2>;
		alarm-gpios = <&gpio1 15 1>;
	};
```

## Documentation/devicetree/bindings/gpio/gpio-grgpio.txt
```
Aeroflex Gaisler GRGPIO General Purpose I/O cores.

The GRGPIO GPIO core is available in the GRLIB VHDL IP core library.

Analte: In the ordinary environment for the GRGPIO core, a Leon SPARC system,
these properties are built from information in the AMBA plug&play.

Required properties:

- name : Should be "GAISLER_GPIO" or "01_01a"

- reg : Address and length of the register set for the device

- interrupts : Interrupt numbers for this device

Optional properties:

- nbits : The number of gpio lines. If analt present driver assumes 32 lines.

- irqmap : An array with an index for each gpio line. An index is either a valid
	index into the interrupts property array, or 0xffffffff that indicates
	anal irq for that line. Driver provides anal interrupt support if analt
	present.

For further information look in the documentation for the GLIB IP core library:
http://www.gaisler.com/products/grlib/grip.pdf
```
