## Documentation/devicetree/bindings/gpio/gpio-virtio.yaml
```yaml
# SPDX-License-Identifier: (GPL-2.0-only OR BSD-2-Clause)
%YAML 1.2
---
$id: http://devicetree.org/schemas/gpio/gpio-virtio.yaml#
$schema: http://devicetree.org/meta-schemas/core.yaml#

title: Virtio GPIO controller

maintainers:
  - Viresh Kumar <viresh.kumar@linaro.org>

allOf:
  - $ref: /schemas/virtio/virtio-device.yaml#

description:
  Virtio GPIO controller, see /schemas/virtio/virtio-device.yaml for more
  details.

properties:
  $nodename:
    const: gpio

  compatible:
    const: virtio,device29

  gpio-controller: true

  "#gpio-cells":
    const: 2

  interrupt-controller: true

  "#interrupt-cells":
    const: 2

required:
  - compatible
  - gpio-controller
  - "#gpio-cells"

unevaluatedProperties: false

examples:
  - |
    virtio@3000 {
        compatible = "virtio,mmio";
        reg = <0x3000 0x100>;
        interrupts = <41>;

        gpio {
            compatible = "virtio,device29";
            gpio-controller;
            #gpio-cells = <2>;
            interrupt-controller;
            #interrupt-cells = <2>;
        };
    };

...
```

## Documentation/devicetree/bindings/gpio/gpio-vt8500.txt
```
VIA/Wondermedia VT8500 GPIO Controller
-----------------------------------------------------

Required properties:
- compatible : "via,vt8500-gpio", "wm,wm8505-gpio"
	or "wm,wm8650-gpio" depending on your SoC
- reg : Should contain 1 register range (address and length)
- #gpio-cells : should be <3>.
	1) bank
	2) pin number
	3) flags - should be 0

Example:

	gpio: gpio-controller@d8110000 {
		compatible = "via,vt8500-gpio";
		gpio-controller;
		reg = <0xd8110000 0x10000>;
		#gpio-cells = <3>;
	};

	vibrate {
		gpios = <&gpio 0 1 0>; /* Bank 0, Pin 1, No flags */
	};
```

## Documentation/devicetree/bindings/gpio/gpio-xgene-sb.txt
```
APM X-Gene Standby GPIO controller bindings

This is a gpio controller in the standby domain. It also supports interrupt in
some particular pins which are sourced to its parent interrupt controller
as diagram below:
                            +-----------------+
                            | X-Gene standby  |
                            | GPIO controller +------ GPIO_0
+------------+              |                 | ...
| Parent IRQ | EXT_INT_0    |                 +------ GPIO_8/EXT_INT_0
| controller | (SPI40)      |                 | ...
| (GICv2)    +--------------+                 +------ GPIO_[N+8]/EXT_INT_N
|            |   ...        |                 |
|            | EXT_INT_N    |                 +------ GPIO_[N+9]
|            | (SPI[40 + N])|                 | ...
|            +--------------+                 +------ GPIO_MAX
+------------+              +-----------------+

Required properties:
- compatible: "apm,xgene-gpio-sb" for the X-Gene Standby GPIO controller
- reg: Physical base address and size of the controller's registers
- #gpio-cells: Should be two.
	- first cell is the pin number
	- second cell is used to specify the gpio polarity:
		0 = active high
		1 = active low
- gpio-controller: Marks the device node as a GPIO controller.
- interrupts: The EXT_INT_0 parent interrupt resource must be listed first.
- interrupt-cells: Should be two.
       - first cell is 0-N coresponding for EXT_INT_0 to EXT_INT_N.
       - second cell is used to specify flags.
- interrupt-controller: Marks the device node as an interrupt controller.
- apm,nr-gpios: Optional, specify number of gpios pin.
- apm,nr-irqs: Optional, specify number of interrupt pins.
- apm,irq-start: Optional, specify lowest gpio pin support interrupt.

Example:
	sbgpio: gpio@17001000{
		compatible = "apm,xgene-gpio-sb";
		reg = <0x0 0x17001000 0x0 0x400>;
		#gpio-cells = <2>;
		gpio-controller;
		interrupts = 	<0x0 0x28 0x1>,
				<0x0 0x29 0x1>,
				<0x0 0x2a 0x1>,
				<0x0 0x2b 0x1>,
				<0x0 0x2c 0x1>,
				<0x0 0x2d 0x1>;
		interrupt-parent = <&gic>;
		#interrupt-cells = <2>;
		interrupt-controller;
		apm,nr-gpios = <22>;
		apm,nr-irqs = <6>;
		apm,irq-start = <8>;
	};

	testuser {
		compatible = "example,testuser";
		/* Use the GPIO_13/EXT_INT_5 line as an active high triggered
		 * level interrupt
		 */
		interrupts = <5 4>;
		interrupt-parent = <&sbgpio>;
	};
```

## Documentation/devicetree/bindings/gpio/gpio-xgene.txt
```
APM X-Gene SoC GPIO controller bindings

This is a gpio controller that is part of the flash controller.
This gpio controller controls a total of 48 gpios.

Required properties:
- compatible: "apm,xgene-gpio" for X-Gene GPIO controller
- reg: Physical base address and size of the controller's registers
- #gpio-cells: Should be two.
	- first cell is the pin number
	- second cell is used to specify the gpio polarity:
		0 = active high
		1 = active low
- gpio-controller: Marks the device node as a GPIO controller.

Example:
	gpio0: gpio0@1701c000 {
		compatible = "apm,xgene-gpio";
		reg = <0x0 0x1701c000 0x0 0x40>;
		gpio-controller;
		#gpio-cells = <2>;
	};
```

## Documentation/devicetree/bindings/gpio/gpio-xilinx.txt
```
Xilinx plb/axi GPIO controller

Dual channel GPIO controller with configurable number of pins
(from 1 to 32 per channel). Every pin can be configured as
input/output/tristate. Both channels share the same global IRQ but
local interrupts can be enabled on channel basis.

Required properties:
- compatible : Should be "xlnx,xps-gpio-1.00.a"
- reg : Address and length of the register set for the device
- #gpio-cells : Should be two. The first cell is the pin number and the
  second cell is used to specify optional parameters (currently unused).
- gpio-controller : Marks the device node as a GPIO controller.

Optional properties:
- interrupts : Interrupt mapping for GPIO IRQ.
- xlnx,all-inputs : if n-th bit is setup, GPIO-n is input
- xlnx,dout-default : if n-th bit is 1, GPIO-n default value is 1
- xlnx,gpio-width : gpio width
- xlnx,tri-default : if n-th bit is 1, GPIO-n is in tristate mode
- xlnx,is-dual : if 1, controller also uses the second channel
- xlnx,all-inputs-2 : as above but for the second channel
- xlnx,dout-default-2 : as above but the second channel
- xlnx,gpio2-width : as above but for the second channel
- xlnx,tri-default-2 : as above but for the second channel


Example:
gpio: gpio@40000000 {
	#gpio-cells = <2>;
	compatible = "xlnx,xps-gpio-1.00.a";
	gpio-controller ;
	interrupt-parent = <&microblaze_0_intc>;
	interrupts = < 6 2 >;
	reg = < 0x40000000 0x10000 >;
	xlnx,all-inputs = <0x0>;
	xlnx,all-inputs-2 = <0x0>;
	xlnx,dout-default = <0x0>;
	xlnx,dout-default-2 = <0x0>;
	xlnx,gpio-width = <0x2>;
	xlnx,gpio2-width = <0x2>;
	xlnx,interrupt-present = <0x1>;
	xlnx,is-dual = <0x1>;
	xlnx,tri-default = <0xffffffff>;
	xlnx,tri-default-2 = <0xffffffff>;
} ;
```

## Documentation/devicetree/bindings/gpio/gpio-xlp.txt
```
Netlogic XLP Family GPIO
========================

This GPIO driver is used for following Netlogic XLP SoCs:
	XLP832, XLP316, XLP208, XLP980, XLP532
This GPIO driver is also compatible with GPIO controller found on
Broadcom Vulcan ARM64.

Required properties:
-------------------

- compatible: Should be one of the following:
  - "netlogic,xlp832-gpio": For Netlogic XLP832
  - "netlogic,xlp316-gpio": For Netlogic XLP316
  - "netlogic,xlp208-gpio": For Netlogic XLP208
  - "netlogic,xlp980-gpio": For Netlogic XLP980
  - "netlogic,xlp532-gpio": For Netlogic XLP532
  - "brcm,vulcan-gpio": For Broadcom Vulcan ARM64
- reg: Physical base address and length of the controller's registers.
- #gpio-cells: Should be two. The first cell is the pin number and the second
  cell is used to specify optional parameters (currently unused).
- gpio-controller: Marks the device node as a GPIO controller.
- nr-gpios: Number of GPIO pins supported by the controller.
- interrupt-cells: Should be two. The first cell is the GPIO Number. The
  second cell is used to specify flags. The following subset of flags is
  supported:
  - trigger type:
	1 = low to high edge triggered.
	2 = high to low edge triggered.
	4 = active high level-sensitive.
	8 = active low level-sensitive.
- interrupts: Interrupt number for this device.
- interrupt-parent: phandle of the parent interrupt controller.
- interrupt-controller: Identifies the node as an interrupt controller.

Example:

	gpio: xlp_gpio@34000 {
		compatible = "netlogic,xlp316-gpio";
		reg = <0 0x34100 0x1000
		       0 0x35100 0x1000>;
		#gpio-cells = <2>;
		gpio-controller;
		nr-gpios = <57>;

		#interrupt-cells = <2>;
		interrupt-parent = <&pic>;
		interrupts = <39>;
		interrupt-controller;
	};
```

## Documentation/devicetree/bindings/gpio/gpio-xra1403.txt
```
GPIO Driver for XRA1403 16-BIT GPIO Expander With Reset Input from EXAR

The XRA1403 is an 16-bit GPIO expander with an SPI interface. Features available:
	- Individually programmable inputs:
		- Internal pull-up resistors
		- Polarity inversion
		- Individual interrupt enable
		- Rising edge and/or Falling edge interrupt
		- Input filter
	- Individually programmable outputs
		- Output Level Control
		- Output Three-State Control

Properties
----------
Check documentation for SPI and GPIO controllers regarding properties needed to configure the node.

	- compatible = "exar,xra1403".
	- reg - SPI id of the device.
	- gpio-controller - marks the node as gpio.
	- #gpio-cells - should be two where the first cell is the pin number
		and the second one is used for optional parameters.

Optional properties:
-------------------
	- reset-gpios: in case available used to control the device reset line.
	- interrupt-controller - marks the node as interrupt controller.
	- #interrupt-cells - should be two and represents the number of cells
		needed to encode interrupt source.

Example
--------

	gpioxra0: gpio@2 {
		compatible = "exar,xra1403";
		reg = <2>;

		gpio-controller;
		#gpio-cells = <2>;

		interrupt-controller;
		#interrupt-cells = <2>;

		reset-gpios = <&gpio3 6 GPIO_ACTIVE_LOW>;
		spi-max-frequency = <1000000>;
	};
```

## Documentation/devicetree/bindings/gpio/gpio-zevio.txt
```
Zevio GPIO controller

Required properties:
- compatible: Should be "lsi,zevio-gpio"
- reg: Address and length of the register set for the device
- #gpio-cells: Should be two. The first cell is the pin number and the
  second cell is used to specify optional parameters (currently unused).
- gpio-controller: Marks the device node as a GPIO controller.

Example:
	gpio: gpio@90000000 {
		compatible = "lsi,zevio-gpio";
		reg = <0x90000000 0x1000>;
		gpio-controller;
		#gpio-cells = <2>;
	};
```

## Documentation/devicetree/bindings/gpio/gpio-zynq.txt
```
Xilinx Zynq GPIO controller Device Tree Bindings
-------------------------------------------

Required properties:
- #gpio-cells 		: Should be two
			  - First cell is the GPIO line number
			  - Second cell is used to specify optional
			    parameters (unused)
- compatible		: Should be "xlnx,zynq-gpio-1.0" or
			  "xlnx,zynqmp-gpio-1.0" or "xlnx,versal-gpio-1.0
- clocks		: Clock specifier (see clock bindings for details)
- gpio-controller	: Marks the device node as a GPIO controller.
- interrupts		: Interrupt specifier (see interrupt bindings for
			  details)
- interrupt-controller	: Marks the device node as an interrupt controller.
- #interrupt-cells 	: Should be 2.  The first cell is the GPIO number.
			  The second cell bits[3:0] is used to specify trigger type and level flags:
			      1 = low-to-high edge triggered.
			      2 = high-to-low edge triggered.
			      4 = active high level-sensitive.
			      8 = active low level-sensitive.
- reg			: Address and length of the register set for the device

Example:
	gpio@e000a000 {
		#gpio-cells = <2>;
		compatible = "xlnx,zynq-gpio-1.0";
		clocks = <&clkc 42>;
		gpio-controller;
		interrupt-parent = <&intc>;
		interrupts = <0 20 4>;
		interrupt-controller;
		#interrupt-cells = <2>;
		reg = <0xe000a000 0x1000>;
	};
```

## Documentation/devicetree/bindings/gpio/gpio-zynq.yaml
```yaml
# SPDX-License-Identifier: (GPL-2.0 OR BSD-2-Clause)
%YAML 1.2
---
$id: http://devicetree.org/schemas/gpio/gpio-zynq.yaml#
$schema: http://devicetree.org/meta-schemas/core.yaml#

title: Xilinx Zynq GPIO controller

maintainers:
  - Michal Simek <michal.simek@amd.com>

properties:
  compatible:
    enum:
      - xlnx,zynq-gpio-1.0
      - xlnx,zynqmp-gpio-1.0
      - xlnx,versal-gpio-1.0
      - xlnx,pmc-gpio-1.0

  reg:
    maxItems: 1

  "#gpio-cells":
    const: 2

  interrupts:
    maxItems: 1

  gpio-controller: true

  gpio-line-names:
    description: strings describing the names of each gpio line
    minItems: 58
    maxItems: 174

  interrupt-controller: true

  "#interrupt-cells":
    const: 2

  clocks:
    maxItems: 1

  power-domains:
    maxItems: 1

allOf:
  - if:
      properties:
        compatible:
          enum:
            - xlnx,zynqmp-gpio-1.0
    then:
      properties:
        gpio-line-names:
          minItems: 174
          maxItems: 174

  - if:
      properties:
        compatible:
          enum:
            - xlnx,zynq-gpio-1.0
    then:
      properties:
        gpio-line-names:
          minItems: 118
          maxItems: 118

  - if:
      properties:
        compatible:
          enum:
            - xlnx,versal-gpio-1.0
    then:
      properties:
        gpio-line-names:
          minItems: 58
          maxItems: 58

  - if:
      properties:
        compatible:
          enum:
            - xlnx,pmc-gpio-1.0
    then:
      properties:
        gpio-line-names:
          minItems: 116
          maxItems: 116

required:
  - compatible
  - reg
  - "#gpio-cells"
  - interrupts
  - gpio-controller
  - interrupt-controller
  - "#interrupt-cells"
  - clocks

additionalProperties: false

examples:
  - |
    gpio@e000a000 {
      #gpio-cells = <2>;
      compatible = "xlnx,zynq-gpio-1.0";
      clocks = <&clkc 42>;
      gpio-controller;
      interrupt-parent = <&intc>;
      interrupts = <0 20 4>;
      interrupt-controller;
      #interrupt-cells = <2>;
      reg = <0xe000a000 0x1000>;
    };
```
