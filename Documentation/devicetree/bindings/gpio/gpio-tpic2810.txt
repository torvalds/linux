## Documentation/devicetree/bindings/gpio/gpio-tpic2810.txt
```
TPIC2810 GPIO controller bindings

Required properties:
 - compatible		: Should be "ti,tpic2810".
 - reg			: The I2C address of the device
 - gpio-controller	: Marks the device node as a GPIO controller.
 - #gpio-cells		: Should be two. For consumer use see gpio.txt.

Example:

	gpio@60 {
		compatible = "ti,tpic2810";
		reg = <0x60>;
		gpio-controller;
		#gpio-cells = <2>;
	};
```

## Documentation/devicetree/bindings/gpio/gpio-tpic2810.yaml
```yaml
# SPDX-License-Identifier: (GPL-2.0-only OR BSD-2-Clause)
%YAML 1.2
---
$id: http://devicetree.org/schemas/gpio/gpio-tpic2810.yaml#
$schema: http://devicetree.org/meta-schemas/core.yaml#

title: TPIC2810 GPIO controller bindings

maintainers:
  - Aswath Govindraju <a-govindraju@ti.com>

properties:
  compatible:
    enum:
      - ti,tpic2810

  reg:
    maxItems: 1

  gpio-controller: true

  "#gpio-cells":
    const: 2

  gpio-line-names:
    minItems: 1
    maxItems: 32

required:
  - compatible
  - reg
  - gpio-controller
  - "#gpio-cells"

additionalProperties: false

examples:
  - |
    #include <dt-bindings/gpio/gpio.h>

    i2c {
        #address-cells = <1>;
        #size-cells = <0>;
        gpio@60 {
            compatible = "ti,tpic2810";
            reg = <0x60>;
            gpio-controller;
            #gpio-cells = <2>;
            gpio-line-names = "LED A", "LED B", "LED C";
        };
    };
```

## Documentation/devicetree/bindings/gpio/gpio-tps65086.txt
```
* TPS65086 GPO Controller bindings

Required properties:
 - compatible		: Should be "ti,tps65086-gpio".
 - gpio-controller	: Marks the device node as a GPIO Controller.
 - #gpio-cells		: Should be two. The first cell is the pin number
			    and the second cell is used to specify flags.
			    See ../gpio/gpio.txt for possible values.

Example:

	gpio4: gpio {
		compatible = "ti,tps65086-gpio";
		gpio-controller;
		#gpio-cells = <2>;
	};
```

## Documentation/devicetree/bindings/gpio/gpio-ts4800.txt
```
* TS-4800 FPGA's GPIO controller bindings

Required properties:
- compatible: Must be "technologic,ts4800-gpio".
- #gpio-cells: Should be two. The first cell is the pin number.
- reg: Physical base address of the controller and length
       of memory mapped region.

Optional property:
- ngpios: See "gpio.txt"

Example:

gpio1: gpio {
	compatible = "technologic,ts4800-gpio";
	reg = <0x10020 0x6>;
	ngpios = <8>;
	gpio-controller;
	#gpio-cells = <2>;
};
```

## Documentation/devicetree/bindings/gpio/gpio-ts4900.txt
```
* Technologic Systems I2C-FPGA's GPIO controller bindings

This bindings describes the GPIO controller for Technologic's FPGA core.
TS-4900's FPGA encodes the GPIO state on 3 bits, whereas the TS-7970's FPGA
uses 2 bits: it doesn't use a dedicated input bit.

Required properties:
- compatible: Should be one of the following
		"technologic,ts4900-gpio"
		"technologic,ts7970-gpio"
- reg: Physical base address of the controller and length
       of memory mapped region.
- #gpio-cells: Should be two. The first cell is the pin number.
- gpio-controller: Marks the device node as a gpio controller.

Optional property:
- ngpios: Number of GPIOs this controller is instantiated with,
  the default is 32. See gpio.txt for more details.

Example:

&i2c2 {
	gpio8: gpio@28 {
		compatible = "technologic,ts4900-gpio";
		reg = <0x28>;
		#gpio-cells = <2>;
		gpio-controller;
		ngpios = <32>;
	};
};
```

## Documentation/devicetree/bindings/gpio/gpio-twl4030.txt
```
twl4030 GPIO controller bindings

Required properties:
- compatible:
  - "ti,twl4030-gpio" for twl4030 GPIO controller
- #gpio-cells : Should be two.
  - first cell is the pin number
  - second cell is used to specify optional parameters (unused)
- gpio-controller : Marks the device node as a GPIO controller.
- #interrupt-cells : Should be 2.
- interrupt-controller: Mark the device node as an interrupt controller
  The first cell is the GPIO number.
  The second cell is not used.
- ti,use-leds : Enables LEDA and LEDB outputs if set
- ti,debounce : if n-th bit is set, debounces GPIO-n
- ti,mmc-cd : if n-th bit is set, GPIO-n controls VMMC(n+1)
- ti,pullups : if n-th bit is set, set a pullup on GPIO-n
- ti,pulldowns : if n-th bit is set, set a pulldown on GPIO-n

Example:

twl_gpio: gpio {
    compatible = "ti,twl4030-gpio";
    #gpio-cells = <2>;
    gpio-controller;
    #interrupt-cells = <2>;
    interrupt-controller;
    ti,use-leds;
};
```

## Documentation/devicetree/bindings/gpio/gpio-tz1090-pdc.txt
```
ImgTec TZ1090 PDC GPIO Controller

Required properties:
- compatible: Compatible property value should be "img,tz1090-pdc-gpio".

- reg: Physical base address of the controller and length of memory mapped
  region. This starts at and cover the SOC_GPIO_CONTROL registers.

- gpio-controller: Specifies that the node is a gpio controller.

- #gpio-cells: Should be 2. The syntax of the gpio specifier used by client
  nodes should have the following values.
     <[phandle of the gpio controller node]
      [PDC gpio number]
      [gpio flags]>

  Values for gpio specifier:
  - GPIO number: a value in the range 0 to 6.
  - GPIO flags: bit field of flags, as defined in <dt-bindings/gpio/gpio.h>.
    Only the following flags are supported:
      GPIO_ACTIVE_HIGH
      GPIO_ACTIVE_LOW

Optional properties:
- gpio-ranges: Mapping to pin controller pins (as described in
  Documentation/devicetree/bindings/gpio/gpio.txt)

- interrupts: Individual syswake interrupts (other GPIOs cannot interrupt)


Example:

	pdc_gpios: gpio-controller@02006500 {
		gpio-controller;
		#gpio-cells = <2>;

		compatible = "img,tz1090-pdc-gpio";
		reg = <0x02006500 0x100>;

		interrupt-parent = <&pdc>;
		interrupts =	<8  IRQ_TYPE_NONE>,	/* Syswake 0 */
				<9  IRQ_TYPE_NONE>,	/* Syswake 1 */
				<10 IRQ_TYPE_NONE>;	/* Syswake 2 */
		gpio-ranges = <&pdc_pinctrl 0 0 7>;
	};
```

## Documentation/devicetree/bindings/gpio/gpio-tz1090.txt
```
ImgTec TZ1090 GPIO Controller

Required properties:
- compatible: Compatible property value should be "img,tz1090-gpio".

- reg: Physical base address of the controller and length of memory mapped
  region.

- #address-cells: Should be 1 (for bank subnodes)

- #size-cells: Should be 0 (for bank subnodes)

- Each bank of GPIOs should have a subnode to represent it.

  Bank subnode required properties:
  - reg: Index of bank in the range 0 to 2.

  - gpio-controller: Specifies that the node is a gpio controller.

  - #gpio-cells: Should be 2. The syntax of the gpio specifier used by client
    nodes should have the following values.
       <[phandle of the gpio controller node]
        [gpio number within the gpio bank]
        [gpio flags]>

    Values for gpio specifier:
    - GPIO number: a value in the range 0 to 29.
    - GPIO flags: bit field of flags, as defined in <dt-bindings/gpio/gpio.h>.
      Only the following flags are supported:
        GPIO_ACTIVE_HIGH
        GPIO_ACTIVE_LOW

  Bank subnode optional properties:
  - gpio-ranges: Mapping to pin controller pins (as described in
    Documentation/devicetree/bindings/gpio/gpio.txt)

  - interrupts: Interrupt for the entire bank

  - interrupt-controller: Specifies that the node is an interrupt controller

  - #interrupt-cells: Should be 2. The syntax of the interrupt specifier used by
    client nodes should have the following values.
       <[phandle of the interurupt controller]
        [gpio number within the gpio bank]
        [irq flags]>

    Values for irq specifier:
    - GPIO number: a value in the range 0 to 29
    - IRQ flags: value to describe edge and level triggering, as defined in
      <dt-bindings/interrupt-controller/irq.h>. Only the following flags are
      supported:
        IRQ_TYPE_EDGE_RISING
        IRQ_TYPE_EDGE_FALLING
        IRQ_TYPE_EDGE_BOTH
        IRQ_TYPE_LEVEL_HIGH
        IRQ_TYPE_LEVEL_LOW



Example:

	gpios: gpio-controller@02005800 {
		#address-cells = <1>;
		#size-cells = <0>;
		compatible = "img,tz1090-gpio";
		reg = <0x02005800 0x90>;

		/* bank 0 with an interrupt */
		gpios0: bank@0 {
			#gpio-cells = <2>;
			#interrupt-cells = <2>;
			reg = <0>;
			interrupts = <13 IRQ_TYPE_LEVEL_HIGH>;
			gpio-controller;
			gpio-ranges = <&pinctrl 0 0 30>;
			interrupt-controller;
		};

		/* bank 2 without interrupt */
		gpios2: bank@2 {
			#gpio-cells = <2>;
			reg = <2>;
			gpio-controller;
			gpio-ranges = <&pinctrl 0 60 30>;
		};
	};
```

## Documentation/devicetree/bindings/gpio/gpio-uniphier.txt
```
UniPhier GPIO controller

Required properties:
- compatible: Should be "socionext,uniphier-gpio".
- reg: Specifies offset and length of the register set for the device.
- gpio-controller: Marks the device node as a GPIO controller.
- #gpio-cells: Should be 2.  The first cell is the pin number and the second
  cell is used to specify optional parameters.
- interrupt-controller: Marks the device node as an interrupt controller.
- #interrupt-cells: Should be 2.  The first cell defines the interrupt number.
  The second cell bits[3:0] is used to specify trigger type as follows:
    1 = low-to-high edge triggered
    2 = high-to-low edge triggered
    4 = active high level-sensitive
    8 = active low level-sensitive
  Valid combinations are 1, 2, 3, 4, 8.
- ngpios: Specifies the number of GPIO lines.
- gpio-ranges: Mapping to pin controller pins (as described in gpio.txt)
- socionext,interrupt-ranges: Specifies an interrupt number mapping between
  this GPIO controller and its interrupt parent, in the form of arbitrary
  number of <child-interrupt-base parent-interrupt-base length> triplets.

Optional properties:
- gpio-ranges-group-names: Used for named gpio ranges (as described in gpio.txt)

Example:
	gpio: gpio@55000000 {
		compatible = "socionext,uniphier-gpio";
		reg = <0x55000000 0x200>;
		interrupt-parent = <&aidet>;
		interrupt-controller;
		#interrupt-cells = <2>;
		gpio-controller;
		#gpio-cells = <2>;
		gpio-ranges = <&pinctrl 0 0 0>;
		gpio-ranges-group-names = "gpio_range";
		ngpios = <248>;
		socionext,interrupt-ranges = <0 48 16>, <16 154 5>, <21 217 3>;
	};

Consumer Example:

	sdhci0_pwrseq {
		compatible = "mmc-pwrseq-emmc";
		reset-gpios = <&gpio UNIPHIER_GPIO_PORT(29, 4) GPIO_ACTIVE_LOW>;
	};

Please note UNIPHIER_GPIO_PORT(29, 4) represents PORT294 in the SoC document.
Unfortunately, only the one's place is octal in the port numbering.  (That is,
PORT 8, 9, 18, 19, 28, 29, ... are missing.)  UNIPHIER_GPIO_PORT() is a helper
macro to calculate 29 * 8 + 4.
```

## Documentation/devicetree/bindings/gpio/gpio-vf610.txt
```
* Freescale VF610 PORT/GPIO module

The Freescale PORT/GPIO modules are two adjacent modules providing GPIO
functionality. Each pair serves 32 GPIOs. The VF610 has 5 instances of
each, and each PORT module has its own interrupt.

Required properties for GPIO node:
- compatible : Should be "fsl,<soc>-gpio", below is supported list:
	       "fsl,vf610-gpio"
	       "fsl,imx7ulp-gpio"
- reg : The first reg tuple represents the PORT module, the second tuple
  the GPIO module.
- interrupts : Should be the port interrupt shared by all 32 pins.
- gpio-controller : Marks the device node as a gpio controller.
- #gpio-cells : Should be two. The first cell is the pin number and
  the second cell is used to specify the gpio polarity:
      0 = active high
      1 = active low
- interrupt-controller: Marks the device node as an interrupt controller.
- #interrupt-cells : Should be 2.  The first cell is the GPIO number.
  The second cell bits[3:0] is used to specify trigger type and level flags:
      1 = low-to-high edge triggered.
      2 = high-to-low edge triggered.
      4 = active high level-sensitive.
      8 = active low level-sensitive.

Optional properties:
-clocks:	Must contain an entry for each entry in clock-names.
		See common clock-bindings.txt for details.
-clock-names:	A list of clock names. For imx7ulp, it must contain
		"gpio", "port".

Note: Each GPIO port should have an alias correctly numbered in "aliases"
node.

Examples:

aliases {
	gpio0 = &gpio1;
	gpio1 = &gpio2;
};

gpio1: gpio@40049000 {
	compatible = "fsl,vf610-gpio";
	reg = <0x40049000 0x1000 0x400ff000 0x40>;
	interrupts = <0 107 IRQ_TYPE_LEVEL_HIGH>;
	gpio-controller;
	#gpio-cells = <2>;
	interrupt-controller;
	#interrupt-cells = <2>;
	gpio-ranges = <&iomuxc 0 0 32>;
};

gpio2: gpio@4004a000 {
	compatible = "fsl,vf610-gpio";
	reg = <0x4004a000 0x1000 0x400ff040 0x40>;
	interrupts = <0 108 IRQ_TYPE_LEVEL_HIGH>;
	gpio-controller;
	#gpio-cells = <2>;
	interrupt-controller;
	#interrupt-cells = <2>;
	gpio-ranges = <&iomuxc 0 32 32>;
};
```

## Documentation/devicetree/bindings/gpio/gpio-vf610.yaml
```yaml
# SPDX-License-Identifier: (GPL-2.0-only OR BSD-2-Clause)
%YAML 1.2
---
$id: http://devicetree.org/schemas/gpio/gpio-vf610.yaml#
$schema: http://devicetree.org/meta-schemas/core.yaml#

title: Freescale VF610 PORT/GPIO module

maintainers:
  - Stefan Agner <stefan@agner.ch>

description: |
  The Freescale PORT/GPIO modules are two adjacent modules providing GPIO
  functionality. Each pair serves 32 GPIOs. The VF610 has 5 instances of
  each, and each PORT module has its own interrupt.

  Note: Each GPIO port should have an alias correctly numbered in "aliases"
  node.

properties:
  compatible:
    oneOf:
      - const: fsl,imx8ulp-gpio
      - const: fsl,vf610-gpio
      - items:
          - const: fsl,imx7ulp-gpio
          - const: fsl,vf610-gpio
      - items:
          - enum:
              - fsl,imx93-gpio
              - fsl,imx94-gpio
              - fsl,imx95-gpio
          - const: fsl,imx8ulp-gpio

  reg:
    minItems: 1
    maxItems: 2

  interrupts:
    items:
      - description: GPIO Trustzone non-secure interrupt number
      - description: GPIO Trustzone secure interrupt number
    minItems: 1

  interrupt-controller: true

  "#interrupt-cells":
    const: 2

  "#gpio-cells":
    const: 2

  gpio-controller: true

  gpio-line-names:
    minItems: 1
    maxItems: 32

  clocks:
    items:
      - description: SoC GPIO clock
      - description: SoC PORT clock

  clock-names:
    items:
      - const: gpio
      - const: port

  gpio-ranges:
    minItems: 1
    maxItems: 4

patternProperties:
  "^.+-hog(-[0-9]+)?$":
    type: object

    required:
      - gpio-hog

required:
  - compatible
  - reg
  - interrupts
  - interrupt-controller
  - "#interrupt-cells"
  - "#gpio-cells"
  - gpio-controller

allOf:
  - if:
      properties:
        compatible:
          contains:
            enum:
              - fsl,vf610-gpio
              - fsl,imx7ulp-gpio
    then:
      properties:
        interrupts:
          maxItems: 1
        reg:
          items:
            - description: PORT register base address
            - description: GPIO register base address
    else:
      properties:
        interrupts:
          minItems: 2
        reg:
          items:
            - description: GPIO register base address

additionalProperties: false

examples:
  - |
    #include <dt-bindings/interrupt-controller/arm-gic.h>

    gpio1: gpio@40049000 {
        compatible = "fsl,vf610-gpio";
        reg = <0x40049000 0x1000>, <0x400ff000 0x40>;
        interrupts = <0 107 IRQ_TYPE_LEVEL_HIGH>;
        gpio-controller;
        #gpio-cells = <2>;
        interrupt-controller;
        #interrupt-cells = <2>;
        gpio-ranges = <&iomuxc 0 0 32>;
    };
```
