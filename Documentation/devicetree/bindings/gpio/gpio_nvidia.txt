## Documentation/devicetree/bindings/gpio/gpio_nvidia.txt
```
NVIDIA Tegra 2 GPIO controller

Required properties:
- compatible : "nvidia,tegra20-gpio"
- reg : Physical base address and length of the controller's registers.
- interrupts : The interrupt outputs from the controller.
- #gpio-cells : Should be two. The first cell is the pin number and the
  second cell is used to specify optional parameters:
  - bit 0 specifies polarity (0 for normal, 1 for inverted)
- gpio-controller : Marks the device node as a GPIO controller.

Example:

gpio: gpio@6000d000 {
	compatible = "nvidia,tegra20-gpio";
	reg = < 0x6000d000 0x1000 >;
	interrupts = < 0 32 0x04
		       0 33 0x04
		       0 34 0x04
		       0 35 0x04
		       0 55 0x04
		       0 87 0x04
		       0 89 0x04 >;
	#gpio-cells = <2>;
	gpio-controller;
};
```

## Documentation/devicetree/bindings/gpio/gpio_oxnas.txt
```
* Oxford Semiconductor OXNAS SoC GPIO Controller

Please refer to gpio.txt for generic information regarding GPIO bindings.

Required properties:
 - compatible: "oxsemi,ox810se-gpio" or "oxsemi,ox820-gpio"
 - reg: Base address and length for the device.
 - interrupts: The port interrupt shared by all pins.
 - gpio-controller: Marks the port as GPIO controller.
 - #gpio-cells: Two. The first cell is the pin number and
   the second cell is used to specify the gpio polarity as defined in
   defined in <dt-bindings/gpio/gpio.h>:
      0 = GPIO_ACTIVE_HIGH
      1 = GPIO_ACTIVE_LOW
 - interrupt-controller: Marks the device node as an interrupt controller.
 - #interrupt-cells: Two. The first cell is the GPIO number and second cell
   is used to specify the trigger type as defined in
   <dt-bindings/interrupt-controller/irq.h>:
      IRQ_TYPE_EDGE_RISING
      IRQ_TYPE_EDGE_FALLING
      IRQ_TYPE_EDGE_BOTH
 - gpio-ranges: Interaction with the PINCTRL subsystem, it also specifies the
   gpio base and count, should be in the format of numeric-gpio-range as
   specified in the gpio.txt file.

Example:

gpio0: gpio@0 {
	compatible = "oxsemi,ox810se-gpio";
	reg = <0x000000 0x100000>;
	interrupts = <21>;
	#gpio-cells = <2>;
	gpio-controller;
	interrupt-controller;
	#interrupt-cells = <2>;
	gpio-ranges = <&pinctrl 0 0 32>;
};

keys {
	...

	button-esc {
		label = "ESC";
		linux,code = <1>;
		gpios = <&gpio0 12 0>;
	};
};
```

## Documentation/devicetree/bindings/gpio/hisilicon,ascend910-gpio.yaml
```yaml
# SPDX-License-Identifier: (GPL-2.0-only OR BSD-2-Clause)
%YAML 1.2
---
$id: http://devicetree.org/schemas/gpio/hisilicon,ascend910-gpio.yaml#
$schema: http://devicetree.org/meta-schemas/core.yaml#

title: HiSilicon common GPIO controller

maintainers:
  - Jay Fang <f.fangjian@huawei.com>

description:
  The HiSilicon common GPIO controller can be used for many different
  types of SoC such as Huawei Ascend AI series chips.

properties:
  compatible:
    const: hisilicon,ascend910-gpio

  reg:
    maxItems: 1

  interrupts:
    maxItems: 1

  gpio-controller: true

  "#gpio-cells":
    const: 2

  ngpios:
    minimum: 1
    maximum: 32

required:
  - compatible
  - reg
  - interrupts
  - gpio-controller
  - "#gpio-cells"
  - ngpios

additionalProperties: false

examples:
  - |
    #include <dt-bindings/interrupt-controller/arm-gic.h>

    gpio@840d0000 {
      compatible = "hisilicon,ascend910-gpio";
      reg = <0x840d0000 0x1000>;
      ngpios = <32>;
      gpio-controller;
      #gpio-cells = <2>;
      interrupts = <GIC_SPI 33 IRQ_TYPE_LEVEL_HIGH>;
    };
```

## Documentation/devicetree/bindings/gpio/ibm,ppc4xx-gpio.txt
```
* IBM/AMCC/APM GPIO Controller for PowerPC 4XX series and compatible SoCs

All GPIOs are pin-shared with other functions. DCRs control whether a
particular pin that has GPIO capabilities acts as a GPIO or is used for
another purpose. GPIO outputs are separately programmable to emulate
an open-drain driver.

Required properties:
	- compatible: must be "ibm,ppc4xx-gpio"
	- reg: address and length of the register set for the device
	- #gpio-cells: must be set to 2. The first cell is the pin number
		and the second cell is used to specify the gpio polarity:
		0 = active high
		1 = active low
	- gpio-controller: marks the device node as a gpio controller.

Example:

GPIO0: gpio@ef600b00 {
	compatible = "ibm,ppc4xx-gpio";
	reg = <0xef600b00 0x00000048>;
	#gpio-cells = <2>;
	gpio-controller;
};
```

## Documentation/devicetree/bindings/gpio/idt,32434-gpio.yaml
```yaml
# SPDX-License-Identifier: (GPL-2.0 OR BSD-2-Clause)
%YAML 1.2
---
$id: http://devicetree.org/schemas/gpio/idt,32434-gpio.yaml#
$schema: http://devicetree.org/meta-schemas/core.yaml#

title: IDT 79RC32434 GPIO controller

maintainers:
  - Thomas Bogendoerfer <tsbogend@alpha.franken.de>

properties:
  compatible:
    const: idt,32434-gpio

  reg:
    maxItems: 2

  reg-names:
    items:
      - const: gpio
      - const: pic

  gpio-controller: true

  "#gpio-cells":
    const: 2

  ngpios:
    minimum: 1
    maximum: 32

  interrupt-controller: true

  "#interrupt-cells":
    const: 2

  interrupts:
    maxItems: 1

required:
  - compatible
  - reg
  - reg-names
  - gpio-controller
  - "#gpio-cells"

additionalProperties: false

examples:
  - |
    gpio0: gpio@50004 {
        compatible = "idt,32434-gpio";
        reg = <0x50004 0x10>, <0x38030 0x0c>;
        reg-names = "gpio", "pic";

        interrupt-controller;
        #interrupt-cells = <2>;

        interrupt-parent = <&cpuintc>;
        interrupts = <6>;

        gpio-controller;
        #gpio-cells = <2>;

        ngpios = <14>;
    };
```

## Documentation/devicetree/bindings/gpio/ingenic,gpio.txt
```
Ingenic jz47xx GPIO controller

That the Ingenic GPIO driver node must be a sub-node of the Ingenic pinctrl
driver node.

Required properties:
--------------------

 - compatible: Must contain one of:
    - "ingenic,jz4740-gpio"
    - "ingenic,jz4770-gpio"
    - "ingenic,jz4780-gpio"
 - reg: The GPIO bank number.
 - interrupt-controller: Marks the device node as an interrupt controller.
 - interrupts: Interrupt specifier for the controllers interrupt.
 - #interrupt-cells: Should be 2. Refer to
   ../interrupt-controller/interrupts.txt for more details.
 - gpio-controller: Marks the device node as a GPIO controller.
 - #gpio-cells: Should be 2. The first cell is the GPIO number and the second
    cell specifies GPIO flags, as defined in <dt-bindings/gpio/gpio.h>. Only the
    GPIO_ACTIVE_HIGH and GPIO_ACTIVE_LOW flags are supported.
 - gpio-ranges: Range of pins managed by the GPIO controller. Refer to
   'gpio.txt' in this directory for more details.

Example:
--------

&pinctrl {
	#address-cells = <1>;
	#size-cells = <0>;

	gpa: gpio@0 {
		compatible = "ingenic,jz4740-gpio";
		reg = <0>;

		gpio-controller;
		gpio-ranges = <&pinctrl 0 0 32>;
		#gpio-cells = <2>;

		interrupt-controller;
		#interrupt-cells = <2>;

		interrupt-parent = <&intc>;
		interrupts = <28>;
	};
};
```

## Documentation/devicetree/bindings/gpio/intel,ixp4xx-gpio.txt
```
Intel IXP4xx XScale Networking Processors GPIO

This GPIO controller is found in the Intel IXP4xx processors.
It supports 16 GPIO lines.

The interrupt portions of the GPIO controller is hierarchical:
the synchronous edge detector is part of the GPIO block, but the
actual enabling/disabling of the interrupt line is done in the
main IXP4xx interrupt controller which has a 1:1 mapping for
the first 12 GPIO lines to 12 system interrupts.

The remaining 4 GPIO lines can not be used for receiving
interrupts.

The interrupt parent of this GPIO controller must be the
IXP4xx interrupt controller.

Required properties:

- compatible : Should be
  "intel,ixp4xx-gpio"
- reg : Should contain registers location and length
- gpio-controller : marks this as a GPIO controller
- #gpio-cells : Should be 2, see gpio/gpio.txt
- interrupt-controller : marks this as an interrupt controller
- #interrupt-cells : a standard two-cell interrupt, see
  interrupt-controller/interrupts.txt

Example:

gpio0: gpio@c8004000 {
	compatible = "intel,ixp4xx-gpio";
	reg = <0xc8004000 0x1000>;
	gpio-controller;
	#gpio-cells = <2>;
	interrupt-controller;
	#interrupt-cells = <2>;
};
```

## Documentation/devicetree/bindings/gpio/intel,ixp4xx-gpio.yaml
```yaml
# SPDX-License-Identifier: (GPL-2.0-only OR BSD-2-Clause)
%YAML 1.2
---
$id: http://devicetree.org/schemas/gpio/intel,ixp4xx-gpio.yaml#
$schema: http://devicetree.org/meta-schemas/core.yaml#

title: Intel IXP4xx XScale Networking Processors GPIO Controller

description: |
  This GPIO controller is found in the Intel IXP4xx
  processors. It supports 16 GPIO lines.
  The interrupt portions of the GPIO controller is hierarchical.
  The synchronous edge detector is part of the GPIO block, but the
  actual enabling/disabling of the interrupt line is done in the
  main IXP4xx interrupt controller which has a 1-to-1 mapping for
  the first 12 GPIO lines to 12 system interrupts.
  The remaining 4 GPIO lines can not be used for receiving
  interrupts.
  The interrupt parent of this GPIO controller must be the
  IXP4xx interrupt controller.
  GPIO 14 and 15 can be used as clock outputs rather than GPIO,
  and this can be enabled by a special flag.

maintainers:
  - Linus Walleij <linus.walleij@linaro.org>

properties:
  compatible:
    const: intel,ixp4xx-gpio

  reg:
    maxItems: 1

  gpio-controller: true

  "#gpio-cells":
    const: 2

  interrupt-controller: true

  "#interrupt-cells":
    const: 2

  intel,ixp4xx-gpio14-clkout:
    description: If defined, enables clock output on GPIO 14
      instead of GPIO.
    type: boolean

  intel,ixp4xx-gpio15-clkout:
    description: If defined, enables clock output on GPIO 15
      instead of GPIO.
    type: boolean

required:
  - compatible
  - reg
  - "#gpio-cells"
  - interrupt-controller
  - "#interrupt-cells"

additionalProperties: false

examples:
  - |
    #include <dt-bindings/interrupt-controller/irq.h>
    gpio@c8004000 {
        compatible = "intel,ixp4xx-gpio";
        reg = <0xc8004000 0x1000>;
        gpio-controller;
        #gpio-cells = <2>;
        interrupt-controller;
        #interrupt-cells = <2>;
    };
```

## Documentation/devicetree/bindings/gpio/kontron,sl28cpld-gpio.yaml
```yaml
# SPDX-License-Identifier: (GPL-2.0-only OR BSD-2-Clause)
%YAML 1.2
---
$id: http://devicetree.org/schemas/gpio/kontron,sl28cpld-gpio.yaml#
$schema: http://devicetree.org/meta-schemas/core.yaml#

title: GPIO driver for the sl28cpld board management controller

maintainers:
  - Michael Walle <michael@walle.cc>

description: |
  This module is part of the sl28cpld multi-function device. For more
  details see ../mfd/kontron,sl28cpld.yaml.

  There are three flavors of the GPIO controller, one full featured
  input/output with interrupt support (kontron,sl28cpld-gpio), one
  output-only (kontron,sl28-gpo) and one input-only (kontron,sl28-gpi).

  Each controller supports 8 GPIO lines.

properties:
  compatible:
    enum:
      - kontron,sl28cpld-gpio
      - kontron,sl28cpld-gpi
      - kontron,sl28cpld-gpo

  reg:
    maxItems: 1

  interrupts:
    maxItems: 1

  "#interrupt-cells":
    const: 2

  interrupt-controller: true

  "#gpio-cells":
    const: 2

  gpio-controller: true

  gpio-line-names:
      minItems: 1
      maxItems: 8

required:
  - compatible
  - "#gpio-cells"
  - gpio-controller

additionalProperties: false
```

## Documentation/devicetree/bindings/gpio/lacie,netxbig-gpio-ext.yaml
```yaml
# SPDX-License-Identifier: (GPL-2.0-only OR BSD-2-Clause)
%YAML 1.2
---
$id: http://devicetree.org/schemas/gpio/lacie,netxbig-gpio-ext.yaml#
$schema: http://devicetree.org/meta-schemas/core.yaml#

title: NetxBig GPIO extension bus

maintainers:
  - Simon Guinot <simon.guinot@sequanux.org>

description: >
  GPIO extension bus found on some LaCie/Seagate boards
  (Example: 2Big/5Big Network v2, 2Big NAS).

properties:
  compatible:
    items:
      - const: lacie,netxbig-gpio-ext

  addr-gpios:
    description: GPIOs representing the address register (LSB->MSB).
    items:
      - description: bit 0 (LSB)
      - description: bit 1
      - description: bit 2 (MSB)

  data-gpios:
    description: GPIOs representing the data register (LSB->MSB).
    items:
      - description: bit 0 (LSB)
      - description: bit 1
      - description: bit 2 (MSB)

  enable-gpio:
    description: Latches the new configuration (address, data) on raising edge.
    maxItems: 1

required:
  - compatible
  - addr-gpios
  - data-gpios
  - enable-gpio

additionalProperties: false

examples:
  - |
    #include <dt-bindings/gpio/gpio.h>

    gpio {
        compatible = "lacie,netxbig-gpio-ext";
        addr-gpios = <&gpio1 15 GPIO_ACTIVE_HIGH
                      &gpio1 16 GPIO_ACTIVE_HIGH
                      &gpio1 17 GPIO_ACTIVE_HIGH>;
        data-gpios = <&gpio1 12 GPIO_ACTIVE_HIGH
                      &gpio1 13 GPIO_ACTIVE_HIGH
                      &gpio1 14 GPIO_ACTIVE_HIGH>;
        enable-gpio = <&gpio0 29 GPIO_ACTIVE_HIGH>;
    };
```

## Documentation/devicetree/bindings/gpio/lantiq,gpio-mm-lantiq.yaml
```yaml
# SPDX-License-Identifier: (GPL-2.0-only OR BSD-2-Clause)
%YAML 1.2
---
$id: http://devicetree.org/schemas/lantiq,gpio-mm-lantiq.yaml#
$schema: http://devicetree.org/meta-schemas/core.yaml#

title: Lantiq SoC External Bus memory mapped GPIO controller

maintainers:
  - John Crispin <john@phrozen.org>

description: |
  By attaching hardware latches to the EBU it is possible to create output
  only gpios. This driver configures a special memory address, which when
  written to outputs 16 bit to the latches.

  The node describing the memory mapped GPIOs needs to be a child of the node
  describing the "lantiq,localbus".

properties:
  compatible:
    enum:
      - lantiq,gpio-mm-lantiq
      - lantiq,gpio-mm

  reg:
    maxItems: 1

  '#gpio-cells':
    const: 2

  gpio-controller: true

  lantiq,shadow:
    description: The default value that we shall assume as already set on the shift register cascade.
    $ref: /schemas/types.yaml#/definitions/uint32

required:
  - compatible
  - reg
  - '#gpio-cells'
  - gpio-controller

additionalProperties: false

examples:
  - |
    gpio@4000000 {
        compatible = "lantiq,gpio-mm-lantiq";
        reg = <0x4000000 0x10>;
        gpio-controller;
        #gpio-cells = <2>;
        lantiq,shadow = <0x77f>;
    };
```

## Documentation/devicetree/bindings/gpio/led.txt
```
LEDs connected to GPIO lines

Required properties:
- compatible : should be "gpio-leds".

Each LED is represented as a sub-node of the gpio-leds device.  Each
node's name represents the name of the corresponding LED.

LED sub-node properties:
- gpios :  Should specify the LED's GPIO, see "gpios property" in
  Documentation/devicetree/bindings/gpio/gpio.txt.  Active low LEDs should be
  indicated using flags in the GPIO specifier.
- label :  (optional)
  see Documentation/devicetree/bindings/leds/common.txt
- linux,default-trigger :  (optional)
  see Documentation/devicetree/bindings/leds/common.txt
- default-state:  (optional) The initial state of the LED.  Valid
  values are "on", "off", and "keep".  If the LED is already on or off
  and the default-state property is set the to same value, then no
  glitch should be produced where the LED momentarily turns off (or
  on).  The "keep" setting will keep the LED at whatever its current
  state is, without producing a glitch.  The default is off if this
  property is not present.

Examples:

leds {
	compatible = "gpio-leds";
	hdd {
		label = "IDE Activity";
		gpios = <&mcu_pio 0 1>; /* Active low */
		linux,default-trigger = "ide-disk";
	};

	fault {
		gpios = <&mcu_pio 1 0>;
		/* Keep LED on if BIOS detected hardware fault */
		default-state = "keep";
	};
};

run-control {
	compatible = "gpio-leds";
	red {
		gpios = <&mpc8572 6 0>;
		default-state = "off";
	};
	green {
		gpios = <&mpc8572 7 0>;
		default-state = "on";
	};
};
```
