## Documentation/devicetree/bindings/gpio/microchip,mpfs-gpio.yaml
```yaml
# SPDX-License-Identifier: (GPL-2.0 OR BSD-2-Clause)
%YAML 1.2
---
$id: http://devicetree.org/schemas/gpio/microchip,mpfs-gpio.yaml#
$schema: http://devicetree.org/meta-schemas/core.yaml#

title: Microchip MPFS GPIO Controller

maintainers:
  - Conor Dooley <conor.dooley@microchip.com>

properties:
  compatible:
    items:
      - enum:
          - microchip,mpfs-gpio
          - microchip,coregpio-rtl-v3

  reg:
    maxItems: 1

  interrupts:
    description:
      Interrupt mapping, one per GPIO. Maximum 32 GPIOs.
    minItems: 1
    maxItems: 32

  interrupt-controller: true

  clocks:
    maxItems: 1

  "#gpio-cells":
    const: 2

  "#interrupt-cells":
    const: 1

  ngpios:
    description:
      The number of GPIOs available.
    minimum: 1
    maximum: 32
    default: 32

  gpio-controller: true
  gpio-line-names: true

patternProperties:
  "^.+-hog(-[0-9]+)?$":
    type: object

    additionalProperties: false

    properties:
      gpio-hog: true
      gpios: true
      input: true
      output-high: true
      output-low: true
      line-name: true

    required:
      - gpio-hog
      - gpios

allOf:
  - if:
      properties:
        compatible:
          contains:
            const: microchip,mpfs-gpio
    then:
      required:
        - interrupts
        - "#interrupt-cells"
        - interrupt-controller

required:
  - compatible
  - reg
  - "#gpio-cells"
  - gpio-controller
  - clocks

additionalProperties: false

examples:
  - |
    gpio@20122000 {
        compatible = "microchip,mpfs-gpio";
        reg = <0x20122000 0x1000>;
        clocks = <&clkcfg 25>;
        interrupt-parent = <&plic>;
        gpio-controller;
        #gpio-cells = <2>;
        interrupt-controller;
        #interrupt-cells = <1>;
        interrupts = <53>, <53>, <53>, <53>,
                     <53>, <53>, <53>, <53>,
                     <53>, <53>, <53>, <53>,
                     <53>, <53>, <53>, <53>,
                     <53>, <53>, <53>, <53>,
                     <53>, <53>, <53>, <53>,
                     <53>, <53>, <53>, <53>,
                     <53>, <53>, <53>, <53>;
    };
...
```

## Documentation/devicetree/bindings/gpio/microchip,pic32-gpio.txt
```
* Microchip PIC32 GPIO devices (PIO).

Required properties:
 - compatible: "microchip,pic32mzda-gpio"
 - reg: Base address and length for the device.
 - interrupts: The port interrupt shared by all pins.
 - gpio-controller: Marks the port as GPIO controller.
 - #gpio-cells: Two. The first cell is the pin number and
   the second cell is used to specify the gpio polarity as defined in
   defined in <dt-bindings/gpio/gpio.h>:
      0 = GPIO_ACTIVE_HIGH
      1 = GPIO_ACTIVE_LOW
      2 = GPIO_OPEN_DRAIN
 - interrupt-controller: Marks the device node as an interrupt controller.
 - #interrupt-cells: Two. The first cell is the GPIO number and second cell
   is used to specify the trigger type as defined in
   <dt-bindings/interrupt-controller/irq.h>:
      IRQ_TYPE_EDGE_RISING
      IRQ_TYPE_EDGE_FALLING
      IRQ_TYPE_EDGE_BOTH
 - clocks: Clock specifier (see clock bindings for details).
 - microchip,gpio-bank: Specifies which bank a controller owns.
 - gpio-ranges: Interaction with the PINCTRL subsystem.

Example:

/* PORTA */
gpio0: gpio0@1f860000 {
	compatible = "microchip,pic32mzda-gpio";
	reg = <0x1f860000 0x100>;
	interrupts = <118 IRQ_TYPE_LEVEL_HIGH>;
	#gpio-cells = <2>;
	gpio-controller;
	interrupt-controller;
	#interrupt-cells = <2>;
	clocks = <&rootclk PB4CLK>;
	microchip,gpio-bank = <0>;
	gpio-ranges = <&pic32_pinctrl 0 0 16>;
};

keys {
	...

	button@sw1 {
		label = "ESC";
		linux,code = <1>;
		gpios = <&gpio0 12 0>;
	};
};
```

## Documentation/devicetree/bindings/gpio/microchip,pic32mzda-gpio.yaml
```yaml
# SPDX-License-Identifier: (GPL-2.0-only OR BSD-2-Clause)
%YAML 1.2
---
$id: http://devicetree.org/schemas/gpio/microchip,pic32mzda-gpio.yaml#
$schema: http://devicetree.org/meta-schemas/core.yaml#

title: Microchip PIC32 GPIO controller

maintainers:
  - Joshua Henderson <joshua.henderson@microchip.com>
  - Purna Chandra Mandal <purna.mandal@microchip.com>

properties:
  compatible:
    const: microchip,pic32mzda-gpio

  reg:
    maxItems: 1

  gpio-controller: true

  gpio-ranges: true

  "#gpio-cells":
    const: 2

  interrupts:
    maxItems: 1

  interrupt-controller: true

  "#interrupt-cells":
    const: 2

  clocks:
    maxItems: 1

  microchip,gpio-bank:
    description: Bank index owned by the controller
    $ref: /schemas/types.yaml#/definitions/uint32

required:
  - compatible
  - reg
  - gpio-controller
  - gpio-ranges
  - "#gpio-cells"
  - interrupts
  - interrupt-controller
  - "#interrupt-cells"
  - clocks
  - microchip,gpio-bank

additionalProperties: false

examples:
  - |
    #include <dt-bindings/interrupt-controller/irq.h>

    gpio@1f860000 {
        compatible = "microchip,pic32mzda-gpio";
        reg = <0x1f860000 0x100>;
        interrupts = <118 IRQ_TYPE_LEVEL_HIGH>;
        #gpio-cells = <2>;
        gpio-controller;
        interrupt-controller;
        #interrupt-cells = <2>;
        clocks = <&rootclk 11>;
        microchip,gpio-bank = <0>;
        gpio-ranges = <&pic32_pinctrl 0 0 16>;
    };
```

## Documentation/devicetree/bindings/gpio/moxa,moxart-gpio.txt
```
MOXA ART GPIO Controller

Required properties:

- #gpio-cells : Should be 2, The first cell is the pin number,
		the second cell is used to specify polarity:
			0 = active high
			1 = active low
- compatible : Must be "moxa,moxart-gpio"
- reg : Should contain registers location and length

Example:

	gpio: gpio@98700000 {
		gpio-controller;
		#gpio-cells = <2>;
		compatible = "moxa,moxart-gpio";
		reg =	<0x98700000 0xC>;
	};
```

## Documentation/devicetree/bindings/gpio/mrvl-gpio.txt
```
* Marvell PXA GPIO controller

Required properties:
- compatible : Should be "intel,pxa25x-gpio", "intel,pxa26x-gpio",
		"intel,pxa27x-gpio", "intel,pxa3xx-gpio",
		"marvell,pxa93x-gpio", "marvell,mmp-gpio",
		"marvell,mmp2-gpio" or marvell,pxa1928-gpio.
- reg : Address and length of the register set for the device
- interrupts : Should be the port interrupt shared by all gpio pins.
  There're three gpio interrupts in arch-pxa, and they're gpio0,
  gpio1 and gpio_mux. There're only one gpio interrupt in arch-mmp,
  gpio_mux.
- interrupt-names : Should be the names of irq resources. Each interrupt
  uses its own interrupt name, so there should be as many interrupt names
  as referenced interrupts.
- interrupt-controller : Identifies the node as an interrupt controller.
- #interrupt-cells: Specifies the number of cells needed to encode an
  interrupt source.
- gpio-controller : Marks the device node as a gpio controller.
- #gpio-cells : Should be two.  The first cell is the pin number and
  the second cell is used to specify flags. See gpio.txt for possible
  values.

Example for a MMP platform:

	gpio: gpio@d4019000 {
		compatible = "marvell,mmp-gpio";
		reg = <0xd4019000 0x1000>;
		interrupts = <49>;
		interrupt-names = "gpio_mux";
		gpio-controller;
		#gpio-cells = <2>;
		interrupt-controller;
		#interrupt-cells = <1>;
      };

Example for a PXA3xx platform:

	gpio: gpio@40e00000 {
		compatible = "intel,pxa3xx-gpio";
		reg = <0x40e00000 0x10000>;
		interrupt-names = "gpio0", "gpio1", "gpio_mux";
		interrupts = <8 9 10>;
		gpio-controller;
		#gpio-cells = <0x2>;
		interrupt-controller;
		#interrupt-cells = <0x2>;
	};
```
