## Documentation/devicetree/bindings/gpio/loongson,ls-gpio.yaml
```yaml
# SPDX-License-Identifier: (GPL-2.0-only OR BSD-2-Clause)
%YAML 1.2
---
$id: http://devicetree.org/schemas/gpio/loongson,ls-gpio.yaml#
$schema: http://devicetree.org/meta-schemas/core.yaml#

title: Loongson GPIO controller.

maintainers:
  - Yinbo Zhu <zhuyinbo@loongson.cn>

properties:
  compatible:
    oneOf:
      - enum:
          - loongson,ls2k-gpio
          - loongson,ls2k0300-gpio
          - loongson,ls2k0500-gpio0
          - loongson,ls2k0500-gpio1
          - loongson,ls2k2000-gpio0
          - loongson,ls2k2000-gpio1
          - loongson,ls2k2000-gpio2
          - loongson,ls3a5000-gpio
          - loongson,ls3a6000-gpio  # Loongson-3A6000 node GPIO
          - loongson,ls7a-gpio
          - loongson,ls7a2000-gpio1 # LS7A2000 chipset GPIO
          - loongson,ls7a2000-gpio2 # LS7A2000 ACPI GPIO
      - items:
          - const: loongson,ls2k1000-gpio
          - const: loongson,ls2k-gpio
      - items:
          - const: loongson,ls7a1000-gpio
          - const: loongson,ls7a-gpio

  reg:
    maxItems: 1

  ngpios:
    minimum: 1
    maximum: 128

  "#gpio-cells":
    const: 2

  gpio-controller: true

  gpio-ranges: true

  interrupts:
    minItems: 1
    maxItems: 64

  "#interrupt-cells":
    const: 2

  interrupt-controller: true

  resets:
    maxItems: 1

required:
  - compatible
  - reg
  - ngpios
  - "#gpio-cells"
  - gpio-controller
  - gpio-ranges
  - interrupts

allOf:
  - if:
      properties:
        compatible:
          contains:
            const: loongson,ls2k0300-gpio
    then:
      required:
        - "#interrupt-cells"
        - interrupt-controller
        - resets
    else:
      properties:
        "#interrupts-cells": false
        interrupt-controller: false
        resets: false

additionalProperties: false

examples:
  - |
    #include <dt-bindings/interrupt-controller/irq.h>

    gpio0: gpio@1fe00500 {
      compatible = "loongson,ls2k1000-gpio", "loongson,ls2k-gpio";
      reg = <0x1fe00500 0x38>;
      ngpios = <64>;
      #gpio-cells = <2>;
      gpio-controller;
      gpio-ranges = <&pctrl 0 0 15>,
                    <&pctrl 16 16 15>,
                    <&pctrl 32 32 10>,
                    <&pctrl 44 44 20>;
      interrupt-parent = <&liointc1>;
      interrupts = <28 IRQ_TYPE_LEVEL_LOW>,
                   <29 IRQ_TYPE_LEVEL_LOW>,
                   <30 IRQ_TYPE_LEVEL_LOW>,
                   <30 IRQ_TYPE_LEVEL_LOW>,
                   <26 IRQ_TYPE_LEVEL_LOW>,
                   <26 IRQ_TYPE_LEVEL_LOW>,
                   <26 IRQ_TYPE_LEVEL_LOW>,
                   <26 IRQ_TYPE_LEVEL_LOW>,
                   <26 IRQ_TYPE_LEVEL_LOW>,
                   <26 IRQ_TYPE_LEVEL_LOW>,
                   <26 IRQ_TYPE_LEVEL_LOW>,
                   <26 IRQ_TYPE_LEVEL_LOW>,
                   <26 IRQ_TYPE_LEVEL_LOW>,
                   <26 IRQ_TYPE_LEVEL_LOW>,
                   <26 IRQ_TYPE_LEVEL_LOW>,
                   <>,
                   <26 IRQ_TYPE_LEVEL_LOW>,
                   <26 IRQ_TYPE_LEVEL_LOW>,
                   <26 IRQ_TYPE_LEVEL_LOW>,
                   <26 IRQ_TYPE_LEVEL_LOW>,
                   <26 IRQ_TYPE_LEVEL_LOW>,
                   <26 IRQ_TYPE_LEVEL_LOW>,
                   <26 IRQ_TYPE_LEVEL_LOW>,
                   <26 IRQ_TYPE_LEVEL_LOW>,
                   <26 IRQ_TYPE_LEVEL_LOW>,
                   <26 IRQ_TYPE_LEVEL_LOW>,
                   <26 IRQ_TYPE_LEVEL_LOW>,
                   <26 IRQ_TYPE_LEVEL_LOW>,
                   <26 IRQ_TYPE_LEVEL_LOW>,
                   <26 IRQ_TYPE_LEVEL_LOW>,
                   <26 IRQ_TYPE_LEVEL_LOW>,
                   <26 IRQ_TYPE_LEVEL_LOW>,
                   <27 IRQ_TYPE_LEVEL_LOW>,
                   <27 IRQ_TYPE_LEVEL_LOW>,
                   <27 IRQ_TYPE_LEVEL_LOW>,
                   <27 IRQ_TYPE_LEVEL_LOW>,
                   <27 IRQ_TYPE_LEVEL_LOW>,
                   <>,
                   <27 IRQ_TYPE_LEVEL_LOW>,
                   <27 IRQ_TYPE_LEVEL_LOW>,
                   <27 IRQ_TYPE_LEVEL_LOW>,
                   <27 IRQ_TYPE_LEVEL_LOW>,
                   <>,
                   <>,
                   <27 IRQ_TYPE_LEVEL_LOW>,
                   <27 IRQ_TYPE_LEVEL_LOW>,
                   <27 IRQ_TYPE_LEVEL_LOW>,
                   <27 IRQ_TYPE_LEVEL_LOW>,
                   <27 IRQ_TYPE_LEVEL_LOW>,
                   <27 IRQ_TYPE_LEVEL_LOW>,
                   <27 IRQ_TYPE_LEVEL_LOW>,
                   <27 IRQ_TYPE_LEVEL_LOW>,
                   <27 IRQ_TYPE_LEVEL_LOW>,
                   <27 IRQ_TYPE_LEVEL_LOW>,
                   <27 IRQ_TYPE_LEVEL_LOW>,
                   <27 IRQ_TYPE_LEVEL_LOW>,
                   <27 IRQ_TYPE_LEVEL_LOW>,
                   <27 IRQ_TYPE_LEVEL_LOW>,
                   <27 IRQ_TYPE_LEVEL_LOW>,
                   <27 IRQ_TYPE_LEVEL_LOW>,
                   <27 IRQ_TYPE_LEVEL_LOW>,
                   <27 IRQ_TYPE_LEVEL_LOW>,
                   <27 IRQ_TYPE_LEVEL_LOW>,
                   <27 IRQ_TYPE_LEVEL_LOW>;
    };
```

## Documentation/devicetree/bindings/gpio/loongson,ls1x-gpio.yaml
```yaml
# SPDX-License-Identifier: (GPL-2.0-only OR BSD-2-Clause)
%YAML 1.2
---
$id: http://devicetree.org/schemas/gpio/loongson,ls1x-gpio.yaml#
$schema: http://devicetree.org/meta-schemas/core.yaml#

title: Loongson-1 GPIO controller

maintainers:
  - Keguang Zhang <keguang.zhang@gmail.com>

properties:
  compatible:
    const: loongson,ls1x-gpio

  reg:
    maxItems: 1

  gpio-controller: true

  "#gpio-cells":
    const: 2

  ngpios:
    minimum: 1
    maximum: 32

required:
  - compatible
  - reg
  - gpio-controller
  - "#gpio-cells"
  - ngpios

additionalProperties: false

examples:
  - |
    gpio0: gpio@1fd010c0 {
        compatible = "loongson,ls1x-gpio";
        reg = <0x1fd010c0 0x4>;

        gpio-controller;
        #gpio-cells = <2>;

        ngpios = <32>;
    };

...
```

## Documentation/devicetree/bindings/gpio/lsi,zevio-gpio.yaml
```yaml
# SPDX-License-Identifier: (GPL-2.0 OR BSD-2-Clause)
%YAML 1.2
---
$id: http://devicetree.org/schemas/gpio/lsi,zevio-gpio.yaml#
$schema: http://devicetree.org/meta-schemas/core.yaml#

title: Zevio GPIO controller

maintainers:
  - Pratik Farkase <pratikfarkase94@gmail.com>

properties:
  compatible:
    items:
      - const: lsi,zevio-gpio

  reg:
    maxItems: 1

  interrupts:
    maxItems: 1

  "#gpio-cells":
    const: 2

  gpio-controller: true

required:
  - compatible
  - reg
  - "#gpio-cells"
  - gpio-controller

unevaluatedProperties: false

examples:
  - |
    gpio@90000000 {
        compatible = "lsi,zevio-gpio";
        reg = <0x90000000 0x1000>;
        gpio-controller;
        #gpio-cells = <2>;
    };
```

## Documentation/devicetree/bindings/gpio/maxim,max31910.yaml
```yaml
# SPDX-License-Identifier: (GPL-2.0-only OR BSD-2-Clause)
%YAML 1.2
---
$id: http://devicetree.org/schemas/gpio/maxim,max31910.yaml#
$schema: http://devicetree.org/meta-schemas/core.yaml#

title: Maxim MAX3191x GPIO serializer

maintainers:
  - Lukas Wunner <lukas@wunner.de>

properties:
  compatible:
    enum:
      - maxim,max31910
      - maxim,max31911
      - maxim,max31912
      - maxim,max31913
      - maxim,max31953
      - maxim,max31963

  reg:
    maxItems: 1

  gpio-controller: true

  '#gpio-cells':
    const: 2

  '#daisy-chained-devices':
    description: Number of chips in the daisy-chain.
    default: 1

  maxim,modesel-gpios:
    description:
      GPIO pins to configure modesel of each chip. The number of GPIOs must
      equal "#daisy-chained-devices" (if each chip is driven by a separate pin)
      or 1 (if all chips are wired to the same pin).

  maxim,fault-gpios:
    description:
      GPIO pins to read fault of each chip. The number of GPIOs must equal
      "#daisy-chained-devices" or 1.

  maxim,db0-gpios:
    description:
      GPIO pins to configure debounce of each chip. The number of GPIOs must
      equal "#daisy-chained-devices" or 1.

  maxim,db1-gpios:
    description:
      GPIO pins to configure debounce of each chip. The number of GPIOs must
      equal "maxim,db0-gpios".

  maxim,modesel-8bit:
    description:
      Boolean whether the modesel pin of the chips is pulled high (8-bit mode).
      Use this if the modesel pin is hardwired and consequently
      "maxim,modesel-gpios" cannot be specified. By default if neither this nor
      "maxim,modesel-gpios" is given, the driver assumes that modesel is pulled
      low (16-bit mode).
    type: boolean

  maxim,ignore-undervoltage:
    description:
      Boolean whether to ignore undervoltage alarms signaled by the
      "maxim,fault-gpios" or by the status byte (in 16-bit mode). Use this if
      the chips are powered through 5VOUT instead of VCC24V, in which case they
      will constantly signal undervoltage.
    type: boolean

required:
  - compatible
  - reg
  - gpio-controller
  - '#gpio-cells'

allOf:
  - $ref: /schemas/spi/spi-peripheral-props.yaml#

unevaluatedProperties: false

examples:
  - |
    #include <dt-bindings/gpio/gpio.h>

    spi {
        #address-cells = <1>;
        #size-cells = <0>;

        gpio@0 {
            compatible = "maxim,max31913";
            reg = <0>;
            gpio-controller;
            #gpio-cells = <2>;

            maxim,modesel-gpios = <&gpio2 23>;
            maxim,fault-gpios = <&gpio2 24 GPIO_ACTIVE_LOW>;
            maxim,db0-gpios = <&gpio2 25>;
            maxim,db1-gpios = <&gpio2 26>;

            spi-max-frequency = <25000000>;
        };
    };
```

## Documentation/devicetree/bindings/gpio/maxim,max7360-gpio.yaml
```yaml
# SPDX-License-Identifier: (GPL-2.0-only OR BSD-2-Clause)
%YAML 1.2
---
$id: http://devicetree.org/schemas/gpio/maxim,max7360-gpio.yaml#
$schema: http://devicetree.org/meta-schemas/core.yaml#

title: Maxim MAX7360 GPIO controller

maintainers:
  - Kamel Bouhara <kamel.bouhara@bootlin.com>
  - Mathieu Dubois-Briand <mathieu.dubois-briand@bootlin.com>

description: |
  Maxim MAX7360 GPIO controller, in MAX7360 chipset
  https://www.analog.com/en/products/max7360.html

  The device provides two series of GPIOs, referred here as GPIOs and GPOs.

  PORT0 to PORT7 pins can be used as GPIOs, with support for interrupts and
  constant-current mode. These pins will also be used by the rotary encoder and
  PWM functionalities.

  COL2 to COL7 pins can be used as GPOs, there is no input capability. COL pins
  will be partitioned, with the first pins being affected to the keypad
  functionality and the last ones as GPOs.

properties:
  compatible:
    enum:
      - maxim,max7360-gpio
      - maxim,max7360-gpo

  gpio-controller: true

  "#gpio-cells":
    const: 2

  interrupt-controller: true

  "#interrupt-cells":
    const: 2

  maxim,constant-current-disable:
    $ref: /schemas/types.yaml#/definitions/uint32
    description:
      Bit field, each bit disables constant-current output of the associated
      GPIO, starting from the least significant bit for the first GPIO.
    maximum: 0xff

required:
  - compatible
  - gpio-controller

allOf:
  - if:
      properties:
        compatible:
          contains:
            enum:
              - maxim,max7360-gpio
        ngpios: false
    then:
      required:
        - interrupt-controller
    else:
      properties:
        interrupt-controller: false
        maxim,constant-current-disable: false

additionalProperties: false

examples:
  - |
    gpio {
      compatible = "maxim,max7360-gpio";

      gpio-controller;
      #gpio-cells = <2>;
      maxim,constant-current-disable = <0x06>;

      interrupt-controller;
      #interrupt-cells = <2>;
    };
```

## Documentation/devicetree/bindings/gpio/maxim,max77759-gpio.yaml
```yaml
# SPDX-License-Identifier: (GPL-2.0-only OR BSD-2-Clause)
%YAML 1.2
---
$id: http://devicetree.org/schemas/gpio/maxim,max77759-gpio.yaml#
$schema: http://devicetree.org/meta-schemas/core.yaml#

title: Maxim Integrated MAX77759 GPIO

maintainers:
  - André Draszik <andre.draszik@linaro.org>

description: |
  This module is part of the MAX77759 PMIC. For additional information, see
  Documentation/devicetree/bindings/mfd/maxim,max77759.yaml.

  The MAX77759 is a PMIC integrating, amongst others, a GPIO controller
  including interrupt support for 2 GPIO lines.

properties:
  compatible:
    const: maxim,max77759-gpio

  "#gpio-cells":
    const: 2

  gpio-controller: true

  gpio-line-names:
    minItems: 1
    maxItems: 2

  "#interrupt-cells":
    const: 2

  interrupt-controller: true

required:
  - compatible
  - "#gpio-cells"
  - gpio-controller
  - "#interrupt-cells"
  - interrupt-controller

additionalProperties: false
```

## Documentation/devicetree/bindings/gpio/mediatek,mt7621-gpio.txt
```
Mediatek MT7621 SoC GPIO controller bindings

The IP core used inside these SoCs has 3 banks of 32 GPIOs each.
The registers of all the banks are interwoven inside one single IO range.
We load one GPIO controller instance per bank. Also the GPIO controller can receive
interrupts on any of the GPIOs, either edge or level. It then interrupts the CPU
using GIC INT12.

Required properties for the top level node:
- #gpio-cells : Should be two. The first cell is the GPIO pin number and the
   second cell specifies GPIO flags, as defined in <dt-bindings/gpio/gpio.h>.
   Only the GPIO_ACTIVE_HIGH and GPIO_ACTIVE_LOW flags are supported.
- #interrupt-cells : Specifies the number of cells needed to encode an
   interrupt. Should be 2. The first cell defines the interrupt number,
   the second encodes the trigger flags encoded as described in
   Documentation/devicetree/bindings/interrupt-controller/interrupts.txt
- compatible:
  - "mediatek,mt7621-gpio" for Mediatek controllers
- reg : Physical base address and length of the controller's registers
- interrupt-parent : phandle of the parent interrupt controller.
- interrupts : Interrupt specifier for the controllers interrupt.
- interrupt-controller : Mark the device node as an interrupt controller.
- gpio-controller : Marks the device node as a GPIO controller.

Example:
	gpio@600 {
		#gpio-cells = <2>;
		#interrupt-cells = <2>;
		compatible = "mediatek,mt7621-gpio";
		gpio-controller;
		interrupt-controller;
		reg = <0x600 0x100>;
		interrupt-parent = <&gic>;
		interrupts = <GIC_SHARED 12 IRQ_TYPE_LEVEL_HIGH>;
	};
```

## Documentation/devicetree/bindings/gpio/mediatek,mt7621-gpio.yaml
```yaml
# SPDX-License-Identifier: GPL-2.0-only OR BSD-2-Clause
%YAML 1.2
---
$id: http://devicetree.org/schemas/gpio/mediatek,mt7621-gpio.yaml#
$schema: http://devicetree.org/meta-schemas/core.yaml#

title: Mediatek MT7621 SoC GPIO controller

maintainers:
  - Sergio Paracuellos <sergio.paracuellos@gmail.com>

description: |
  The IP core used inside these SoCs has 3 banks of 32 GPIOs each.
  The registers of all the banks are interwoven inside one single IO range.
  We load one GPIO controller instance per bank. Also the GPIO controller can receive
  interrupts on any of the GPIOs, either edge or level. It then interrupts the CPU
  using GIC INT12.

properties:
  $nodename:
    pattern: "^gpio@[0-9a-f]+$"

  compatible:
    const: mediatek,mt7621-gpio

  reg:
    maxItems: 1

  "#gpio-cells":
    const: 2

  gpio-controller: true
  gpio-ranges: true

  interrupt-controller: true

  "#interrupt-cells":
    const: 2

  interrupts:
    maxItems: 1

required:
  - compatible
  - reg
  - "#gpio-cells"
  - gpio-controller
  - gpio-ranges
  - interrupt-controller
  - "#interrupt-cells"
  - interrupts

additionalProperties: false

examples:
  - |
    #include <dt-bindings/gpio/gpio.h>
    #include <dt-bindings/interrupt-controller/mips-gic.h>

    gpio@600 {
      compatible = "mediatek,mt7621-gpio";
      reg = <0x600 0x100>;
      #gpio-cells = <2>;
      gpio-controller;
      gpio-ranges = <&pinctrl 0 0 95>;
      interrupt-controller;
      #interrupt-cells = <2>;
      interrupt-parent = <&gic>;
      interrupts = <GIC_SHARED 12 IRQ_TYPE_LEVEL_HIGH>;
    };

...
```
