## Documentation/devicetree/bindings/gpio/gpio-pisosr.txt
```
Generic Parallel-in/Serial-out Shift Register GPIO Driver

This binding describes generic parallel-in/serial-out shift register
devices that can be used for GPI (General Purpose Input). This includes
SN74165 serial-out shift registers and the SN65HVS88x series of
industrial serializers.

Required properties:
 - compatible		: Should be "pisosr-gpio".
 - gpio-controller	: Marks the device node as a GPIO controller.
 - #gpio-cells		: Should be two. For consumer use see gpio.txt.

Optional properties:
 - ngpios		: Number of used GPIO lines (0..n-1), default is 8.
 - load-gpios		: GPIO pin specifier attached to load enable, this
			  pin is pulsed before reading from the device to
			  load input pin values into the device.

For other required and optional properties of SPI slave
nodes please refer to ../spi/spi-bus.txt.

Example:

	gpio@0 {
		compatible = "ti,sn65hvs882", "pisosr-gpio";
		gpio-controller;
		#gpio-cells = <2>;

		load-gpios = <&gpio2 23 GPIO_ACTIVE_LOW>;

		reg = <0>;
		spi-max-frequency = <1000000>;
		spi-cpol;
	};
```

## Documentation/devicetree/bindings/gpio/gpio-pl061.txt
```
PL061 GPIO controller bindings

Required properties:
- compatible:
  - "arm,pl061", "arm,primecell".
- #gpio-cells : Should be two.
  - first cell is the gpio pin number
  - second cell is used to specify the gpio polarity:
      0 = active high
      1 = active low
- gpio-controller : Marks the device node as a GPIO controller.
- interrupt-controller : Marks the device node as an interrupt controller.
- #interrupt-cells : Should be two.
  - first cell is the hw irq number
  - second cell is used to specify the interrupt type:
      0 = default, unspecified type
      1 = rising edge triggered
      2 = falling edge triggered
      4 = high level triggered
      8 = low level triggered
- linux,gpio-base : Should be the global GPIO number.

Example:
	gpio0: gpio@fc806000 {
		compatible = "arm,pl061", "arm,primecell";
		reg = <0xfc806000 0x1000>;
		interrupts = <0 64 0x4>;
		gpio-controller;
		#gpio-cells = <2>;
		interrupt-controller;
		#interrupt-cells = <2>;
		linux,gpio-base = <0>;
	};
```

## Documentation/devicetree/bindings/gpio/gpio-poweroff.txt
```
GPIO line that should be set high/low to power off a device

Required properties:
- compatible : should be "gpio-poweroff".
- gpios : The GPIO to set high/low, see "gpios property" in
  Documentation/devicetree/bindings/gpio/gpio.txt. If the pin should be
  low to power down the board set it to "Active Low", otherwise set
  gpio to "Active High".

Optional properties:
- input : Initially configure the GPIO line as an input. Only reconfigure
  it to an output when the pm_power_off function is called. If this optional
  property is not specified, the GPIO is initialized as an output in its
  inactive state.


Examples:

gpio-poweroff {
	compatible = "gpio-poweroff";
	gpios = <&gpio 4 0>; /* GPIO 4 Active Low */
};
```

## Documentation/devicetree/bindings/gpio/gpio-rda.yaml
```yaml
# SPDX-License-Identifier: (GPL-2.0 OR BSD-2-Clause)
%YAML 1.2
---
$id: http://devicetree.org/schemas/gpio/gpio-rda.yaml#
$schema: http://devicetree.org/meta-schemas/core.yaml#

title: RDA Micro GPIO controller

maintainers:
  - Manivannan Sadhasivam <manivannan.sadhasivam@linaro.org>

properties:
  compatible:
    const: rda,8810pl-gpio

  reg:
    maxItems: 1

  gpio-controller: true

  "#gpio-cells":
    const: 2

  ngpios:
    description:
      Number of available gpios in a bank.
    minimum: 1
    maximum: 32

  interrupt-controller: true

  "#interrupt-cells":
    const: 2

  interrupts:
    maxItems: 1

required:
  - compatible
  - reg
  - gpio-controller
  - "#gpio-cells"
  - ngpios
  - interrupt-controller
  - "#interrupt-cells"
  - interrupts

additionalProperties: false

...
```

## Documentation/devicetree/bindings/gpio/gpio-restart.txt
```
Drive a GPIO line that can be used to restart the system from a restart
handler.

This binding supports level and edge triggered reset.  At driver load
time, the driver will request the given gpio line and install a restart
handler. If the optional properties 'open-source' is not found, the GPIO line
will be driven in the inactive state.  Otherwise its not driven until
the restart is initiated.

When the system is restarted, the restart handler will be invoked in
priority order.  The gpio is configured as an output, and driven active,
triggering a level triggered reset condition. This will also cause an
inactive->active edge condition, triggering positive edge triggered
reset. After a delay specified by active-delay, the GPIO is set to
inactive, thus causing an active->inactive edge, triggering negative edge
triggered reset. After a delay specified by inactive-delay, the GPIO
is driven active again.  After a delay specified by wait-delay, the
restart handler completes allowing other restart handlers to be attempted.

Required properties:
- compatible : should be "gpio-restart".
- gpios : The GPIO to set high/low, see "gpios property" in
  Documentation/devicetree/bindings/gpio/gpio.txt. If the pin should be
  low to reset the board set it to "Active Low", otherwise set
  gpio to "Active High".

Optional properties:
- open-source : Treat the GPIO as being open source and defer driving
  it to when the restart is initiated.  If this optional property is not
  specified, the GPIO is initialized as an output in its inactive state.
- priority : A priority ranging from 0 to 255 (default 128) according to
  the following guidelines:
	0:	Restart handler of last resort, with limited restart
		capabilities
	128:	Default restart handler; use if no other restart handler is
		expected to be available, and/or if restart functionality is
		sufficient to restart the entire system
	255:	Highest priority restart handler, will preempt all other
		restart handlers
- active-delay: Delay (default 100) to wait after driving gpio active [ms]
- inactive-delay: Delay (default 100) to wait after driving gpio inactive [ms]
- wait-delay: Delay (default 3000) to wait after completing restart
  sequence [ms]

Examples:

gpio-restart {
	compatible = "gpio-restart";
	gpios = <&gpio 4 0>;
	priority = <128>;
	active-delay = <100>;
	inactive-delay = <100>;
	wait-delay = <3000>;
};
```

## Documentation/devicetree/bindings/gpio/gpio-samsung.txt
```
Samsung Exynos4 GPIO Controller

Required properties:
- compatible: Compatible property value should be "samsung,exynos4-gpio>".

- reg: Physical base address of the controller and length of memory mapped
  region.

- #gpio-cells: Should be 4. The syntax of the gpio specifier used by client nodes
  should be the following with values derived from the SoC user manual.
     <[phandle of the gpio controller node]
      [pin number within the gpio controller]
      [mux function]
      [flags and pull up/down]
      [drive strength]>

  Values for gpio specifier:
  - Pin number: is a value between 0 to 7.
  - Flags and Pull Up/Down: 0 - Pull Up/Down Disabled.
                            1 - Pull Down Enabled.
                            3 - Pull Up Enabled.
          Bit 16 (0x00010000) - Input is active low.
  - Drive Strength: 0 - 1x,
                    1 - 3x,
                    2 - 2x,
                    3 - 4x

- gpio-controller: Specifies that the node is a gpio controller.
- #address-cells: should be 1.
- #size-cells: should be 1.

Example:

	gpa0: gpio-controller@11400000 {
		#address-cells = <1>;
		#size-cells = <1>;
		compatible = "samsung,exynos4-gpio";
		reg = <0x11400000 0x20>;
		#gpio-cells = <4>;
		gpio-controller;
	};
```

## Documentation/devicetree/bindings/gpio/gpio-sprd.txt
```
Spreadtrum GPIO controller bindings

The controller's registers are organized as sets of sixteen 16-bit
registers with each set controlling a bank of up to 16 pins. A single
interrupt is shared for all of the banks handled by the controller.

Required properties:
- compatible: Should be "sprd,sc9860-gpio".
- reg: Define the base and range of the I/O address space containing
the GPIO controller registers.
- gpio-controller: Marks the device node as a GPIO controller.
- #gpio-cells: Should be <2>. The first cell is the gpio number and
the second cell is used to specify optional parameters.
- interrupt-controller: Marks the device node as an interrupt controller.
- #interrupt-cells: Should be <2>. Specifies the number of cells needed
to encode interrupt source.
- interrupts: Should be the port interrupt shared by all the gpios.

Example:
	ap_gpio: gpio@40280000 {
		compatible = "sprd,sc9860-gpio";
		reg = <0 0x40280000 0 0x1000>;
		gpio-controller;
		#gpio-cells = <2>;
		interrupt-controller;
		#interrupt-cells = <2>;
		interrupts = <GIC_SPI 50 IRQ_TYPE_LEVEL_HIGH>;
	};
```

## Documentation/devicetree/bindings/gpio/gpio-stericsson-coh901.txt
```
ST-Ericsson COH 901 571/3 GPIO controller

Required properties:
- compatible: Compatible property value should be "stericsson,gpio-coh901"
- reg: Physical base address of the controller and length of memory mapped
  region.
- interrupts: the 0...n interrupts assigned to the different GPIO ports/banks.
```

## Documentation/devicetree/bindings/gpio/gpio-stmpe.txt
```
STMPE gpio
----------

Required properties:
 - compatible: "st,stmpe-gpio"

Optional properties:
 - st,norequest-mask: bitmask specifying which GPIOs should _not_ be requestable
   due to different usage (e.g. touch, keypad)

Node should be child node of stmpe node to which it belongs.

Example:
	stmpe_gpio {
		compatible = "st,stmpe-gpio";
		st,norequest-mask = <0x20>;	//gpio 5 can't be used
	};
```

## Documentation/devicetree/bindings/gpio/gpio-stp-xway.txt
```
Lantiq SoC Serial To Parallel (STP) GPIO controller

The Serial To Parallel (STP) is found on MIPS based Lantiq socs. It is a
peripheral controller used to drive external shift register cascades. At most
3 groups of 8 bits can be driven. The hardware is able to allow the DSL modem
to drive the 2 LSBs of the cascade automatically.


Required properties:
- compatible : Should be "lantiq,gpio-stp-xway"
- reg : Address and length of the register set for the device
- #gpio-cells : Should be two.  The first cell is the pin number and
  the second cell is used to specify optional parameters (currently
  unused).
- gpio-controller : Marks the device node as a gpio controller.

Optional properties:
- lantiq,shadow : The default value that we shall assume as already set on the
  shift register cascade.
- lantiq,groups : Set the 3 bit mask to select which of the 3 groups are enabled
  in the shift register cascade.
- lantiq,dsl : The dsl core can control the 2 LSBs of the gpio cascade. This 2 bit
  property can enable this feature.
- lantiq,phy1 : The gphy1 core can control 3 bits of the gpio cascade.
- lantiq,phy2 : The gphy2 core can control 3 bits of the gpio cascade.
- lantiq,rising : use rising instead of falling edge for the shift register

Example:

gpio1: stp@E100BB0 {
	compatible = "lantiq,gpio-stp-xway";
	reg = <0xE100BB0 0x40>;
	#gpio-cells = <2>;
	gpio-controller;

	lantiq,shadow = <0xffff>;
	lantiq,groups = <0x7>;
	lantiq,dsl = <0x3>;
	lantiq,phy1 = <0x7>;
	lantiq,phy2 = <0x7>;
	/* lantiq,rising; */
};
```

## Documentation/devicetree/bindings/gpio/gpio-stp-xway.yaml
```yaml
# SPDX-License-Identifier: (GPL-2.0-only OR BSD-2-Clause)
%YAML 1.2
---
$id: http://devicetree.org/schemas/gpio/gpio-stp-xway.yaml#
$schema: http://devicetree.org/meta-schemas/core.yaml#

title: Lantiq SoC Serial To Parallel (STP) GPIO controller

description: |
  The Serial To Parallel (STP) is found on MIPS based Lantiq socs. It is a
  peripheral controller used to drive external shift register cascades. At most
  3 groups of 8 bits can be driven. The hardware is able to allow the DSL modem
  and Ethernet PHYs to drive some bytes of the cascade automatically.

maintainers:
  - John Crispin <john@phrozen.org>

properties:
  $nodename:
    pattern: "^gpio@[0-9a-f]+$"

  compatible:
    const: lantiq,gpio-stp-xway

  reg:
    maxItems: 1

  gpio-controller: true

  "#gpio-cells":
    description:
      The first cell is the pin number and the second cell is used to specify
      consumer flags.
    const: 2

  lantiq,shadow:
    description:
      The default value that we shall assume as already set on the
      shift register cascade.
    $ref: /schemas/types.yaml#/definitions/uint32
    minimum: 0x000000
    maximum: 0xffffff

  lantiq,groups:
    description:
      Set the 3 bit mask to select which of the 3 groups are enabled
      in the shift register cascade.
    $ref: /schemas/types.yaml#/definitions/uint32
    minimum: 0x0
    maximum: 0x7

  lantiq,dsl:
    description:
      The dsl core can control the 2 LSBs of the gpio cascade. This 2 bit
      property can enable this feature.
    $ref: /schemas/types.yaml#/definitions/uint32
    minimum: 0x0
    maximum: 0x3

  lantiq,rising:
    description:
      Use rising instead of falling edge for the shift register.
    type: boolean

patternProperties:
  "^lantiq,phy[1-4]$":
    description:
      The gphy core can control 3 bits of the gpio cascade. In the xRX200 family
      phy[1-2] are available, in xRX330 phy[1-3] and in XRX330 phy[1-4].
    $ref: /schemas/types.yaml#/definitions/uint32
    minimum: 0x0
    maximum: 0x7

required:
  - compatible
  - reg
  - gpio-controller
  - "#gpio-cells"

additionalProperties: false

examples:
  - |
    gpio@e100bb0 {
        compatible = "lantiq,gpio-stp-xway";
        reg = <0xE100BB0 0x40>;
        #gpio-cells = <2>;
        gpio-controller;

        pinctrl-0 = <&stp_pins>;
        pinctrl-names = "default";

        lantiq,shadow = <0xffffff>;
        lantiq,groups = <0x7>;
        lantiq,dsl = <0x3>;
        lantiq,phy1 = <0x7>;
        lantiq,phy2 = <0x7>;
    };
...
```

## Documentation/devicetree/bindings/gpio/gpio-sx150x.txt
```
SEMTECH SX150x GPIO expander bindings


Required properties:

- compatible: should be "semtech,sx1506q",
			"semtech,sx1508q",
			"semtech,sx1509q".

- reg: The I2C slave address for this device.

- interrupt-parent: phandle of the parent interrupt controller.

- interrupts: Interrupt specifier for the controllers interrupt.

- #gpio-cells: Should be 2. The first cell is the GPIO number and the
		second cell is used to specify optional parameters:
		bit 0: polarity (0: normal, 1: inverted)

- gpio-controller: Marks the device as a GPIO controller.

- interrupt-controller: Marks the device as a interrupt controller.

The GPIO expander can optionally be used as an interrupt controller, in
which case it uses the default two cell specifier as described in
Documentation/devicetree/bindings/interrupt-controller/interrupts.txt.

Example:

	i2c_gpio_expander@20{
		#gpio-cells = <2>;
		#interrupt-cells = <2>;
		compatible = "semtech,sx1506q";
		reg = <0x20>;
		interrupt-parent = <&gpio_1>;
		interrupts = <16 0>;

		gpio-controller;
		interrupt-controller;
	};
```

## Documentation/devicetree/bindings/gpio/gpio-thunderx.txt
```
Cavium ThunderX/OCTEON-TX GPIO controller bindings

Required Properties:
- reg: The controller bus address.
- gpio-controller: Marks the device node as a GPIO controller.
- #gpio-cells: Must be 2.
  - First cell is the GPIO pin number relative to the controller.
  - Second cell is a standard generic flag bitfield as described in gpio.txt.

Optional Properties:
- compatible: "cavium,thunder-8890-gpio", unused as PCI driver binding is used.
- interrupt-controller: Marks the device node as an interrupt controller.
- #interrupt-cells: Must be present and have value of 2 if
                    "interrupt-controller" is present.
  - First cell is the GPIO pin number relative to the controller.
  - Second cell is triggering flags as defined in interrupts.txt.

Example:

gpio_6_0: gpio@6,0 {
	compatible = "cavium,thunder-8890-gpio";
	reg = <0x3000 0 0 0 0>; /*  DEVFN = 0x30 (6:0) */
	gpio-controller;
	#gpio-cells = <2>;
	interrupt-controller;
	#interrupt-cells = <2>;
};
```
