## Documentation/devicetree/bindings/gpio/mrvl-gpio.yaml
```yaml
# SPDX-License-Identifier: GPL-2.0-only
%YAML 1.2
---
$id: http://devicetree.org/schemas/gpio/mrvl-gpio.yaml#
$schema: http://devicetree.org/meta-schemas/core.yaml#

title: Marvell PXA GPIO controller

maintainers:
  - Linus Walleij <linus.walleij@linaro.org>
  - Bartosz Golaszewski <bgolaszewski@baylibre.com>
  - Rob Herring <robh+dt@kernel.org>

allOf:
  - if:
      properties:
        compatible:
          contains:
            enum:
              - intel,pxa25x-gpio
              - intel,pxa26x-gpio
              - intel,pxa27x-gpio
              - intel,pxa3xx-gpio
    then:
      properties:
        interrupts:
          minItems: 3
          maxItems: 3
        interrupt-names:
          items:
            - const: gpio0
            - const: gpio1
            - const: gpio_mux
  - if:
      properties:
        compatible:
          contains:
            enum:
              - marvell,mmp-gpio
              - marvell,mmp2-gpio
    then:
      properties:
        interrupts:
          maxItems: 1
        interrupt-names:
          items:
            - const: gpio_mux

properties:
  $nodename:
    pattern: '^gpio@[0-9a-f]+$'

  compatible:
    enum:
      - intel,pxa25x-gpio
      - intel,pxa26x-gpio
      - intel,pxa27x-gpio
      - intel,pxa3xx-gpio
      - marvell,mmp-gpio
      - marvell,mmp2-gpio
      - marvell,pxa93x-gpio

  reg:
    maxItems: 1

  clocks:
    maxItems: 1

  resets:
    maxItems: 1

  ranges: true

  '#address-cells':
    const: 1

  '#size-cells':
    const: 1

  gpio-controller: true

  '#gpio-cells':
    const: 2

  gpio-ranges: true

  interrupts: true

  interrupt-names: true

  interrupt-controller: true

  '#interrupt-cells':
    const: 2

patternProperties:
  '^gpio@[0-9a-f]*$':
    type: object
    properties:
      reg:
        maxItems: 1

    required:
      - reg

    additionalProperties: false

required:
  - compatible
  - '#address-cells'
  - '#size-cells'
  - reg
  - gpio-controller
  - '#gpio-cells'
  - interrupts
  - interrupt-names
  - interrupt-controller
  - '#interrupt-cells'

additionalProperties: false

examples:
  - |
    #include <dt-bindings/clock/pxa-clock.h>
    gpio@40e00000 {
        compatible = "intel,pxa3xx-gpio";
        #address-cells = <1>;
        #size-cells = <1>;
        reg = <0x40e00000 0x10000>;
        gpio-controller;
        #gpio-cells = <2>;
        interrupts = <8>, <9>, <10>;
        interrupt-names = "gpio0", "gpio1", "gpio_mux";
        clocks = <&clks CLK_GPIO>;
        interrupt-controller;
        #interrupt-cells = <2>;
    };
  - |
    #include <dt-bindings/clock/marvell,pxa910.h>
    gpio@d4019000 {
        compatible = "marvell,mmp-gpio";
        #address-cells = <1>;
        #size-cells = <1>;
        reg = <0xd4019000 0x1000>;
        gpio-controller;
        #gpio-cells = <2>;
        interrupts = <49>;
        interrupt-names = "gpio_mux";
        clocks = <&soc_clocks PXA910_CLK_GPIO>;
        resets = <&soc_clocks PXA910_CLK_GPIO>;
        interrupt-controller;
        #interrupt-cells = <2>;
        ranges;

        gpio@d4019000 {
            reg = <0xd4019000 0x4>;
        };

        gpio@d4019004 {
            reg = <0xd4019004 0x4>;
        };

        gpio@d4019008 {
            reg = <0xd4019008 0x4>;
        };

        gpio@d4019100 {
            reg = <0xd4019100 0x4>;
        };
     };

...
```

## Documentation/devicetree/bindings/gpio/mstar,msc313-gpio.yaml
```yaml
# SPDX-License-Identifier: GPL-2.0-only OR BSD-2-Clause
%YAML 1.2
---
$id: http://devicetree.org/schemas/gpio/mstar,msc313-gpio.yaml#
$schema: http://devicetree.org/meta-schemas/core.yaml#

title: MStar/SigmaStar GPIO controller

maintainers:
  - Daniel Palmer <daniel@thingy.jp>

properties:
  $nodename:
    pattern: "^gpio@[0-9a-f]+$"

  compatible:
    enum:
      - mstar,msc313-gpio
      - sstar,ssd20xd-gpio

  reg:
    maxItems: 1

  gpio-controller: true

  "#gpio-cells":
    const: 2

  gpio-ranges: true

  interrupt-controller: true

  "#interrupt-cells":
    const: 2

required:
  - compatible
  - reg
  - gpio-controller
  - "#gpio-cells"
  - interrupt-controller
  - "#interrupt-cells"

additionalProperties: false

examples:
  - |
    #include <dt-bindings/gpio/msc313-gpio.h>

    gpio: gpio@207800 {
      compatible = "mstar,msc313-gpio";
      #gpio-cells = <2>;
      reg = <0x207800 0x200>;
      gpio-controller;
      gpio-ranges = <&pinctrl 0 36 22>,
                    <&pinctrl 22 63 4>,
                    <&pinctrl 26 68 6>;
      #interrupt-cells = <2>;
      interrupt-controller;
      interrupt-parent = <&intc_fiq>;
    };
```

## Documentation/devicetree/bindings/gpio/netxbig-gpio-ext.txt
```
Binding for the GPIO extension bus found on some LaCie/Seagate boards
(Example: 2Big/5Big Network v2, 2Big NAS).

Required properties:
- compatible: "lacie,netxbig-gpio-ext".
- addr-gpios: GPIOs representing the address register (LSB -> MSB).
- data-gpios: GPIOs representing the data register (LSB -> MSB).
- enable-gpio: latches the new configuration (address, data) on raising edge.

Example:

netxbig_gpio_ext: netxbig-gpio-ext {
	compatible = "lacie,netxbig-gpio-ext";

	addr-gpios = <&gpio1 15 GPIO_ACTIVE_HIGH
		      &gpio1 16 GPIO_ACTIVE_HIGH
		      &gpio1 17 GPIO_ACTIVE_HIGH>;
	data-gpios = <&gpio1 12 GPIO_ACTIVE_HIGH
		      &gpio1 13 GPIO_ACTIVE_HIGH
		      &gpio1 14 GPIO_ACTIVE_HIGH>;
	enable-gpio = <&gpio0 29 GPIO_ACTIVE_HIGH>;
};
```

## Documentation/devicetree/bindings/gpio/ni,169445-nand-gpio.txt
```
Bindings for the National Instruments 169445 GPIO NAND controller

The 169445 GPIO NAND controller has two memory mapped GPIO registers, one
for input (the ready signal) and one for output (control signals).  It is
intended to be used with the GPIO NAND driver.

Required properties:
	- compatible: should be "ni,169445-nand-gpio"
	- reg-names: must contain
		"dat" - data register
	- reg: address + size pairs describing the GPIO register sets;
		order must correspond with the order of entries in reg-names
	- #gpio-cells: must be set to 2. The first cell is the pin number and
			the second cell is used to specify the gpio polarity:
			0 = active high
			1 = active low
	- gpio-controller: Marks the device node as a gpio controller.

Optional properties:
	- no-output: disables driving output on the pins

Examples:
	gpio1: nand-gpio-out@1f300010 {
		compatible = "ni,169445-nand-gpio";
		reg = <0x1f300010 0x4>;
		reg-names = "dat";
		gpio-controller;
		#gpio-cells = <2>;
	};

	gpio2: nand-gpio-in@1f300014 {
		compatible = "ni,169445-nand-gpio";
		reg = <0x1f300014 0x4>;
		reg-names = "dat";
		gpio-controller;
		#gpio-cells = <2>;
		no-output;
	};
```

## Documentation/devicetree/bindings/gpio/nintendo,hollywood-gpio.txt
```
Nintendo Wii (Hollywood) GPIO controller

Required properties:
- compatible: "nintendo,hollywood-gpio"
- reg: Physical base address and length of the controller's registers.
- gpio-controller: Marks the device node as a GPIO controller.
- #gpio-cells: Should be <2>. The first cell is the pin number and the
  second cell is used to specify optional parameters:
   - bit 0 specifies polarity (0 for normal, 1 for inverted).

Optional properties:
- ngpios: see Documentation/devicetree/bindings/gpio/gpio.txt
- interrupt-controller: Marks the device node as an interrupt controller.
- #interrupt-cells: Should be two.
- interrupts: Interrupt specifier for the controller's Broadway (PowerPC)
  interrupt.

Example:

	GPIO: gpio@d8000c0 {
		#gpio-cells = <2>;
		compatible = "nintendo,hollywood-gpio";
		reg = <0x0d8000c0 0x40>;
		gpio-controller;
		ngpios = <24>;
	}
```

## Documentation/devicetree/bindings/gpio/novo,nca9539-gpio.yaml
```yaml
# SPDX-License-Identifier: (GPL-2.0 OR BSD-2-Clause)
%YAML 1.2
---
$id: http://devicetree.org/schemas/gpio/novo,nca9539-gpio.yaml#
$schema: http://devicetree.org/meta-schemas/core.yaml#

title: Novosense I2C GPIO controller

maintainers:
  - Cody Xie <cody.xie@rock-chips.com>

description: |
  This controller is A GPIO expander with I2C interface and one interrupt pin.

properties:
  compatible:
    const: novo,nca9539-gpio

  reg:
    items:
      - description: the I2C address containing the GPIO controller registers.

  gpio-controller: true

  '#gpio-cells':
    const: 2

  ngpios:
    minimum: 0
    maximum: 32

  interrupt-controller: true

  '#interrupt-cells':
    const: 2

  interrupts:
    maxItems: 1

  vdd-supply:
    - description: the regulator for the VDD supplier.

required:
  - compatible
  - reg
  - "#gpio-cells"
  - gpio-controller
  - vdd-supply

additionalProperties: false

dependencies:
  interrupt-controller: [ interrupts ]

examples:
  - |
    #include <dt-bindings/interrupt-controller/irq.h>
    #include <dt-bindings/interrupt-controller/arm-gic.h>
    / {
	  nca9539_vdd: nca9539-vdd {
		compatible = "regulator-fixed";
		regulator-name = "nca9539_vdd";
		enable-active-high;
		regulator-boot-on;
		regulator-always-on;
	  };
	};

    nca9539_gpio: gpio@74 {
		compatible = "novo,nca9539-gpio";
        reg = <0x74>;
        gpio-controller;
        #gpio-cells = <2>;
		interrupt-controller;
		#interrupt-cells = <2>;
		vdd-supply = <&nca9539_vdd>;
    };


...
```

## Documentation/devicetree/bindings/gpio/nuvoton,sgpio.yaml
```yaml
# SPDX-License-Identifier: (GPL-2.0-only OR BSD-2-Clause)
%YAML 1.2
---
$id: http://devicetree.org/schemas/gpio/nuvoton,sgpio.yaml#
$schema: http://devicetree.org/meta-schemas/core.yaml#

title: Nuvoton SGPIO controller

maintainers:
  - Jim LIU <JJLIU0@nuvoton.com>

description: |
  This SGPIO controller is for NUVOTON NPCM7xx and NPCM8xx SoC and detailed
  information is in the NPCM7XX/8XX SERIAL I/O EXPANSION INTERFACE section.
  Nuvoton NPCM7xx SGPIO module is combines a serial to parallel IC (HC595)
  and a parallel to serial IC (HC165).
  Clock is a division of the APB3 clock.
  This interface has 4 pins (D_out , D_in, S_CLK, LDSH).
  NPCM7xx/NPCM8xx have two sgpio modules. Each module can support up
  to 64 output pins, and up to 64 input pins, the pin is only for GPI or GPO.
  GPIO pins can be programmed to support the following options
  - Support interrupt option for each input port and various interrupt
    sensitivity options (level-high, level-low, edge-high, edge-low)
  - ngpios is number of nuvoton,input-ngpios GPIO lines and nuvoton,output-ngpios GPIO lines.
    nuvoton,input-ngpios GPIO lines is only for GPI.
    nuvoton,output-ngpios GPIO lines is only for GPO.

properties:
  compatible:
    enum:
      - nuvoton,npcm750-sgpio
      - nuvoton,npcm845-sgpio

  reg:
    maxItems: 1

  gpio-controller: true

  '#gpio-cells':
    const: 2

  interrupts:
    maxItems: 1

  clocks:
    maxItems: 1

  nuvoton,input-ngpios:
    $ref: /schemas/types.yaml#/definitions/uint32
    description:
      The numbers of GPIO's exposed. GPIO lines are only for GPI.
    minimum: 0
    maximum: 64

  nuvoton,output-ngpios:
    $ref: /schemas/types.yaml#/definitions/uint32
    description:
      The numbers of GPIO's exposed. GPIO lines are only for GPO.
    minimum: 0
    maximum: 64

required:
  - compatible
  - reg
  - gpio-controller
  - '#gpio-cells'
  - interrupts
  - nuvoton,input-ngpios
  - nuvoton,output-ngpios
  - clocks

additionalProperties: false

examples:
  - |
    #include <dt-bindings/clock/nuvoton,npcm7xx-clock.h>
    #include <dt-bindings/interrupt-controller/arm-gic.h>
    gpio8: gpio@101000 {
        compatible = "nuvoton,npcm750-sgpio";
        reg = <0x101000 0x200>;
        clocks = <&clk NPCM7XX_CLK_APB3>;
        interrupts = <GIC_SPI 19 IRQ_TYPE_LEVEL_HIGH>;
        gpio-controller;
        #gpio-cells = <2>;
        nuvoton,input-ngpios = <64>;
        nuvoton,output-ngpios = <64>;
    };
```
