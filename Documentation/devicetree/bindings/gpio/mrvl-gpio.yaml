## Documentation/devicetree/bindings/gpio/nvidia,tegra20-gpio.yaml
```yaml
# SPDX-License-Identifier: (GPL-2.0-only OR BSD-2-Clause)
%YAML 1.2
---
$id: http://devicetree.org/schemas/gpio/nvidia,tegra20-gpio.yaml#
$schema: http://devicetree.org/meta-schemas/core.yaml#

title: NVIDIA Tegra GPIO Controller (Tegra20 - Tegra210)

maintainers:
  - Thierry Reding <thierry.reding@gmail.com>
  - Jon Hunter <jonathanh@nvidia.com>

properties:
  compatible:
    oneOf:
      - enum:
          - nvidia,tegra20-gpio
          - nvidia,tegra30-gpio

      - items:
          - enum:
              - nvidia,tegra114-gpio
              - nvidia,tegra124-gpio
              - nvidia,tegra210-gpio
          - const: nvidia,tegra30-gpio

  reg:
    maxItems: 1

  interrupts:
    description: The interrupt outputs from the controller. For Tegra20,
      there should be 7 interrupts specified, and for Tegra30, there should
      be 8 interrupts specified.

  "#gpio-cells":
    description: The first cell is the pin number and the second cell is used
      to specify the GPIO polarity (0 = active high, 1 = active low).
    const: 2

  gpio-controller: true

  gpio-ranges:
    maxItems: 1

  "#interrupt-cells":
    description: |
      Should be 2. The first cell is the GPIO number. The second cell is
      used to specify flags:

        bits[3:0] trigger type and level flags:
          1 = low-to-high edge triggered.
          2 = high-to-low edge triggered.
          4 = active high level-sensitive.
          8 = active low level-sensitive.

      Valid combinations are 1, 2, 3, 4, 8.
    const: 2

  interrupt-controller: true

allOf:
  - if:
      properties:
        compatible:
          contains:
            const: nvidia,tegra30-gpio
    then:
      properties:
        interrupts:
          minItems: 8
          maxItems: 8
    else:
      properties:
        interrupts:
          minItems: 7
          maxItems: 7

required:
  - compatible
  - reg
  - interrupts
  - "#gpio-cells"
  - gpio-controller
  - "#interrupt-cells"
  - interrupt-controller

additionalProperties:
  type: object
  required:
    - gpio-hog

examples:
  - |
    #include <dt-bindings/interrupt-controller/arm-gic.h>

    gpio: gpio@6000d000 {
        compatible = "nvidia,tegra20-gpio";
        reg = <0x6000d000 0x1000>;
        interrupts = <GIC_SPI 32 IRQ_TYPE_LEVEL_HIGH>,
                     <GIC_SPI 33 IRQ_TYPE_LEVEL_HIGH>,
                     <GIC_SPI 34 IRQ_TYPE_LEVEL_HIGH>,
                     <GIC_SPI 35 IRQ_TYPE_LEVEL_HIGH>,
                     <GIC_SPI 55 IRQ_TYPE_LEVEL_HIGH>,
                     <GIC_SPI 87 IRQ_TYPE_LEVEL_HIGH>,
                     <GIC_SPI 89 IRQ_TYPE_LEVEL_HIGH>;
        #gpio-cells = <2>;
        gpio-controller;
        #interrupt-cells = <2>;
        interrupt-controller;
    };
```

## Documentation/devicetree/bindings/gpio/nxp,lpc1850-gpio.txt
```
NXP LPC18xx/43xx GPIO controller Device Tree Bindings
-----------------------------------------------------

Required properties:
- compatible		: Should be "nxp,lpc1850-gpio"
- reg			: List of addresses and lengths of the GPIO controller
			  register sets
- reg-names		: Should be "gpio", "gpio-pin-ic", "gpio-group0-ic" and
			  "gpio-gpoup1-ic"
- clocks		: Phandle and clock specifier pair for GPIO controller
- resets		: Phandle and reset specifier pair for GPIO controller
- gpio-controller	: Marks the device node as a GPIO controller
- #gpio-cells 		: Should be two:
			  - The first cell is the GPIO line number
			  - The second cell is used to specify polarity
- interrupt-controller	: Marks the device node as an interrupt controller
- #interrupt-cells	: Should be two:
			  - The first cell is an interrupt number within
			    0..9 range, for GPIO pin interrupts it is equal
			    to 'nxp,gpio-pin-interrupt' property value of
			    GPIO pin configuration, 8 is for GPIO GROUP0
			    interrupt, 9 is for GPIO GROUP1 interrupt
			  - The second cell is used to specify interrupt type

Optional properties:
- gpio-ranges		: Mapping between GPIO and pinctrl

Example:
#define LPC_GPIO(port, pin)	(port * 32 + pin)
#define LPC_PIN(port, pin)	(0x##port * 32 + pin)

gpio: gpio@400f4000 {
	compatible = "nxp,lpc1850-gpio";
	reg = <0x400f4000 0x4000>, <0x40087000 0x1000>,
	      <0x40088000 0x1000>, <0x40089000 0x1000>;
	reg-names = "gpio", "gpio-pin-ic",
		    "gpio-group0-ic", "gpio-gpoup1-ic";
	clocks = <&ccu1 CLK_CPU_GPIO>;
	resets = <&rgu 28>;
	gpio-controller;
	#gpio-cells = <2>;
	interrupt-controller;
	#interrupt-cells = <2>;
	gpio-ranges =	<&pinctrl LPC_GPIO(0,0)  LPC_PIN(0,0)  2>,
			...
			<&pinctrl LPC_GPIO(7,19) LPC_PIN(f,5)  7>;
};

gpio_joystick {
	compatible = "gpio-keys";
	...

	button0 {
		...
		interrupt-parent = <&gpio>;
		interrupts = <1 IRQ_TYPE_EDGE_BOTH>;
		gpios = <&gpio LPC_GPIO(4,8) GPIO_ACTIVE_LOW>;
	};
};
```

## Documentation/devicetree/bindings/gpio/nxp,lpc1850-gpio.yaml
```yaml
# SPDX-License-Identifier: (GPL-2.0-only OR BSD-2-Clause)
%YAML 1.2
---
$id: http://devicetree.org/schemas/gpio/nxp,lpc1850-gpio.yaml#
$schema: http://devicetree.org/meta-schemas/core.yaml#

title: NXP LPC18xx/43xx GPIO controller

maintainers:
  - Frank Li <Frank.Li@nxp.com>

properties:
  compatible:
    const: nxp,lpc1850-gpio

  reg:
    minItems: 1
    maxItems: 4

  reg-names:
    minItems: 1
    items:
      - const: gpio
      - const: gpio-pin-ic
      - const: gpio-group0-ic
      - const: gpio-gpoup1-ic

  clocks:
    maxItems: 1

  resets:
    maxItems: 1

  gpio-controller: true

  '#gpio-cells':
    const: 2

  interrupt-controller: true

  '#interrupt-cells':
    const: 2
    description: |
      - The first cell is an interrupt number within
        0..9 range, for GPIO pin interrupts it is equal
        to 'nxp,gpio-pin-interrupt' property value of
        GPIO pin configuration, 8 is for GPIO GROUP0
        interrupt, 9 is for GPIO GROUP1 interrupt
      - The second cell is used to specify interrupt type

  gpio-ranges: true

required:
  - compatible
  - reg
  - clocks
  - gpio-controller
  - '#gpio-cells'

additionalProperties: false

examples:
  - |
    #include <dt-bindings/clock/lpc18xx-ccu.h>

    gpio@400f4000 {
        compatible = "nxp,lpc1850-gpio";
        reg = <0x400f4000 0x4000>, <0x40087000 0x1000>,
              <0x40088000 0x1000>, <0x40089000 0x1000>;
        reg-names = "gpio", "gpio-pin-ic", "gpio-group0-ic", "gpio-gpoup1-ic";
        clocks = <&ccu1 CLK_CPU_GPIO>;
        resets = <&rgu 28>;
        gpio-controller;
        #gpio-cells = <2>;
        interrupt-controller;
        #interrupt-cells = <2>;
    };
```

## Documentation/devicetree/bindings/gpio/nxp,lpc3220-gpio.yaml
```yaml
# SPDX-License-Identifier: GPL-2.0-only OR BSD-2-Clause
%YAML 1.2
---
$id: http://devicetree.org/schemas/gpio/nxp,lpc3220-gpio.yaml#
$schema: http://devicetree.org/meta-schemas/core.yaml#

title: NXP LPC3220 SoC GPIO controller

maintainers:
  - Animesh Agarwal <animeshagarwal28@gmail.com>

properties:
  compatible:
    const: nxp,lpc3220-gpio

  reg:
    maxItems: 1

  gpio-controller: true

  '#gpio-cells':
    const: 3
    description: |
      1) bank:
        0: GPIO P0
        1: GPIO P1
        2: GPIO P2
        3: GPIO P3
        4: GPI P3
        5: GPO P3
      2) pin number
      3) flags:
        - bit 0 specifies polarity (0 for normal, 1 for inverted)

required:
  - compatible
  - reg
  - gpio-controller
  - '#gpio-cells'

additionalProperties: false

examples:
  - |
    gpio@40028000 {
        compatible = "nxp,lpc3220-gpio";
        reg = <0x40028000 0x1000>;
        gpio-controller;
        #gpio-cells = <3>; /* bank, pin, flags */
    };
```

## Documentation/devicetree/bindings/gpio/nxp,pcf8575.yaml
```yaml
# SPDX-License-Identifier: (GPL-2.0-only OR BSD-2-Clause)
%YAML 1.2
---
$id: http://devicetree.org/schemas/gpio/nxp,pcf8575.yaml#
$schema: http://devicetree.org/meta-schemas/core.yaml#

title: PCF857x-compatible I/O expanders

maintainers:
  - Laurent Pinchart <laurent.pinchart+renesas@ideasonboard.com>

description:
  The PCF857x-compatible chips have "quasi-bidirectional" I/O lines that can be
  driven high by a pull-up current source or driven low to ground. This
  combines the direction and output level into a single bit per line, which
  can't be read back. We can't actually know at initialization time whether a
  line is configured (a) as output and driving the signal low/high, or (b) as
  input and reporting a low/high value, without knowing the last value written
  since the chip came out of reset (if any). The only reliable solution for
  setting up line direction is thus to do it explicitly.

properties:
  compatible:
    enum:
      - maxim,max7328
      - maxim,max7329
      - nxp,pca8574
      - nxp,pca8575
      - nxp,pca9670
      - nxp,pca9671
      - nxp,pca9672
      - nxp,pca9673
      - nxp,pca9674
      - nxp,pca9675
      - nxp,pcf8574
      - nxp,pcf8574a
      - nxp,pcf8575

  reg:
    maxItems: 1

  gpio-line-names:
    minItems: 1
    maxItems: 16

  gpio-controller: true

  '#gpio-cells':
    const: 2
    description:
      The first cell is the GPIO number and the second cell specifies GPIO
      flags, as defined in <dt-bindings/gpio/gpio.h>. Only the GPIO_ACTIVE_HIGH
      and GPIO_ACTIVE_LOW flags are supported.

  lines-initial-states:
    $ref: /schemas/types.yaml#/definitions/uint32
    description:
      Bitmask that specifies the initial state of each line.
      When a bit is set to zero, the corresponding line will be initialized to
      the input (pulled-up) state.
      When the  bit is set to one, the line will be initialized to the
      low-level output state.
      If the property is not specified all lines will be initialized to the
      input state.

  interrupts:
    maxItems: 1

  interrupt-controller: true

  '#interrupt-cells':
    const: 2

  wakeup-source: true

  reset-gpios:
    maxItems: 1
    description:
      GPIO controlling the (reset active LOW) RESET# pin.

      The active polarity of the GPIO must translate to the low state of the
      RESET# pin on the IC, i.e. if a GPIO is directly routed to the RESET# pin
      without any inverter, GPIO_ACTIVE_LOW is expected.

      Performing a reset makes all lines initialized to their input (pulled-up)
      state.

allOf:
  - if:
      properties:
        compatible:
          not:
            contains:
              enum:
                - nxp,pca9670
                - nxp,pca9671
                - nxp,pca9672
                - nxp,pca9673
    then:
      properties:
        reset-gpios: false

  # lines-initial-states XOR reset-gpios
  # Performing a reset reinitializes all lines to a known state which
  # may not match passed lines-initial-states
  - if:
      required:
        - lines-initial-states
    then:
      properties:
        reset-gpios: false

patternProperties:
  "^(.+-hog(-[0-9]+)?)$":
    type: object

    required:
      - gpio-hog

required:
  - compatible
  - reg
  - gpio-controller
  - '#gpio-cells'

additionalProperties: false

examples:
  - |
    i2c {
        #address-cells = <1>;
        #size-cells = <0>;

        gpio@20 {
            compatible = "nxp,pcf8575";
            reg = <0x20>;
            interrupt-parent = <&irqpin2>;
            interrupts = <3 0>;
            gpio-controller;
            #gpio-cells = <2>;
            interrupt-controller;
            #interrupt-cells = <2>;
        };
    };
```

## Documentation/devicetree/bindings/gpio/pin-control-gpio.yaml
```yaml
# SPDX-License-Identifier: GPL-2.0-only OR BSD-2-Clause
%YAML 1.2
---
$id: http://devicetree.org/schemas/gpio/pin-control-gpio.yaml#
$schema: http://devicetree.org/meta-schemas/core.yaml#

title: Pin control based generic GPIO controller

description:
  The pin control-based GPIO will facilitate a pin controller's ability
  to drive electric lines high/low and other generic properties of a
  pin controller to perform general-purpose one-bit binary I/O.

maintainers:
  - Dan Carpenter <dan.carpenter@linaro.org>

properties:
  compatible:
    const: scmi-pinctrl-gpio

  gpio-controller: true

  "#gpio-cells":
    const: 2

  gpio-line-names: true

  gpio-ranges: true

  ngpios: true

patternProperties:
  "^.+-hog(-[0-9]+)?$":
    type: object

    required:
      - gpio-hog

required:
  - compatible
  - gpio-controller
  - "#gpio-cells"
  - gpio-ranges
  - ngpios

additionalProperties: false

examples:
  - |
    gpio {
        compatible = "scmi-pinctrl-gpio";
        gpio-controller;
        #gpio-cells = <2>;
        ngpios = <4>;
        gpio-line-names = "gpio_5_17", "gpio_5_20", "gpio_5_22", "gpio_2_1";
        gpio-ranges = <&scmi_pinctrl 0 30 4>;
        pinctrl-names = "default";
        pinctrl-0 = <&keys_pins>;
    };
```

## Documentation/devicetree/bindings/gpio/pisosr-gpio.yaml
```yaml
# SPDX-License-Identifier: (GPL-2.0-only OR BSD-2-Clause)
%YAML 1.2
---
$id: http://devicetree.org/schemas/gpio/pisosr-gpio.yaml#
$schema: http://devicetree.org/meta-schemas/core.yaml#

title: Generic Parallel-in/Serial-out Shift Register GPIO Driver

description:
  This binding describes generic parallel-in/serial-out shift register
  devices that can be used for GPI (General Purpose Input). This includes
  SN74165 serial-out shift registers and the SN65HVS88x series of
  industrial serializers.

maintainers:
  - Frank Li <Frank.Li@nxp.com>

properties:
  compatible:
    enum:
      - pisosr-gpio

  gpio-controller: true

  '#gpio-cells':
    const: 2

  ngpios:
    maximum: 32
    default: 8

  load-gpios:
    description:
      GPIO pin specifier attached to load enable, this
      pin is pulsed before reading from the device to
      load input pin values into the device.

  spi-cpol: true

required:
  - compatible
  - gpio-controller
  - '#gpio-cells'

allOf:
  - $ref: /schemas/spi/spi-peripheral-props.yaml#

unevaluatedProperties: false

examples:
  - |
    #include <dt-bindings/gpio/gpio.h>

    spi {
        #address-cells = <1>;
        #size-cells = <0>;

        gpio@0 {
            compatible = "pisosr-gpio";
            reg = <0>;
            gpio-controller;
            #gpio-cells = <2>;
            load-gpios = <&gpio2 23 GPIO_ACTIVE_LOW>;
            spi-max-frequency = <1000000>;
            spi-cpol;
        };
    };
```

## Documentation/devicetree/bindings/gpio/pl061-gpio.txt
```
ARM PL061 GPIO controller

Required properties:
- compatible : "arm,pl061", "arm,primecell"
- #gpio-cells : Should be two. The first cell is the pin number and the
  second cell is used to specify optional parameters:
  - bit 0 specifies polarity (0 for normal, 1 for inverted)
- gpio-controller : Marks the device node as a GPIO controller.
- interrupts : Interrupt mapping for GPIO IRQ.
```

## Documentation/devicetree/bindings/gpio/pl061-gpio.yaml
```yaml
# SPDX-License-Identifier: (GPL-2.0 OR BSD-2-Clause)
%YAML 1.2
---
$id: http://devicetree.org/schemas/gpio/pl061-gpio.yaml#
$schema: http://devicetree.org/meta-schemas/core.yaml#

title: ARM PL061 GPIO controller

maintainers:
  - Linus Walleij <linus.walleij@linaro.org>
  - Rob Herring <robh@kernel.org>

# We need a select here so we don't match all nodes with 'arm,primecell'
select:
  properties:
    compatible:
      contains:
        const: arm,pl061
  required:
    - compatible

properties:
  $nodename:
    pattern: "^gpio@[0-9a-f]+$"

  compatible:
    items:
      - const: arm,pl061
      - const: arm,primecell

  reg:
    maxItems: 1

  interrupts:
    oneOf:
      - maxItems: 1
      - maxItems: 8

  interrupt-controller: true

  "#interrupt-cells":
    const: 2

  clocks:
    maxItems: 1

  clock-names: true

  "#gpio-cells":
    const: 2

  gpio-controller: true

  gpio-ranges:
    maxItems: 8

required:
  - compatible
  - reg
  - interrupts
  - interrupt-controller
  - "#interrupt-cells"
  - clocks
  - "#gpio-cells"
  - gpio-controller

additionalProperties: false

...
```
