## Documentation/devicetree/bindings/gpio/qca,ar7100-gpio.yaml
```yaml
# SPDX-License-Identifier: (GPL-2.0-only OR BSD-2-Clause)
%YAML 1.2
---
$id: http://devicetree.org/schemas/gpio/qca,ar7100-gpio.yaml#
$schema: http://devicetree.org/meta-schemas/core.yaml#

title: Qualcomm Atheros AR7xxx/AR9xxx GPIO controller

maintainers:
  - Alban Bedel <albeu@free.fr>

properties:
  compatible:
    oneOf:
      - items:
          - const: qca,ar9132-gpio
          - const: qca,ar7100-gpio
      - enum:
          - qca,ar7100-gpio
          - qca,ar9340-gpio

  reg:
    maxItems: 1

  gpio-controller: true

  '#gpio-cells':
    const: 2

  ngpios: true

  interrupts:
    maxItems: 1

  interrupt-controller: true

  '#interrupt-cells':
    const: 2

required:
  - compatible
  - reg
  - gpio-controller
  - '#gpio-cells'
  - ngpios

additionalProperties: false

examples:
  - |
    gpio@18040000 {
        compatible = "qca,ar9132-gpio", "qca,ar7100-gpio";
        reg = <0x18040000 0x30>;
        interrupts = <2>;
        ngpios = <22>;
        gpio-controller;
        #gpio-cells = <2>;
        interrupt-controller;
        #interrupt-cells = <2>;
    };
```

## Documentation/devicetree/bindings/gpio/qcom,wcd934x-gpio.yaml
```yaml
# SPDX-License-Identifier: (GPL-2.0 OR BSD-2-Clause)
%YAML 1.2
---
$id: http://devicetree.org/schemas/gpio/qcom,wcd934x-gpio.yaml#
$schema: http://devicetree.org/meta-schemas/core.yaml#

title: WCD9340/WCD9341 GPIO controller

maintainers:
  - Srinivas Kandagatla <srinivas.kandagatla@linaro.org>

description: |
  Qualcomm Technologies Inc WCD9340/WCD9341 Audio Codec has integrated
  gpio controller to control 5 gpios on the chip.

properties:
  compatible:
    enum:
      - qcom,wcd9340-gpio
      - qcom,wcd9341-gpio

  reg:
    maxItems: 1

  gpio-controller: true

  '#gpio-cells':
    const: 2

required:
  - compatible
  - reg
  - gpio-controller
  - "#gpio-cells"

additionalProperties: false

examples:
  - |
    wcdgpio: gpio@42 {
        compatible = "qcom,wcd9340-gpio";
        reg = <0x042 0x2>;
        gpio-controller;
        #gpio-cells = <2>;
    };

...
```

## Documentation/devicetree/bindings/gpio/raspberrypi,firmware-gpio.txt
```
Raspberry Pi GPIO expander

The Raspberry Pi 3 GPIO expander is controlled by the VC4 firmware. The
firmware exposes a mailbox interface that allows the ARM core to control the
GPIO lines on the expander.

The Raspberry Pi GPIO expander node must be a child node of the Raspberry Pi
firmware node.

Required properties:

- compatible : Should be "raspberrypi,firmware-gpio"
- gpio-controller : Marks the device node as a gpio controller
- #gpio-cells : Should be two.  The first cell is the pin number, and
  the second cell is used to specify the gpio polarity:
  0 = active high
  1 = active low

Example:

firmware: firmware-rpi {
	compatible = "raspberrypi,bcm2835-firmware";
	mboxes = <&mailbox>;

	expgpio: gpio {
		 compatible = "raspberrypi,firmware-gpio";
		 gpio-controller;
		 #gpio-cells = <2>;
	 };
};
```

## Documentation/devicetree/bindings/gpio/realtek,otto-gpio.yaml
```yaml
# SPDX-License-Identifier: GPL-2.0-only OR BSD-2-Clause
%YAML 1.2
---
$id: http://devicetree.org/schemas/gpio/realtek,otto-gpio.yaml#
$schema: http://devicetree.org/meta-schemas/core.yaml#

title: Realtek Otto GPIO controller

maintainers:
  - Sander Vanheule <sander@svanheule.net>
  - Bert Vermeulen <bert@biot.com>

description: |
  Realtek's GPIO controller on their MIPS switch SoCs (Otto platform) consists
  of two banks of 32 GPIOs. These GPIOs can generate edge-triggered interrupts.
  Each bank's interrupts are cascased into one interrupt line on the parent
  interrupt controller, if provided.
  This binding allows defining a single bank in the devicetree. The interrupt
  controller is not supported on the fallback compatible name, which only
  allows for GPIO port use.

properties:
  $nodename:
    pattern: "^gpio@[0-9a-f]+$"

  compatible:
    items:
      - enum:
          - realtek,rtl8380-gpio
          - realtek,rtl8390-gpio
          - realtek,rtl9300-gpio
          - realtek,rtl9310-gpio
      - const: realtek,otto-gpio

  reg: true

  "#gpio-cells":
    const: 2

  gpio-controller: true

  ngpios:
    minimum: 1
    maximum: 32

  interrupt-controller: true

  "#interrupt-cells":
    const: 2

  interrupts:
    maxItems: 1

if:
  properties:
    compatible:
      contains:
        const: realtek,rtl9300-gpio
then:
  properties:
    reg:
      items:
        - description: GPIO and interrupt control
        - description: interrupt CPU map
else:
  properties:
    reg:
      items:
        - description: GPIO and interrupt control

required:
  - compatible
  - reg
  - "#gpio-cells"
  - gpio-controller

additionalProperties: false

dependencies:
  interrupt-controller: [ interrupts ]

examples:
  - |
      gpio@3500 {
        compatible = "realtek,rtl8380-gpio", "realtek,otto-gpio";
        reg = <0x3500 0x1c>;
        gpio-controller;
        #gpio-cells = <2>;
        ngpios = <24>;
        interrupt-controller;
        #interrupt-cells = <2>;
        interrupt-parent = <&rtlintc>;
        interrupts = <23>;
      };
  - |
      gpio@3300 {
        compatible = "realtek,rtl9300-gpio", "realtek,otto-gpio";
        reg = <0x3300 0x1c>, <0x3338 0x8>;
        gpio-controller;
        #gpio-cells = <2>;
        ngpios = <24>;
        interrupt-controller;
        #interrupt-cells = <2>;
        interrupt-parent = <&rtlintc>;
        interrupts = <13>;
      };

...
```

## Documentation/devicetree/bindings/gpio/realtek,rtd-gpio.yaml
```yaml
# SPDX-License-Identifier: (GPL-2.0 OR BSD-2-Clause)
# Copyright 2023 Realtek Semiconductor Corporation
%YAML 1.2
---
$id: http://devicetree.org/schemas/gpio/realtek,rtd-gpio.yaml#
$schema: http://devicetree.org/meta-schemas/core.yaml#

title: Realtek DHC GPIO controller

maintainers:
  - Tzuyi Chang <tychang@realtek.com>

description:
  The GPIO controller is designed for the Realtek DHC (Digital Home Center)
  RTD series SoC family, which are high-definition media processor SoCs.

properties:
  compatible:
    enum:
      - realtek,rtd1295-misc-gpio
      - realtek,rtd1295-iso-gpio
      - realtek,rtd1315e-iso-gpio
      - realtek,rtd1319-iso-gpio
      - realtek,rtd1319d-iso-gpio
      - realtek,rtd1395-iso-gpio
      - realtek,rtd1619-iso-gpio
      - realtek,rtd1619b-iso-gpio

  reg:
    items:
      - description: GPIO controller registers
      - description: GPIO interrupt registers

  interrupts:
    items:
      - description: Interrupt number of the assert GPIO interrupt, which is
                     triggered when there is a rising edge.
      - description: Interrupt number of the deassert GPIO interrupt, which is
                     triggered when there is a falling edge.

  gpio-ranges: true

  gpio-controller: true

  "#gpio-cells":
    const: 2

required:
  - compatible
  - reg
  - interrupts
  - gpio-ranges
  - gpio-controller
  - "#gpio-cells"

additionalProperties: false

examples:
  - |
    gpio@100 {
      compatible = "realtek,rtd1319d-iso-gpio";
      reg = <0x100 0x100>,
            <0x0 0xb0>;
      interrupt-parent = <&iso_irq_mux>;
      interrupts = <19>, <20>;
      gpio-ranges = <&pinctrl 0 0 82>;
      gpio-controller;
      #gpio-cells = <2>;
    };
```

## Documentation/devicetree/bindings/gpio/realtek,rtd1625-gpio.yaml
```yaml
# SPDX-License-Identifier: (GPL-2.0 OR BSD-2-Clause)
# Copyright 2023 Realtek Semiconductor Corporation
%YAML 1.2
---
$id: http://devicetree.org/schemas/gpio/realtek,rtd1625-gpio.yaml#
$schema: http://devicetree.org/meta-schemas/core.yaml#

title: Realtek DHC RTD1625 GPIO controller

maintainers:
  - Tzuyi Chang <tychang@realtek.com>

description: |
  GPIO controller for the Realtek RTD1625 SoC, featuring a per-pin register
  architecture that differs significantly from earlier RTD series controllers.
  Each GPIO has dedicated registers for configuration (direction, input/output
  values, debounce), and interrupt control supporting edge and level detection
  modes.

properties:
  compatible:
    enum:
      - realtek,rtd1625-iso-gpio
      - realtek,rtd1625-isom-gpio

  reg:
    maxItems: 1

  interrupts:
    items:
      - description: Interrupt number of the assert GPIO interrupt, which is
                     triggered when there is a rising edge.
      - description: Interrupt number of the deassert GPIO interrupt, which is
                     triggered when there is a falling edge.
      - description: Interrupt number of the level-sensitive GPIO interrupt,
                     triggered by a configured logic level.

  interrupt-controller: true

  "#interrupt-cells":
    const: 2

  gpio-ranges: true

  gpio-controller: true

  "#gpio-cells":
    const: 2

required:
  - compatible
  - reg
  - gpio-ranges
  - gpio-controller
  - "#gpio-cells"

additionalProperties: false

examples:
  - |
    gpio@89100 {
      compatible = "realtek,rtd1625-isom-gpio";
      reg = <0x89100 0x30>;
      interrupt-parent = <&iso_m_irq_mux>;
      interrupts = <0>, <1>, <2>;
      interrupt-controller;
      #interrupt-cells = <2>;
      gpio-ranges = <&isom_pinctrl 0 0 4>;
      gpio-controller;
      #gpio-cells = <2>;
    };
```

## Documentation/devicetree/bindings/gpio/renesas,em-gio.yaml
```yaml
# SPDX-License-Identifier: (GPL-2.0-only OR BSD-2-Clause)
%YAML 1.2
---
$id: http://devicetree.org/schemas/gpio/renesas,em-gio.yaml#
$schema: http://devicetree.org/meta-schemas/core.yaml#

title: Renesas EMMA Mobile General Purpose I/O Interface

maintainers:
  - Magnus Damm <magnus.damm@gmail.com>

properties:
  compatible:
    const: renesas,em-gio

  reg:
    items:
      - description: First set of contiguous registers
      - description: Second set of contiguous registers

  interrupts:
    items:
      - description: Interrupt for the first set of 16 GPIO ports
      - description: Interrupt for the second set of 16 GPIO ports

  gpio-controller: true

  '#gpio-cells':
    const: 2

  gpio-ranges:
    maxItems: 1

  ngpios:
    minimum: 1
    maximum: 32

  interrupt-controller: true

  '#interrupt-cells':
    const: 2

required:
  - compatible
  - reg
  - interrupts
  - gpio-controller
  - '#gpio-cells'
  - gpio-ranges
  - ngpios
  - interrupt-controller
  - '#interrupt-cells'

additionalProperties: false

examples:
  - |
    #include <dt-bindings/interrupt-controller/arm-gic.h>
    gpio0: gpio@e0050000 {
        compatible = "renesas,em-gio";
        reg = <0xe0050000 0x2c>, <0xe0050040 0x20>;
        interrupts = <GIC_SPI 67 IRQ_TYPE_LEVEL_HIGH>,
                     <GIC_SPI 68 IRQ_TYPE_LEVEL_HIGH>;
        gpio-controller;
        #gpio-cells = <2>;
        gpio-ranges = <&pfc 0 0 32>;
        ngpios = <32>;
        interrupt-controller;
        #interrupt-cells = <2>;
    };
```
