## Documentation/devicetree/bindings/regulator/mediatek,mt6397-regulator.yaml
```yaml
# SPDX-License-Identifier: (GPL-2.0 OR BSD-2-Clause)
%YAML 1.2
---
$id: http://devicetree.org/schemas/regulator/mediatek,mt6397-regulator.yaml#
$schema: http://devicetree.org/meta-schemas/core.yaml#

title: MediaTek MT6397 Regulator

maintainers:
  - Sen Chu <sen.chu@mediatek.com>
  - Macpaul Lin <macpaul.lin@mediatek.com>

description:
  Regulator node of the PMIC. This node should under the PMIC's device node.
  All voltage regulators provided by the PMIC are described as sub-nodes of
  this node.

properties:
  compatible:
    items:
      - const: mediatek,mt6397-regulator

patternProperties:
  "^(buck_)?v(core|drm|gpu|io18|pca(7|15)|sramca(7|15))$":
    description: Buck regulators
    type: object
    $ref: regulator.yaml#
    properties:
      regulator-allowed-modes:
        description: |
          BUCK regulators can set regulator-initial-mode and regulator-allowed-modes to
          values specified in dt-bindings/regulator/mediatek,mt6397-regulator.h
        items:
          enum: [0, 1]
    unevaluatedProperties: false

  "^(ldo_)?v(tcxo|(a|io)28)$":
    description: LDOs with fixed 2.8V output and 0~100/10mV tuning
    type: object
    $ref: regulator.yaml#
    properties:
      regulator-allowed-modes: false
    unevaluatedProperties: false

  "^(ldo_)?vusb$":
    description: LDOs with fixed 3.0V output and 0~100/10mV tuning
    type: object
    $ref: regulator.yaml#
    properties:
      regulator-allowed-modes: false
    unevaluatedProperties: false

  "^(ldo_)?v(cama|emc3v3|gp[123456]|ibr|mc|mch)$":
    description: LDOs with variable output and 0~100/10mV tuning
    type: object
    $ref: regulator.yaml#
    properties:
      regulator-allowed-modes: false
    unevaluatedProperties: false

required:
  - compatible

additionalProperties: false

examples:
  - |
    #include <dt-bindings/interrupt-controller/arm-gic.h>

    mt6397_regulators: regulators {
        compatible = "mediatek,mt6397-regulator";

        mt6397_vpca15_reg: buck_vpca15 {
            regulator-name = "vpca15";
            regulator-min-microvolt = < 850000>;
            regulator-max-microvolt = <1350000>;
            regulator-ramp-delay = <12500>;
            regulator-enable-ramp-delay = <200>;
        };

        mt6397_vpca7_reg: buck_vpca7 {
            regulator-name = "vpca7";
            regulator-min-microvolt = < 850000>;
            regulator-max-microvolt = <1350000>;
            regulator-ramp-delay = <12500>;
            regulator-enable-ramp-delay = <115>;
        };

        mt6397_vsramca15_reg: buck_vsramca15 {
            regulator-name = "vsramca15";
            regulator-min-microvolt = < 850000>;
            regulator-max-microvolt = <1350000>;
            regulator-ramp-delay = <12500>;
            regulator-enable-ramp-delay = <115>;
        };

        mt6397_vsramca7_reg: buck_vsramca7 {
            regulator-name = "vsramca7";
            regulator-min-microvolt = < 850000>;
            regulator-max-microvolt = <1350000>;
            regulator-ramp-delay = <12500>;
            regulator-enable-ramp-delay = <115>;
        };

        mt6397_vcore_reg: buck_vcore {
            regulator-name = "vcore";
            regulator-min-microvolt = < 850000>;
            regulator-max-microvolt = <1350000>;
            regulator-ramp-delay = <12500>;
            regulator-enable-ramp-delay = <115>;
        };

        mt6397_vgpu_reg: buck_vgpu {
            regulator-name = "vgpu";
            regulator-min-microvolt = < 700000>;
            regulator-max-microvolt = <1350000>;
            regulator-ramp-delay = <12500>;
            regulator-enable-ramp-delay = <115>;
        };

        mt6397_vdrm_reg: buck_vdrm {
            regulator-name = "vdrm";
            regulator-min-microvolt = < 800000>;
            regulator-max-microvolt = <1400000>;
            regulator-ramp-delay = <12500>;
            regulator-enable-ramp-delay = <500>;
        };

        mt6397_vio18_reg: buck_vio18 {
            regulator-name = "vio18";
            regulator-min-microvolt = <1500000>;
            regulator-max-microvolt = <2120000>;
            regulator-ramp-delay = <12500>;
            regulator-enable-ramp-delay = <500>;
        };

        mt6397_vtcxo_reg: ldo_vtcxo {
            regulator-name = "vtcxo";
            regulator-min-microvolt = <2800000>;
            regulator-max-microvolt = <2800000>;
            regulator-enable-ramp-delay = <90>;
        };

        mt6397_va28_reg: ldo_va28 {
            regulator-name = "va28";
            /* fixed output 2.8 V */
            regulator-enable-ramp-delay = <218>;
        };

        mt6397_vcama_reg: ldo_vcama {
            regulator-name = "vcama";
            regulator-min-microvolt = <1500000>;
            regulator-max-microvolt = <2800000>;
            regulator-enable-ramp-delay = <218>;
        };

        mt6397_vio28_reg: ldo_vio28 {
            regulator-name = "vio28";
            /* fixed output 2.8 V */
            regulator-enable-ramp-delay = <240>;
        };

        mt6397_usb_reg: ldo_vusb {
            regulator-name = "vusb";
            /* fixed output 3.3 V */
            regulator-enable-ramp-delay = <218>;
        };

        mt6397_vmc_reg: ldo_vmc {
            regulator-name = "vmc";
            regulator-min-microvolt = <1800000>;
            regulator-max-microvolt = <3300000>;
            regulator-enable-ramp-delay = <218>;
        };

        mt6397_vmch_reg: ldo_vmch {
            regulator-name = "vmch";
            regulator-min-microvolt = <3000000>;
            regulator-max-microvolt = <3300000>;
            regulator-enable-ramp-delay = <218>;
        };

        mt6397_vemc_3v3_reg: ldo_vemc3v3 {
            regulator-name = "vemc_3v3";
            regulator-min-microvolt = <3000000>;
            regulator-max-microvolt = <3300000>;
            regulator-enable-ramp-delay = <218>;
        };

        mt6397_vgp1_reg: ldo_vgp1 {
            regulator-name = "vcamd";
            regulator-min-microvolt = <1220000>;
            regulator-max-microvolt = <3300000>;
            regulator-enable-ramp-delay = <240>;
        };

        mt6397_vgp2_reg: ldo_vgp2 {
            regulator-name = "vcamio";
            regulator-min-microvolt = <1000000>;
            regulator-max-microvolt = <3300000>;
            regulator-enable-ramp-delay = <218>;
        };

        mt6397_vgp3_reg: ldo_vgp3 {
            regulator-name = "vcamaf";
            regulator-min-microvolt = <1200000>;
            regulator-max-microvolt = <3300000>;
            regulator-enable-ramp-delay = <218>;
        };

        mt6397_vgp4_reg: ldo_vgp4 {
            regulator-name = "vgp4";
            regulator-min-microvolt = <1200000>;
            regulator-max-microvolt = <3300000>;
            regulator-enable-ramp-delay = <218>;
        };

        mt6397_vgp5_reg: ldo_vgp5 {
            regulator-name = "vgp5";
            regulator-min-microvolt = <1200000>;
            regulator-max-microvolt = <3000000>;
            regulator-enable-ramp-delay = <218>;
        };

        mt6397_vgp6_reg: ldo_vgp6 {
            regulator-name = "vgp6";
            regulator-min-microvolt = <1200000>;
            regulator-max-microvolt = <3300000>;
            regulator-enable-ramp-delay = <218>;
        };

        mt6397_vibr_reg: ldo_vibr {
            regulator-name = "vibr";
            regulator-min-microvolt = <1200000>;
            regulator-max-microvolt = <3300000>;
            regulator-enable-ramp-delay = <218>;
        };
    };
```

## Documentation/devicetree/bindings/regulator/mediatek,mt6873-dvfsrc-regulator.yaml
```yaml
# SPDX-License-Identifier: (GPL-2.0 OR BSD-2-Clause)
%YAML 1.2
---
$id: http://devicetree.org/schemas/regulator/mediatek,mt6873-dvfsrc-regulator.yaml#
$schema: http://devicetree.org/meta-schemas/core.yaml#

title: MediaTek DVFSRC-controlled Regulators

description:
  The Dynamic Voltage and Frequency Scaling Resource Collector Regulators
  are controlled with votes to the DVFSRC hardware.

maintainers:
  - AngeloGioacchino Del Regno <angelogioacchino.delregno@collabora.com>

properties:
  compatible:
    enum:
      - mediatek,mt6873-dvfsrc-regulator
      - mediatek,mt8183-dvfsrc-regulator
      - mediatek,mt8192-dvfsrc-regulator
      - mediatek,mt8195-dvfsrc-regulator

  dvfsrc-vcore:
    description: DVFSRC-controlled SoC Vcore regulator
    $ref: regulator.yaml#
    unevaluatedProperties: false

  dvfsrc-vscp:
    description: DVFSRC-controlled System Control Processor regulator
    $ref: regulator.yaml#
    unevaluatedProperties: false

required:
  - compatible

anyOf:
  - required:
      - dvfsrc-vcore
  - required:
      - dvfsrc-vscp

additionalProperties: false
```

## Documentation/devicetree/bindings/regulator/microchip,mcp16502.yaml
```yaml
# SPDX-License-Identifier: GPL-2.0-only OR BSD-2-Clause
%YAML 1.2
---
$id: http://devicetree.org/schemas/regulator/microchip,mcp16502.yaml#
$schema: http://devicetree.org/meta-schemas/core.yaml#

title: MCP16502 - High-Performance PMIC

maintainers:
  - Andrei Simion <andrei.simion@microchip.com>

description:
  The MCP16502 is an optimally integrated PMIC compatible
  with Microchip's eMPUs(Embedded Microprocessor Units),
  requiring Dynamic Voltage Scaling (DVS) with the use
  of High-Performance mode (HPM).

properties:
  compatible:
    const: microchip,mcp16502

  lpm-gpios:
    maxItems: 1
    description: GPIO for LPM pin.
      Note that this GPIO must remain high during
      suspend-to-ram, keeping the PMIC into HIBERNATE mode.

  reg:
    maxItems: 1

  lvin-supply:
    description: Input supply phandle for LDO1 and LDO2

  pvin1-supply:
    description: Input supply phandle for VDD_IO (BUCK1)

  pvin2-supply:
    description: Input supply phandle for VDD_DDR (BUCK2)

  pvin3-supply:
    description: Input supply phandle for VDD_CORE (BUCK3)

  pvin4-supply:
    description: Input supply phandle for VDD_OTHER (BUCK4)

  regulators:
    type: object
    additionalProperties: false
    description: List of regulators and its properties.

    patternProperties:
      "^(VDD_(IO|CORE|DDR|OTHER)|LDO[1-2])$":
        type: object
        $ref: regulator.yaml#
        unevaluatedProperties: false

        properties:
          regulator-initial-mode:
            enum: [2, 4]
            default: 2
            description: Initial operating mode

          regulator-allowed-modes:
            items:
              enum: [2, 4]
            description: Supported modes
              2 - FPWM higher precision, higher consumption
              4 - AutoPFM lower precision, lower consumption

required:
  - compatible
  - reg
  - regulators

additionalProperties: false

examples:
  - |
    i2c {
        #address-cells = <1>;
        #size-cells = <0>;

        pmic@5b {
            compatible = "microchip,mcp16502";
            reg = <0x5b>;
            lvin-supply = <&reg_5v>;
            pvin1-supply = <&reg_5v>;
            pvin2-supply = <&reg_5v>;
            pvin3-supply = <&reg_5v>;
            pvin4-supply = <&reg_5v>;

            regulators {
                VDD_IO {
                    regulator-name = "VDD_IO";
                    regulator-min-microvolt = <3300000>;
                    regulator-max-microvolt = <3300000>;
                    regulator-initial-mode = <2>;
                    regulator-allowed-modes = <2>, <4>;
                    regulator-always-on;

                    regulator-state-standby {
                        regulator-on-in-suspend;
                        regulator-mode = <4>;
                    };

                    regulator-state-mem {
                        regulator-off-in-suspend;
                        regulator-mode = <4>;
                    };
                };

                VDD_DDR {
                    regulator-name = "VDD_DDR";
                    regulator-min-microvolt = <1350000>;
                    regulator-max-microvolt = <1350000>;
                    regulator-initial-mode = <2>;
                    regulator-allowed-modes = <2>, <4>;
                    regulator-always-on;

                    regulator-state-standby {
                        regulator-on-in-suspend;
                        regulator-mode = <4>;
                    };

                    regulator-state-mem {
                        regulator-on-in-suspend;
                        regulator-mode = <4>;
                    };
                };

                VDD_CORE {
                    regulator-name = "VDD_CORE";
                    regulator-min-microvolt = <1150000>;
                    regulator-max-microvolt = <1150000>;
                    regulator-initial-mode = <2>;
                    regulator-allowed-modes = <2>, <4>;
                    regulator-always-on;

                    regulator-state-standby {
                        regulator-on-in-suspend;
                        regulator-mode = <4>;
                    };

                    regulator-state-mem {
                        regulator-off-in-suspend;
                        regulator-mode = <4>;
                    };
                };

                VDD_OTHER {
                    regulator-name = "VDD_OTHER";
                    regulator-min-microvolt = <1050000>;
                    regulator-max-microvolt = <1250000>;
                    regulator-initial-mode = <2>;
                    regulator-allowed-modes = <2>, <4>;
                    regulator-always-on;

                    regulator-state-standby {
                        regulator-on-in-suspend;
                        regulator-mode = <4>;
                    };

                    regulator-state-mem {
                        regulator-off-in-suspend;
                        regulator-mode = <4>;
                    };
                };

                LDO1 {
                    regulator-name = "LDO1";
                    regulator-min-microvolt = <1800000>;
                    regulator-max-microvolt = <1800000>;
                    regulator-always-on;

                    regulator-state-standby {
                        regulator-on-in-suspend;
                    };

                    regulator-state-mem {
                        regulator-off-in-suspend;
                    };
                };

                LDO2 {
                    regulator-name = "LDO2";
                    regulator-min-microvolt = <1200000>;
                    regulator-max-microvolt = <3700000>;
                    regulator-always-on;

                    regulator-state-standby {
                        regulator-on-in-suspend;
                    };

                    regulator-state-mem {
                        regulator-off-in-suspend;
                    };
                };
            };
        };
    };
```
