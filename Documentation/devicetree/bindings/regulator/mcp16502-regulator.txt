## Documentation/devicetree/bindings/regulator/motorola,cpcap-regulator.yaml
```yaml
# SPDX-License-Identifier: (GPL-2.0 OR BSD-2-Clause)
%YAML 1.2
---
$id: http://devicetree.org/schemas/regulator/motorola,cpcap-regulator.yaml#
$schema: http://devicetree.org/meta-schemas/core.yaml#

title: Motorola CPCAP PMIC regulators

maintainers:
  - Svyatoslav Ryhel <clamor95@gmail.com>

description:
  This module is part of the Motorola CPCAP MFD device. For more details
  see Documentation/devicetree/bindings/mfd/motorola,cpcap.yaml. The
  regulator controller is represented as a sub-node of the PMIC node
  on the device tree.

properties:
  compatible:
    enum:
      - motorola,cpcap-regulator
      - motorola,mapphone-cpcap-regulator
      - motorola,mot-cpcap-regulator
      - motorola,xoom-cpcap-regulator

  regulators:
    type: object

    patternProperties:
      "^(SW[1-6]|V(CAM|CSI|DAC|DIG|FUSE|HVIO|SDIO|PLL|RF[12]|RFREF|WLAN[12]|SIM|SIMCARD|VIB|USB|AUDIO))$":
        $ref: /schemas/regulator/regulator.yaml#
        type: object

        required:
          - regulator-name
          - regulator-enable-ramp-delay
          - regulator-min-microvolt
          - regulator-max-microvolt

        unevaluatedProperties: false

required:
  - compatible

additionalProperties: false

...
```

## Documentation/devicetree/bindings/regulator/mp8859.txt
```
Monolithic Power Systems MP8859 voltage regulator

Required properties:
- compatible: "mps,mp8859";
- reg: I2C slave address.

Optional subnode for regulator: "mp8859_dcdc", using common regulator
bindings given in <Documentation/devicetree/bindings/regulator/regulator.txt>.

Example:

	mp8859: regulator@66 {
		compatible = "mps,mp8859";
		reg = <0x66>;
		dc_12v: mp8859_dcdc {
			regulator-name = "dc_12v";
			regulator-min-microvolt = <12000000>;
			regulator-max-microvolt = <12000000>;
			regulator-boot-on;
			regulator-always-on;
		};
	};
```

## Documentation/devicetree/bindings/regulator/mp8865-regulator.txt
```
MPS MP8865 Regulator Driver

Required properties:
- compatible: "mps,mp8865"
- reg: I2C slave address
- regulators: List of regulators provided by this controller.
  The definition for each of these nodes is defined using the standard binding
  for regulators at Documentation/devicetree/bindings/regulator/regulator.txt.

example:
	mp8865: mp8865@68 {
		compatible = "mps,mp8865";
		reg = <0x68>;
		status = "okay";
		regulators {
			vdd_gpu: mp8865_dcdc1 {
				regulator-name = "vdd_gpu";
				regulator-min-microvolt = <712500>;
				regulator-max-microvolt = <1500000>;
				regulator-always-on;
				regulator-boot-on;
			};
		};
	};
```

## Documentation/devicetree/bindings/regulator/mp886x.txt
```
Monolithic Power Systems MP8867/MP8869 voltage regulator

Required properties:
- compatible: Must be one of the following.
	"mps,mp8867"
	"mps,mp8869"
- reg: I2C slave address.
- enable-gpios: enable gpios.
- mps,fb-voltage-divider: An array of two integers containing the resistor
  values R1 and R2 of the feedback voltage divider in kilo ohms.

Any property defined as part of the core regulator binding, defined in
./regulator.txt, can also be used.

Example:

	vcpu: regulator@62 {
		compatible = "mps,mp8869";
		regulator-name = "vcpu";
		regulator-min-microvolt = <700000>;
		regulator-max-microvolt = <850000>;
		regulator-always-on;
		regulator-boot-on;
		enable-gpios = <&porta 1 GPIO_ACTIVE_LOW>;
		mps,fb-voltage-divider = <80 240>;
		reg = <0x62>;
	};
```

## Documentation/devicetree/bindings/regulator/mps,mp5416.yaml
```yaml
# SPDX-License-Identifier: GPL-2.0-only OR BSD-2-Clause
%YAML 1.2
---
$id: http://devicetree.org/schemas/regulator/mps,mp5416.yaml#
$schema: http://devicetree.org/meta-schemas/core.yaml#

title: Monolithic Power System MP5416 PMIC

maintainers:
  - Saravanan Sekar <sravanhome@gmail.com>

properties:
  $nodename:
    pattern: "^pmic@[0-9a-f]{1,2}$"
  compatible:
    enum:
      - mps,mp5416
      - mps,mp5496

  reg:
    maxItems: 1

  regulators:
    type: object
    description: |
      list of regulators provided by this controller, must be named
      after their hardware counterparts BUCK[1-4] and LDO[1-4]

    patternProperties:
      "^buck[1-4]$":
        $ref: regulator.yaml#
        type: object

      "^ldo[1-4]$":
        $ref: regulator.yaml#
        type: object

    additionalProperties: false

required:
  - compatible
  - reg
  - regulators

additionalProperties: false

examples:
  - |
    i2c {
        #address-cells = <1>;
        #size-cells = <0>;

        pmic@69 {
          compatible = "mps,mp5416";
          reg = <0x69>;

          regulators {

            buck1 {
             regulator-name = "buck1";
             regulator-min-microvolt = <600000>;
             regulator-max-microvolt = <2187500>;
             regulator-min-microamp  = <3800000>;
             regulator-max-microamp  = <6800000>;
             regulator-boot-on;
            };

            ldo2 {
             regulator-name = "ldo2";
             regulator-min-microvolt = <800000>;
             regulator-max-microvolt = <3975000>;
            };
         };
       };
     };
...
```

## Documentation/devicetree/bindings/regulator/mps,mp8859.yaml
```yaml
# SPDX-License-Identifier: (GPL-2.0-only OR BSD-2-Clause)
%YAML 1.2
---
$id: http://devicetree.org/schemas/regulator/mps,mp8859.yaml#
$schema: http://devicetree.org/meta-schemas/core.yaml#

title: Monolithic Power Systems MP8859 Voltage Regulator

maintainers:
  - Markus Reichl <reichl@t-online.de>

description:
  The MP8859 is a synchronous, 4-switch, integrated buck-boost converter
  capable of regulating the output voltage from 2.8V to 22V wide input voltage
  range with high efficiency.

properties:
  compatible:
    const: mps,mp8859

  reg:
    maxItems: 1

  mp8859_dcdc:
    $ref: /schemas/regulator/regulator.yaml#
    type: object
    description: DCDC regulator subnode
    unevaluatedProperties: false

required:
  - compatible
  - reg

additionalProperties: false

examples:
  - |
    i2c {
        #address-cells = <1>;
        #size-cells = <0>;

        regulator@66 {
            compatible = "mps,mp8859";
            reg = <0x66>;

            mp8859_dcdc {
                regulator-name = "dc_12v";
                regulator-min-microvolt = <12000000>;
                regulator-max-microvolt = <12000000>;
                regulator-boot-on;
                regulator-always-on;
            };
        };
    };
```

## Documentation/devicetree/bindings/regulator/mps,mp886x.yaml
```yaml
# SPDX-License-Identifier: (GPL-2.0-only OR BSD-2-Clause)
%YAML 1.2
---
$id: http://devicetree.org/schemas/regulator/mps,mp886x.yaml#
$schema: http://devicetree.org/meta-schemas/core.yaml#

title: Monolithic Power Systems MP8867/MP8869 voltage regulator

maintainers:
  - Jisheng Zhang <jszhang@kernel.org>

allOf:
  - $ref: regulator.yaml#

properties:
  compatible:
    enum:
      - mps,mp8867
      - mps,mp8869

  reg:
    maxItems: 1

  enable-gpios:
    description: GPIO to enable/disable the regulator.
    maxItems: 1

  mps,fb-voltage-divider:
    description: An array of two integers containing the resistor
      values R1 and R2 of the feedback voltage divider in kilo ohms.
    $ref: /schemas/types.yaml#/definitions/uint32-array
    maxItems: 2

  mps,switch-frequency-hz:
    description: The valid switch frequency in Hertz.
    enum: [500000, 750000, 1000000, 1250000, 1500000]

required:
  - compatible
  - reg
  - enable-gpios
  - mps,fb-voltage-divider

unevaluatedProperties: false

examples:
  - |
    #include <dt-bindings/gpio/gpio.h>
    i2c {
        #address-cells = <1>;
        #size-cells = <0>;
        regulator@62 {
          compatible = "mps,mp8869";
          regulator-name = "vcpu";
          regulator-min-microvolt = <800000>;
          regulator-max-microvolt = <1150000>;
          enable-gpios = <&porta 1 GPIO_ACTIVE_LOW>;
          mps,fb-voltage-divider = <80 240>;
          reg = <0x62>;
        };
    };

...
```

## Documentation/devicetree/bindings/regulator/mps,mpq2286.yaml
```yaml
# SPDX-License-Identifier: GPL-2.0-only OR BSD-2-Clause
%YAML 1.2
---
$id: http://devicetree.org/schemas/regulator/mps,mpq2286.yaml#
$schema: http://devicetree.org/meta-schemas/core.yaml#

title: Monolithic Power System MPQ2286 PMIC

maintainers:
  - Saravanan Sekar <saravanan@linumiz.com>

properties:
  compatible:
    enum:
      - mps,mpq2286

  reg:
    maxItems: 1

  regulators:
    type: object

    properties:
      buck:
        type: object
        $ref: regulator.yaml#

        unevaluatedProperties: false

    additionalProperties: false

required:
  - compatible
  - reg
  - regulators

additionalProperties: false

examples:
  - |
    i2c {
        #address-cells = <1>;
        #size-cells = <0>;

        pmic@3 {
            compatible = "mps,mpq2286";
            reg = <0x3>;

            regulators {
                buck {
                    regulator-name = "buck";
                    regulator-min-microvolt = <1600000>;
                    regulator-max-microvolt = <1800000>;
                    regulator-boot-on;
                };
            };
        };
    };
...
```

## Documentation/devicetree/bindings/regulator/mps,mpq7920.yaml
```yaml
# SPDX-License-Identifier: GPL-2.0-only OR BSD-2-Clause
%YAML 1.2
---
$id: http://devicetree.org/schemas/regulator/mps,mpq7920.yaml#
$schema: http://devicetree.org/meta-schemas/core.yaml#

title: Monolithic Power System MPQ7920 PMIC

maintainers:
  - Saravanan Sekar <sravanhome@gmail.com>

properties:
  $nodename:
    pattern: "pmic@[0-9a-f]{1,2}"
  compatible:
    enum:
      - mps,mpq7920

  reg:
    maxItems: 1

  regulators:
    type: object
    $ref: regulator.yaml#

    description: |
      list of regulators provided by this controller, must be named
      after their hardware counterparts BUCK[1-4], one LDORTC, and LDO[2-5]

    properties:
      mps,switch-freq:
        $ref: "/schemas/types.yaml#/definitions/uint8"
        enum: [0, 1, 2, 3]
        default: 2
        description: |
          switching frequency must be one of following corresponding value
          1.1MHz, 1.65MHz, 2.2MHz, 2.75MHz

    patternProperties:
      "^ldo[1-4]$":
        type: object
        $ref: regulator.yaml#

      "^ldortc$":
        type: object
        $ref: regulator.yaml#

      "^buck[1-4]$":
        type: object
        $ref: regulator.yaml#

        properties:
          mps,buck-softstart:
            $ref: "/schemas/types.yaml#/definitions/uint8"
            enum: [0, 1, 2, 3]
            description: |
              defines the soft start time of this buck, must be one of the following
              corresponding values 150us, 300us, 610us, 920us

          mps,buck-phase-delay:
            $ref: "/schemas/types.yaml#/definitions/uint8"
            enum: [0, 1, 2, 3]
            description: |
              defines the phase delay of this buck, must be one of the following
              corresponding values 0deg, 90deg, 180deg, 270deg

          mps,buck-ovp-disable:
            type: boolean
            description: |
              disables over voltage protection of this buck

        unevaluatedProperties: false

    additionalProperties: false

required:
  - compatible
  - reg
  - regulators

additionalProperties: false

examples:
  - |
    i2c {
        #address-cells = <1>;
        #size-cells = <0>;

        pmic@69 {
          compatible = "mps,mpq7920";
          reg = <0x69>;

          regulators {
            mps,switch-freq = /bits/ 8 <1>;

            buck1 {
             regulator-name = "buck1";
             regulator-min-microvolt = <400000>;
             regulator-max-microvolt = <3587500>;
             regulator-min-microamp  = <460000>;
             regulator-max-microamp  = <7600000>;
             regulator-boot-on;
             mps,buck-ovp-disable;
             mps,buck-phase-delay = /bits/ 8 <2>;
             mps,buck-softstart = /bits/ 8 <1>;
            };

            ldo2 {
             regulator-name = "ldo2";
             regulator-min-microvolt = <650000>;
             regulator-max-microvolt = <3587500>;
            };
         };
       };
     };
...
```

## Documentation/devicetree/bindings/regulator/mps,mpq7932.yaml
```yaml
# SPDX-License-Identifier: GPL-2.0-only OR BSD-2-Clause
%YAML 1.2
---
$id: http://devicetree.org/schemas/regulator/mps,mpq7932.yaml#
$schema: http://devicetree.org/meta-schemas/core.yaml#

title: Monolithic Power System MPQ7932 PMIC

maintainers:
  - Saravanan Sekar <saravanan@linumiz.com>

properties:
  compatible:
    enum:
      - mps,mpq7932

  reg:
    maxItems: 1

  regulators:
    type: object
    description: |
      list of regulators provided by this controller, must be named
      after their hardware counterparts BUCK[1-6]

    patternProperties:
      "^buck[1-6]$":
        type: object
        $ref: regulator.yaml#
        unevaluatedProperties: false

    additionalProperties: false

required:
  - compatible
  - reg
  - regulators

additionalProperties: false

examples:
  - |
    i2c {
        #address-cells = <1>;
        #size-cells = <0>;

        pmic@3 {
            compatible = "mps,mpq7932";
            reg = <0x3>;

            regulators {
                buck1 {
                    regulator-name = "buck1";
                    regulator-min-microvolt = <1600000>;
                    regulator-max-microvolt = <1800000>;
                    regulator-boot-on;
                };

                buck2 {
                    regulator-name = "buck2";
                    regulator-min-microvolt = <1700000>;
                    regulator-max-microvolt = <1800000>;
                    regulator-boot-on;
                };
            };
        };
    };
...
```

## Documentation/devicetree/bindings/regulator/mt6311-regulator.txt
```
Mediatek MT6311 Regulator

Required properties:
- compatible: "mediatek,mt6311-regulator"
- reg: I2C slave address, usually 0x6b.
- regulators: List of regulators provided by this controller. It is named
  to VDVFS and VBIASN.
  The definition for each of these nodes is defined using the standard binding
  for regulators at Documentation/devicetree/bindings/regulator/regulator.txt.

The valid names for regulators are:
BUCK:
  VDVFS
LDO:
  VBIASN

Example:
	mt6311: pmic@6b {
		compatible = "mediatek,mt6311-regulator";
		reg = <0x6b>;

		regulators {
			mt6311_vcpu_reg: VDVFS {
				regulator-name = "VDVFS";
				regulator-min-microvolt = < 600000>;
				regulator-max-microvolt = <1400000>;
				regulator-ramp-delay = <10000>;
			};
			mt6311_ldo_reg: VBIASN {
				regulator-name = "VBIASN";
				regulator-min-microvolt = <200000>;
				regulator-max-microvolt = <800000>;
			};
		};
	};
```
