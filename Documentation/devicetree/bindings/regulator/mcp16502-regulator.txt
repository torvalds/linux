## Documentation/devicetree/bindings/regulator/mcp16502-regulator.txt
```
MCP16502 PMIC

Required properties:
- compatible: "microchip,mcp16502"
- reg: I2C slave address
- lpm-gpios: GPIO for LPM pin. Note that this GPIO *must* remain high during
	     suspend-to-ram, keeping the PMIC into HIBERNATE mode.
- regulators: A node that houses a sub-node for each regulator within
              the device. Each sub-node is identified using the node's
              name. The content of each sub-node is defined by the
              standard binding for regulators; see regulator.txt.

Regulators of MCP16502 PMIC:
1) VDD_IO	- Buck (1.2 - 3.7 V)
2) VDD_DDR	- Buck (0.6 - 1.85 V)
3) VDD_CORE	- Buck (0.6 - 1.85 V)
4) VDD_OTHER	- BUCK (0.6 - 1.85 V)
5) LDO1		- LDO  (1.2 - 3.7 V)
6) LDO2		- LDO  (1.2 - 3.7 V)

Regulator modes:
2 - FPWM: higher precision, higher consumption
4 - AutoPFM: lower precision, lower consumption

Each regulator is defined using the standard binding for regulators.

Example:

mcp16502@5b {
	compatible = "microchip,mcp16502";
	reg = <0x5b>;
	status = "okay";
	lpm-gpios = <&pioBU 7 GPIO_ACTIVE_HIGH>;

	regulators {
		VDD_IO {
			regulator-name = "VDD_IO";
			regulator-min-microvolt = <1200000>;
			regulator-max-microvolt = <3700000>;
			regulator-initial-mode = <2>;
			regulator-allowed-modes = <2>, <4>;
			regulator-always-on;

			regulator-state-standby {
				regulator-on-in-suspend;
				regulator-mode = <4>;
			};

			regulator-state-mem {
				regulator-off-in-suspend;
				regulator-mode = <4>;
			};
		};

		VDD_DDR {
			regulator-name = "VDD_DDR";
			regulator-min-microvolt = <600000>;
			regulator-max-microvolt = <1850000>;
			regulator-initial-mode = <2>;
			regulator-allowed-modes = <2>, <4>;
			regulator-always-on;

			regulator-state-standby {
				regulator-on-in-suspend;
				regulator-mode = <4>;
			};

			regulator-state-mem {
				regulator-on-in-suspend;
				regulator-mode = <4>;
			};
		};

		VDD_CORE {
			regulator-name = "VDD_CORE";
			regulator-min-microvolt = <600000>;
			regulator-max-microvolt = <1850000>;
			regulator-initial-mode = <2>;
			regulator-allowed-modes = <2>, <4>;
			regulator-always-on;

			regulator-state-standby {
				regulator-on-in-suspend;
				regulator-mode = <4>;
			};

			regulator-state-mem {
				regulator-off-in-suspend;
				regulator-mode = <4>;
			};
		};

		VDD_OTHER {
			regulator-name = "VDD_OTHER";
			regulator-min-microvolt = <600000>;
			regulator-max-microvolt = <1850000>;
			regulator-initial-mode = <2>;
			regulator-allowed-modes = <2>, <4>;
			regulator-always-on;

			regulator-state-standby {
				regulator-on-in-suspend;
				regulator-mode = <4>;
			};

			regulator-state-mem {
				regulator-off-in-suspend;
				regulator-mode = <4>;
			};
		};

		LDO1 {
			regulator-name = "LDO1";
			regulator-min-microvolt = <1200000>;
			regulator-max-microvolt = <3700000>;
			regulator-always-on;

			regulator-state-standby {
				regulator-on-in-suspend;
			};

			regulator-state-mem {
				regulator-off-in-suspend;
			};
		};

		LDO2 {
			regulator-name = "LDO2";
			regulator-min-microvolt = <1200000>;
			regulator-max-microvolt = <3700000>;
			regulator-always-on;

			regulator-state-standby {
				regulator-on-in-suspend;
			};

			regulator-state-mem {
				regulator-off-in-suspend;
			};
		};

	};
};
```

## Documentation/devicetree/bindings/regulator/mediatek,mt6311-regulator.yaml
```yaml
# SPDX-License-Identifier: (GPL-2.0 OR BSD-2-Clause)
%YAML 1.2
---
$id: http://devicetree.org/schemas/regulator/mediatek,mt6311-regulator.yaml#
$schema: http://devicetree.org/meta-schemas/core.yaml#

title: MediaTek MT6311 Regulator

maintainers:
  - AngeloGioacchino Del Regno <angelogioacchino.delregno@collabora.com>

description:
  The MediaTek MT6311 is an I2C power management IC that provides one step-down
  converter and one low-dropout regulator. The regulators are named VDVFS and
  VBIASN, respectively.

properties:
  compatible:
    const: mediatek,mt6311-regulator

  reg:
    description: I2C slave address.
    maxItems: 1

  regulators:
    type: object
    description: List of regulators provided by this controller.

    patternProperties:
      "^(VDVFS|VBIASN)$":
        type: object
        $ref: regulator.yaml#
        unevaluatedProperties: false

    additionalProperties: false

required:
  - compatible
  - reg
  - regulators

additionalProperties: false

examples:
  - |
    i2c {
      #address-cells = <1>;
      #size-cells = <0>;

      pmic@6b {
        compatible = "mediatek,mt6311-regulator";
        reg = <0x6b>;

        regulators {
          VDVFS {
            regulator-name = "VDVFS";
            regulator-min-microvolt = <600000>;
            regulator-max-microvolt = <1400000>;
            regulator-ramp-delay = <10000>;
          };

          VBIASN {
            regulator-name = "VBIASN";
            regulator-min-microvolt = <200000>;
            regulator-max-microvolt = <800000>;
          };
        };
      };
    };
...
```

## Documentation/devicetree/bindings/regulator/mediatek,mt6316b-regulator.yaml
```yaml
# SPDX-License-Identifier: (GPL-2.0 OR BSD-2-Clause)
%YAML 1.2
---
$id: http://devicetree.org/schemas/regulator/mediatek,mt6316b-regulator.yaml#
$schema: http://devicetree.org/meta-schemas/core.yaml#

title: MediaTek MT6316 BP/VP SPMI PMIC Regulators

maintainers:
  - AngeloGioacchino Del Regno <angelogioacchino.delregno@collabora.com>

description:
  The MediaTek MT6316BP/VP PMICs are fully controlled by SPMI interface, both
  feature four step-down DC/DC (buck) converters, and provides 2+2 Phases,
  joining Buck 1+2 for the first phase, and Buck 3+4 for the second phase.

properties:
  compatible:
    const: mediatek,mt6316b-regulator

  reg:
    maxItems: 1

patternProperties:
  "^vbuck(12|34)$":
    type: object
    $ref: regulator.yaml#
    unevaluatedProperties: false
    properties:
      regulator-allowed-modes:
        description: |
          Allowed Buck regulator operating modes allowed. Valid values below.
            0 - Normal mode with automatic power saving, reducing the switching
                frequency when light load conditions are detected
            1 - Forced Continuous Conduction mode (FCCM) for improved voltage
                regulation accuracy with constant switching frequency but lower
                regulator efficiency
            2 - Forced Low Power mode for improved regulator efficiency, used
                when no heavy load is expected, will shut down unnecessary IP
                blocks and secondary phases to reduce quiescent current.
                This mode does not limit the maximum output current but unless
                only a light load is applied, there will be regulation accuracy
                and efficiency losses.
        minItems: 1
        maxItems: 3
        items:
          enum: [ 0, 1, 2 ]

required:
  - compatible
  - reg

additionalProperties: false

examples:
  - |
    #include <dt-bindings/spmi/spmi.h>

    spmi {
      #address-cells = <2>;
      #size-cells = <0>;

      pmic@8 {
        compatible = "mediatek,mt6316b-regulator";
        reg = <0x8 SPMI_USID>;

        vbuck12 {
          regulator-name = "dvdd_core";
          regulator-min-microvolt = <450000>;
          regulator-max-microvolt = <965000>;
          regulator-allowed-modes = <0 1 2>;
          regulator-enable-ramp-delay = <256>;
        };
      };
    };
...
```

## Documentation/devicetree/bindings/regulator/mediatek,mt6316c-regulator.yaml
```yaml
# SPDX-License-Identifier: (GPL-2.0 OR BSD-2-Clause)
%YAML 1.2
---
$id: http://devicetree.org/schemas/regulator/mediatek,mt6316c-regulator.yaml#
$schema: http://devicetree.org/meta-schemas/core.yaml#

title: MediaTek MT6316 CP/HP/KP SPMI PMIC Regulators

maintainers:
  - AngeloGioacchino Del Regno <angelogioacchino.delregno@collabora.com>

description:
  The MediaTek MT6316CP/HP/KP PMICs are fully controlled by SPMI interface,
  features four step-down DC/DC (buck) converters, and provides 3+1 Phases,
  joining Buck 1+2+4 for the first phase, and uses Buck 3 for the second.

properties:
  compatible:
    const: mediatek,mt6316c-regulator

  reg:
    maxItems: 1

patternProperties:
  "^vbuck(124|3)$":
    type: object
    $ref: regulator.yaml#
    unevaluatedProperties: false
    properties:
      regulator-allowed-modes:
        description: |
          Allowed Buck regulator operating modes allowed. Valid values below.
            0 - Normal mode with automatic power saving, reducing the switching
                frequency when light load conditions are detected
            1 - Forced Continuous Conduction mode (FCCM) for improved voltage
                regulation accuracy with constant switching frequency but lower
                regulator efficiency
            2 - Forced Low Power mode for improved regulator efficiency, used
                when no heavy load is expected, will shut down unnecessary IP
                blocks and secondary phases to reduce quiescent current.
                This mode does not limit the maximum output current but unless
                only a light load is applied, there will be regulation accuracy
                and efficiency losses.
        minItems: 1
        maxItems: 3
        items:
          enum: [ 0, 1, 2 ]

required:
  - compatible
  - reg

additionalProperties: false

examples:
  - |
    #include <dt-bindings/spmi/spmi.h>

    spmi {
      #address-cells = <2>;
      #size-cells = <0>;

      pmic@6 {
        compatible = "mediatek,mt6316c-regulator";
        reg = <0x6 SPMI_USID>;

        vbuck124 {
          regulator-name = "dvdd_proc_m";
          regulator-min-microvolt = <450000>;
          regulator-max-microvolt = <1277500>;
          regulator-allowed-modes = <0 1 2>;
          regulator-enable-ramp-delay = <256>;
        };
      };
    };
...
```

## Documentation/devicetree/bindings/regulator/mediatek,mt6316d-regulator.yaml
```yaml
# SPDX-License-Identifier: (GPL-2.0 OR BSD-2-Clause)
%YAML 1.2
---
$id: http://devicetree.org/schemas/regulator/mediatek,mt6316d-regulator.yaml#
$schema: http://devicetree.org/meta-schemas/core.yaml#

title: MediaTek MT6316 DP/TP SPMI PMIC Regulators

maintainers:
  - AngeloGioacchino Del Regno <angelogioacchino.delregno@collabora.com>

description:
  The MediaTek MT6316DP/TP PMICs are fully controlled by SPMI interface, both
  feature four step-down DC/DC (buck) converters, and provides a single Phase,
  joining Buck 1+2+3+4.

properties:
  compatible:
    const: mediatek,mt6316d-regulator

  reg:
    maxItems: 1

  vbuck1234:
    type: object
    $ref: regulator.yaml#
    unevaluatedProperties: false
    properties:
      regulator-allowed-modes:
        description: |
          Allowed Buck regulator operating modes allowed. Valid values below.
            0 - Normal mode with automatic power saving, reducing the switching
                frequency when light load conditions are detected
            1 - Forced Continuous Conduction mode (FCCM) for improved voltage
                regulation accuracy with constant switching frequency but lower
                regulator efficiency
            2 - Forced Low Power mode for improved regulator efficiency, used
                when no heavy load is expected, will shut down unnecessary IP
                blocks and secondary phases to reduce quiescent current.
                This mode does not limit the maximum output current but unless
                only a light load is applied, there will be regulation accuracy
                and efficiency losses.
        minItems: 1
        maxItems: 3
        items:
          enum: [ 0, 1, 2 ]

required:
  - compatible
  - reg

additionalProperties: false

examples:
  - |
    #include <dt-bindings/spmi/spmi.h>

    spmi {
      #address-cells = <2>;
      #size-cells = <0>;

      pmic@7 {
        compatible = "mediatek,mt6316d-regulator";
        reg = <0x7 SPMI_USID>;

        vbuck1234 {
          regulator-name = "dvdd_gpustack";
          regulator-min-microvolt = <400000>;
          regulator-max-microvolt = <1277500>;
          regulator-allowed-modes = <0 1 2>;
          regulator-enable-ramp-delay = <256>;
        };
      };
    };
...
```
