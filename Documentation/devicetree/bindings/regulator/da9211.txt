## Documentation/devicetree/bindings/regulator/dlg,da9211.yaml
```yaml
# SPDX-License-Identifier: (GPL-2.0 OR BSD-2-Clause)
%YAML 1.2
---
$id: http://devicetree.org/schemas/regulator/dlg,da9211.yaml#
$schema: http://devicetree.org/meta-schemas/core.yaml#

title:
  Dialog Semiconductor DA9211-9215, DA9223-9225 Voltage Regulators

maintainers:
  - Ariel D'Alessandro <ariel.dalessandro@collabora.com>

properties:
  compatible:
    enum:
      - dlg,da9211
      - dlg,da9212
      - dlg,da9213
      - dlg,da9214
      - dlg,da9215
      - dlg,da9223
      - dlg,da9224
      - dlg,da9225

  reg:
    maxItems: 1

  interrupts:
    maxItems: 1

  regulators:
    type: object
    additionalProperties: false
    description:
      List of regulators provided by the device

    patternProperties:
      "^BUCK([AB])$":
        type: object
        $ref: regulator.yaml#
        unevaluatedProperties: false
        description:
          Properties for a single BUCK regulator

        properties:
          regulator-initial-mode:
            items:
              enum: [ 1, 2, 3 ]
            description:
              Defined in include/dt-bindings/regulator/dlg,da9211-regulator.h

          regulator-allowed-modes:
            items:
              enum: [ 1, 2, 3 ]
            description:
              Defined in include/dt-bindings/regulator/dlg,da9211-regulator.h

          enable-gpios:
            maxItems: 1

required:
  - compatible
  - reg
  - interrupts
  - regulators

additionalProperties: false

examples:
  - |
    #include <dt-bindings/regulator/dlg,da9211-regulator.h>

    i2c {
        #address-cells = <1>;
        #size-cells = <0>;

        regulator@68 {
            compatible = "dlg,da9212";
            reg = <0x68>;
            interrupts = <3 27>;

            regulators {
                BUCKA {
                    regulator-name = "VBUCKA";
                    regulator-min-microvolt = < 300000>;
                    regulator-max-microvolt = <1570000>;
                    regulator-min-microamp = <2000000>;
                    regulator-max-microamp = <5000000>;
                    enable-gpios = <&gpio 27 0>;
                };
                BUCKB {
                    regulator-name = "VBUCKB";
                    regulator-min-microvolt = < 300000>;
                    regulator-max-microvolt = <1570000>;
                    regulator-min-microamp = <2000000>;
                    regulator-max-microamp = <5000000>;
                    enable-gpios = <&gpio 17 0>;
                };
            };
        };
    };

...
```

## Documentation/devicetree/bindings/regulator/dlg,slg51000.yaml
```yaml
# SPDX-License-Identifier: GPL-2.0-only OR BSD-2-Clause
%YAML 1.2
---
$id: http://devicetree.org/schemas/regulator/dlg,slg51000.yaml#
$schema: http://devicetree.org/meta-schemas/core.yaml#

title: Dialog Semiconductor SLG51000 Voltage Regulator

maintainers:
  - Eric Jeong <eric.jeong.opensource@diasemi.com>
  - Support Opensource <support.opensource@diasemi.com>

properties:
  compatible:
    const: dlg,slg51000

  reg:
    maxItems: 1

  interrupts:
    maxItems: 1

  dlg,cs-gpios:
    maxItems: 1
    description:
      GPIO for chip select

  vin3-supply:
    description:
      Input supply for ldo3, required if regulator is enabled

  vin4-supply:
    description:
      Input supply for ldo4, required if regulator is enabled

  vin5-supply:
    description:
      Input supply for ldo5, required if regulator is enabled

  vin6-supply:
    description:
      Input supply for ldo6, required if regulator is enabled

  vin7-supply:
    description:
      Input supply for ldo7, required if regulator is enabled

  regulators:
    type: object
    additionalProperties: false

    patternProperties:
      "^ldo[1-7]$":
        type: object
        $ref: /schemas/regulator/regulator.yaml#
        unevaluatedProperties: false

        properties:
          enable-gpios:
            maxItems: 1

        required:
          - regulator-name

required:
  - compatible
  - reg
  - regulators

additionalProperties: false

examples:
  - |
    #include <dt-bindings/gpio/gpio.h>
    #include <dt-bindings/interrupt-controller/irq.h>
    #include <dt-bindings/regulator/dlg,da9121-regulator.h>
    i2c {
        #address-cells = <1>;
        #size-cells = <0>;

        pmic@75 {
            compatible = "dlg,slg51000";
            reg = <0x75>;
            dlg,cs-gpios = <&tlmm 69 GPIO_ACTIVE_HIGH>;
            vin5-supply = <&vreg_s1f_1p2>;
            vin6-supply = <&vreg_s1f_1p2>;

            regulators {
                ldo1 {
                    regulator-name = "slg51000_b_ldo1";
                    regulator-min-microvolt = <2400000>;
                    regulator-max-microvolt = <3300000>;
                };

                ldo2 {
                    regulator-name = "slg51000_b_ldo2";
                    regulator-min-microvolt = <2400000>;
                    regulator-max-microvolt = <3300000>;
                };

                ldo3 {
                    regulator-name = "slg51000_b_ldo3";
                    regulator-min-microvolt = <1200000>;
                    regulator-max-microvolt = <3750000>;
                };

                ldo4 {
                    regulator-name = "slg51000_b_ldo4";
                    regulator-min-microvolt = <1200000>;
                    regulator-max-microvolt = <3750000>;
                };

                ldo5 {
                    regulator-name = "slg51000_b_ldo5";
                    regulator-min-microvolt = <500000>;
                    regulator-max-microvolt = <1200000>;
                };

                ldo6 {
                    regulator-name = "slg51000_b_ldo6";
                    regulator-min-microvolt = <500000>;
                    regulator-max-microvolt = <1200000>;
                };

                ldo7 {
                    regulator-name = "slg51000_b_ldo7";
                    regulator-min-microvolt = <1200000>;
                    regulator-max-microvolt = <3750000>;
                };
            };
        };
    };
```

## Documentation/devicetree/bindings/regulator/fan53555.txt
```
Binding for Fairchild FAN53555 regulators

Required properties:
  - compatible: one of "fcs,fan53555", "silergy,syr827", "silergy,syr828",
		"rockchip,rk8603", "rockchip,rk8604"
  - reg: I2C address

Optional properties:
  - fcs,suspend-voltage-selector: declare which of the two available
		voltage selector registers should be used for the suspend
		voltage. The other one is used for the runtime voltage setting
		Possible values are either <0> or <1>
  - vin-supply: regulator supplying the vin pin

Example:

	regulator@40 {
		compatible = "fcs,fan53555";
		regulator-name = "fan53555";
		regulator-min-microvolt = <1000000>;
		regulator-max-microvolt = <1800000>;
		vin-supply = <&parent_reg>;
		fcs,suspend-voltage-selector = <1>;
	};
```

## Documentation/devicetree/bindings/regulator/fcs,fan53555.yaml
```yaml
# SPDX-License-Identifier: GPL-2.0
%YAML 1.2
---
$id: http://devicetree.org/schemas/regulator/fcs,fan53555.yaml#
$schema: http://devicetree.org/meta-schemas/core.yaml#

title: Fairchild FAN53555 regulators

maintainers:
  - Heiko Stuebner <heiko@sntech.de>

allOf:
  - $ref: regulator.yaml#

properties:
  compatible:
    enum:
      - fcs,fan53555
      - fcs,fan53526
      - silergy,syr827
      - silergy,syr828
      - tcs,tcs4525

  reg:
    maxItems: 1

  fcs,suspend-voltage-selector:
    description: Declares which of the two available voltage selector
      registers should be used for the suspend voltage. The other one is used
      for the runtime voltage setting.
    $ref: /schemas/types.yaml#/definitions/uint32
    enum: [ 0, 1 ]

  vin-supply:
    description: Supply for the vin pin

  vsel-gpios:
    description: Voltage Select. When this pin is LOW, VOUT is set by the
      VSEL0 register. When this pin is HIGH, VOUT is set by the VSEL1 register.
    maxItems: 1

required:
  - compatible
  - reg

unevaluatedProperties: false

examples:
  - |
    i2c {
        #address-cells = <1>;
        #size-cells = <0>;

        regulator@40 {
            compatible = "fcs,fan53555";
            reg = <0x40>;
            regulator-name = "fan53555";
            regulator-min-microvolt = <1000000>;
            regulator-max-microvolt = <1800000>;
            vin-supply = <&parent_reg>;
            fcs,suspend-voltage-selector = <1>;
        };
    };
...
```

## Documentation/devicetree/bindings/regulator/fitipower,fp9931.yaml
```yaml
# SPDX-License-Identifier: GPL-2.0-only OR BSD-2-Clause
%YAML 1.2
---
$id: http://devicetree.org/schemas/regulator/fitipower,fp9931.yaml#
$schema: http://devicetree.org/meta-schemas/core.yaml#

title: FitiPower FP9931/JD9930 Power Management Integrated Circuit

maintainers:
  - Andreas Kemnade <andreas@kemnade.info>

description:
  FP9931 is a Power Management IC to provide Power for EPDs with one 3.3V
  switch, 2 symmetric LDOs behind 2 DC/DC converters, and one unsymmetric
  regulator for a compensation voltage.
  JD9930 has in addition some kind of night mode.

properties:
  compatible:
    oneOf:
      - const: fitipower,fp9931

      - items:
          - const: fitipower,jd9930
          - const: fitipower,fp9931

  reg:
    maxItems: 1

  enable-gpios:
    maxItems: 1

  pg-gpios:
    maxItems: 1

  en-ts-gpios:
    maxItems: 1

  xon-gpios:
    maxItems: 1

  vin-supply:
    description:
      Supply for the whole chip. Some vendor kernels and devicetrees
      declare this as a non-existing GPIO named "pwrall".

  fitipower,tdly-ms:
    description:
      Power up soft start delay settings tDLY1-4 bitfields in the
      POWERON_DELAY register
    items:
      - enum: [0, 1, 2, 4]
      - enum: [0, 1, 2, 4]
      - enum: [0, 1, 2, 4]
      - enum: [0, 1, 2, 4]

  regulators:
    type: object
    additionalProperties: false
    patternProperties:
      "^(vcom|vposneg|v3p3)$":
        unevaluatedProperties: false
        type: object
        $ref: /schemas/regulator/regulator.yaml

required:
  - compatible
  - reg
  - pg-gpios
  - enable-gpios

additionalProperties: false

examples:
  - |
    #include <dt-bindings/gpio/gpio.h>
    i2c {
        #address-cells = <1>;
        #size-cells = <0>;

        pmic@18 {
            compatible = "fitipower,fp9931";
            reg = <0x18>;
            pinctrl-names = "default";
            pinctrl-0 = <&pinctrl_fp9931_gpio>;
            vin-supply = <&epd_pmic_supply>;
            pg-gpios = <&gpio2 7 GPIO_ACTIVE_HIGH>;
            en-ts-gpios = <&gpio2 9 GPIO_ACTIVE_HIGH>;
            enable-gpios = <&gpio2 8 GPIO_ACTIVE_HIGH>;
            fitipower,tdly-ms = <2 2 4 4>;

            regulators {
                vcom {
                    regulator-name = "vcom";
                    regulator-min-microvolt = <2352840>;
                    regulator-max-microvolt = <2352840>;
                };

                vposneg {
                    regulator-name = "vposneg";
                    regulator-min-microvolt = <15060000>;
                    regulator-max-microvolt = <15060000>;
                };

                v3p3 {
                    regulator-name = "v3p3";
                };
            };
        };
    };
```

## Documentation/devicetree/bindings/regulator/fixed-regulator.txt
```
Fixed Voltage regulators

Required properties:
- compatible: Must be "regulator-fixed";

Optional properties:
- gpio: gpio to use for enable control
- startup-delay-us: startup time in microseconds
- enable-active-high: Polarity of GPIO is Active high
If this property is missing, the default assumed is Active low.

Any property defined as part of the core regulator
binding, defined in regulator.txt, can also be used.
However a fixed voltage regulator is expected to have the
regulator-min-microvolt and regulator-max-microvolt
to be the same.

Example:

	abc: fixedregulator@0 {
		compatible = "regulator-fixed";
		regulator-name = "fixed-supply";
		regulator-min-microvolt = <1800000>;
		regulator-max-microvolt = <1800000>;
		gpio = <&gpio1 16 0>;
		startup-delay-us = <70000>;
		enable-active-high;
		regulator-boot-on
	};
```
