## Documentation/devicetree/bindings/regulator/fixed-regulator.yaml
```yaml
# SPDX-License-Identifier: GPL-2.0
%YAML 1.2
---
$id: http://devicetree.org/schemas/regulator/fixed-regulator.yaml#
$schema: http://devicetree.org/meta-schemas/core.yaml#

title: Fixed Voltage regulators

maintainers:
  - Liam Girdwood <lgirdwood@gmail.com>
  - Mark Brown <broonie@kernel.org>

description:
  Any property defined as part of the core regulator binding, defined in
  regulator.yaml, can also be used. However a fixed voltage regulator is
  expected to have the regulator-min-microvolt and regulator-max-microvolt
  to be the same.

allOf:
  - $ref: regulator.yaml#
  - if:
      properties:
        compatible:
          contains:
            const: regulator-fixed-clock
    then:
      required:
        - clocks
  - if:
      properties:
        compatible:
          contains:
            const: regulator-fixed-domain
    then:
      required:
        - power-domains
        - required-opps
  - not:
      required:
        - gpio
        - gpios

properties:
  compatible:
    enum:
      - regulator-fixed
      - regulator-fixed-clock
      - regulator-fixed-domain

  regulator-name: true

  gpio:
    description: gpio to use for enable control
    maxItems: 1

  gpios:
    maxItems: 1

  clocks:
    description:
      clock to use for enable control. This binding is only available if
      the compatible is chosen to regulator-fixed-clock. The clock binding
      is mandatory if compatible is chosen to regulator-fixed-clock.
    maxItems: 1

  power-domains:
    deprecated: true
    description:
      Power domain to use for enable control. This binding is only
      available if the compatible is chosen to regulator-fixed-domain.
    maxItems: 1

  required-opps:
    deprecated: true
    description:
      Performance state to use for enable control. This binding is only
      available if the compatible is chosen to regulator-fixed-domain. The
      power-domain binding is mandatory if compatible is chosen to
      regulator-fixed-domain.
    maxItems: 1

  startup-delay-us:
    description: startup time in microseconds

  off-on-delay-us:
    description: off delay time in microseconds

  enable-active-high:
    description:
      Polarity of GPIO is Active high. If this property is missing,
      the default assumed is Active low.
    type: boolean

  gpio-open-drain:
    description:
      GPIO is open drain type. If this property is missing then default
      assumption is false.
    type: boolean

  vin-supply:
    description: Input supply phandle.

  interrupts:
    maxItems: 1
    description:
      Interrupt signaling a critical under-voltage event.

required:
  - compatible
  - regulator-name

unevaluatedProperties: false

examples:
  - |
    reg_1v8: regulator-1v8 {
      compatible = "regulator-fixed";
      regulator-name = "1v8";
      regulator-min-microvolt = <1800000>;
      regulator-max-microvolt = <1800000>;
      gpio = <&gpio1 16 0>;
      startup-delay-us = <70000>;
      enable-active-high;
      regulator-boot-on;
      gpio-open-drain;
      vin-supply = <&parent_reg>;
    };
    reg_1v8_clk: regulator-1v8-clk {
      compatible = "regulator-fixed-clock";
      regulator-name = "1v8";
      regulator-min-microvolt = <1800000>;
      regulator-max-microvolt = <1800000>;
      clocks = <&clock1>;
      startup-delay-us = <70000>;
      enable-active-high;
      regulator-boot-on;
      vin-supply = <&parent_reg>;
    };
    reg_1v8_domain: regulator-1v8-domain {
      compatible = "regulator-fixed-domain";
      regulator-name = "1v8";
      regulator-min-microvolt = <1800000>;
      regulator-max-microvolt = <1800000>;
      power-domains = <&domain1>;
      required-opps = <&domain1_state1>;
      startup-delay-us = <70000>;
      enable-active-high;
      regulator-boot-on;
      vin-supply = <&parent_reg>;
    };
...
```

## Documentation/devicetree/bindings/regulator/google,cros-ec-regulator.yaml
```yaml
# SPDX-License-Identifier: (GPL-2.0-only OR BSD-2-Clause)
%YAML 1.2
---
$id: http://devicetree.org/schemas/regulator/google,cros-ec-regulator.yaml#
$schema: http://devicetree.org/meta-schemas/core.yaml#

title: ChromeOS EC controlled voltage regulators

maintainers:
  - Pi-Hsun Shih <pihsun@chromium.org>

description:
  Any property defined as part of the core regulator binding, defined in
  regulator.yaml, can also be used.

allOf:
  - $ref: regulator.yaml#

properties:
  compatible:
    const: google,cros-ec-regulator

  reg:
    maxItems: 1
    description: Identifier for the voltage regulator to ChromeOS EC.

required:
  - compatible
  - reg

unevaluatedProperties: false

examples:
  - |
    spi {
        #address-cells = <1>;
        #size-cells = <0>;

        cros_ec: ec@0 {
            compatible = "google,cros-ec-spi";
            reg = <0>;
            #address-cells = <1>;
            #size-cells = <0>;
            interrupts = <99 0>;

            regulator@0 {
                compatible = "google,cros-ec-regulator";
                regulator-min-microvolt = <1800000>;
                regulator-max-microvolt = <3300000>;
                reg = <0>;
            };
        };
    };
...
```

## Documentation/devicetree/bindings/regulator/gpio-regulator.txt
```
GPIO controlled regulators

Required properties:
- compatible		: Must be "regulator-gpio".
- regulator-name	: Defined in regulator.txt as optional, but required
			  here.
- gpios			: Array of one or more GPIO pins used to select the
			  regulator voltage/current listed in "states".
- states		: Selection of available voltages/currents provided by
			  this regulator and matching GPIO configurations to
			  achieve them. If there are no states in the "states"
			  array, use a fixed regulator instead.

Optional properties:
- enable-gpios		: GPIO used to enable/disable the regulator.
			  Warning, the GPIO phandle flags are ignored and the
			  GPIO polarity is controlled solely by the presence
			  of "enable-active-high" DT property. This is due to
			  compatibility with old DTs.
- enable-active-high	: Polarity of "enable-gpio" GPIO is active HIGH.
			  Default is active LOW.
- gpios-states		: On operating systems, that don't support reading back
			  gpio values in output mode (most notably linux), this
			  array provides the state of GPIO pins set when
			  requesting them from the gpio controller. Systems,
			  that are capable of preserving state when requesting
			  the lines, are free to ignore this property.
			  0: LOW, 1: HIGH. Default is LOW if nothing else
			  is specified.
- startup-delay-us	: Startup time in microseconds.
- regulator-type	: Specifies what is being regulated, must be either
			  "voltage" or "current", defaults to voltage.

Any property defined as part of the core regulator binding defined in
regulator.txt can also be used.

Example:

	mmciv: gpio-regulator {
		compatible = "regulator-gpio";

		regulator-name = "mmci-gpio-supply";
		regulator-min-microvolt = <1800000>;
		regulator-max-microvolt = <2600000>;
		regulator-boot-on;

		enable-gpios = <&gpio0 23 0x4>;
		gpios = <&gpio0 24 0x4
			 &gpio0 25 0x4>;
		states = <1800000 0x3
			  2200000 0x2
			  2600000 0x1
			  2900000 0x0>;

		startup-delay-us = <100000>;
		enable-active-high;
	};
```

## Documentation/devicetree/bindings/regulator/gpio-regulator.yaml
```yaml
# SPDX-License-Identifier: GPL-2.0
%YAML 1.2
---
$id: http://devicetree.org/schemas/regulator/gpio-regulator.yaml#
$schema: http://devicetree.org/meta-schemas/core.yaml#

title: GPIO controlled regulators

maintainers:
  - Liam Girdwood <lgirdwood@gmail.com>
  - Mark Brown <broonie@kernel.org>

description:
  Any property defined as part of the core regulator binding, defined in
  regulator.txt, can also be used.

allOf:
  - $ref: regulator.yaml#

properties:
  compatible:
    const: regulator-gpio

  regulator-name: true

  enable-gpios:
    description: GPIO to use to enable/disable the regulator.
      Warning, the GPIO phandle flags are ignored and the GPIO polarity is
      controlled solely by the presence of "enable-active-high" DT property.
      This is due to compatibility with old DTs.
    maxItems: 1

  gpios:
    description: Array of one or more GPIO pins used to select the regulator
      voltage/current listed in "states".
    minItems: 1
    maxItems: 8  # Should be enough...

  gpios-states:
    description: |
      On operating systems, that don't support reading back gpio values in
      output mode (most notably linux), this array provides the state of GPIO
      pins set when requesting them from the gpio controller. Systems, that are
      capable of preserving state when requesting the lines, are free to ignore
      this property.
        0: LOW
        1: HIGH
      Default is LOW if nothing else is specified.
    $ref: /schemas/types.yaml#/definitions/uint32-array
    minItems: 1
    maxItems: 8
    items:
      enum: [0, 1]
      default: 0

  states:
    description: Selection of available voltages/currents provided by this
      regulator and matching GPIO configurations to achieve them. If there are
      no states in the "states" array, use a fixed regulator instead.
    $ref: /schemas/types.yaml#/definitions/uint32-matrix
    minItems: 2
    maxItems: 256
    items:
      items:
        - description: Voltage in microvolts
        - description: GPIO group state value

  startup-delay-us:
    description: startup time in microseconds

  enable-active-high:
    description: Polarity of "enable-gpio" GPIO is active HIGH. Default is
      active LOW.
    type: boolean

  gpio-open-drain:
    description:
      GPIO is open drain type. If this property is missing then default
      assumption is false.
    type: boolean

  regulator-type:
    description: Specifies what is being regulated.
    $ref: /schemas/types.yaml#/definitions/string
    enum:
      - voltage
      - current
    default: voltage

  vin-supply:
    description: Input supply phandle.

required:
  - compatible
  - regulator-name
  - gpios
  - states

unevaluatedProperties: false

examples:
  - |
    gpio-regulator {
      compatible = "regulator-gpio";

      regulator-name = "mmci-gpio-supply";
      regulator-min-microvolt = <1800000>;
      regulator-max-microvolt = <2600000>;
      regulator-boot-on;

      enable-gpios = <&gpio0 23 0x4>;
      gpios = <&gpio0 24 0x4
        &gpio0 25 0x4>;
      states = <1800000 0x3>,
        <2200000 0x2>,
        <2600000 0x1>,
        <2900000 0x0>;

      startup-delay-us = <100000>;
      enable-active-high;
    };
...
```

## Documentation/devicetree/bindings/regulator/hisilicon,hi6220-mtcmos.txt
```
Hi6220 mtcmos Voltage regulators

Required parent device properties:
- compatible: Must be "hisilicon,hi6220-mtcmos-driver"
- hisilicon,mtcmos-steady-us: The time to wait for power steady
- hisilicon,mtcmos-sc-on-base: address of hi6220 soc control register

Required child device properties:
- regulator-name: The name of mtcmos
- hisilicon,ctrl-regs: offset of ctrl-regs
- hisilicon,ctrl-data: the bit to ctrl the regulator

Example:
        mtcmos {
                compatible = "hisilicon,hi6220-mtcmos-driver";
                hisilicon,mtcmos-steady-us = <10>;
                hisilicon,mtcmos-sc-on-base  = <0xf7800000>;
                hisilicon,mtcmos-acpu-on-base = <0xf65a0000>;

                mtcmos1: regulator@a1{
                        regulator-name = "G3D_PD_VDD";
                        regulator-compatible = "mtcmos1";
                        hisilicon,ctrl-regs = <0x830 0x834 0x83c>;
                        hisilicon,ctrl-data = <1 0x1>;
                };
                mtcmos2: regulator@a2{
                        regulator-name = "SOC_MED";
                         regulator-compatible = "mtcmos2";
                        hisilicon,ctrl-regs = <0x830 0x834 0x83c>;
                        hisilicon,ctrl-data = <2 0x1>;
                };
        };
```

## Documentation/devicetree/bindings/regulator/hisilicon,hi655x-regulator.txt
```
Hisilicon Hi655x Voltage regulators

Analte:
The Hi655x regulator control is managed by Hi655x PMIC.
So the analde of this regulator must be child analde of Hi655x
PMIC analde.

The driver uses the regulator core framework, so please also
take the bindings of regulator.txt for reference.

The valid names for regulators are:

LDO2_2V8 LDO7_SDIO LDO10_2V85 LDO13_1V8 LDO14_2V8
LDO15_1V8 LDO17_2V5 LDO19_3V0 LDO21_1V8 LDO22_1V2

Example:
        pmic: pmic@f8000000 {
                compatible = "hisilicon,hi655x-pmic";
		...
		regulators {
			ldo2: LDO2@a21 {
				regulator-name = "LDO2_2V8";
				regulator-min-microvolt = <2500000>;
				regulator-max-microvolt = <3200000>;
				regulator-enable-ramp-delay = <120>;
			};
			...
		}
	}
```

## Documentation/devicetree/bindings/regulator/infineon,ir38060.yaml
```yaml
# SPDX-License-Identifier: GPL-2.0-only OR BSD-2-Clause
%YAML 1.2
---
$id: http://devicetree.org/schemas/regulator/infineon,ir38060.yaml#
$schema: http://devicetree.org/meta-schemas/core.yaml#

title: Infineon Buck Regulators with PMBUS interfaces

maintainers:
  - Guenter Roeck <linux@roeck-us.net>

allOf:
  - $ref: regulator.yaml#

properties:
  compatible:
    enum:
      - infineon,ir38060
      - infineon,ir38064
      - infineon,ir38164
      - infineon,ir38263

  reg:
    maxItems: 1

required:
  - compatible
  - reg

unevaluatedProperties: false

examples:
  - |
    i2c {
      #address-cells = <1>;
      #size-cells = <0>;

      regulator@34 {
        compatible = "infineon,ir38060";
        reg = <0x34>;

        regulator-min-microvolt = <437500>;
        regulator-max-microvolt = <1387500>;
      };
    };
```

## Documentation/devicetree/bindings/regulator/isl9305.txt
```
Intersil ISL9305/ISL9305H voltage regulator

Required properties:

- compatible: "isil,isl9305" or "isil,isl9305h"
- reg: I2C slave address, usually 0x68.
- regulators: A node that houses a sub-node for each regulator within the
  device. Each sub-node is identified using the node's name, with valid
  values being "dcd1", "dcd2", "ldo1" and "ldo2". The content of each sub-node
  is defined by the standard binding for regulators; see regulator.txt.
- VINDCD1-supply: A phandle to a regulator node supplying VINDCD1.
  VINDCD2-supply: A phandle to a regulator node supplying VINDCD2.
  VINLDO1-supply: A phandle to a regulator node supplying VINLDO1.
  VINLDO2-supply: A phandle to a regulator node supplying VINLDO2.

Optional properties:
- Per-regulator optional properties are defined in regulator.txt

Example

	pmic: isl9305@68 {
		compatible = "isil,isl9305";
		reg = <0x68>;

		VINDCD1-supply = <&system_power>;
		VINDCD2-supply = <&system_power>;
		VINLDO1-supply = <&system_power>;
		VINLDO2-supply = <&system_power>;

		regulators {
			dcd1 {
			        regulator-name = "VDD_DSP";
				regulator-always-on;
                        };
		};
	};
```
