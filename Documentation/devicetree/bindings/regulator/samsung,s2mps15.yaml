## Documentation/devicetree/bindings/regulator/slg51000.txt
```
* Dialog Semiconductor SLG51000 Voltage Regulator

Required properties:
- compatible : Should be "dlg,slg51000" for SLG51000
- reg : Specifies the I2C slave address.
- xxx-supply: Input voltage supply regulator for ldo3 to ldo7.
  These entries are required if regulators are enabled for a device.
  An absence of these properties can cause the regulator registration to fail.
  If some of input supply is powered through battery or always-on supply then
  also it is required to have these parameters with proper node handle of always
  on power supply.
    vin3-supply: Input supply for ldo3
    vin4-supply: Input supply for ldo4
    vin5-supply: Input supply for ldo5
    vin6-supply: Input supply for ldo6
    vin7-supply: Input supply for ldo7

Optional properties:
- interrupt-parent : Specifies the reference to the interrupt controller.
- interrupts : IRQ line information.
- dlg,cs-gpios : Specify a valid GPIO for chip select

Sub-nodes:
- regulators : This node defines the settings for the regulators.
  The content of the sub-node is defined by the standard binding
  for regulators; see regulator.txt.

  The SLG51000 regulators are bound using their names listed below:
    ldo1
    ldo2
    ldo3
    ldo4
    ldo5
    ldo6
    ldo7

Optional properties for regulators:
- enable-gpios : Specify a valid GPIO for platform control of the regulator.

Example:
	pmic: slg51000@75 {
		compatible = "dlg,slg51000";
		reg = <0x75>;

		regulators {
			ldo1 {
			        regulator-name = "ldo1";
			        regulator-min-microvolt = <2400000>;
			        regulator-max-microvolt = <3300000>;
			};

			ldo2 {
			        regulator-name = "ldo2";
			        regulator-min-microvolt = <2400000>;
			        regulator-max-microvolt = <3300000>;
			};

			ldo3 {
			        regulator-name = "ldo3";
			        regulator-min-microvolt = <1200000>;
			        regulator-max-microvolt = <3750000>;
			};

			ldo4 {
			        regulator-name = "ldo4";
			        regulator-min-microvolt = <1200000>;
			        regulator-max-microvolt = <3750000>;
			};

			ldo5 {
			        regulator-name = "ldo5";
			        regulator-min-microvolt = <500000>;
			        regulator-max-microvolt = <1200000>;
			};

			ldo6 {
			        regulator-name = "ldo6";
			        regulator-min-microvolt = <500000>;
			        regulator-max-microvolt = <1200000>;
			};

			ldo7 {
			        regulator-name = "ldo7";
			        regulator-min-microvolt = <1200000>;
			        regulator-max-microvolt = <3750000>;
			};
		};
	};
```

## Documentation/devicetree/bindings/regulator/socionext,uniphier-regulator.yaml
```yaml
# SPDX-License-Identifier: (GPL-2.0-only OR BSD-2-Clause)
%YAML 1.2
---
$id: http://devicetree.org/schemas/regulator/socionext,uniphier-regulator.yaml#
$schema: http://devicetree.org/meta-schemas/core.yaml#

title: Socionext UniPhier regulator controller

description: |
  This regulator controls VBUS and belongs to USB3 glue layer. Before using
  the regulator, it is necessary to control the clocks and resets to enable
  this layer. These clocks and resets should be described in each property.

maintainers:
  - Kunihiko Hayashi <hayashi.kunihiko@socionext.com>

# USB3 Controller

properties:
  compatible:
    enum:
      - socionext,uniphier-pro4-usb3-regulator
      - socionext,uniphier-pro5-usb3-regulator
      - socionext,uniphier-pxs2-usb3-regulator
      - socionext,uniphier-ld20-usb3-regulator
      - socionext,uniphier-pxs3-usb3-regulator
      - socionext,uniphier-nx1-usb3-regulator

  reg:
    maxItems: 1

  clocks:
    minItems: 1
    maxItems: 2

  clock-names: true

  resets:
    minItems: 1
    maxItems: 2

  reset-names: true

allOf:
  - $ref: regulator.yaml#
  - if:
      properties:
        compatible:
          contains:
            enum:
              - socionext,uniphier-pro4-usb3-regulator
              - socionext,uniphier-pro5-usb3-regulator
    then:
      properties:
        clocks:
          minItems: 2
          maxItems: 2
        clock-names:
          items:
            - const: gio
            - const: link
        resets:
          minItems: 2
          maxItems: 2
        reset-names:
          items:
            - const: gio
            - const: link
    else:
      properties:
        clocks:
          maxItems: 1
        clock-names:
          const: link
        resets:
          maxItems: 1
        reset-names:
          const: link

unevaluatedProperties: false

required:
  - compatible
  - reg
  - clocks
  - clock-names
  - resets
  - reset-names

examples:
  - |
    usb_vbus0: regulators@100 {
        compatible = "socionext,uniphier-ld20-usb3-regulator";
        reg = <0x100 0x10>;
        clock-names = "link";
        clocks = <&sys_clk 14>;
        reset-names = "link";
        resets = <&sys_rst 14>;
    };
```

## Documentation/devicetree/bindings/regulator/sprd,sc2731-regulator.txt
```
Spreadtrum SC2731 Voltage regulators

The SC2731 integrates low-voltage and low quiescent current DCDC/LDO.
14 LDO and 3 DCDCs are designed for external use. All DCDCs/LDOs have
their own bypass (power-down) control signals. External tantalum or MLCC
ceramic capacitors are recommended to use with these LDOs.

Required properties:
 - compatible: should be "sprd,sc27xx-regulator".

List of regulators provided by this controller. It is named according to
its regulator type, BUCK_<name> and LDO_<name>. The definition for each
of these nodes is defined using the standard binding for regulators at
Documentation/devicetree/bindings/regulator/regulator.txt.

The valid names for regulators are:
BUCK:
	BUCK_CPU0, BUCK_CPU1, BUCK_RF
LDO:
	LDO_CAMA0, LDO_CAMA1, LDO_CAMMOT, LDO_VLDO, LDO_EMMCCORE, LDO_SDCORE,
	LDO_SDIO, LDO_WIFIPA, LDO_USB33, LDO_CAMD0, LDO_CAMD1, LDO_CON,
	LDO_CAMIO, LDO_SRAM

Example:
	regulators {
		compatible = "sprd,sc27xx-regulator";

		vddarm0: BUCK_CPU0 {
			regulator-name = "vddarm0";
			regulator-min-microvolt = <400000>;
			regulator-max-microvolt = <1996875>;
			regulator-ramp-delay = <25000>;
			regulator-always-on;
		};

		vddcama0: LDO_CAMA0 {
			regulator-name = "vddcama0";
			regulator-min-microvolt = <1200000>;
			regulator-max-microvolt = <3750000>;
			regulator-enable-ramp-delay = <100>;
		};
		...
	};
```

## Documentation/devicetree/bindings/regulator/sprd,sc2731-regulator.yaml
```yaml
# SPDX-License-Identifier: GPL-2.0-only OR BSD-2-Clause
%YAML 1.2
---
$id: http://devicetree.org/schemas/regulator/sprd,sc2731-regulator.yaml#
$schema: http://devicetree.org/meta-schemas/core.yaml#

title: Spreadtrum SC2731 Power Management IC regulators

maintainers:
  - Orson Zhai <orsonzhai@gmail.com>
  - Baolin Wang <baolin.wang7@gmail.com>
  - Chunyan Zhang <zhang.lyra@gmail.com>

description: |
  The SC2731 integrates low-voltage and low quiescent current DCDC/LDO.
  14 LDO and 3 DCDCs are designed for external use. All DCDCs/LDOs have
  their own bypass (power-down) control signals. It is recommended to use
  external tantalum or MLCC ceramic capacitors with these LDOs.
  Valid names for the regulators are:
    BUCK:
      BUCK_CPU0, BUCK_CPU1, BUCK_RF
    LDO:
      LDO_CAMA0, LDO_CAMA1, LDO_CAMD0, LDO_CAMD1, LDO_CAMIO, LDO_CAMMOT,
      LDO_CON, LDO_EMMCCORE, LDO_SDCORE, LDO_SDIO, LDO_SRAM, LDO_USB33,
      LDO_VLDO, LDO_WIFIPA

properties:
  compatible:
    const: sprd,sc2731-regulator

patternProperties:
  "^BUCK_(CPU[0-1]|RF)$":
    type: object
    $ref: regulator.yaml#
    unevaluatedProperties: false

  "^LDO_(CAM(A0|A1|D0|D1|IO|MOT)|CON|EMMCCORE|SD(CORE|IO)|SRAM|USB33|VLDO|WIFIPA)$":
    type: object
    $ref: regulator.yaml#
    unevaluatedProperties: false

required:
  - compatible

additionalProperties: false

examples:
  - |
    regulators {
      compatible = "sprd,sc2731-regulator";

      BUCK_CPU0 {
        regulator-name = "vddarm0";
        regulator-min-microvolt = <400000>;
        regulator-max-microvolt = <1996875>;
        regulator-ramp-delay = <25000>;
        regulator-always-on;
      };

      LDO_CAMA0 {
        regulator-name = "vddcama0";
        regulator-min-microvolt = <1200000>;
        regulator-max-microvolt = <3750000>;
        regulator-enable-ramp-delay = <100>;
      };
    };
...
```

## Documentation/devicetree/bindings/regulator/st,stm32-booster.txt
```
STM32 BOOSTER - Booster for ADC analog input switches

Some STM32 devices embed a 3.3V booster supplied by Vdda, that can be used
to supply ADC analog input switches.

Required properties:
- compatible: Should be one of:
  "st,stm32h7-booster"
  "st,stm32mp1-booster"
- st,syscfg: Phandle to system configuration controller.
- vdda-supply: Phandle to the vdda input analog voltage.

Example:
	booster: regulator-booster {
		compatible = "st,stm32mp1-booster";
		st,syscfg = <&syscfg>;
		vdda-supply = <&vdda>;
	};
```

## Documentation/devicetree/bindings/regulator/st,stm32-booster.yaml
```yaml
# SPDX-License-Identifier: (GPL-2.0-only OR BSD-2-Clause)
%YAML 1.2
---
$id: http://devicetree.org/schemas/regulator/st,stm32-booster.yaml#
$schema: http://devicetree.org/meta-schemas/core.yaml#

title: STMicroelectronics STM32 booster for ADC analog input switches bindings

maintainers:
  - Fabrice Gasnier <fabrice.gasnier@st.com>

description: |
  Some STM32 devices embed a 3.3V booster supplied by Vdda, that can be used
  to supply ADC analog input switches.

allOf:
  - $ref: "regulator.yaml#"

properties:
  compatible:
    enum:
      - st,stm32h7-booster
      - st,stm32mp1-booster

  st,syscfg:
    $ref: "/schemas/types.yaml#/definitions/phandle-array"
    description: phandle to system configuration controller.

  vdda-supply:
    description: phandle to the vdda input analog voltage.

required:
  - compatible
  - st,syscfg
  - vdda-supply

unevaluatedProperties: false

examples:
  - |
    regulator-booster {
      compatible = "st,stm32mp1-booster";
      st,syscfg = <&syscfg>;
      vdda-supply = <&vdda>;
    };

...
```

## Documentation/devicetree/bindings/regulator/st,stm32-vrefbuf.txt
```
STM32 VREFBUF - Voltage reference buffer

Some STM32 devices embed a voltage reference buffer which can be used as
voltage reference for ADCs, DACs and also as voltage reference for external
components through the dedicated VREF+ pin.

Required properties:
- compatible:		Must be "st,stm32-vrefbuf".
- reg:			Offset and length of VREFBUF register set.
- clocks:		Must contain an entry for peripheral clock.

Example:
	vrefbuf: regulator@58003c00 {
		compatible = "st,stm32-vrefbuf";
		reg = <0x58003C00 0x8>;
		clocks = <&rcc VREF_CK>;
		regulator-min-microvolt = <1500000>;
		regulator-max-microvolt = <2500000>;
		vdda-supply = <&vdda>;
	};
```

## Documentation/devicetree/bindings/regulator/st,stm32-vrefbuf.yaml
```yaml
# SPDX-License-Identifier: (GPL-2.0-only OR BSD-2-Clause)
%YAML 1.2
---
$id: http://devicetree.org/schemas/regulator/st,stm32-vrefbuf.yaml#
$schema: http://devicetree.org/meta-schemas/core.yaml#

title: STMicroelectronics STM32 Voltage reference buffer bindings

description: |
  Some STM32 devices embed a voltage reference buffer which can be used as
  voltage reference for ADCs, DACs and also as voltage reference for external
  components through the dedicated VREF+ pin.

maintainers:
  - Fabrice Gasnier <fabrice.gasnier@foss.st.com>

allOf:
  - $ref: "regulator.yaml#"

properties:
  compatible:
    const: st,stm32-vrefbuf

  reg:
    maxItems: 1

  clocks:
    maxItems: 1

  vdda-supply:
    description: phandle to the vdda input analog voltage.

required:
  - compatible
  - reg
  - clocks
  - vdda-supply

unevaluatedProperties: false

examples:
  - |
    #include <dt-bindings/clock/stm32mp1-clks.h>
    vrefbuf@50025000 {
      compatible = "st,stm32-vrefbuf";
      reg = <0x50025000 0x8>;
      regulator-min-microvolt = <1500000>;
      regulator-max-microvolt = <2500000>;
      clocks = <&rcc VREF>;
      vdda-supply = <&vdda>;
    };

...
```

## Documentation/devicetree/bindings/regulator/st,stm32mp1-pwr-reg.txt
```
STM32MP1 PWR Regulators
-----------------------

Available Regulators in STM32MP1 PWR block are:
  - reg11 for regulator 1V1
  - reg18 for regulator 1V8
  - usb33 for the swtich USB3V3

Required properties:
- compatible: Must be "st,stm32mp1,pwr-reg"
- list of child nodes that specify the regulator reg11, reg18 or usb33
  initialization data for defined regulators. The definition for each of
  these nodes is defined using the standard binding for regulators found at
  Documentation/devicetree/bindings/regulator/regulator.txt.
- vdd-supply: phandle to the parent supply/regulator node for vdd input
- vdd_3v3_usbfs-supply: phandle to the parent supply/regulator node for usb33

Example:

pwr_regulators: pwr@50001000 {
	compatible = "st,stm32mp1,pwr-reg";
	reg = <0x50001000 0x10>;
	vdd-supply = <&vdd>;
	vdd_3v3_usbfs-supply = <&vdd_usb>;

	reg11: reg11 {
		regulator-name = "reg11";
		regulator-min-microvolt = <1100000>;
		regulator-max-microvolt = <1100000>;
	};

	reg18: reg18 {
		regulator-name = "reg18";
		regulator-min-microvolt = <1800000>;
		regulator-max-microvolt = <1800000>;
	};

	usb33: usb33 {
		regulator-name = "usb33";
		regulator-min-microvolt = <3300000>;
		regulator-max-microvolt = <3300000>;
	};
};
```

## Documentation/devicetree/bindings/regulator/st,stm32mp1-pwr-reg.yaml
```yaml
# SPDX-License-Identifier: (GPL-2.0-only OR BSD-2-Clause)
%YAML 1.2
---
$id: http://devicetree.org/schemas/regulator/st,stm32mp1-pwr-reg.yaml#
$schema: http://devicetree.org/meta-schemas/core.yaml#

title: STM32MP1 PWR voltage regulators

maintainers:
  - Pascal Paillet <p.paillet@st.com>

properties:
  compatible:
    const: st,stm32mp1,pwr-reg

  reg:
    maxItems: 1

  vdd-supply:
    description: Input supply phandle(s) for vdd input

  vdd_3v3_usbfs-supply:
    description: Input supply phandle(s) for vdd_3v3_usbfs input

patternProperties:
  "^(reg11|reg18|usb33)$":
    type: object

    allOf:
      - $ref: "regulator.yaml#"

required:
  - compatible
  - reg

additionalProperties: false

examples:
  - |
    pwr@50001000 {
      compatible = "st,stm32mp1,pwr-reg";
      reg = <0x50001000 0x10>;
      vdd-supply = <&vdd>;
      vdd_3v3_usbfs-supply = <&vdd_usb>;

      reg11 {
        regulator-name = "reg11";
        regulator-min-microvolt = <1100000>;
        regulator-max-microvolt = <1100000>;
      };

      reg18 {
        regulator-name = "reg18";
        regulator-min-microvolt = <1800000>;
        regulator-max-microvolt = <1800000>;
      };

      usb33 {
        regulator-name = "usb33";
        regulator-min-microvolt = <3300000>;
        regulator-max-microvolt = <3300000>;
      };
    };
...
```
