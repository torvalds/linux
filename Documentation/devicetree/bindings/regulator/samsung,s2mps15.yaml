## Documentation/devicetree/bindings/regulator/st,stpmic1-regulator.txt
```
STMicroelectronics STPMIC1 Voltage regulators

Regulator Nodes are optional depending on needs.

Available Regulators in STPMIC1 device are:
  - buck1 for Buck BUCK1
  - buck2 for Buck BUCK2
  - buck3 for Buck BUCK3
  - buck4 for Buck BUCK4
  - ldo1 for LDO LDO1
  - ldo2 for LDO LDO2
  - ldo3 for LDO LDO3
  - ldo4 for LDO LDO4
  - ldo5 for LDO LDO5
  - ldo6 for LDO LDO6
  - vref_ddr for LDO Vref DDR
  - boost for Buck BOOST
  - pwr_sw1 for VBUS_OTG switch
  - pwr_sw2 for SW_OUT switch

Switches are fixed voltage regulators with only enable/disable capability.

Optional properties:
- st,mask-reset: mask reset for this regulator: the regulator configuration
  is maintained during pmic reset.
- regulator-over-current-protection:
    if set, all regulators are switched off in case of over-current detection
    on this regulator,
    if not set, the driver only sends an over-current event.
- interrupts: index of current limit detection interrupt
- <regulator>-supply: phandle to the parent supply/regulator node
	each regulator supply can be described except vref_ddr.
- regulator-active-discharge: can be used on pwr_sw1 and pwr_sw2.

Example:
regulators {
	compatible = "st,stpmic1-regulators";

	ldo6-supply = <&v3v3>;

	vdd_core: buck1 {
		regulator-name = "vdd_core";
		interrupts = <IT_CURLIM_BUCK1 0>;
		st,mask-reset;
		regulator-pull-down;
		regulator-min-microvolt = <700000>;
		regulator-max-microvolt = <1200000>;
	};

	v3v3: buck4 {
		regulator-name = "v3v3";
		interrupts = <IT_CURLIM_BUCK4 0>;

		regulator-min-microvolt = <3300000>;
		regulator-max-microvolt = <3300000>;
	};

	v1v8: ldo6 {
		regulator-name = "v1v8";
		regulator-min-microvolt = <1800000>;
		regulator-max-microvolt = <1800000>;
		regulator-over-current-protection;
	};
};
```

## Documentation/devicetree/bindings/regulator/sy8106a-regulator.txt
```
SY8106A Voltage regulator

Required properties:
- compatible: Must be "silergy,sy8106a"
- reg: I2C slave address - must be <0x65>
- silergy,fixed-microvolt - the voltage when I2C regulating is disabled (set
  by external resistor like a fixed voltage)

Any property defined as part of the core regulator binding, defined in
./regulator.txt, can also be used.

Example:

	sy8106a {
		compatible = "silergy,sy8106a";
		reg = <0x65>;
		regulator-name = "sy8106a-vdd";
		silergy,fixed-microvolt = <1200000>;
		regulator-min-microvolt = <1000000>;
		regulator-max-microvolt = <1400000>;
		regulator-boot-on;
		regulator-always-on;
	};
```

## Documentation/devicetree/bindings/regulator/sy8824x.txt
```
SY8824C/SY8824E/SY20276 Voltage regulator

Required properties:
- compatible: Must be one of the following.
	"silergy,sy8824c"
	"silergy,sy8824e"
	"silergy,sy20276"
	"silergy,sy20278"
- reg: I2C slave address

Any property defined as part of the core regulator binding, defined in
./regulator.txt, can also be used.

Example:

	vcore: regulator@00 {
		compatible = "silergy,sy8824c";
		reg = <0x66>;
		regulator-name = "vcore";
		regulator-min-microvolt = <800000>;
		regulator-max-microvolt = <1150000>;
		regulator-boot-on;
		regulator-always-on;
	};
```

## Documentation/devicetree/bindings/regulator/ti,tps62360.yaml
```yaml
# SPDX-License-Identifier: (GPL-2.0-only OR BSD-2-Clause)
%YAML 1.2
---
$id: http://devicetree.org/schemas/regulator/ti,tps62360.yaml#
$schema: http://devicetree.org/meta-schemas/core.yaml#

title: Texas Instruments TPS6236x Voltage Regulators

maintainers:
  - Laxman Dewangan <ldewangan@nvidia.com>

description: |
  The TPS6236x are a family of step down dc-dc converter with
  an input voltage range of 2.5V to 5.5V. The devices provide
  up to 3A peak load current, and an output voltage range of
  0.77V to 1.4V (TPS62360/62) and 0.5V to 1.77V (TPS62361B/63).

  Datasheet is available at:
  https://www.ti.com/lit/gpn/tps62360

allOf:
  - $ref: "regulator.yaml#"

properties:
  compatible:
    enum:
      - ti,tps62360
      - ti,tps62361
      - ti,tps62362
      - ti,tps62363

  reg:
    maxItems: 1

  ti,vsel0-gpio:
    description: |
      GPIO for controlling VSEL0 line. If this property
      is missing, then assume that there is no GPIO for
      VSEL0 control.
    maxItems: 1

  ti,vsel1-gpio:
    description: |
      GPIO for controlling VSEL1 line. If this property
      is missing, then assume that there is no GPIO for
      VSEL1 control.
    maxItems: 1

  ti,enable-vout-discharge:
    description: Enable output discharge.
    type: boolean

  ti,enable-pull-down:
    description: Enable pull down.
    type: boolean

  ti,vsel0-state-high:
    description: |
      Initial state of VSEL0 input is high. If this property
      is missing, then assume the state as low.
    type: boolean

  ti,vsel1-state-high:
    description: |
      Initial state of VSEL1 input is high. If this property
      is missing, then assume the state as low.
    type: boolean

required:
  - compatible
  - reg

unevaluatedProperties: false

examples:
  - |
    #include <dt-bindings/gpio/gpio.h>
    i2c {
        #address-cells = <1>;
        #size-cells = <0>;

        regulator@60 {
            compatible = "ti,tps62361";
            reg = <0x60>;
            regulator-name = "tps62361-vout";
            regulator-min-microvolt = <500000>;
            regulator-max-microvolt = <1500000>;
            regulator-boot-on;
            ti,vsel0-gpio = <&gpio1 16 GPIO_ACTIVE_HIGH>;
            ti,vsel1-gpio = <&gpio1 17 GPIO_ACTIVE_HIGH>;
            ti,vsel0-state-high;
            ti,vsel1-state-high;
            ti,enable-pull-down;
            ti,enable-vout-discharge;
        };
    };

...
```
