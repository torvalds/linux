## Documentation/devicetree/bindings/regulator/samsung,s5m8767.txt
```
Binding for Samsung S5M8767 regulator block
===========================================

This is a part of device tree bindings for S5M family multi-function devices.
More information can be found in bindings/mfd/sec-core.txt file.

The S5M8767 device provide buck and LDO regulators.

To register these with regulator framework instantiate under main device node
a sub-node named "regulators" with more sub-nodes for each regulator using the
common regulator binding documented in:
 - Documentation/devicetree/bindings/regulator/regulator.txt


Required properties of the main device node (the parent!):
 - s5m8767,pmic-buck-ds-gpios: GPIO specifiers for three host gpio's used
   for selecting GPIO DVS lines. It is one-to-one mapped to dvs gpio lines.

 [1] If either of the 's5m8767,pmic-buck[2/3/4]-uses-gpio-dvs' optional
     property is specified, then all the eight voltage values for the
     's5m8767,pmic-buck[2/3/4]-dvs-voltage' should be specified.

Optional properties of the main device node (the parent!):
 - s5m8767,pmic-buck2-dvs-voltage: A set of 8 voltage values in micro-volt (uV)
   units for buck2 when changing voltage using gpio dvs. Refer to [1] below
   for additional information.

 - s5m8767,pmic-buck3-dvs-voltage: A set of 8 voltage values in micro-volt (uV)
   units for buck3 when changing voltage using gpio dvs. Refer to [1] below
   for additional information.

 - s5m8767,pmic-buck4-dvs-voltage: A set of 8 voltage values in micro-volt (uV)
   units for buck4 when changing voltage using gpio dvs. Refer to [1] below
   for additional information.

 - s5m8767,pmic-buck2-uses-gpio-dvs: 'buck2' can be controlled by gpio dvs.
 - s5m8767,pmic-buck3-uses-gpio-dvs: 'buck3' can be controlled by gpio dvs.
 - s5m8767,pmic-buck4-uses-gpio-dvs: 'buck4' can be controlled by gpio dvs.

Additional properties required if either of the optional properties are used:

 - s5m8767,pmic-buck-default-dvs-idx: Default voltage setting selected from
   the possible 8 options selectable by the dvs gpios. The value of this
   property should be between 0 and 7. If not specified or if out of range, the
   default value of this property is set to 0.

 - s5m8767,pmic-buck-dvs-gpios: GPIO specifiers for three host gpio's used
   for dvs. The format of the gpio specifier depends in the gpio controller.


Names of regulators supported by S5M8767 device:
	- LDOn
		  - valid values for n are 1 to 28
		  - Example: LDO1, LDO2, LDO28
	- BUCKn
		  - valid values for n are 1 to 9.
		  - Example: BUCK1, BUCK2, BUCK9
Note: The 'n' in LDOn and BUCKn represents the LDO or BUCK number
as per the datasheet of device.


Optional properties of the nodes under "regulators" sub-node:
 - op_mode: describes the different operating modes of the LDO's with
            power mode change in SOC. The different possible values are,
             0 - always off mode
             1 - on in normal mode
             2 - low power mode
             3 - suspend mode
 - s5m8767,pmic-ext-control-gpios: (optional) GPIO specifier for one
                                   GPIO controlling this regulator
                                   (enable/disable); This is valid only
                                   for buck9.

Example:

	s5m8767_pmic@66 {
		compatible = "samsung,s5m8767-pmic";
		reg = <0x66>;

		s5m8767,pmic-buck2-uses-gpio-dvs;
		s5m8767,pmic-buck3-uses-gpio-dvs;
		s5m8767,pmic-buck4-uses-gpio-dvs;

		s5m8767,pmic-buck-default-dvs-idx = <0>;

		s5m8767,pmic-buck-dvs-gpios = <&gpx0 0 0>, /* DVS1 */
						 <&gpx0 1 0>, /* DVS2 */
						 <&gpx0 2 0>; /* DVS3 */

		s5m8767,pmic-buck-ds-gpios = <&gpx2 3 0>, /* SET1 */
						<&gpx2 4 0>, /* SET2 */
						<&gpx2 5 0>; /* SET3 */

		s5m8767,pmic-buck2-dvs-voltage = <1350000>, <1300000>,
						 <1250000>, <1200000>,
						 <1150000>, <1100000>,
						 <1000000>, <950000>;

		s5m8767,pmic-buck3-dvs-voltage = <1100000>, <1100000>,
						 <1100000>, <1100000>,
						 <1000000>, <1000000>,
						 <1000000>, <1000000>;

		s5m8767,pmic-buck4-dvs-voltage = <1200000>, <1200000>,
						 <1200000>, <1200000>,
						 <1200000>, <1200000>,
						 <1200000>, <1200000>;

		regulators {
			ldo1_reg: LDO1 {
				regulator-name = "VDD_ABB_3.3V";
				regulator-min-microvolt = <3300000>;
				regulator-max-microvolt = <3300000>;
				op_mode = <1>; /* Normal Mode */
			};

			ldo2_reg: LDO2 {
				regulator-name = "VDD_ALIVE_1.1V";
				regulator-min-microvolt = <1100000>;
				regulator-max-microvolt = <1100000>;
				regulator-always-on;
			};

			buck1_reg: BUCK1 {
				regulator-name = "VDD_MIF_1.2V";
				regulator-min-microvolt = <950000>;
				regulator-max-microvolt = <1350000>;
				regulator-always-on;
				regulator-boot-on;
			};

			vemmc_reg: BUCK9 {
				regulator-name = "VMEM_VDD_2.8V";
				regulator-min-microvolt = <2800000>;
				regulator-max-microvolt = <2800000>;
				op_mode = <3>; /* Standby Mode */
				s5m8767,pmic-ext-control-gpios = <&gpk0 2 0>;
			};
		};
	};
```

## Documentation/devicetree/bindings/regulator/samsung,s5m8767.yaml
```yaml
# SPDX-License-Identifier: GPL-2.0-only OR BSD-2-Clause
%YAML 1.2
---
$id: http://devicetree.org/schemas/regulator/samsung,s5m8767.yaml#
$schema: http://devicetree.org/meta-schemas/core.yaml#

title: Samsung S5M8767 Power Management IC regulators

maintainers:
  - Krzysztof Kozlowski <krzk@kernel.org>

description: |
  This is a part of device tree bindings for S2M and S5M family of Power
  Management IC (PMIC).

  The S5M8767 provides buck and LDO regulators.

  See also Documentation/devicetree/bindings/mfd/samsung,s5m8767.yaml for
  additional information and example.

patternProperties:
  # 28 LDOs
  "^LDO([1-9]|1[0-9]|2[0-8])$":
    type: object
    $ref: regulator.yaml#
    unevaluatedProperties: false
    description:
      Properties for single LDO regulator.

    properties:
      op_mode:
        $ref: /schemas/types.yaml#/definitions/uint32
        enum: [0, 1, 2, 3]
        default: 1
        description: |
          Describes the different operating modes of the LDO's with power mode
          change in SOC. The different possible values are:
            0 - always off mode
            1 - on in normal mode
            2 - low power mode
            3 - suspend mode

    required:
      - regulator-name

  # 8 bucks
  "^BUCK[1-8]$":
    type: object
    $ref: regulator.yaml#
    unevaluatedProperties: false
    description:
      Properties for single BUCK regulator.

    properties:
      op_mode:
        $ref: /schemas/types.yaml#/definitions/uint32
        enum: [0, 1, 2, 3]
        default: 1
        description: |
          Describes the different operating modes of the regulator with power
          mode change in SOC. The different possible values are:
            0 - always off mode
            1 - on in normal mode
            2 - low power mode
            3 - suspend mode

    required:
      - regulator-name

properties:
  # 9 buck
  BUCK9:
    type: object
    $ref: regulator.yaml#
    unevaluatedProperties: false
    description:
      Properties for single BUCK regulator.

    properties:
      op_mode:
        $ref: /schemas/types.yaml#/definitions/uint32
        enum: [0, 1, 2, 3]
        default: 1
        description: |
          Describes the different operating modes of the regulator with power
          mode change in SOC. The different possible values are:
            0 - always off mode
            1 - on in normal mode
            2 - low power mode
            3 - suspend mode

      s5m8767,pmic-ext-control-gpios:
        maxItems: 1
        description: |
          GPIO specifier for one GPIO controlling this regulator on/off.

    required:
      - regulator-name

additionalProperties: false
```

## Documentation/devicetree/bindings/regulator/sgmicro,sgm3804.yaml
```yaml
# SPDX-License-Identifier: (GPL-2.0 OR BSD-2-Clause)
%YAML 1.2
---
$id: http://devicetree.org/schemas/regulator/sgmicro,sgm3804.yaml#
$schema: http://devicetree.org/meta-schemas/core.yaml#

title: SG Micro SGM3804 Single Inductor Dual Output Buck/Boost Converter

maintainers:
  - Neil Armstrong <neil.armstrong@linaro.org>

description:
  The SGM3804 is a dual voltage regulator, designed to support positive/negative
  supply for driving LCD panels. It support software-configurable output
  switching. The output voltages can be programmed via an I2C compatible interface.

properties:
  compatible:
    const: sgmicro,sgm3804

  reg:
    maxItems: 1

  vin-supply: true

patternProperties:
  "^(pos|neg)$":
    type: object
    $ref: regulator.yaml#

    properties:
      enable-gpios: true

    unevaluatedProperties: false

    required:
      - enable-gpios

required:
  - compatible
  - reg
  - pos
  - neg

additionalProperties: false

examples:
  - |
    #include <dt-bindings/gpio/gpio.h>

    i2c {
        #address-cells = <1>;
        #size-cells = <0>;

        regulator@3e {
            compatible = "sgmicro,sgm3804";
            reg = <0x3e>;

            vin-supply = <&vin_reg>;

            pos {
                regulator-name = "outpos";
                regulator-min-microvolt = <5000000>;
                regulator-max-microvolt = <5000000>;
                enable-gpios = <&gpio 17 GPIO_ACTIVE_HIGH>;
            };

            neg {
                regulator-name = "outneg";
                regulator-min-microvolt = <5000000>;
                regulator-max-microvolt = <5000000>;
                enable-gpios = <&gpio 18 GPIO_ACTIVE_HIGH>;
            };
        };
    };
...
```

## Documentation/devicetree/bindings/regulator/silergy,sy8106a.yaml
```yaml
# SPDX-License-Identifier: GPL-2.0
%YAML 1.2
---
$id: http://devicetree.org/schemas/regulator/silergy,sy8106a.yaml#
$schema: http://devicetree.org/meta-schemas/core.yaml#

title: Silergy SY8106A Voltage Regulator Device Tree Bindings

maintainers:
  - Ondrej Jirman <megous@megous.com>

allOf:
  - $ref: regulator.yaml#

properties:
  compatible:
    const: silergy,sy8106a

  reg:
    maxItems: 1

  silergy,fixed-microvolt:
    description: >
      The voltage when I2C regulating is disabled (set by external resistor
      like a fixed voltage)

required:
  - compatible
  - reg
  - silergy,fixed-microvolt

unevaluatedProperties: false

examples:
  - |
    i2c {
        #address-cells = <1>;
        #size-cells = <0>;

        regulator@65 {
            compatible = "silergy,sy8106a";
            reg = <0x65>;
            regulator-name = "sy8106a-vdd";
            silergy,fixed-microvolt = <1200000>;
            regulator-min-microvolt = <1000000>;
            regulator-max-microvolt = <1400000>;
            regulator-boot-on;
            regulator-always-on;
        };
    };

...
```

## Documentation/devicetree/bindings/regulator/silergy,sy8824x.yaml
```yaml
# SPDX-License-Identifier: (GPL-2.0-only OR BSD-2-Clause)
%YAML 1.2
---
$id: http://devicetree.org/schemas/regulator/silergy,sy8824x.yaml#
$schema: http://devicetree.org/meta-schemas/core.yaml#

title: silergy sy8824c,sy8824e,sy20276 and sy20278 PMIC

maintainers:
  - Jisheng Zhang <jszhang@kernel.org>

allOf:
  - $ref: regulator.yaml#

properties:
  compatible:
    enum:
      - silergy,sy8824c
      - silergy,sy8824e
      - silergy,sy20276
      - silergy,sy20278

  reg:
    maxItems: 1

required:
  - compatible
  - reg

unevaluatedProperties: false

examples:
  - |
    i2c {
        #address-cells = <1>;
        #size-cells = <0>;
        regulator@60 {
          compatible = "silergy,sy8824c";
          regulator-min-microvolt = <800000>;
          regulator-max-microvolt = <1150000>;
          reg = <0x60>;
        };
    };

...
```

## Documentation/devicetree/bindings/regulator/silergy,sy8827n.yaml
```yaml
# SPDX-License-Identifier: GPL-2.0
%YAML 1.2
---
$id: http://devicetree.org/schemas/regulator/silergy,sy8827n.yaml#
$schema: http://devicetree.org/meta-schemas/core.yaml#

title: silergy sy8827n PMIC

maintainers:
  - Jisheng Zhang <jszhang@kernel.org>

properties:
  compatible:
    enum:
      - silergy,sy8827n

  reg:
    maxItems: 1

  enable-gpios:
    description: GPIO to enable/disable the regulator.
    maxItems: 1

  silergy,vsel-state-high:
    type: boolean
    description:
      Indicates if the VSEL pin is set to high.
      If this property is missing, assume the VSEL pin is set to low.

required:
  - compatible
  - reg

examples:
  - |
    i2c {
        #address-cells = <1>;
        #size-cells = <0>;
        regulator@60 {
          compatible = "silergy,sy8827n";
          reg = <0x60>;
        };
    };

...
```

## Documentation/devicetree/bindings/regulator/siliconmitus,sm5703-regulator.yaml
```yaml
# SPDX-License-Identifier: GPL-2.0-only OR BSD-2-Clause
%YAML 1.2
---
$id: http://devicetree.org/schemas/regulator/siliconmitus,sm5703-regulator.yaml#
$schema: http://devicetree.org/meta-schemas/core.yaml#

title: Silicon Mitus SM5703 multi function device regulators

maintainers:
  - Markuss Broks <markuss.broks@gmail.com>

description: |
  SM5703 regulators node should be a sub node of the SM5703 MFD node. See SM5703 MFD
  bindings at Documentation/devicetree/bindings/mfd/siliconmitus,sm5703.yaml
  Regulator nodes should be named as USBLDO_<number>, BUCK, VBUS, LDO_<number>.
  The definition for each of these nodes is defined using the standard
  binding for regulators at Documentation/devicetree/bindings/regulator/regulator.txt.

properties:
  buck:
    type: object
    $ref: regulator.yaml#
    unevaluatedProperties: false
    description:
      Properties for the BUCK regulator.

  vbus:
    type: object
    $ref: regulator.yaml#
    unevaluatedProperties: false
    description:
      Properties for the VBUS regulator.

patternProperties:
  "^ldo[1-3]$":
    type: object
    $ref: regulator.yaml#
    unevaluatedProperties: false
    description:
      Properties for single LDO regulator.

  "^usbldo[1-2]$":
    type: object
    $ref: regulator.yaml#
    unevaluatedProperties: false
    description:
      Properties for a single USBLDO regulator.

additionalProperties: false
```

## Documentation/devicetree/bindings/regulator/sky81452-regulator.txt
```
SKY81452 voltage regulator

Required properties:
- regulator node named lout.
- any required generic properties defined in regulator.txt

Optional properties:
- any available generic properties defined in regulator.txt

Example:

	regulator {
		lout {
			regulator-name = "sky81452-lout";
			regulator-min-microvolt = <4500000>;
			regulator-max-microvolt = <8000000>;
		};
	};
```
