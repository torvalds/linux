## Documentation/devicetree/bindings/regulator/richtek,rt4801-regulator.yaml
```yaml
# SPDX-License-Identifier: GPL-2.0-only OR BSD-2-Clause
%YAML 1.2
---
$id: http://devicetree.org/schemas/regulator/richtek,rt4801-regulator.yaml#
$schema: http://devicetree.org/meta-schemas/core.yaml#

title: Richtek RT4801 Display Bias regulators

maintainers:
  - ChiYuan Huang <cy_huang@richtek.com>

description: |
  Regulator nodes should be named to DSVP and DSVN. The
  definition for each of these nodes is defined using the standard
  binding for regulators at
  Documentation/devicetree/bindings/regulator/regulator.txt.
  Datasheet is available at
  https://www.richtek.com/assets/product_file/RT4801H/DS4801H-00.pdf

properties:
  compatible:
    enum:
      - richtek,rt4801

  reg:
    maxItems: 1

  enable-gpios:
    description: GPIOs to use to enable DSVP/DSVN regulator.
      The first one is ENP to enable DSVP, and second one is ENM to enable DSVN.
      Number of GPIO in the array list could be 1 or 2.
      If only one gpio is specified, only one gpio used to control ENP/ENM.
      Else if both are specified, DSVP/DSVN could be controlled individually.
      If this property not specified, treat both as always-on regulators.

      Property is deprecated. Use enable-gpios in each regulator.
    minItems: 1
    maxItems: 2
    deprecated: true

patternProperties:
  "^DSV(P|N)$":
    type: object
    $ref: regulator.yaml#
    unevaluatedProperties: false
    description:
      Properties for single display bias regulator.

    properties:
      enable-gpios:
        description:
          GPIO to use to enable DSVP/DSVN regulator. One GPIO can be configured
          for controlling both regulators.  If this property not specified for
          any regulator, treat both as always-on regulators.
        maxItems: 1

required:
  - compatible
  - reg

additionalProperties: false

examples:
  - |
    i2c {
        #address-cells = <1>;
        #size-cells = <0>;

        rt4801@73 {
            compatible = "richtek,rt4801";
            reg = <0x73>;

            dsvp: DSVP {
                regulator-name = "rt4801,dsvp";
                regulator-min-microvolt = <4000000>;
                regulator-max-microvolt = <6000000>;
                regulator-boot-on;
                enable-gpios = <&gpio26 2 0>;
            };
            dsvn: DSVN {
                regulator-name = "rt4801,dsvn";
                regulator-min-microvolt = <4000000>;
                regulator-max-microvolt = <6000000>;
                regulator-boot-on;
                enable-gpios = <&gpio26 3 0>;
            };

        };
    };
```

## Documentation/devicetree/bindings/regulator/richtek,rt4803.yaml
```yaml
# SPDX-License-Identifier: GPL-2.0-only OR BSD-2-Clause
%YAML 1.2
---
$id: http://devicetree.org/schemas/regulator/richtek,rt4803.yaml#
$schema: http://devicetree.org/meta-schemas/core.yaml#

title: Richtek RT4803 Boost Regulator

maintainers:
  - ChiYuan Huang <cy_huang@richtek.com>

description: |
  RT4803 is a boost regulator that's designed to provide the minimum output
  voltage, even if the input voltage is lower than the required voltage. It
  supports boost and auto bypass mode that depends on the difference between the
  input and output voltage. If the input is lower than the output, mode will
  transform to boost mode. Otherwise, turn on bypass switch to enter bypass mode.

  Datasheet is available at
  https://www.richtek.com/assets/product_file/RT4803/DS4803-03.pdf
  https://www.richtek.com/assets/product_file/RT4803A/DS4803A-06.pdf

allOf:
  - $ref: regulator.yaml#

properties:
  compatible:
    enum:
      - richtek,rt4803

  reg:
    maxItems: 1

  richtek,vsel-active-high:
    type: boolean
    description: Specify the VSEL register group is using when system is active

  regulator-allowed-modes:
    description: |
      Available operating mode
        1: Auto PFM/PWM
        2: Force PWM
    items:
      enum: [1, 2]

required:
  - compatible
  - reg

unevaluatedProperties: false

examples:
  - |
    i2c {
      #address-cells = <1>;
      #size-cells = <0>;

      regulator@75 {
        compatible = "richtek,rt4803";
        reg = <0x75>;
        richtek,vsel-active-high;
        regulator-name = "rt4803-regulator";
        regulator-min-microvolt = <2850000>;
        regulator-max-microvolt = <4400000>;
        regulator-allowed-modes = <1 2>;
        regulator-always-on;
      };
    };
```

## Documentation/devicetree/bindings/regulator/richtek,rt5133.yaml
```yaml
# SPDX-License-Identifier: GPL-2.0-only OR BSD-2-Clause
%YAML 1.2
---
$id: http://devicetree.org/schemas/regulator/richtek,rt5133.yaml#
$schema: http://devicetree.org/meta-schemas/core.yaml#

title: Richtek RT5133 PMIC Regulator

maintainers:
  - ShihChia Chang <jeff_chang@richtek.com>

description:
  The RT5133 is an integrated Power Management IC for portable devices,
  featuring 8 LDOs and 3 GPOs. It allows programmable output voltages,
  soft-start times, and protections via I2C. GPO operation depends on LDO1
  voltage.

properties:
  compatible:
    enum:
      - richtek,rt5133

  reg:
    maxItems: 1

  enable-gpios:
    maxItems: 1

  wakeup-source: true

  interrupts:
    maxItems: 1

  gpio-controller: true

  "#gpio-cells":
    const: 2

  richtek,oc-shutdown-all:
    type: boolean
    description:
      Controls the behavior when any LDO (Low Dropout Regulator) enters an
      Over Current state.
      If set to true, all LDO channels will be shut down.
      If set to false, only the affected LDO channel will shut down itself.

  richtek,pgb-shutdown-all:
    type: boolean
    description:
      Controls the behavior when any LDO enters a Power Good Bad state.
      If set to true, all LDO channels will be shut down.
      If set to false, only the affected LDO channel will shut down itself.

  regulators:
    type: object
    additionalProperties: false

    properties:
      base:
        type: object
        $ref: regulator.yaml#
        unevaluatedProperties: false
        description:
          Properties for the base regulator, which is the top-level supply for
          LDO1 to LDO6. It functions merely as an on/off switch rather than
          regulating voltages. If none of LDO1 to LDO6 are in use, switching
          off the base will reduce the quiescent current.

        required:
          - regulator-name

    patternProperties:
      "^ldo([1-6])$":
        type: object
        $ref: regulator.yaml#
        unevaluatedProperties: false
        description:
          Properties for single LDO regulator

        required:
          - regulator-name

      "^ldo([7-8])$":
        type: object
        $ref: regulator.yaml#
        unevaluatedProperties: false
        description:
          Properties for single LDO regulator

        properties:
          vin-supply: true

        required:
          - regulator-name
          - vin-supply

required:
  - compatible
  - reg
  - interrupts

additionalProperties: false

examples:
  - |
    #include <dt-bindings/interrupt-controller/irq.h>
    #include <dt-bindings/gpio/gpio.h>
    i2c {
      #address-cells = <1>;
      #size-cells = <0>;

      pmic@18 {
        compatible = "richtek,rt5133";
        reg = <0x18>;
        wakeup-source;
        interrupts-extended = <&gpio 0 IRQ_TYPE_EDGE_FALLING>;
        enable-gpios = <&gpio 2 GPIO_ACTIVE_HIGH>;
        gpio-controller;
        #gpio-cells = <2>;
        richtek,oc-shutdown-all;
        richtek,pgb-shutdown-all;
        regulators {
          base {
            regulator-name = "base";
          };
          pvin78: ldo1 {
            regulator-name = "ldo1";
            regulator-min-microvolt = <1800000>;
            regulator-max-microvolt = <3199998>;
            regulator-active-discharge = <1>;
          };
          ldo2 {
            regulator-name = "ldo2";
            regulator-min-microvolt = <1800000>;
            regulator-max-microvolt = <3200000>;
            regulator-active-discharge = <1>;
          };
          ldo3 {
            regulator-name = "ldo3";
            regulator-min-microvolt = <1700000>;
            regulator-max-microvolt = <3000000>;
            regulator-active-discharge = <1>;
          };
          ldo4 {
            regulator-name = "ldo4";
            regulator-min-microvolt = <1700000>;
            regulator-max-microvolt = <3000000>;
            regulator-active-discharge = <1>;
          };
          ldo5 {
            regulator-name = "ldo5";
            regulator-min-microvolt = <1700000>;
            regulator-max-microvolt = <3000000>;
            regulator-active-discharge = <1>;
          };
          ldo6 {
            regulator-name = "ldo6";
            regulator-min-microvolt = <1700000>;
            regulator-max-microvolt = <3000000>;
            regulator-active-discharge = <1>;
          };
          ldo7 {
            regulator-name = "ldo7";
            regulator-min-microvolt = <900000>;
            regulator-max-microvolt = <1200000>;
            regulator-active-discharge = <1>;
            vin-supply = <&pvin78>;
          };
          ldo8 {
            regulator-name = "ldo8";
            regulator-min-microvolt = <855000>;
            regulator-max-microvolt = <1200000>;
            regulator-active-discharge = <1>;
            vin-supply = <&pvin78>;
          };
        };
      };
    };
```

## Documentation/devicetree/bindings/regulator/richtek,rt5190a-regulator.yaml
```yaml
# SPDX-License-Identifier: GPL-2.0-only OR BSD-2-Clause
%YAML 1.2
---
$id: http://devicetree.org/schemas/regulator/richtek,rt5190a-regulator.yaml#
$schema: http://devicetree.org/meta-schemas/core.yaml#

title: Richtek RT5190A PMIC Regulator

maintainers:
  - ChiYuan Huang <cy_huang@richtek.com>

description: |
  The RT5190A integrates 1 channel buck controller, 3 channels high efficiency
  synchronous buck converters, 1 LDO, I2C control interface and peripherial
  logical control.

  It also supports mute AC OFF depop sound and quick setting storage while
  input power is removed.

properties:
  compatible:
    enum:
      - richtek,rt5190a

  reg:
    maxItems: 1

  interrupts:
    maxItems: 1

  vin2-supply:
    description: phandle to buck2 input voltage.

  vin3-supply:
    description: phandle to buck3 input voltage.

  vin4-supply:
    description: phandle to buck4 input voltage.

  vinldo-supply:
    description: phandle to ldo input voltage

  richtek,mute-enable:
    description: |
      The mute function uses 'mutein', 'muteout', and 'vdet' pins as the control
      signal. When enabled, The normal behavior is to bypass the 'mutein' signal
      'muteout'. But if the power source removal is detected from 'vdet',
      whatever the 'mutein' signal is, it will pull down the 'muteout' to force
      speakers mute. this function is commonly used to prevent the speaker pop
      noise during AC power turned off in the modern TV system design.
    type: boolean

  regulators:
    type: object

    patternProperties:
      "^buck[1-4]$|^ldo$":
        type: object
        $ref: regulator.yaml#
        description: |
          regulator description for buck1 and buck4.

        properties:
          regulator-allowed-modes:
            description: |
             buck operating mode, only buck1/4 support mode operating.
              0: auto mode
              1: force pwm mode
            items:
              enum: [0, 1]

          richtek,latchup-enable:
            type: boolean
            description: |
              If specified, undervolt protection mode changes from the default
              hiccup to latchup.

        unevaluatedProperties: false

    additionalProperties: false

required:
  - compatible
  - reg
  - regulators

additionalProperties: false

examples:
  - |
    #include <dt-bindings/interrupt-controller/irq.h>
    #include <dt-bindings/regulator/richtek,rt5190a-regulator.h>

    i2c {
      #address-cells = <1>;
      #size-cells = <0>;

      pmic@64 {
        compatible = "richtek,rt5190a";
        reg = <0x64>;
        interrupts-extended = <&gpio26 0 IRQ_TYPE_LEVEL_LOW>;
        vin2-supply = <&rt5190_buck1>;
        vin3-supply = <&rt5190_buck1>;
        vin4-supply = <&rt5190_buck1>;

        regulators {
          rt5190_buck1: buck1 {
            regulator-name = "rt5190a-buck1";
            regulator-min-microvolt = <5090000>;
            regulator-max-microvolt = <5090000>;
            regulator-allowed-modes = <RT5190A_OPMODE_AUTO RT5190A_OPMODE_FPWM>;
            regulator-boot-on;
          };
          buck2 {
            regulator-name = "rt5190a-buck2";
            regulator-min-microvolt = <600000>;
            regulator-max-microvolt = <1400000>;
            regulator-boot-on;
          };
          buck3 {
            regulator-name = "rt5190a-buck3";
            regulator-min-microvolt = <600000>;
            regulator-max-microvolt = <1400000>;
            regulator-boot-on;
          };
          buck4 {
            regulator-name = "rt5190a-buck4";
            regulator-min-microvolt = <850000>;
            regulator-max-microvolt = <850000>;
            regulator-allowed-modes = <RT5190A_OPMODE_AUTO RT5190A_OPMODE_FPWM>;
            regulator-boot-on;
          };
          ldo {
            regulator-name = "rt5190a-ldo";
            regulator-min-microvolt = <1200000>;
            regulator-max-microvolt = <1200000>;
            regulator-boot-on;
          };
        };
      };
    };
```

## Documentation/devicetree/bindings/regulator/richtek,rt5739.yaml
```yaml
# SPDX-License-Identifier: GPL-2.0-only OR BSD-2-Clause
%YAML 1.2
---
$id: http://devicetree.org/schemas/regulator/richtek,rt5739.yaml#
$schema: http://devicetree.org/meta-schemas/core.yaml#

title: Richtek RT5739 Step-Down Buck Converter

maintainers:
  - ChiYuan Huang <cy_huang@richtek.com>

description: |
  The RT5739 is a step-down switching buck converter that can deliver the
  programmable output voltage from 300mV to 1300mV with wide input voltage
  supply of 2.5V to 5.5V. It can provide up to 3.5A continuous current
  capability at over 80% high efficiency.

allOf:
  - $ref: regulator.yaml#

properties:
  compatible:
    enum:
      - richtek,rt5733
      - richtek,rt5739

  reg:
    maxItems: 1

  enable-gpios:
    maxItems: 1

  richtek,vsel-active-high:
    description: |
      If property is present, use the 'VSEL1' register group for buck control.
      Else, use the 'VSEL0' register group. This depends on external hardware
      'VSEL' pin connection.
    type: boolean

  regulator-allowed-modes:
    description: |
      buck allowed operating mode
        0: Auto PFM/PWM mode
        1: Forced PWM mode
    items:
      enum: [0, 1]

required:
  - compatible
  - reg

unevaluatedProperties: false

examples:
  - |
    #include <dt-bindings/gpio/gpio.h>

    i2c {
      #address-cells = <1>;
      #size-cells = <0>;

      regulator@50 {
        compatible = "richtek,rt5739";
        reg = <0x50>;
        enable-gpios = <&gpio26 1 GPIO_ACTIVE_HIGH>;
        richtek,vsel-active-high;
        regulator-name = "richtek,rt5739-buck";
        regulator-min-microvolt = <300000>;
        regulator-max-microvolt = <1300000>;
        regulator-allowed-modes = <0 1>;
        regulator-boot-on;
      };
    };
```
