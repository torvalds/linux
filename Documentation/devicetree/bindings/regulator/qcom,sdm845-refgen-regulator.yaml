## Documentation/devicetree/bindings/regulator/richtek,rt5759-regulator.yaml
```yaml
# SPDX-License-Identifier: GPL-2.0-only OR BSD-2-Clause
%YAML 1.2
---
$id: http://devicetree.org/schemas/regulator/richtek,rt5759-regulator.yaml#
$schema: http://devicetree.org/meta-schemas/core.yaml#

title: Richtek RT5759 High Performance DCDC Converter

maintainers:
  - ChiYuan Huang <cy_huang@richtek.com>

description: |
  The RT5759 is a high-performance, synchronous step-down DC-DC converter that
  can deliver up to 9A output current from 3V to 6.5V input supply, The output
  voltage can be programmable with I2C controlled 7-Bit VID.

  Datasheet is available at
  https://www.richtek.com/assets/product_file/RT5759/DS5759-00.pdf

properties:
  compatible:
    enum:
      - richtek,rt5759
      - richtek,rt5759a

  reg:
    maxItems: 1

  regulator-allowed-modes:
    description: |
      buck allowed operating mode
        0: auto mode (PSKIP: pulse skipping)
        1: force pwm mode
    items:
      enum: [0, 1]

  richtek,watchdog-enable:
    description: enable the external watchdog reset pin listening
    type: boolean

allOf:
  - $ref: regulator.yaml#

  - if:
      properties:
        compatible:
          contains:
            const: richtek,rt5759
    then:
      properties:
        richtek,watchdog-enable: false

required:
  - compatible
  - reg

unevaluatedProperties: false

examples:
  # example 1 for RT5759
  - |
    i2c {
      #address-cells = <1>;
      #size-cells = <0>;

      regulator@62 {
        compatible = "richtek,rt5759";
        reg = <0x62>;
        regulator-name = "rt5759-buck";
        regulator-min-microvolt = <600000>;
        regulator-max-microvolt = <1500000>;
        regulator-boot-on;
      };
    };
  # example 2 for RT5759A
  - |
    i2c {
      #address-cells = <1>;
      #size-cells = <0>;

      regulator@62 {
        compatible = "richtek,rt5759a";
        reg = <0x62>;
        regulator-name = "rt5759a-buck";
        regulator-min-microvolt = <600000>;
        regulator-max-microvolt = <1725000>;
        regulator-boot-on;
        richtek,watchdog-enable;
      };
    };
```

## Documentation/devicetree/bindings/regulator/richtek,rt6160-regulator.yaml
```yaml
# SPDX-License-Identifier: GPL-2.0-only OR BSD-2-Clause
%YAML 1.2
---
$id: http://devicetree.org/schemas/regulator/richtek,rt6160-regulator.yaml#
$schema: http://devicetree.org/meta-schemas/core.yaml#

title: Richtek RT6160 BuckBoost converter

maintainers:
  - ChiYuan Huang <cy_huang@richtek.com>

description: |
  The RT6160 is a high-efficiency buck-boost converter that can provide
  up to 3A output current from 2025mV to 5200mV. And it support the wide
  input voltage range from 2200mV to 5500mV.

  Datasheet is available at
  https://www.richtek.com/assets/product_file/RT6160A/DS6160A-00.pdf

allOf:
  - $ref: regulator.yaml#

properties:
  compatible:
    enum:
      - richtek,rt6160

  reg:
    maxItems: 1

  enable-gpios:
    description: A connection of the 'enable' gpio line.
    maxItems: 1

  richtek,vsel-active-low:
    description: |
      Used to indicate the 'vsel' pin active level. if not specified, use
      high active level as the default.
    type: boolean

required:
  - compatible
  - reg

unevaluatedProperties: false

examples:
  - |
    i2c {
      #address-cells = <1>;
      #size-cells = <0>;

      rt6160@75 {
        compatible = "richtek,rt6160";
        reg = <0x75>;
        enable-gpios = <&gpio26 2 0>;
        regulator-name = "rt6160-buckboost";
        regulator-min-microvolt = <2025000>;
        regulator-max-microvolt = <5200000>;
      };
    };
```

## Documentation/devicetree/bindings/regulator/richtek,rt6190.yaml
```yaml
# SPDX-License-Identifier: GPL-2.0-only OR BSD-2-Clause
%YAML 1.2
---
$id: http://devicetree.org/schemas/regulator/richtek,rt6190.yaml#
$schema: http://devicetree.org/meta-schemas/core.yaml#

title: Richtek RT6190 4-Switch BuckBoost controller

maintainers:
  - ChiYuan Huang <cy_huang@richtek.com>

description: |
  The RT6190 is 4-Switch BuckBoost controller designed for converting input
  voltage to output voltage that can be equal to, higher or lower than input
  voltage. It operates with wide input voltage range from 4.5V to 36V, and
  the output voltage can be set from 3V to 36V by external FB pin. It's commonly
  used for the application like as BuckBoost bus supply, docking station and USB
  power delivery product.

  Datasheet is available at
  https://www.richtek.com/assets/product_file/RT6190/DS6190-02.pdf

allOf:
  - $ref: regulator.yaml#

properties:
  compatible:
    enum:
      - richtek,rt6190

  reg:
    maxItems: 1

  enable-gpios:
    maxItems: 1

  wakeup-source: true

  interrupts:
    maxItems: 1

  regulator-allowed-modes:
    description: |
      buck allowed operating mode
        0: PSM mode (light load Power Saving Mode)
        1: FCCM mode (Forced-CCM mode)
    maxItems: 2
    items:
      enum: [0, 1]

required:
  - compatible
  - reg

unevaluatedProperties: false

examples:
  - |
    #include <dt-bindings/gpio/gpio.h>
    #include <dt-bindings/interrupt-controller/irq.h>

    i2c {
      #address-cells = <1>;
      #size-cells = <0>;

      regulator@2c {
        compatible = "richtek,rt6190";
        reg = <0x2c>;
        wakeup-source;
        interrupts-extended = <&gpio26 0 IRQ_TYPE_LEVEL_LOW>;
        enable-gpios = <&gpio26 1 GPIO_ACTIVE_HIGH>;
        regulator-name = "richtek,rt6190-buckboost";
        regulator-min-microvolt = <3000000>;
        regulator-max-microvolt = <32000000>;
        regulator-min-microamp = <306000>;
        regulator-max-microamp = <12114000>;
        regulator-allowed-modes = <0 1>;
      };
    };
```

## Documentation/devicetree/bindings/regulator/richtek,rt6245-regulator.yaml
```yaml
# SPDX-License-Identifier: GPL-2.0-only OR BSD-2-Clause
%YAML 1.2
---
$id: http://devicetree.org/schemas/regulator/richtek,rt6245-regulator.yaml#
$schema: http://devicetree.org/meta-schemas/core.yaml#

title: Richtek RT6245 High Current Voltage Regulator

maintainers:
  - ChiYuan Huang <cy_huang@richtek.com>

description: |
  The RT6245 is a high-performance, synchronous step-down converter
  that can deliver up to 14A output current with an input supply
  voltage range of 4.5V to 17V.

allOf:
  - $ref: regulator.yaml#

properties:
  compatible:
    enum:
      - richtek,rt6245

  reg:
    maxItems: 1

  enable-gpios:
    description: |
      A connection of the chip 'enable' gpio line. If not provided,
      it will be treat as a default-on power.
    maxItems: 1

  richtek,oc-level-select:
    $ref: "/schemas/types.yaml#/definitions/uint8"
    enum: [0, 1, 2, 3]
    description: |
      Over current level selection. Each respective value means the current
      limit 8A, 14A, 12A, 10A. If this property is missing then keep in
      in chip default.

  richtek,ot-level-select:
    $ref: "/schemas/types.yaml#/definitions/uint8"
    enum: [0, 1, 2]
    description: |
      Over temperature level selection. Each respective value means the degree
      150'c, 130'c, 170'c. If this property is missing then keep in chip
      default.

  richtek,pgdly-time-select:
    $ref: "/schemas/types.yaml#/definitions/uint8"
    enum: [0, 1, 2, 3]
    description: |
      Power good signal delay time selection. Each respective value means the
      delay time 0us, 10us, 20us, 40us. If this property is missing then keep
      in chip default.


  richtek,switch-freq-select:
    $ref: "/schemas/types.yaml#/definitions/uint8"
    enum: [0, 1, 2]
    description: |
      Buck switch frequency selection. Each respective value means 400KHz,
      800KHz, 1200KHz. If this property is missing then keep in chip default.

required:
  - compatible
  - reg

unevaluatedProperties: false

examples:
  - |
    i2c {
      #address-cells = <1>;
      #size-cells = <0>;

      rt6245@34 {
        compatible = "richtek,rt6245";
        status = "okay";
        reg = <0x34>;
        enable-gpios = <&gpio26 2 0>;

        regulator-name = "rt6245-regulator";
        regulator-min-microvolt = <437500>;
        regulator-max-microvolt = <1387500>;
        regulator-boot-on;
      };
    };
```
