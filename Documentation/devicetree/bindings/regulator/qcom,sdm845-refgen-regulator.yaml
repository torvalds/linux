## Documentation/devicetree/bindings/regulator/qcom-labibb-regulator.yaml
```yaml
# SPDX-License-Identifier: GPL-2.0-only OR BSD-2-Clause
%YAML 1.2
---
$id: http://devicetree.org/schemas/regulator/qcom-labibb-regulator.yaml#
$schema: http://devicetree.org/meta-schemas/core.yaml#

title: Qualcomm's LAB(LCD AMOLED Boost)/IBB(Inverting Buck Boost) Regulator

maintainers:
  - Sumit Semwal <sumit.semwal@linaro.org>

description:
  LAB can be used as a positive boost power supply and IBB can be used as a
  negative boost power supply for display panels. Currently implemented for
  pmi8998.

properties:
  compatible:
    oneOf:
      - const: qcom,pmi8998-lab-ibb
      - items:
          - enum:
              - qcom,pmi8950-lab-ibb
          - const: qcom,pmi8998-lab-ibb

  lab:
    type: object
    $ref: regulator.yaml#
    unevaluatedProperties: false

    properties:
      qcom,soft-start-us:
        description: Regulator soft start time in microseconds.
        enum: [200, 400, 600, 800]
        default: 200

      interrupts:
        minItems: 1
        maxItems: 2
        description:
          Short-circuit and over-current interrupts for lab.

      interrupt-names:
        minItems: 1
        items:
          - const: sc-err
          - const: ocp

    required:
      - interrupts
      - interrupt-names

  ibb:
    type: object
    $ref: regulator.yaml#
    unevaluatedProperties: false

    properties:
      qcom,discharge-resistor-kohms:
        $ref: /schemas/types.yaml#/definitions/uint32
        description: Discharge resistor value in KiloOhms.
        enum: [300, 64, 32, 16]
        default: 300

      interrupts:
        minItems: 1
        maxItems: 2
        description:
          Short-circuit and over-current interrupts for ibb.

      interrupt-names:
        minItems: 1
        items:
          - const: sc-err
          - const: ocp

    required:
      - interrupts
      - interrupt-names

required:
  - compatible

additionalProperties: false

examples:
  - |
    #include <dt-bindings/interrupt-controller/irq.h>

    labibb {
      compatible = "qcom,pmi8998-lab-ibb";

      lab {
        interrupts = <0x3 0xde 0x1 IRQ_TYPE_EDGE_RISING>,
                     <0x3 0xde 0x0 IRQ_TYPE_LEVEL_LOW>;
        interrupt-names = "sc-err", "ocp";
      };

      ibb {
        interrupts = <0x3 0xdc 0x2 IRQ_TYPE_EDGE_RISING>,
                     <0x3 0xdc 0x0 IRQ_TYPE_LEVEL_LOW>;
        interrupt-names = "sc-err", "ocp";
      };
    };

...
```

## Documentation/devicetree/bindings/regulator/raspberrypi,7inch-touchscreen-panel-regulator-v2.yaml
```yaml
# SPDX-License-Identifier: (GPL-2.0-only OR BSD-2-Clause)
%YAML 1.2
---
$id: http://devicetree.org/schemas/regulator/raspberrypi,7inch-touchscreen-panel-regulator-v2.yaml#
$schema: http://devicetree.org/meta-schemas/core.yaml#

title: RaspberryPi 5" and 7" display V2 MCU-based regulator/backlight controller

maintainers:
  - Marek Vasut <marek.vasut+renesas@mailbox.org>

description: |
  The RaspberryPi 5" and 7" display 2 has an MCU-based regulator, PWM
  backlight and GPIO controller on the PCB, which is used to turn the
  display unit on/off and control the backlight.

allOf:
  - $ref: regulator.yaml#

properties:
  compatible:
    const: raspberrypi,touchscreen-panel-regulator-v2

  reg:
    maxItems: 1

  gpio-controller: true
  "#gpio-cells":
    const: 2
    description:
      The first cell is the pin number, and the second cell is used to
      specify the gpio polarity (GPIO_ACTIVE_HIGH or GPIO_ACTIVE_LOW).

  "#pwm-cells":
    const: 3
    description: See ../../pwm/pwm.yaml for description of the cell formats.

additionalProperties: false

required:
  - compatible
  - reg
  - gpio-controller
  - "#gpio-cells"
  - "#pwm-cells"

examples:
  - |
    i2c {
      #address-cells = <1>;
      #size-cells = <0>;
      regulator@45 {
        compatible = "raspberrypi,touchscreen-panel-regulator-v2";
        reg = <0x45>;
        gpio-controller;
        #gpio-cells = <2>;
        #pwm-cells = <3>;
      };
    };

...
```

## Documentation/devicetree/bindings/regulator/raspberrypi,7inch-touchscreen-panel-regulator.yaml
```yaml
# SPDX-License-Identifier: (GPL-2.0-only OR BSD-2-Clause)
%YAML 1.2
---
$id: http://devicetree.org/schemas/regulator/raspberrypi,7inch-touchscreen-panel-regulator.yaml#
$schema: http://devicetree.org/meta-schemas/core.yaml#

title: RaspberryPi 7" display ATTINY88-based regulator/backlight controller

maintainers:
  - Marek Vasut <marex@denx.de>

description: |
  The RaspberryPi 7" display has an ATTINY88-based regulator/backlight
  controller on the PCB, which is used to turn the display unit on/off
  and control the backlight.

allOf:
  - $ref: regulator.yaml#

properties:
  compatible:
    const: raspberrypi,7inch-touchscreen-panel-regulator

  reg:
    maxItems: 1

additionalProperties: false

required:
  - compatible
  - reg

examples:
  - |
    i2c {
      #address-cells = <1>;
      #size-cells = <0>;
      regulator@45 {
        compatible = "raspberrypi,7inch-touchscreen-panel-regulator";
        reg = <0x45>;
      };
    };

...
```

## Documentation/devicetree/bindings/regulator/regulator-max77620.txt
```
Regulator DT binding for MAX77620 Power management IC from Maxim Semiconductor.

Device has multiple DCDC(sd[0-3] and LDOs(ldo[0-8]). The input supply
of these regulators are defined under parent device node.
Details of regulator properties are defined as child node under
sub-node "regulators" which is child node of device node.

Please refer file <Documentation/devicetree/bindings/regulator/regulator.txt>
for common regulator bindings used by client.

Following are properties of parent node related to regulators.

Optional properties:
-------------------
The input supply of regulators are the optional properties on the
parent device node. The input supply of these regulators are provided
through following properties:
in-sd0-supply:		Input supply for SD0, INA-SD0 or INB-SD0 pins.
in-sd1-supply:		Input supply for SD1.
in-sd2-supply:		Input supply for SD2.
in-sd3-supply:		Input supply for SD3.
in-ldo0-1-supply:	Input supply for LDO0 and LDO1.
in-ldo2-supply:		Input supply for LDO2.
in-ldo3-5-supply:	Input supply for LDO3 and LDO5
in-ldo4-6-supply:	Input supply for LDO4 and LDO6.
in-ldo7-8-supply:	Input supply for LDO7 and LDO8.

Optional sub nodes for regulators under "regulators" subnode:
------------------------------------------------------------
The subnodes name is the name of regulator and it must be one of:
	sd[0-3], ldo[0-8]

Each sub-node should contain the constraints and initialization
information for that regulator. The definition for each of these
nodes is defined using the standard binding for regulators found at
<Documentation/devicetree/bindings/regulator/regulator.txt>.

There are also additional properties for SD/LDOs. These additional properties
are required to configure FPS configuration parameters for SDs and LDOs.
Please refer <devicetree/bindings/mfd/max77620.txt> for more detail of Flexible
Power Sequence (FPS).
Following are additional properties:

- maxim,active-fps-source:		FPS source for the regulators to get
					enabled/disabled when system is in
					active state.  Valid values are:
					- MAX77620_FPS_SRC_0,
						FPS source is FPS0.
					- MAX77620_FPS_SRC_1,
						FPS source is FPS1
					- MAX77620_FPS_SRC_2 and
						FPS source is FPS2
					- MAX77620_FPS_SRC_NONE.
						Regulator is not controlled
						by FPS events and it gets
						enabled/disabled by register
						access.
					Absence of this property will leave
					the FPS configuration register for that
					regulator to default configuration.

- maxim,active-fps-power-up-slot:	Sequencing event slot number on which
					the regulator get enabled when
					master FPS input event set to HIGH.
					Valid values are 0 to 7.
					This is applicable if FPS source is
					selected as FPS0, FPS1 or FPS2.
			
- maxim,active-fps-power-down-slot:	Sequencing event slot number on which
					the regulator get disabled when master
					FPS input event set to LOW.
					Valid values are 0 to 7.
					This is applicable if FPS source is
					selected as FPS0, FPS1 or FPS2.
			
- maxim,suspend-fps-source:		This is same as property
					"maxim,active-fps-source" but value
					get configured when system enters in
					to suspend state.

- maxim,suspend-fps-power-up-slot:	This is same as property
					"maxim,active-fps-power-up-slot" but
					this value get configured into FPS
					configuration register when system
					enters into suspend.
					This is applicable if suspend state
					FPS source is selected as FPS0, FPS1 or

- maxim,suspend-fps-power-down-slot:	This is same as property
					"maxim,active-fps-power-down-slot" but
					this value get configured into FPS
					configuration register when system
					enters into suspend.
					This is applicable if suspend state
					FPS source is selected as FPS0, FPS1 or
					FPS2.
- maxim,ramp-rate-setting:		integer, ramp rate(uV/us) setting to be
					configured to the device.
					The platform may have different ramp
					rate than advertised ramp rate if it has
					design variation from Maxim's
					recommended. On this case, platform
					specific ramp rate is used for ramp time
					calculation and this property is used
					for device register configurations.
					The measured ramp rate of platform is
					provided by the regulator-ramp-delay
					as described in <devicetree/bindings/
					regulator/regulator.txt>.
					Maxim Max77620 supports following ramp
					delay:
					  SD: 13.75mV/us, 27.5mV/us, 55mV/us
					  LDOs: 5mV/us, 100mV/us

Note: If the measured ramp delay is same as advertised ramp delay then it is not
required to provide the ramp delay with property "maxim,ramp-rate-setting". The
ramp rate can be provided by the regulator-ramp-delay which will be used for
ramp time calculation for voltage change as well as for device configuration.

Example:
--------
#include <dt-bindings/mfd/max77620.h>
...
max77620@3c {
	in-ldo0-1-supply = <&max77620_sd2>;
	in-ldo7-8-supply = <&max77620_sd2>;
	regulators {
		sd0 {
			regulator-name = "vdd-core";
			regulator-min-microvolt = <600000>;
			regulator-max-microvolt = <1400000>;
			regulator-boot-on;
			regulator-always-on;
			maxim,active-fps-source = <MAX77620_FPS_SRC_1>;
		};

		sd1 {
			regulator-name = "vddio-ddr";
			regulator-min-microvolt = <1200000>;
			regulator-max-microvolt = <1200000>;
			regulator-always-on;
			regulator-boot-on;
			maxim,active-fps-source = <MAX77620_FPS_SRC_0>;
		};

		sd2 {
			regulator-name = "vdd-pre-reg";
			regulator-min-microvolt = <1350000>;
			regulator-max-microvolt = <1350000>;
		};

		sd3 {
			regulator-name = "vdd-1v8";
			regulator-min-microvolt = <1800000>;
			regulator-max-microvolt = <1800000>;
			regulator-always-on;
			regulator-boot-on;
		};

		ldo0 {
			regulator-name = "avdd-sys";
			regulator-min-microvolt = <1200000>;
			regulator-max-microvolt = <1200000>;
			regulator-always-on;
			regulator-boot-on;
		};

		ldo1 {
			regulator-name = "vdd-pex";
			regulator-min-microvolt = <1050000>;
			regulator-max-microvolt = <1050000>;
		};

		ldo2 {
			regulator-name = "vddio-sdmmc3";
			regulator-min-microvolt = <1800000>;
			regulator-max-microvolt = <3300000>;
		};

		ldo3 {
			regulator-name = "vdd-cam-hv";
			regulator-min-microvolt = <2800000>;
			regulator-max-microvolt = <2800000>;
		};

		ldo4 {
			regulator-name = "vdd-rtc";
			regulator-min-microvolt = <1250000>;
			regulator-max-microvolt = <1250000>;
			regulator-always-on;
			regulator-boot-on;
		};

		ldo5 {
			regulator-name = "avdd-ts-hv";
			regulator-min-microvolt = <3000000>;
			regulator-max-microvolt = <3000000>;
		};

		ldo6 {
			regulator-name = "vdd-ts";
			regulator-min-microvolt = <1800000>;
			regulator-max-microvolt = <1800000>;
			regulator-always-on;
			regulator-boot-on;
		};

		ldo7 {
			regulator-name = "vdd-gen-pll-edp";
			regulator-min-microvolt = <1050000>;
			regulator-max-microvolt = <1050000>;
			regulator-always-on;
			regulator-boot-on;
		};

		ldo8 {
			regulator-name = "vdd-hdmi-dp";
			regulator-min-microvolt = <1050000>;
			regulator-max-microvolt = <1050000>;
		};
	};
};
```

## Documentation/devicetree/bindings/regulator/regulator-output.yaml
```yaml
# SPDX-License-Identifier: (GPL-2.0-only OR BSD-2-Clause)
%YAML 1.2
---

$id: http://devicetree.org/schemas/regulator/regulator-output.yaml#
$schema: http://devicetree.org/meta-schemas/core.yaml#

title: Regulator output connector

maintainers:
  - Zev Weiss <zev@bewilderbeest.net>

description: |
  This describes a power output connector supplied by a regulator,
  such as a power outlet on a power distribution unit (PDU).  The
  connector may be standalone or merely one channel or set of pins
  within a ganged physical connector carrying multiple independent
  power outputs.

properties:
  compatible:
    const: regulator-output

  vout-supply:
    description:
      Phandle of the regulator supplying the output.

required:
  - compatible
  - vout-supply

additionalProperties: false

examples:
  - |
      output {
          compatible = "regulator-output";
          vout-supply = <&output_reg>;
      };
```
