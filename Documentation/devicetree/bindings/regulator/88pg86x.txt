## Documentation/devicetree/bindings/regulator/active-semi,act8945a.yaml
```yaml
# SPDX-License-Identifier: (GPL-2.0-only OR BSD-2-Clause)
%YAML 1.2
---
$id: http://devicetree.org/schemas/regulator/active-semi,act8945a.yaml#
$schema: http://devicetree.org/meta-schemas/core.yaml#

title: Active-semi ACT8945a regulator

maintainers:
  - Paul Cercueil <paul@crapouillou.net>

properties:
  compatible:
    const: active-semi,act8945a

  reg:
    maxItems: 1

  system-power-controller:
    description:
      Indicates that the ACT8945a is responsible for powering OFF
      the system.
    type: boolean

  active-semi,vsel-high:
    description:
      Indicates the VSEL pin is high. If this property is missing,
      the VSEL pin is assumed to be low.
    type: boolean

  regulators:
    type: object
    additionalProperties: false

    properties:
      REG_DCDC1:
        type: object
        $ref: /schemas/regulator/regulator.yaml#
        unevaluatedProperties: false

        properties:
          vp1-supply:
            description: Handle to the VP1 input supply

      REG_DCDC2:
        type: object
        $ref: /schemas/regulator/regulator.yaml#
        unevaluatedProperties: false

        properties:
          vp2-supply:
            description: Handle to the VP2 input supply

      REG_DCDC3:
        type: object
        $ref: /schemas/regulator/regulator.yaml#
        unevaluatedProperties: false

        properties:
          vp3-supply:
            description: Handle to the VP3 input supply

    patternProperties:
      "^REG_LDO[1-2]$":
        type: object
        $ref: /schemas/regulator/regulator.yaml#
        unevaluatedProperties: false

        properties:
          inl45-supply:
            description: Handle to the INL45 input supply

      "^REG_LDO[3-4]$":
        type: object
        $ref: /schemas/regulator/regulator.yaml#
        unevaluatedProperties: false

        properties:
          inl67-supply:
            description: Handle to the INL67 input supply

  charger:
    type: object
    additionalProperties: false

    properties:
      compatible:
        const: active-semi,act8945a-charger

      interrupts:
        maxItems: 1

      active-semi,chglev-gpios:
        description: charge current level GPIO
        maxItems: 1

      active-semi,lbo-gpios:
        description: low battery voltage detect GPIO
        maxItems: 1

      active-semi,input-voltage-threshold-microvolt:
        description:
          Specifies the charger's input over-voltage threshold value. Despite
          the name, specified values are in millivolt (mV).
        enum: [ 6600, 7000, 7500, 8000 ]
        default: 6600

      active-semi,precondition-timeout:
        description:
          Specifies the charger's PRECONDITION safety timer setting value in
          minutes. If 0, it means to disable this timer.
        enum: [ 0, 40, 60, 80 ]
        default: 40
        $ref: /schemas/types.yaml#/definitions/uint32

      active-semi,total-timeout:
        description:
          Specifies the charger's total safety timer setting value in hours; If
          0, it means to disable this timer;
        enum: [ 0, 3, 4, 5 ]
        default: 3
        $ref: /schemas/types.yaml#/definitions/uint32

    required:
      - compatible
      - interrupts
      - active-semi,chglev-gpios
      - active-semi,lbo-gpios

additionalProperties: false

required:
  - reg
  - compatible
  - regulators

examples:
  - |
    #include <dt-bindings/gpio/gpio.h>
    #include <dt-bindings/interrupt-controller/irq.h>
    #include <dt-bindings/mfd/atmel-flexcom.h>
    #include <dt-bindings/regulator/active-semi,8945a-regulator.h>

    i2c {
      #address-cells = <1>;
      #size-cells = <0>;

      pmic@5b {
        compatible = "active-semi,act8945a";
        reg = <0x5b>;
        active-semi,vsel-high;

        regulators {
          REG_DCDC1 {
            regulator-name = "VDD_1V35";
            regulator-min-microvolt = <1350000>;
            regulator-max-microvolt = <1350000>;
            regulator-allowed-modes = <ACT8945A_REGULATOR_MODE_FIXED>,
                                      <ACT8945A_REGULATOR_MODE_LOWPOWER>;
            regulator-initial-mode = <ACT8945A_REGULATOR_MODE_FIXED>;
            regulator-always-on;

            regulator-state-mem {
              regulator-on-in-suspend;
              regulator-suspend-min-microvolt = <1400000>;
              regulator-suspend-max-microvolt = <1400000>;
              regulator-changeable-in-suspend;
              regulator-mode = <ACT8945A_REGULATOR_MODE_LOWPOWER>;
            };
          };

          REG_DCDC2 {
            regulator-name = "VDD_1V2";
            regulator-min-microvolt = <1100000>;
            regulator-max-microvolt = <1300000>;
            regulator-allowed-modes = <ACT8945A_REGULATOR_MODE_FIXED>,
                                      <ACT8945A_REGULATOR_MODE_LOWPOWER>;
            regulator-initial-mode = <ACT8945A_REGULATOR_MODE_FIXED>;
            regulator-always-on;

            regulator-state-mem {
              regulator-off-in-suspend;
            };
          };

          REG_DCDC3 {
            regulator-name = "VDD_3V3";
            regulator-min-microvolt = <3300000>;
            regulator-max-microvolt = <3300000>;
            regulator-allowed-modes = <ACT8945A_REGULATOR_MODE_FIXED>,
                                      <ACT8945A_REGULATOR_MODE_LOWPOWER>;
            regulator-initial-mode = <ACT8945A_REGULATOR_MODE_FIXED>;
            regulator-always-on;

            regulator-state-mem {
              regulator-off-in-suspend;
            };
          };

          REG_LDO1 {
            regulator-name = "VDD_FUSE";
            regulator-min-microvolt = <2500000>;
            regulator-max-microvolt = <2500000>;
            regulator-allowed-modes = <ACT8945A_REGULATOR_MODE_NORMAL>,
                                      <ACT8945A_REGULATOR_MODE_LOWPOWER>;
            regulator-initial-mode = <ACT8945A_REGULATOR_MODE_NORMAL>;
            regulator-always-on;

            regulator-state-mem {
              regulator-off-in-suspend;
            };
          };

          REG_LDO2 {
            regulator-name = "VDD_3V3_LP";
            regulator-min-microvolt = <3300000>;
            regulator-max-microvolt = <3300000>;
            regulator-allowed-modes = <ACT8945A_REGULATOR_MODE_NORMAL>,
                                      <ACT8945A_REGULATOR_MODE_LOWPOWER>;
            regulator-initial-mode = <ACT8945A_REGULATOR_MODE_NORMAL>;
            regulator-always-on;

            regulator-state-mem {
              regulator-off-in-suspend;
            };
          };

          REG_LDO3 {
            regulator-name = "VDD_LED";
            regulator-min-microvolt = <3300000>;
            regulator-max-microvolt = <3300000>;
            regulator-allowed-modes = <ACT8945A_REGULATOR_MODE_NORMAL>,
                                      <ACT8945A_REGULATOR_MODE_LOWPOWER>;
            regulator-initial-mode = <ACT8945A_REGULATOR_MODE_NORMAL>;
            regulator-always-on;

            regulator-state-mem {
              regulator-off-in-suspend;
            };
          };

          REG_LDO4 {
            regulator-name = "VDD_SDHC_1V8";
            regulator-min-microvolt = <1800000>;
            regulator-max-microvolt = <1800000>;
            regulator-allowed-modes = <ACT8945A_REGULATOR_MODE_NORMAL>,
                                      <ACT8945A_REGULATOR_MODE_LOWPOWER>;
            regulator-initial-mode = <ACT8945A_REGULATOR_MODE_NORMAL>;
            regulator-always-on;

            regulator-state-mem {
              regulator-off-in-suspend;
            };
          };
        };

        charger {
          compatible = "active-semi,act8945a-charger";
          pinctrl-names = "default";
          pinctrl-0 = <&pinctrl_charger_chglev &pinctrl_charger_lbo &pinctrl_charger_irq>;
          interrupt-parent = <&pioA>;
          interrupts = <45 IRQ_TYPE_EDGE_RISING>;

          active-semi,chglev-gpios = <&pioA 12 GPIO_ACTIVE_HIGH>;
          active-semi,lbo-gpios = <&pioA 72 GPIO_ACTIVE_LOW>;
          active-semi,input-voltage-threshold-microvolt = <6600>;
          active-semi,precondition-timeout = <40>;
          active-semi,total-timeout = <3>;
        };
      };
    };
```

## Documentation/devicetree/bindings/regulator/adi,adp5055-regulator.yaml
```yaml
# SPDX-License-Identifier: (GPL-2.0 OR BSD-2-Clause)
%YAML 1.2
---
$id: http://devicetree.org/schemas/regulator/adi,adp5055-regulator.yaml#
$schema: http://devicetree.org/meta-schemas/core.yaml#

title: Analog Devices ADP5055 Triple Buck Regulator

maintainers:
  - Alexis Czezar Torreno <alexisczezar.torreno@analog.com>

description: |
  The ADP5055 combines three high performance buck regulator. The device enables
  direct connection to high input voltages up to 18 V with no preregulators.
  https://www.analog.com/media/en/technical-documentation/data-sheets/adp5055.pdf

properties:
  compatible:
    enum:
      - adi,adp5055

  reg:
    enum:
      - 0x70
      - 0x71

  adi,tset-us:
    description:
      Setting time used by the device. This is changed via soldering specific
      resistor values on the CFG2 pin.
    enum: [2600, 20800]
    default: 2600

  adi,ocp-blanking:
    description:
      If present, overcurrent protection (OCP) blanking for all regulator is on.
    type: boolean

  adi,delay-power-good:
    description:
      Configures delay timer of the power good (PWRGD) pin. Delay is based on
      Tset which can be 2.6 ms or 20.8 ms.
    type: boolean

  '#address-cells':
    const: 1

  '#size-cells':
    const: 0

patternProperties:
  '^buck[0-2]$':
    type: object
    $ref: regulator.yaml#
    unevaluatedProperties: false

    properties:
      enable-gpios:
        maxItems: 1
        description:
          GPIO specifier to enable the GPIO control for each regulator. The
          driver supports two modes of enable, hardware only (GPIOs) or software
          only (Registers). Pure hardware enabling requires each regulator to
          contain this property. If at least one regulator does not have this,
          the driver automatically switches to software only mode.

      adi,dvs-limit-upper-microvolt:
        description:
          Configure the allowable upper side limit of the voltage output of each
          regulator in microvolt. Relative to the default Vref trimming value.
          Vref = 600 mV. Voltages are in 12 mV steps, value is autoadjusted.
          Vout_high = Vref_trim + dvs-limit-upper.
        minimum: 12000
        maximum: 192000
        default: 192000

      adi,dvs-limit-lower-microvolt:
        description:
          Configure the allowable lower side limit of the voltage output of each
          regulator in microvolt. Relative to the default Vref trimming value.
          Vref = 600 mV. Voltages are in 12 mV steps, value is autoadjusted.
          Vout_low = Vref_trim + dvs-limit-lower.
        minimum: -190500
        maximum: -10500
        default: -190500

      adi,fast-transient:
        description:
          Configures the fast transient sensitivity for each regulator.
          "none"    - No fast transient.
          "3G_1.5%" - 1.5% window with 3*350uA/V
          "5G_1.5%" - 1.5% window with 5*350uA/V
          "5G_2.5%" - 2.5% window with 5*350uA/V
        enum: [none, 3G_1.5%, 5G_1.5%, 5G_2.5%]
        default: 5G_2.5%

      adi,mask-power-good:
        description:
          If present, masks individual regulators PWRGD signal to the external
          PWRGD hardware pin.
        type: boolean

    required:
      - regulator-name

required:
  - compatible
  - reg

additionalProperties: false

examples:
  - |
    #include <dt-bindings/gpio/gpio.h>

    i2c {
        #address-cells = <1>;
        #size-cells = <0>;

        regulator@70 {
            compatible = "adi,adp5055";
            reg = <0x70>;
            #address-cells = <1>;
            #size-cells = <0>;

            adi,tset-us = <2600>;
            adi,ocp-blanking;
            adi,delay-power-good;

            buck0 {
                regulator-name = "buck0";
                enable-gpios = <&gpio 17 GPIO_ACTIVE_HIGH>;
                adi,dvs-limit-upper-microvolt = <192000>;
                adi,dvs-limit-lower-microvolt = <(-190500)>;
                adi,fast-transient = "5G_2.5%";
                adi,mask-power-good;
            };

            buck1 {
                regulator-name = "buck1";
                enable-gpios = <&gpio 18 GPIO_ACTIVE_HIGH>;
                adi,dvs-limit-upper-microvolt = <192000>;
                adi,dvs-limit-lower-microvolt = <(-190500)>;
                adi,fast-transient = "5G_2.5%";
                adi,mask-power-good;
            };

            buck2 {
                regulator-name = "buck2";
                enable-gpios = <&gpio 19 GPIO_ACTIVE_HIGH>;
                adi,dvs-limit-upper-microvolt = <192000>;
                adi,dvs-limit-lower-microvolt = <(-190500)>;
                adi,fast-transient = "5G_2.5%";
                adi,mask-power-good;
            };
        };
    };
```

## Documentation/devicetree/bindings/regulator/adi,max77503-regulator.yaml
```yaml
# SPDX-License-Identifier: (GPL-2.0 OR BSD-2-Clause)
# Copyright (c) 2023 Analog Devices, Inc.
%YAML 1.2
---
$id: http://devicetree.org/schemas/regulator/adi,max77503-regulator.yaml#
$schema: http://devicetree.org/meta-schemas/core.yaml#

title: Analog Devices MAX77503 Buck Converter

maintainers:
  - Gokhan Celik <Gokhan.Celik@analog.com>

description: |
  The Analog Devices MAX77503 is a single channel 14V input, 1.5A
  high-efficiency buck converter. This converter has 94% efficiency
  for 2-Cell/3-Cell battery applications.

allOf:
  - $ref: regulator.yaml#

properties:
  compatible:
    enum:
      - adi,max77503

  reg:
    description: I2C address of the device
    items:
      - enum: [0x1e, 0x24, 0x37]

required:
  - compatible
  - reg

unevaluatedProperties: false

examples:
  - |
    i2c {
        #address-cells = <1>;
        #size-cells = <0>;

        regulator@1e {
            compatible = "adi,max77503";
            reg = <0x1e>;

            regulator-min-microvolt = <800000>;
            regulator-max-microvolt = <5000000>;
        };
    };
```

## Documentation/devicetree/bindings/regulator/adi,max77541-regulator.yaml
```yaml
# SPDX-License-Identifier: GPL-2.0-only OR BSD-2-Clause
%YAML 1.2
---
$id: http://devicetree.org/schemas/regulator/adi,max77541-regulator.yaml#
$schema: http://devicetree.org/meta-schemas/core.yaml#

title: Buck Converter for MAX77540/MAX77541

maintainers:
  - Okan Sahin <okan.sahin@analog.com>

description: |
  This is a part of device tree bindings for ADI MAX77540/MAX77541

  The buck converter is represented as a sub-node of the PMIC node on the device tree.

  The device has two buck regulators.
  See also Documentation/devicetree/bindings/mfd/adi,max77541.yaml for
  additional information and example.

patternProperties:
  "^buck[12]$":
    type: object
    $ref: regulator.yaml#
    additionalProperties: false
    description: |
      Buck regulator.

    properties:
      regulator-name: true
      regulator-always-on: true
      regulator-boot-on: true
      regulator-min-microvolt:
        minimum: 300000
      regulator-max-microvolt:
        maximum: 5200000

additionalProperties: false
```
