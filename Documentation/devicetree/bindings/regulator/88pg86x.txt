## Documentation/devicetree/bindings/regulator/88pg86x.txt
```
Marvell 88PG867/88PG868 voltage regulators

Required properties:
- compatible: one of "marvell,88pg867", "marvell,88pg868";
- reg: I2C slave address.

Optional subnodes for regulators: "buck1", "buck2", using common regulator
bindings given in <Documentation/devicetree/bindings/regulator/regulator.txt>.

Example:

	pg868@19 {
		compatible = "marvell,88pg868";
		reg = <0x19>;

		vcpu: buck1 {
			regulator-boot-on;
			regulator-always-on;
			regulator-min-microvolt = <1000000>;
			regulator-max-microvolt = <1350000>;
		};
	};
```

## Documentation/devicetree/bindings/regulator/88pm800.txt
```
Marvell 88PM800 regulator

Required properties:
- compatible: "marvell,88pm800"
- reg: I2C slave address
- regulators: A node that houses a sub-node for each regulator within the
  device. Each sub-node is identified using the node's name (or the deprecated
  regulator-compatible property if present), with valid values listed below.
  The content of each sub-node is defined by the standard binding for
  regulators; see regulator.txt.

The valid names for regulators are:

  buck1, buck2, buck3, buck4, buck5, ldo1, ldo2, ldo3, ldo4, ldo5, ldo6, ldo7,
  ldo8, ldo9, ldo10, ldo11, ldo12, ldo13, ldo14, ldo15, ldo16, ldo17, ldo18, ldo19

Example:

	pmic: 88pm800@31 {
		compatible = "marvell,88pm800";
		reg = <0x31>;

		regulators {
			buck1 {
			        regulator-min-microvolt = <600000>;
			        regulator-max-microvolt = <3950000>;
			        regulator-boot-on;
			        regulator-always-on;
			};
			ldo1 {
			        regulator-min-microvolt = <600000>;
			        regulator-max-microvolt = <15000000>;
			        regulator-boot-on;
			        regulator-always-on;
			};
...
		};
	};
```

## Documentation/devicetree/bindings/regulator/88pm860x.txt
```
Marvell 88PM860x regulator

Required properties:
- compatible: "marvell,88pm860x"
- reg: I2C slave address
- regulators: A node that houses a sub-node for each regulator within the
  device. Each sub-node is identified using the regulator-compatible
  property, with valid values listed below.

Example:

	pmic: 88pm860x@34 {
		compatible = "marvell,88pm860x";
		reg = <0x34>;

		regulators {
			BUCK1 {
			        regulator-min-microvolt = <1000000>;
			        regulator-max-microvolt = <1500000>;
			        regulator-boot-on;
			        regulator-always-on;
			};
			BUCK3 {
			        regulator-min-microvolt = <1000000>;
			        regulator-max-microvolt = <3000000>;
			        regulator-boot-on;
			        regulator-always-on;
			};
		};
	};
```

## Documentation/devicetree/bindings/regulator/act8846.txt
```
act8846 Power Management Integrated Circuit

Required properties:
- compatible: "act,act8846" 
- reg: I2C slave address
- gpios: the interrupt pin or sleep pin
  use gpio get IRQ number
- regulators: This is the list of child nodes that specify the regulator
  initialization data for defined regulators. Not all regulators for the given
  device need to be present. The definition for each of these nodes is defined
  using the standard binding for regulators found at
  Documentation/devicetree/bindings/regulator/regulator.txt.
  The regulator is matched with the regulator-compatible.

  The valid regulator-compatible values are:
  act8846: act_dcdc1, act_dcdc2, act_dcdc3, act_dcdc4, act_ldo1, act_ldo2, act_ldo3, act_ldo4, act_ldo5, act_ldo6,
            act_ldo7, act_ldo8

Optional properties:
- gpios: 
	gpios 0 :vsel pin gpio
	use vsel pin switch dcdc voltage when reset or power down
- regulator-initial-mode: default mode to set on startup
- regulator-initial-state: suspend state to set at init
- regulator-state-mem, regulator-state-disk, regulator-state-standby:
	defines regulator suspend to memory, suspend to disk (hibernate) and standby respectively.
	have following sub-constarints:
	- regulator-state-uv: suspend voltage
	- regulator-state-mode: suspend regulator operating mode
	- regulator-state-enabled: is regulator enabled in this suspend state
	- regulator-state-disabled: is the regulator disbled in this suspend state
-regulator-initial-mode and regulator-state-mode is set as:
	REGULATOR_MODE_FAST			0x1
	REGULATOR_MODE_NORMAL			0x2
	REGULATOR_MODE_IDLE			0x4
	REGULATOR_MODE_STANDBY			0x8
 
Example:

		act8846: act8846@5a {
		reg = <0x5a>;
		status = "okay";
	};

	gpios =<&gpio3 GPIO_D3 GPIO_ACTIVE_LOW>; 
&act8846{

	compatible = "act,act8846";

	regulators {
	
		#address-cells = <1>;
		#size-cells = <0>;	

		 dcdc1_reg: regulator@0{
			reg = <0>;
			regulator-compatible= "act_dcdc1";
		};

		dcdc2_reg: regulator@1 {
			reg = <1>;
			regulator-compatible = "act_dcdc2";	
			regulator-min-microvolt = <800000>;
			regulator-max-microvolt = <1500000>;
			regulator-initial-state = <3>;
			regulator-state-mem {
				regulator-state-enabled;
				regulator-state-uv = <1200000>;
			};		
		};

		dcdc3_reg: regulator@2 {
			reg = <2>;
			regulator-compatible = "act_dcdc3";
			regulator-min-microvolt = <800000>;
			regulator-max-microvolt = <1500000>;
			regulator-initial-state = <3>;
			regulator-state-mem {
				regulator-state-enabled;
				regulator-state-uv = <1200000>;
			};		
		};

		dcdc4_reg: regulator@3 {
			reg = <3>;
			regulator-compatible = "act_dcdc4";
			regulator-initial-state = <3>;
			regulator-state-mem {
				regulator-state-enabled;
				regulator-state-uv = <3300000>;
			};
		};

		ldo1_reg: regulator@4 {
			reg = <4>;
			regulator-compatible= "act_ldo1";
			regulator-initial-state = <3>;
			regulator-state-mem {
				regulator-state-enabled;
			};
		};

		ldo2_reg: regulator@5 {
			reg = <5>;
			regulator-compatible = "act_ldo2";
			regulator-initial-state = <3>;
			regulator-state-mem {
				regulator-state-enabled;
			};
		};

		ldo3_reg: regulator@6 {
			reg = <6>;
			regulator-compatible = "act_ldo3";
			regulator-initial-state = <3>;
			regulator-state-mem {
				regulator-state-enabled;
			};
		};

		ldo4_reg:regulator@7 {
			reg = <7>;
			regulator-compatible = "act_ldo4";
			regulator-initial-state = <3>;
			regulator-state-mem {
				regulator-state-enabled;
			};
		};

		ldo5_reg: regulator@8 {
			reg = <8>;
			regulator-compatible= "act_ldo5";
			regulator-initial-state = <3>;
			regulator-state-mem {
				regulator-state-enabled;
			};
		};

		ldo6_reg: regulator@9 {
			reg = <9>;
			regulator-compatible = "act_ldo6";
			regulator-initial-state = <3>;
			regulator-state-mem {
				regulator-state-enabled;
			};
		};

		ldo7_reg: regulator@10 {
			reg = <10>;
			regulator-compatible = "act_ldo7";
			regulator-initial-state = <3>;
			regulator-state-mem {
				regulator-state-enabled;
			};
		};

		ldo8_reg: regulator@11 {
			reg = <11>;
			regulator-compatible = "act_ldo8";
			regulator-initial-state = <3>;
			regulator-state-mem {
				regulator-state-enabled;
			};
		};
	};
		
};
```

## Documentation/devicetree/bindings/regulator/act8865-regulator.txt
```
ACT88xx regulators
-------------------

Required properties:
- compatible: "active-semi,act8846" or "active-semi,act8865" or "active-semi,act8600"
- reg: I2C slave address

Optional properties:
- system-power-controller: Telling whether or not this pmic is controlling
  the system power. See Documentation/devicetree/bindings/power/power-controller.txt .
- active-semi,vsel-high: Indicates the VSEL pin is high.
  If this property is missing, assume the VSEL pin is low(0).

Optional input supply properties:
- for act8600:
  - vp1-supply: The input supply for DCDC_REG1
  - vp2-supply: The input supply for DCDC_REG2
  - vp3-supply: The input supply for DCDC_REG3
  - inl-supply: The input supply for LDO_REG5, LDO_REG6, LDO_REG7 and LDO_REG8
  SUDCDC_REG4, LDO_REG9 and LDO_REG10 do not have separate supplies.
- for act8846:
  - vp1-supply: The input supply for REG1
  - vp2-supply: The input supply for REG2
  - vp3-supply: The input supply for REG3
  - vp4-supply: The input supply for REG4
  - inl1-supply: The input supply for REG5, REG6 and REG7
  - inl2-supply: The input supply for REG8 and LDO_REG9
  - inl3-supply: The input supply for REG10, REG11 and REG12
- for act8865:
  - vp1-supply: The input supply for DCDC_REG1
  - vp2-supply: The input supply for DCDC_REG2
  - vp3-supply: The input supply for DCDC_REG3
  - inl45-supply: The input supply for LDO_REG1 and LDO_REG2
  - inl67-supply: The input supply for LDO_REG3 and LDO_REG4

Any standard regulator properties can be used to configure the single regulator.

The valid names for regulators are:
	- for act8846:
	REG1, REG2, REG3, REG4, REG5, REG6, REG7, REG8, REG9, REG10, REG11, REG12
	- for act8865:
	DCDC_REG1, DCDC_REG2, DCDC_REG3, LDO_REG1, LDO_REG2, LDO_REG3, LDO_REG4.
	- for act8600:
	DCDC_REG1, DCDC_REG2, DCDC_REG3, SUDCDC_REG4, LDO_REG5, LDO_REG6, LDO_REG7,
	LDO_REG8, LDO_REG9, LDO_REG10,

Example:
--------

		i2c1: i2c@f0018000 {
			pmic: act8865@5b {
				compatible = "active-semi,act8865";
				reg = <0x5b>;
				active-semi,vsel-high;

				regulators {
					vcc_1v8_reg: DCDC_REG1 {
						regulator-name = "VCC_1V8";
						regulator-min-microvolt = <1800000>;
						regulator-max-microvolt = <1800000>;
						regulator-always-on;
					};

					vcc_1v2_reg: DCDC_REG2 {
						regulator-name = "VCC_1V2";
						regulator-min-microvolt = <1100000>;
						regulator-max-microvolt = <1300000>;
						regulator-suspend-mem-microvolt = <1150000>;
						regulator-suspend-standby-microvolt = <1150000>;
						regulator-always-on;
					};

					vcc_3v3_reg: DCDC_REG3 {
						regulator-name = "VCC_3V3";
						regulator-min-microvolt = <3300000>;
						regulator-max-microvolt = <3300000>;
						regulator-always-on;
					};

					vddana_reg: LDO_REG1 {
						regulator-name = "VDDANA";
						regulator-min-microvolt = <3300000>;
						regulator-max-microvolt = <3300000>;
						regulator-always-on;
					};

					vddfuse_reg: LDO_REG2 {
						regulator-name = "FUSE_2V5";
						regulator-min-microvolt = <2500000>;
						regulator-max-microvolt = <2500000>;
					};
				};
			};
		};
```

## Documentation/devicetree/bindings/regulator/act8945a-regulator.txt
```
Device-Tree bindings for regulators of Active-semi ACT8945A Multi-Function Device

Required properties:
 - compatible: "active-semi,act8945a", please refer to ../mfd/act8945a.txt.

Optional properties:
- active-semi,vsel-high: Indicates if the VSEL pin is set to logic-high.
  If this property is missing, assume the VSEL pin is set to logic-low.

Optional input supply properties:
  - vp1-supply: The input supply for REG_DCDC1
  - vp2-supply: The input supply for REG_DCDC2
  - vp3-supply: The input supply for REG_DCDC3
  - inl45-supply: The input supply for REG_LDO1 and REG_LDO2
  - inl67-supply: The input supply for REG_LDO3 and REG_LDO4

Any standard regulator properties can be used to configure the single regulator.
regulator-initial-mode, regulator-allowed-modes and regulator-mode could be
specified using mode values from dt-bindings/regulator/active-semi,8945a-regulator.h
file.

The valid names for regulators are:
	REG_DCDC1, REG_DCDC2, REG_DCDC3, REG_LDO1, REG_LDO2, REG_LDO3, REG_LDO4.

Example:

#include <dt-bindings/regulator/active-semi,8945a-regulator.h>

	pmic@5b {
		compatible = "active-semi,act8945a";
		reg = <0x5b>;

		active-semi,vsel-high;

		regulators {
			vdd_1v35_reg: REG_DCDC1 {
				regulator-name = "VDD_1V35";
				regulator-min-microvolt = <1350000>;
				regulator-max-microvolt = <1350000>;
				regulator-always-on;

				regulator-allowed-modes = <ACT8945A_REGULATOR_MODE_FIXED>,
							  <ACT8945A_REGULATOR_MODE_LOWPOWER>;
				regulator-initial-mode = <ACT8945A_REGULATOR_MODE_FIXED>;

				regulator-state-mem {
					regulator-on-in-suspend;
					regulator-suspend-min-microvolt=<1400000>;
					regulator-suspend-max-microvolt=<1400000>;
					regulator-changeable-in-suspend;
					regulator-mode=<ACT8945A_REGULATOR_MODE_LOWPOWER>;
				};
			};

			vdd_1v2_reg: REG_DCDC2 {
				regulator-name = "VDD_1V2";
				regulator-min-microvolt = <1100000>;
				regulator-max-microvolt = <1300000>;
				regulator-always-on;

				regulator-allowed-modes = <ACT8945A_REGULATOR_MODE_FIXED>,
							  <ACT8945A_REGULATOR_MODE_LOWPOWER>;
				regulator-initial-mode = <ACT8945A_REGULATOR_MODE_FIXED>;

				regulator-state-mem {
					regulator-off-in-suspend;
				};
			};

			vdd_3v3_reg: REG_DCDC3 {
				regulator-name = "VDD_3V3";
				regulator-min-microvolt = <3300000>;
				regulator-max-microvolt = <3300000>;
				regulator-always-on;
			};

			vdd_fuse_reg: REG_LDO1 {
				regulator-name = "VDD_FUSE";
				regulator-min-microvolt = <2500000>;
				regulator-max-microvolt = <2500000>;
				regulator-always-on;

				regulator-allowed-modes = <ACT8945A_REGULATOR_MODE_NORMAL>,
							  <ACT8945A_REGULATOR_MODE_LOWPOWER>;
				regulator-initial-mode = <ACT8945A_REGULATOR_MODE_NORMAL>;

				regulator-state-mem {
					regulator-off-in-suspend;
				};
			};

			vdd_3v3_lp_reg: REG_LDO2 {
				regulator-name = "VDD_3V3_LP";
				regulator-min-microvolt = <3300000>;
				regulator-max-microvolt = <3300000>;
				regulator-always-on;
			};

			vdd_led_reg: REG_LDO3 {
				regulator-name = "VDD_LED";
				regulator-min-microvolt = <3300000>;
				regulator-max-microvolt = <3300000>;
				regulator-always-on;
			};

			vdd_sdhc_1v8_reg: REG_LDO4 {
				regulator-name = "VDD_SDHC_1V8";
				regulator-min-microvolt = <1800000>;
				regulator-max-microvolt = <1800000>;
				regulator-always-on;
			};
		};
	};
```
