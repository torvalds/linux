## Documentation/devicetree/bindings/regulator/adi,max77675.yaml
```yaml
# SPDX-License-Identifier: (GPL-2.0-only OR BSD-2-Clause)
%YAML 1.2
---
$id: http://devicetree.org/schemas/regulator/adi,max77675.yaml#
$schema: http://devicetree.org/meta-schemas/core.yaml#

title: Maxim MAX77675 PMIC Regulator

maintainers:
  - Joan Na <joan.na@analog.com>

description:
  The MAX77675 is a Power Management IC providing four switching buck
  regulators (SBB0–SBB3) accessible via I2C. It supports configuration
  of output voltages and enable controls for each regulator.

allOf:
  - $ref: /schemas/input/input.yaml
  - $ref: /schemas/pinctrl/pincfg-node.yaml

properties:
  compatible:
    const: adi,max77675

  reg:
    maxItems: 1

  reset-time-sec:
    description: Manual reset time in seconds
    enum: [4, 8, 12, 16]
    default: 4

  bias-disable:
    type: boolean
    description: Disable internal pull-up for EN pin

  input-debounce:
    description: Debounce time for the enable pin, in microseconds
    items:
      - enum: [100, 30000]
    default: 100

  adi,en-mode:
    description: |
      Enable mode configuration.
      The debounce time set by 'input-debounce' applies to
      both push-button and slide-switch modes.
      "push-button"  - A long press triggers power-on or power-down
      "slide-switch" - Low : powers on, High : powers down
      "logic"        - Low : powers on, High : powers down (no debounce time)
    $ref: /schemas/types.yaml#/definitions/string
    enum: [push-button, slide-switch, logic]
    default: slide-switch

  adi,voltage-change-latency-us:
    description:
      Specifies the delay (in microseconds) between an output voltage change
      request and the start of the SBB voltage ramp.
    enum: [10, 100]
    default: 100

  adi,drv-sbb-strength:
    description: |
      SIMO Buck-Boost Drive Strength Trim.
      Controls the drive strength of the SIMO regulator's power MOSFETs.
      This setting affects switching speed, impacting power efficiency and EMI.
      "max"  – Maximum drive strength (~0.6 ns transition time)
      "high" – High drive strength (~1.2 ns transition time)
      "low"  – Low drive strength (~1.8 ns transition time)
      "min"  – Minimum drive strength (~8 ns transition time)
    $ref: /schemas/types.yaml#/definitions/string
    enum: [max, high, low, min]
    default: max

  adi,dvs-slew-rate-mv-per-us:
    description:
      Dynamic rising slew rate for output voltage transitions, in mV/μs.
      This setting is only used when 'adi,fixed-slew-rate' is not present.
    enum: [5, 10]
    default: 5

  adi,bias-low-power-request:
    type: boolean
    description: Request low-power bias mode

  adi,simo-ldo-always-on:
    type: boolean
    description: Set internal LDO to always supply 1.8V

  regulators:
    type: object
    description: Regulator child nodes
    patternProperties:
      "^sbb[0-3]$":
        type: object
        $ref: regulator.yaml#
        properties:
          adi,fps-slot:
            description: |
              FPS (Flexible Power Sequencer) slot selection.
              The Flexible Power Sequencer allows resources to power up under
              hardware or software control. Additionally, each resource can
              power up independently or among a group of other regulators with
              adjustable power-up and power-down slots.
              "slot0"   - Assign to FPS Slot 0
              "slot1"   - Assign to FPS Slot 1
              "slot2"   - Assign to FPS Slot 2
              "slot3"   - Assign to FPS Slot 3
              "default" - Use the default FPS slot value stored in register
            $ref: /schemas/types.yaml#/definitions/string
            enum: [slot0, slot1, slot2, slot3, default]
            default: default

          adi,fixed-slew-rate:
            type: boolean
            description:
              When this property is present, the device uses a constant 2 mV/μs
              slew rate and ignores any dynamic slew rate configuration.
              When absent, the device uses the dynamic slew rate specified
              by 'adi,dvs-slew-rate-mv-per-us'

        unevaluatedProperties: false

required:
  - compatible
  - reg
  - regulators

additionalProperties: false

examples:
  - |
    i2c {
      #address-cells = <1>;
      #size-cells = <0>;

      max77675: pmic@44 {
        compatible = "adi,max77675";
        reg = <0x44>;

        reset-time-sec = <4>;
        input-debounce = <100>;

        adi,en-mode = "slide-switch";
        adi,voltage-change-latency-us = <100>;
        adi,drv-sbb-strength = "max";
        adi,dvs-slew-rate-mv-per-us = <5>;

        regulators {
          sbb0: sbb0 {
            regulator-name = "sbb0";
            regulator-min-microvolt = <500000>;
            regulator-max-microvolt = <5500000>;
            adi,fps-slot = "default";
            adi,fixed-slew-rate;
          };

          sbb1: sbb1 {
            regulator-name = "sbb1";
            regulator-min-microvolt = <500000>;
            regulator-max-microvolt = <5500000>;
            adi,fps-slot = "default";
            adi,fixed-slew-rate;
          };

          sbb2: sbb2 {
            regulator-name = "sbb2";
            regulator-min-microvolt = <500000>;
            regulator-max-microvolt = <5500000>;
            adi,fps-slot = "default";
            adi,fixed-slew-rate;
          };

          sbb3: sbb3 {
            regulator-name = "sbb3";
            regulator-min-microvolt = <500000>;
            regulator-max-microvolt = <5500000>;
            adi,fps-slot = "default";
            adi,fixed-slew-rate;
          };
        };
      };
    };
```

## Documentation/devicetree/bindings/regulator/adi,max77857.yaml
```yaml
# SPDX-License-Identifier: (GPL-2.0 OR BSD-2-Clause)
# Copyright 2022 Analog Devices Inc.
%YAML 1.2
---
$id: http://devicetree.org/schemas/regulator/adi,max77857.yaml#
$schema: http://devicetree.org/meta-schemas/core.yaml#

title: Analog Devices MAX77857 Buck-Boost Converter

maintainers:
  - Ibrahim Tilki <Ibrahim.Tilki@analog.com>
  - Okan Sahin <Okan.Sahin@analog.com>

description: Analog Devices MAX77857 Buck-Boost Converter

properties:
  compatible:
    enum:
      - adi,max77831
      - adi,max77857
      - adi,max77859
      - adi,max77859a

  reg:
    description: I2C address of the device
    items:
      - enum: [0x66, 0x67, 0x6E, 0x6F]

  interrupts:
    maxItems: 1

  adi,switch-frequency-hz:
    description: Switching frequency of the Buck-Boost converter in Hz.
    items:
      - enum: [1200000, 1500000, 1800000, 2100000]

  adi,rtop-ohms:
    description: Top feedback resistor value in ohms for external feedback.
    minimum: 150000
    maximum: 330000

  adi,rbot-ohms:
    description: Bottom feedback resistor value in ohms for external feedback.

dependencies:
  adi,rtop-ohms: [ 'adi,rbot-ohms' ]
  adi,rbot-ohms: [ 'adi,rtop-ohms' ]

required:
  - compatible
  - reg

allOf:
  - $ref: regulator.yaml#
  - if:
      properties:
        compatible:
          contains:
            enum:
              - adi,max77831

    then:
      properties:
        adi,switch-frequency-hz:
          items:
            enum: [1200000, 1500000, 1800000]

unevaluatedProperties: false

examples:
  - |
    #include <dt-bindings/interrupt-controller/irq.h>
    i2c {
        #address-cells = <1>;
        #size-cells = <0>;

        regulator@66 {
            reg = <0x66>;
            compatible = "adi,max77857";
            interrupt-parent = <&gpio>;
            interrupts = <26 IRQ_TYPE_EDGE_FALLING>;

            adi,rtop-ohms = <312000>;
            adi,rbot-ohms = <12000>;
        };
    };
```

## Documentation/devicetree/bindings/regulator/allwinner,sun20i-d1-system-ldos.yaml
```yaml
# SPDX-License-Identifier: (GPL-2.0-only OR BSD-2-Clause)
%YAML 1.2
---
$id: http://devicetree.org/schemas/regulator/allwinner,sun20i-d1-system-ldos.yaml#
$schema: http://devicetree.org/meta-schemas/core.yaml#

title: Allwinner D1 System LDOs

maintainers:
  - Samuel Holland <samuel@sholland.org>

description:
  Allwinner D1 contains a pair of general-purpose LDOs which are designed to
  supply power inside and outside the SoC. They are controlled by a register
  within the system control MMIO space.

properties:
  compatible:
    enum:
      - allwinner,sun20i-d1-system-ldos

  reg:
    maxItems: 1

patternProperties:
  "^ldo[ab]$":
    type: object
    $ref: regulator.yaml#
    unevaluatedProperties: false

required:
  - compatible
  - reg

additionalProperties: false

...
```

## Documentation/devicetree/bindings/regulator/anatop-regulator.txt
```
Anatop Voltage regulators

Required properties:
- compatible: Must be "fsl,anatop-regulator"
- regulator-name: A string used as a descriptive name for regulator outputs
- anatop-reg-offset: Anatop MFD register offset
- anatop-vol-bit-shift: Bit shift for the register
- anatop-vol-bit-width: Number of bits used in the register
- anatop-min-bit-val: Minimum value of this register
- anatop-min-voltage: Minimum voltage of this regulator
- anatop-max-voltage: Maximum voltage of this regulator

Optional properties:
- anatop-delay-reg-offset: Anatop MFD step time register offset
- anatop-delay-bit-shift: Bit shift for the step time register
- anatop-delay-bit-width: Number of bits used in the step time register
- vin-supply: The supply for this regulator
- anatop-enable-bit: Regulator enable bit offset

Any property defined as part of the core regulator
binding, defined in regulator.txt, can also be used.

Example:

	regulator-vddpu {
		compatible = "fsl,anatop-regulator";
		regulator-name = "vddpu";
		regulator-min-microvolt = <725000>;
		regulator-max-microvolt = <1300000>;
		regulator-always-on;
		anatop-reg-offset = <0x140>;
		anatop-vol-bit-shift = <9>;
		anatop-vol-bit-width = <5>;
		anatop-delay-reg-offset = <0x170>;
		anatop-delay-bit-shift = <24>;
		anatop-delay-bit-width = <2>;
		anatop-min-bit-val = <1>;
		anatop-min-voltage = <725000>;
		anatop-max-voltage = <1300000>;
	};
```

## Documentation/devicetree/bindings/regulator/anatop-regulator.yaml
```yaml
# SPDX-License-Identifier: (GPL-2.0-only OR BSD-2-Clause)
%YAML 1.2
---
$id: http://devicetree.org/schemas/regulator/anatop-regulator.yaml#
$schema: http://devicetree.org/meta-schemas/core.yaml#

title: Freescale Anatop Voltage Regulators

maintainers:
  - Ying-Chun Liu (PaulLiu) <paul.liu@linaro.org>

allOf:
  - $ref: regulator.yaml#

properties:
  compatible:
    const: fsl,anatop-regulator

  regulator-name: true

  anatop-reg-offset:
    $ref: /schemas/types.yaml#/definitions/uint32
    description: u32 value representing the anatop MFD register offset.

  anatop-vol-bit-shift:
    $ref: /schemas/types.yaml#/definitions/uint32
    description: u32 value representing the bit shift for the register.

  anatop-vol-bit-width:
    $ref: /schemas/types.yaml#/definitions/uint32
    description: u32 value representing the number of bits used in the register.

  anatop-min-bit-val:
    $ref: /schemas/types.yaml#/definitions/uint32
    description: u32 value representing the minimum value of this register.

  anatop-min-voltage:
    $ref: /schemas/types.yaml#/definitions/uint32
    description: u32 value representing the minimum voltage of this regulator.

  anatop-max-voltage:
    $ref: /schemas/types.yaml#/definitions/uint32
    description: u32 value representing the maximum voltage of this regulator.

  anatop-delay-reg-offset:
    $ref: /schemas/types.yaml#/definitions/uint32
    description: u32 value representing the anatop MFD step time register offset.

  anatop-delay-bit-shift:
    $ref: /schemas/types.yaml#/definitions/uint32
    description: u32 value representing the bit shift for the step time register.

  anatop-delay-bit-width:
    $ref: /schemas/types.yaml#/definitions/uint32
    description: u32 value representing the number of bits used in the step time register.

  anatop-enable-bit:
    $ref: /schemas/types.yaml#/definitions/uint32
    description: u32 value representing regulator enable bit offset.

  vin-supply:
    description: input supply phandle.

required:
  - compatible
  - regulator-name
  - anatop-reg-offset
  - anatop-vol-bit-shift
  - anatop-vol-bit-width
  - anatop-min-bit-val
  - anatop-min-voltage
  - anatop-max-voltage

unevaluatedProperties: false

examples:
  - |
    regulator-vddpu {
        compatible = "fsl,anatop-regulator";
        regulator-name = "vddpu";
        regulator-min-microvolt = <725000>;
        regulator-max-microvolt = <1300000>;
        regulator-always-on;
        anatop-reg-offset = <0x140>;
        anatop-vol-bit-shift = <9>;
        anatop-vol-bit-width = <5>;
        anatop-delay-reg-offset = <0x170>;
        anatop-delay-bit-shift = <24>;
        anatop-delay-bit-width = <2>;
        anatop-min-bit-val = <1>;
        anatop-min-voltage = <725000>;
        anatop-max-voltage = <1300000>;
    };
```

## Documentation/devicetree/bindings/regulator/arizona-regulator.txt
```
Cirrus Logic Arizona class audio SoCs

These devices are audio SoCs with extensive digital capabilities and a range
of analogue I/O.

This document lists regulator specific bindings, see the primary binding
document:
  For Wolfson Microelectronic Arizona codecs: ../mfd/arizona.txt
  For Cirrus Logic Madera codecs: ../mfd/madera.txt

Optional properties:
  - wlf,ldoena : GPIO specifier for the GPIO controlling LDOENA

Optional subnodes:
  - ldo1 : Initial data for the LDO1 regulator, as covered in
    Documentation/devicetree/bindings/regulator/regulator.txt
  - micvdd : Initial data for the MICVDD regulator, as covered in
    Documentation/devicetree/bindings/regulator/regulator.txt
```
