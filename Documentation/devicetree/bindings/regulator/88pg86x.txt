## Documentation/devicetree/bindings/regulator/active-semi,act8600.yaml
```yaml
# SPDX-License-Identifier: (GPL-2.0-only OR BSD-2-Clause)
%YAML 1.2
---
$id: http://devicetree.org/schemas/regulator/active-semi,act8600.yaml#
$schema: http://devicetree.org/meta-schemas/core.yaml#

title: Active-semi ACT8600 regulator

maintainers:
  - Paul Cercueil <paul@crapouillou.net>

properties:
  compatible:
    const: active-semi,act8600

  reg:
    maxItems: 1

  system-power-controller:
    description:
      Indicates that the ACT8600 is responsible for powering OFF
      the system.
    type: boolean

  active-semi,vsel-high:
    description:
      Indicates the VSEL pin is high. If this property is missing,
      the VSEL pin is assumed to be low.
    type: boolean

  regulators:
    type: object
    additionalProperties: false

    properties:
      DCDC1:
        type: object
        $ref: /schemas/regulator/regulator.yaml#
        unevaluatedProperties: false

        properties:
          vp1-supply:
            description: Handle to the VP1 input supply

      DCDC2:
        type: object
        $ref: /schemas/regulator/regulator.yaml#
        unevaluatedProperties: false

        properties:
          vp2-supply:
            description: Handle to the VP2 input supply

      DCDC3:
        type: object
        $ref: /schemas/regulator/regulator.yaml#
        unevaluatedProperties: false

        properties:
          vp3-supply:
            description: Handle to the VP3 input supply

    patternProperties:
      "^(SUDCDC_REG4|LDO_REG9|LDO_REG10)$":
        type: object
        $ref: /schemas/regulator/regulator.yaml#
        unevaluatedProperties: false

      "^LDO[5-8]$":
        type: object
        $ref: /schemas/regulator/regulator.yaml#
        unevaluatedProperties: false

        properties:
          inl-supply:
            description: Handle to the INL input supply

additionalProperties: false

required:
  - reg
  - compatible
  - regulators

examples:
  - |
    i2c {
      #address-cells = <1>;
      #size-cells = <0>;

      pmic@5a {
        compatible = "active-semi,act8600";
        reg = <0x5a>;

        regulators {
          SUDCDC_REG4 {
            regulator-min-microvolt = <5300000>;
            regulator-max-microvolt = <5300000>;
            inl-supply = <&vcc>;
          };

          LDO5 {
            regulator-min-microvolt = <2500000>;
            regulator-max-microvolt = <2500000>;
            inl-supply = <&vcc>;
          };

          LDO6 {
            regulator-min-microvolt = <3300000>;
            regulator-max-microvolt = <3300000>;
            inl-supply = <&vcc>;
          };

          LDO7 {
            regulator-min-microvolt = <3300000>;
            regulator-max-microvolt = <3300000>;
            inl-supply = <&vcc>;
          };

          LDO8 {
            regulator-min-microvolt = <1800000>;
            regulator-max-microvolt = <1800000>;
            regulator-always-on;
            inl-supply = <&vcc>;
          };

          LDO_REG9 {
            regulator-min-microvolt = <3300000>;
            regulator-max-microvolt = <3300000>;
            regulator-always-on;
            inl-supply = <&vcc>;
          };

          LDO_REG10 {
            inl-supply = <&vcc>;
          };
        };
      };
    };
```

## Documentation/devicetree/bindings/regulator/active-semi,act8846.yaml
```yaml
# SPDX-License-Identifier: (GPL-2.0-only OR BSD-2-Clause)
%YAML 1.2
---
$id: http://devicetree.org/schemas/regulator/active-semi,act8846.yaml#
$schema: http://devicetree.org/meta-schemas/core.yaml#

title: Active-semi ACT8846 regulator

maintainers:
  - Paul Cercueil <paul@crapouillou.net>

properties:
  compatible:
    const: active-semi,act8846

  reg:
    maxItems: 1

  system-power-controller:
    description:
      Indicates that the ACT8846 is responsible for powering OFF
      the system.
    type: boolean

  active-semi,vsel-high:
    description:
      Indicates the VSEL pin is high. If this property is missing,
      the VSEL pin is assumed to be low.
    type: boolean

  regulators:
    type: object
    additionalProperties: false

    properties:
      REG1:
        type: object
        $ref: /schemas/regulator/regulator.yaml#
        unevaluatedProperties: false

        properties:
          vp1-supply:
            description: Handle to the VP1 input supply

      REG2:
        type: object
        $ref: /schemas/regulator/regulator.yaml#
        unevaluatedProperties: false

        properties:
          vp2-supply:
            description: Handle to the VP2 input supply

      REG3:
        type: object
        $ref: /schemas/regulator/regulator.yaml#
        unevaluatedProperties: false

        properties:
          vp3-supply:
            description: Handle to the VP3 input supply

      REG4:
        type: object
        $ref: /schemas/regulator/regulator.yaml#
        unevaluatedProperties: false

        properties:
          vp4-supply:
            description: Handle to the VP4 input supply

    patternProperties:
      "^REG[5-7]$":
        type: object
        $ref: /schemas/regulator/regulator.yaml#
        unevaluatedProperties: false

        properties:
          inl1-supply:
            description: Handle to the INL1 input supply

      "^REG[8-9]$":
        type: object
        $ref: /schemas/regulator/regulator.yaml#
        unevaluatedProperties: false

        properties:
          inl2-supply:
            description: Handle to the INL2 input supply

      "^REG1[0-2]$":
        type: object
        $ref: /schemas/regulator/regulator.yaml#
        unevaluatedProperties: false

        properties:
          inl3-supply:
            description: Handle to the INL3 input supply

additionalProperties: false

required:
  - reg
  - compatible
  - regulators

examples:
  - |
    i2c {
      #address-cells = <1>;
      #size-cells = <0>;

      pmic@5a {
        compatible = "active-semi,act8846";
        reg = <0x5a>;

        system-power-controller;

        regulators {
          REG1 {
            regulator-name = "VCC_DDR";
            regulator-min-microvolt = <1200000>;
            regulator-max-microvolt = <1200000>;
            regulator-always-on;
          };

          REG2 {
            regulator-name = "VCC_IO";
            regulator-min-microvolt = <3300000>;
            regulator-max-microvolt = <3300000>;
            regulator-always-on;
          };

          REG3 {
            regulator-name = "VDD_LOG";
            regulator-min-microvolt = <1000000>;
            regulator-max-microvolt = <1000000>;
            regulator-always-on;
          };

          REG4 {
            regulator-name = "VCC_20";
            regulator-min-microvolt = <2000000>;
            regulator-max-microvolt = <2000000>;
            regulator-always-on;
          };

          REG5 {
            regulator-name = "VCCIO_SD";
            regulator-min-microvolt = <3300000>;
            regulator-max-microvolt = <3300000>;
            regulator-always-on;
          };

          REG6 {
            regulator-name = "VDD10_LCD";
            regulator-min-microvolt = <1000000>;
            regulator-max-microvolt = <1000000>;
            regulator-always-on;
          };

          REG7 {
            regulator-name = "VCC_WL";
            regulator-min-microvolt = <3300000>;
            regulator-max-microvolt = <3300000>;
            regulator-always-on;
          };

          REG8 {
            regulator-name = "VCCA_33";
            regulator-min-microvolt = <3300000>;
            regulator-max-microvolt = <3300000>;
            regulator-always-on;
          };

          REG9 {
            regulator-name = "VCC_LAN";
            regulator-min-microvolt = <3300000>;
            regulator-max-microvolt = <3300000>;
            regulator-always-on;
          };

          REG10 {
            regulator-name = "VDD_10";
            regulator-min-microvolt = <1000000>;
            regulator-max-microvolt = <1000000>;
            regulator-always-on;
          };

          REG11 {
            regulator-name = "VCC_18";
            regulator-min-microvolt = <1800000>;
            regulator-max-microvolt = <1800000>;
            regulator-always-on;
          };

          REG12 {
            regulator-name = "VCC18_LCD";
            regulator-min-microvolt = <1800000>;
            regulator-max-microvolt = <1800000>;
            regulator-always-on;
          };
        };
      };
    };
```

## Documentation/devicetree/bindings/regulator/active-semi,act8865.yaml
```yaml
# SPDX-License-Identifier: (GPL-2.0-only OR BSD-2-Clause)
%YAML 1.2
---
$id: http://devicetree.org/schemas/regulator/active-semi,act8865.yaml#
$schema: http://devicetree.org/meta-schemas/core.yaml#

title: Active-semi ACT8865 regulator

maintainers:
  - Paul Cercueil <paul@crapouillou.net>

properties:
  compatible:
    const: active-semi,act8865

  reg:
    maxItems: 1

  system-power-controller:
    description:
      Indicates that the ACT8865 is responsible for powering OFF
      the system.
    type: boolean

  active-semi,vsel-high:
    description:
      Indicates the VSEL pin is high. If this property is missing,
      the VSEL pin is assumed to be low.
    type: boolean

  regulators:
    type: object
    additionalProperties: false

    properties:
      DCDC_REG1:
        type: object
        $ref: /schemas/regulator/regulator.yaml#
        unevaluatedProperties: false

        properties:
          vp1-supply:
            description: Handle to the VP1 input supply

      DCDC_REG2:
        type: object
        $ref: /schemas/regulator/regulator.yaml#
        unevaluatedProperties: false

        properties:
          vp2-supply:
            description: Handle to the VP2 input supply

      DCDC_REG3:
        type: object
        $ref: /schemas/regulator/regulator.yaml#
        unevaluatedProperties: false

        properties:
          vp3-supply:
            description: Handle to the VP3 input supply

    patternProperties:
      "^LDO_REG[1-2]$":
        type: object
        $ref: /schemas/regulator/regulator.yaml#
        unevaluatedProperties: false

        properties:
          inl45-supply:
            description: Handle to the INL45 input supply

      "^LDO_REG[3-4]$":
        type: object
        $ref: /schemas/regulator/regulator.yaml#
        unevaluatedProperties: false

        properties:
          inl67-supply:
            description: Handle to the INL67 input supply

additionalProperties: false

required:
  - reg
  - compatible
  - regulators

examples:
  - |
    #include <dt-bindings/regulator/active-semi,8865-regulator.h>

    i2c {
      #address-cells = <1>;
      #size-cells = <0>;

      pmic@5b {
        compatible = "active-semi,act8865";
        reg = <0x5b>;
        active-semi,vsel-high;

        regulators {
          DCDC_REG1 {
            regulator-name = "VCC_1V8";
            regulator-min-microvolt = <1800000>;
            regulator-max-microvolt = <1800000>;
            regulator-always-on;
          };

          DCDC_REG2 {
            regulator-name = "VCC_1V2";
            regulator-min-microvolt = <1100000>;
            regulator-max-microvolt = <1300000>;
            regulator-always-on;

            regulator-allowed-modes = <ACT8865_REGULATOR_MODE_FIXED>,
                                      <ACT8865_REGULATOR_MODE_LOWPOWER>;
            regulator-initial-mode = <ACT8865_REGULATOR_MODE_FIXED>;

            regulator-state-mem {
              regulator-on-in-suspend;
              regulator-suspend-min-microvolt = <1150000>;
              regulator-suspend-max-microvolt = <1150000>;
              regulator-changeable-in-suspend;
              regulator-mode = <ACT8865_REGULATOR_MODE_LOWPOWER>;
            };
          };

          DCDC_REG3 {
            regulator-name = "VCC_3V3";
            regulator-min-microvolt = <3300000>;
            regulator-max-microvolt = <3300000>;
            regulator-always-on;
          };

          LDO_REG1 {
            regulator-name = "VDDANA";
            regulator-min-microvolt = <3300000>;
            regulator-max-microvolt = <3300000>;
            regulator-always-on;

            regulator-allowed-modes = <ACT8865_REGULATOR_MODE_NORMAL>,
                                      <ACT8865_REGULATOR_MODE_LOWPOWER>;
            regulator-initial-mode = <ACT8865_REGULATOR_MODE_NORMAL>;

            regulator-state-mem {
              regulator-off-in-suspend;
            };
          };

          LDO_REG2 {
            regulator-name = "FUSE_2V5";
            regulator-min-microvolt = <2500000>;
            regulator-max-microvolt = <2500000>;
          };
        };
      };
    };
```
