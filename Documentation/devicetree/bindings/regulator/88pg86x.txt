## Documentation/devicetree/bindings/regulator/as3722-regulator.txt
```
Regulator of AMS AS3722 PMIC.
Name of the regulator subnode must be "regulators".

Optional properties:
--------------------
The input supply of regulators are the optional properties on the
regulator node. The AS3722 is having 7 DCDC step-down regulators as
sd[0-6], 10 LDOs as ldo[0-7], ldo[9-11]. The input supply of these
regulators are provided through following properties:
vsup-sd2-supply: Input supply for SD2.
vsup-sd3-supply: Input supply for SD3.
vsup-sd4-supply: Input supply for SD4.
vsup-sd5-supply: Input supply for SD5.
vin-ldo0-supply: Input supply for LDO0.
vin-ldo1-6-supply: Input supply for LDO1 and LDO6.
vin-ldo2-5-7-supply: Input supply for LDO2, LDO5 and LDO7.
vin-ldo3-4-supply: Input supply for LDO3 and LDO4.
vin-ldo9-10-supply: Input supply for LDO9 and LDO10.
vin-ldo11-supply: Input supply for LDO11.

Optional nodes:
--------------
- regulators : Must contain a sub-node per regulator from the list below.
	       Each sub-node should contain the constraints and initialization
	       information for that regulator. See regulator.txt for a
	       description of standard properties for these sub-nodes.
	       Additional custom properties  are listed below.
	       sd[0-6], ldo[0-7], ldo[9-11].

	       Optional sub-node properties:
	       ----------------------------
		ams,ext-control: External control of the rail. The option of
			this properties will tell which external input is
			controlling this rail. Valid values are 0, 1, 2 ad 3.
			0: There is no external control of this rail.
			1: Rail is controlled by ENABLE1 input pin.
			2: Rail is controlled by ENABLE2 input pin.
			3: Rail is controlled by ENABLE3 input pin.
		ams,enable-tracking: Enable tracking with SD1, only supported
			by LDO3.

Example:
-------
	ams3722: ams3722 {
		compatible = "ams,as3722";
		reg = <0x40>;
		...

		regulators {
			vsup-sd2-supply = <...>;
			...

			sd0 {
				regulator-name = "vdd_cpu";
				regulator-min-microvolt = <700000>;
				regulator-max-microvolt = <1400000>;
				regulator-always-on;
				ams,ext-control = <2>;
			};

			sd1 {
				regulator-name = "vdd_core";
				regulator-min-microvolt = <700000>;
				regulator-max-microvolt = <1400000>;
				regulator-always-on;
				ams,ext-control = <1>;
			};

			sd2 {
				regulator-name = "vddio_ddr";
				regulator-min-microvolt = <1350000>;
				regulator-max-microvolt = <1350000>;
				regulator-always-on;
			};

			sd4 {
				regulator-name = "avdd-hdmi-pex";
				regulator-min-microvolt = <1050000>;
				regulator-max-microvolt = <1050000>;
				regulator-always-on;
			};

			sd5 {
				regulator-name = "vdd-1v8";
				regulator-min-microvolt = <1800000>;
				regulator-max-microvolt = <1800000>;
				regulator-always-on;
			};
			....
		};
	};
```

## Documentation/devicetree/bindings/regulator/awinic,aw37503.yaml
```yaml
# SPDX-License-Identifier: (GPL-2.0 OR BSD-2-Clause)
%YAML 1.2
---
$id: http://devicetree.org/schemas/regulator/awinic,aw37503.yaml#
$schema: http://devicetree.org/meta-schemas/core.yaml#

title: Awinic AW37503 Voltage Regulator

maintainers:
  - Alec Li <like@awinic.com>

description:
  The AW37503 are dual voltage regulator, designed to support positive/negative
  supply for driving TFT-LCD panels. It support software-configurable output
  switching and monitoring. The output voltages can be programmed via an I2C
  compatible interface.

properties:
  compatible:
    const: awinic,aw37503

  reg:
    maxItems: 1

patternProperties:
  "^out[pn]$":
    type: object
    $ref: regulator.yaml#
    unevaluatedProperties: false
    description:
      Properties for single regulator.

    properties:
      enable-gpios:
        maxItems: 1
        description:
          GPIO specifier to enable the GPIO control (on/off) for regulator.

    required:
      - regulator-name

required:
  - compatible
  - reg
  - outp
  - outn

additionalProperties: false

examples:
  - |
    #include <dt-bindings/gpio/gpio.h>

    i2c {
        #address-cells = <1>;
        #size-cells = <0>;

        regulator@3e {
            compatible = "awinic,aw37503";
            reg = <0x3e>;

            outp {
                regulator-name = "outp";
                regulator-boot-on;
                regulator-always-on;
                enable-gpios = <&gpio 17 GPIO_ACTIVE_LOW>;
            };

            outn {
                regulator-name = "outn";
                regulator-boot-on;
                regulator-always-on;
                enable-gpios = <&gpio 27 GPIO_ACTIVE_LOW>;
            };
        };
    };
...
```

## Documentation/devicetree/bindings/regulator/brcm,bcm59056.yaml
```yaml
# SPDX-License-Identifier: (GPL-2.0-only OR BSD-2-Clause)
%YAML 1.2
---
$id: http://devicetree.org/schemas/regulator/brcm,bcm59056.yaml#
$schema: http://devicetree.org/meta-schemas/core.yaml#

title: Broadcom BCM59056 Power Management Unit regulators

description: |
  This is a part of device tree bindings for the BCM59056 power
  management unit.

  See Documentation/devicetree/bindings/mfd/brcm,bcm59056.yaml for
  additional information and example.

maintainers:
  - Artur Weber <aweber.kernel@gmail.com>

patternProperties:
  "^(cam|sim|mmc)ldo[1-2]$":
    type: object
    $ref: /schemas/regulator/regulator.yaml#
    unevaluatedProperties: false

  "^(rf|sd|sdx|aud|mic|usb|vib)ldo$":
    type: object
    $ref: /schemas/regulator/regulator.yaml#
    unevaluatedProperties: false

  "^(c|m|v)sr$":
    type: object
    $ref: /schemas/regulator/regulator.yaml#
    unevaluatedProperties: false

  "^(io|sd)sr[1-2]$":
    type: object
    $ref: /schemas/regulator/regulator.yaml#
    unevaluatedProperties: false

  "^gpldo[1-6]$":
    type: object
    $ref: /schemas/regulator/regulator.yaml#
    unevaluatedProperties: false

properties:
  vbus:
    type: object
    $ref: /schemas/regulator/regulator.yaml#
    unevaluatedProperties: false

additionalProperties: false
```

## Documentation/devicetree/bindings/regulator/cirrus,lochnagar.txt
```
Cirrus Logic Lochnagar Audio Development Board

Lochnagar is an evaluation and development board for Cirrus Logic
Smart CODEC and Amp devices. It allows the connection of most Cirrus
Logic devices on mini-cards, as well as allowing connection of
various application processor systems to provide a full evaluation
platform.  Audio system topology, clocking and power can all be
controlled through the Lochnagar, allowing the device under test
to be used in a variety of possible use cases.

This binding document describes the binding for the regulator portion
of the driver.

Also see these documents for generic binding information:
  [1] Regulator: ../regulator/regulator.txt

This binding must be part of the Lochnagar MFD binding:
  [2] ../mfd/cirrus,lochnagar.txt

Optional sub-nodes:

  - VDDCORE : Initialisation data for the VDDCORE regulator, which
    supplies the CODECs digital core if it has no build regulator for that
    purpose.
      Required Properties:
      - compatible : One of the following strings:
                     "cirrus,lochnagar2-vddcore"
      - SYSVDD-supply: Primary power supply for the Lochnagar.

  - MICVDD : Initialisation data for the MICVDD regulator, which
    supplies the CODECs MICVDD.
      Required Properties:
      - compatible : One of the following strings:
                     "cirrus,lochnagar2-micvdd"
      - SYSVDD-supply: Primary power supply for the Lochnagar.

  - MIC1VDD, MIC2VDD : Initialisation data for the MICxVDD supplies.
      Required Properties:
      - compatible : One of the following strings:
                     "cirrus,lochnagar2-mic1vdd", "cirrus,lochnagar2-mic2vdd"
      Optional Properties:
      - cirrus,micbias-input : A property selecting which of the CODEC
        minicard micbias outputs should be used, valid values are 1 - 4.
      - MICBIAS1-supply, MICBIAS2-supply: Regulator supplies for the
        MICxVDD outputs, supplying the digital microphones, normally
        supplied from the attached CODEC.

  - VDD1V8 : Recommended fixed regulator for the VDD1V8 regulator, which supplies the
    CODECs analog and 1.8V digital supplies.
      Required Properties:
      - compatible : Should be set to "regulator-fixed"
      - regulator-min-microvolt : Should be set to 1.8V
      - regulator-max-microvolt : Should be set to 1.8V
      - regulator-boot-on
      - regulator-always-on
      - vin-supply : Should be set to same supply as SYSVDD

Example:

lochnagar {
	lochnagar-micvdd: MICVDD {
		compatible = "cirrus,lochnagar2-micvdd";

		SYSVDD-supply = <&wallvdd>;

		regulator-min-microvolt = <3300000>;
		regulator-max-microvolt = <3300000>;
	};

	lochnagar-vdd1v8: VDD1V8 {
		compatible = "regulator-fixed";

		regulator-name = "VDD1V8";
		regulator-min-microvolt = <1800000>;
		regulator-max-microvolt = <1800000>;
		regulator-boot-on;
		regulator-always-on;

		vin-supply = <&wallvdd>;
	};
};
```

## Documentation/devicetree/bindings/regulator/cpcap-regulator.txt
```
Motorola CPCAP PMIC voltage regulators
------------------------------------

Requires node properties:
- "compatible" value one of:
    "motorola,cpcap-regulator"
    "motorola,mapphone-cpcap-regulator"
    "motorola,xoom-cpcap-regulator"

Required regulator properties:
- "regulator-name"
- "regulator-enable-ramp-delay"
- "regulator-min-microvolt"
- "regulator-max-microvolt"

Optional regulator properties:
- "regulator-boot-on"

See Documentation/devicetree/bindings/regulator/regulator.txt
for more details about the regulator properties.

Example:

cpcap_regulator: regulator {
	compatible = "motorola,cpcap-regulator";

	cpcap_regulators: regulators {
		sw5: SW5 {
			regulator-min-microvolt = <5050000>;
			regulator-max-microvolt = <5050000>;
			regulator-enable-ramp-delay = <50000>;
			regulator-boot-on;
		};
	};
};
```

## Documentation/devicetree/bindings/regulator/da9210.txt
```
* Dialog Semiconductor DA9210 Multi-phase 12A DCDC BUCK Converter

Required properties:

- compatible:	must be "dlg,da9210"
- reg:		the i2c slave address of the regulator. It should be 0x68.

Optional properties:

- interrupts:	a reference to the DA9210 interrupt, if available.

Any standard regulator properties can be used to configure the single da9210
DCDC.

Example:

	da9210@68 {
		compatible = "dlg,da9210";
		reg = <0x68>;

		interrupt-parent = <...>;
		interrupts = <...>;

		regulator-min-microvolt = <300000>;
		regulator-max-microvolt = <1570000>;
		regulator-min-microamp = <1600000>;
		regulator-max-microamp = <4600000>;
		regulator-boot-on;
	};
```
