## Documentation/devicetree/bindings/regulator/richtek,rtmv20-regulator.yaml
```yaml
# SPDX-License-Identifier: GPL-2.0
%YAML 1.2
---
$id: http://devicetree.org/schemas/regulator/richtek,rtmv20-regulator.yaml#
$schema: http://devicetree.org/meta-schemas/core.yaml#

title: Richtek RTMV20 laser diode regulator

maintainers:
  - ChiYuan Huang <cy_huang@richtek.com>

description: |
  Richtek RTMV20 is a load switch current regulator that can supply up to 6A.
  It is used to drive laser diode. There're two signals for chip controls
  (Enable/Fail), Enable pin to turn chip on, and Fail pin as fault indication.
  There're still four pins for camera control, two inputs (strobe and vsync),
  the others for outputs (fsin1 and fsin2). Strobe input to start the current
  supply, vsync input from IR camera, and fsin1/fsin2 output for the optional.

properties:
  compatible:
    const: richtek,rtmv20

  reg:
    maxItems: 1

  wakeup-source: true

  interrupts:
    maxItems: 1

  enable-gpios:
    description: A connection of the 'enable' gpio line.
    maxItems: 1

  richtek,ld-pulse-delay-us:
    description: |
      load current pulse delay in microsecond after strobe pin pulse high.
    minimum: 0
    maximum: 100000
    default: 0

  richtek,ld-pulse-width-us:
    description: |
      Load current pulse width in microsecond after strobe pin pulse high.
    minimum: 0
    maximum: 10000
    default: 1200

  richtek,fsin1-delay-us:
    description: |
      Fsin1 pulse high delay in microsecond after vsync signal pulse high.
    minimum: 0
    maximum: 100000
    default: 23000

  richtek,fsin1-width-us:
    description: |
      Fsin1 pulse high width in microsecond after vsync signal pulse high.
    minimum: 40
    maximum: 10000
    default: 160

  richtek,fsin2-delay-us:
    description: |
      Fsin2 pulse high delay in microsecond after vsync signal pulse high.
    minimum: 0
    maximum: 100000
    default: 23000

  richtek,fsin2-width-us:
    description: |
      Fsin2 pulse high width in microsecond after vsync signal pulse high.
    minimum: 40
    maximum: 10000
    default: 160

  richtek,es-pulse-width-us:
    description: Eye safety function pulse width limit in microsecond.
    minimum: 0
    maximum: 10000
    default: 1200

  richtek,es-ld-current-microamp:
    description: Eye safety function load current limit in microamp.
    minimum: 0
    maximum: 6000000
    default: 3000000

  richtek,lbp-level-microvolt:
    description: Low battery protection level in microvolt.
    minimum: 2400000
    maximum: 3700000
    default: 2700000

  richtek,lbp-enable:
    description: Low battery protection function enable control.
    type: boolean

  richtek,strobe-polarity-high:
    description: Strobe pin active polarity control.
    type: boolean

  richtek,vsync-polarity-high:
    description: Vsync pin active polarity control.
    type: boolean

  richtek,fsin-enable:
    description: Fsin function enable control.
    type: boolean

  richtek,fsin-output:
    description: Fsin function output control.
    type: boolean

  richtek,es-enable:
    description: Eye safety function enable control.
    type: boolean

  lsw:
    description: load switch current regulator description.
    type: object
    $ref: "regulator.yaml#"

required:
  - compatible
  - reg
  - wakeup-source
  - interrupts
  - enable-gpios
  - lsw

additionalProperties: false

examples:
  - |
    #include <dt-bindings/interrupt-controller/irq.h>
    i2c {
      #address-cells = <1>;
      #size-cells = <0>;

      rtmv20@34 {
        compatible = "richtek,rtmv20";
        reg = <0x34>;
        wakeup-source;
        interrupts-extended = <&gpio26 2 IRQ_TYPE_LEVEL_LOW>;
        enable-gpios = <&gpio26 3 0>;

        richtek,strobe-polarity-high;
        richtek,vsync-polarity-high;

        lsw {
                regulator-name = "rtmv20,lsw";
                regulator-min-microamp = <0>;
                regulator-max-microamp = <6000000>;
        };
      };
    };
...
```

## Documentation/devicetree/bindings/regulator/richtek,rtq2134-regulator.yaml
```yaml
# SPDX-License-Identifier: GPL-2.0-only OR BSD-2-Clause
%YAML 1.2
---
$id: http://devicetree.org/schemas/regulator/richtek,rtq2134-regulator.yaml#
$schema: http://devicetree.org/meta-schemas/core.yaml#

title: Richtek RTQ2134 SubPMIC Regulator

maintainers:
  - ChiYuan Huang <cy_huang@richtek.com>

description: |
  The RTQ2134 is a multi-phase, programmable power management IC that
  integrates with four high efficient, synchronous step-down converter cores.

  Datasheet is available at
  https://www.richtek.com/assets/product_file/RTQ2134-QA/DSQ2134-QA-01.pdf

properties:
  compatible:
    enum:
      - richtek,rtq2134

  reg:
    maxItems: 1

  regulators:
    type: object

    patternProperties:
      "^buck[1-3]$":
        type: object
        $ref: regulator.yaml#
        description: |
          regulator description for buck[1-3].

        properties:
          richtek,use-vsel-dvs:
            type: boolean
            description: |
              If specified, buck will listen to 'vsel' pin for dvs config.
              Else, use dvs0 voltage by default.

          richtek,uv-shutdown:
            type: boolean
            description: |
              If specified, use shutdown as UV action. Else, hiccup by default.

        unevaluatedProperties: false

    additionalProperties: false

required:
  - compatible
  - reg
  - regulators

additionalProperties: false

examples:
  - |
    i2c {
      #address-cells = <1>;
      #size-cells = <0>;

      rtq2134@18 {
        compatible = "richtek,rtq2134";
        reg = <0x18>;

        regulators {
          buck1 {
            regulator-name = "rtq2134-buck1";
            regulator-min-microvolt = <300000>;
            regulator-max-microvolt = <1850000>;
            regulator-always-on;
            richtek,use-vsel-dvs;
            regulator-state-mem {
              regulator-suspend-min-microvolt = <550000>;
              regulator-suspend-max-microvolt = <550000>;
            };
          };
          buck2 {
            regulator-name = "rtq2134-buck2";
            regulator-min-microvolt = <1120000>;
            regulator-max-microvolt = <1120000>;
            regulator-always-on;
            richtek,use-vsel-dvs;
            regulator-state-mem {
              regulator-suspend-min-microvolt = <1120000>;
              regulator-suspend-max-microvolt = <1120000>;
            };
          };
          buck3 {
            regulator-name = "rtq2134-buck3";
            regulator-min-microvolt = <600000>;
            regulator-max-microvolt = <600000>;
            regulator-always-on;
            richtek,use-vsel-dvs;
            regulator-state-mem {
              regulator-suspend-min-microvolt = <600000>;
              regulator-suspend-max-microvolt = <600000>;
            };
          };
        };
      };
    };
```

## Documentation/devicetree/bindings/regulator/richtek,rtq2208.yaml
```yaml
# SPDX-License-Identifier: GPL-2.0-only OR BSD-2-Clause
%YAML 1.2
---
$id: http://devicetree.org/schemas/regulator/richtek,rtq2208.yaml#
$schema: http://devicetree.org/meta-schemas/core.yaml#

title: Richtek RTQ2208 SubPMIC Regulator

maintainers:
  - Alina Yu <alina_yu@richtek.com>

description: |
  RTQ2208 is a highly integrated power converter that offers functional safety dual
  multi-configurable synchronous buck converters and two LDOs.

  Bucks support "regulator-allowed-modes" and "regulator-mode". The former defines the permitted
  switching operation in normal mode; the latter defines the operation in suspend to RAM mode.

  No matter the RTQ2208 is configured to normal or suspend to RAM mode, there are two switching
  operation modes for all buck rails, automatic power saving mode (Auto mode) and forced continuous
  conduction mode (FCCM).

  The definition of modes is in the datasheet which is available in below link
  and their meaning is::
    0 - Auto mode for power saving, which reducing the switching frequency at light load condition
    to maintain high frequency.
    1 - FCCM to meet the strict voltage regulation accuracy, which keeping constant switching frequency.

  Datasheet will be available soon at
  https://www.richtek.com/assets/Products

properties:
  compatible:
    enum:
      - richtek,rtq2208

  reg:
    maxItems: 1

  interrupts:
    maxItems: 1
    
  richtek,mtp-sel-high:
    type: boolean
    description:
      vout register selection based on this boolean value.
      false - Using DVS0 register setting to adjust vout
      true - Using DVS1 register setting to adjust vout

  regulators:
    type: object
    additionalProperties: false

    patternProperties:
      "^buck-[a-h]$":
        type: object
        $ref: regulator.yaml#
        unevaluatedProperties: false
        description:
          description for buck-[a-h] regulator.

        properties:
          regulator-allowed-modes:
            description:
              two buck modes in different switching accuracy.
              0 - Auto mode
              1 - FCCM
            items:
              enum: [0, 1]

      "^ldo[1-2]$":
        type: object
        $ref: regulator.yaml#
        unevaluatedProperties: false
        description:
          regulator description for ldo[1-2].

required:
  - compatible
  - reg
  - regulators

additionalProperties: false

examples:
  - |
    #include <dt-bindings/interrupt-controller/irq.h>
    i2c {
      #address-cells = <1>;
      #size-cells = <0>;

      pmic@10 {
        compatible = "richtek,rtq2208";
        reg = <0x10>;
        interrupts-extended = <&gpio26 0 IRQ_TYPE_LEVEL_LOW>;
        richtek,mtp-sel-high;

        regulators {
          buck-a {
            regulator-min-microvolt = <400000>;
            regulator-max-microvolt = <2050000>;
            regulator-allowed-modes = <0 1>;
            regulator-always-on;
            regulator-state-mem {
              regulator-on-in-suspend;
              regulator-mode = <1>;
            };
          };
          buck-b {
            regulator-min-microvolt = <400000>;
            regulator-max-microvolt = <2050000>;
            regulator-allowed-modes = <0 1>;
            regulator-always-on;
            regulator-state-mem {
              regulator-on-in-suspend;
              regulator-mode = <1>;
            };
          };
          buck-c {
            regulator-min-microvolt = <400000>;
            regulator-max-microvolt = <2050000>;
            regulator-allowed-modes = <0 1>;
            regulator-always-on;
            regulator-state-mem {
              regulator-on-in-suspend;
              regulator-mode = <1>;
            };
          };
          buck-d {
            regulator-min-microvolt = <400000>;
            regulator-max-microvolt = <2050000>;
            regulator-allowed-modes = <0 1>;
            regulator-always-on;
            regulator-state-mem {
              regulator-on-in-suspend;
              regulator-mode = <1>;
            };
          };
          buck-e {
            regulator-min-microvolt = <400000>;
            regulator-max-microvolt = <2050000>;
            regulator-allowed-modes = <0 1>;
            regulator-always-on;
            regulator-state-mem {
              regulator-on-in-suspend;
              regulator-mode = <1>;
            };
          };
          buck-f {
            regulator-min-microvolt = <400000>;
            regulator-max-microvolt = <2050000>;
            regulator-allowed-modes = <0 1>;
            regulator-always-on;
            regulator-state-mem {
              regulator-on-in-suspend;
              regulator-mode = <1>;
            };
          };
          buck-g {
            regulator-min-microvolt = <400000>;
            regulator-max-microvolt = <2050000>;
            regulator-allowed-modes = <0 1>;
            regulator-always-on;
            regulator-state-mem {
              regulator-on-in-suspend;
              regulator-mode = <1>;
            };
          };
          buck-h {
            regulator-min-microvolt = <400000>;
            regulator-max-microvolt = <2050000>;
            regulator-allowed-modes = <0 1>;
            regulator-always-on;
            regulator-state-mem {
              regulator-on-in-suspend;
              regulator-mode = <1>;
            };
          };
          ldo1 {
            regulator-min-microvolt = <1200000>;
            regulator-max-microvolt = <1200000>;
            regulator-always-on;
            regulator-state-mem {
              regulator-on-in-suspend;
            };
          };
          ldo2 {
            regulator-min-microvolt = <3300000>;
            regulator-max-microvolt = <3300000>;
            regulator-always-on;
            regulator-state-mem {
              regulator-on-in-suspend;
            };
          };
        };
      };
    };
```

## Documentation/devicetree/bindings/regulator/richtek,rtq6752-regulator.yaml
```yaml
# SPDX-License-Identifier: GPL-2.0-only OR BSD-2-Clause
%YAML 1.2
---
$id: http://devicetree.org/schemas/regulator/richtek,rtq6752-regulator.yaml#
$schema: http://devicetree.org/meta-schemas/core.yaml#

title: Richtek RTQ6752 TFT LCD Voltage Regulator

maintainers:
  - ChiYuan Huang <cy_huang@richtek.com>

description: |
  The RTQ6752 is an I2C interface pgorammable power management IC. It includes
  two synchronous boost converter for PAVDD, and one synchronous NAVDD
  buck-boost. The device is suitable for automotive TFT-LCD panel.

properties:
  compatible:
    enum:
      - richtek,rtq6752

  reg:
    maxItems: 1

  enable-gpios:
    description: |
      A connection of the chip 'enable' gpio line. If not provided, treat it as
      external pull up.
    maxItems: 1

  regulators:
    type: object

    patternProperties:
      "^(p|n)avdd$":
        type: object
        $ref: regulator.yaml#
        unevaluatedProperties: false
        description: |
          regulator description for pavdd and navdd.

    additionalProperties: false

required:
  - compatible
  - reg
  - regulators

additionalProperties: false

examples:
  - |
    i2c {
      #address-cells = <1>;
      #size-cells = <0>;

      rtq6752@6b {
        compatible = "richtek,rtq6752";
        reg = <0x6b>;
        enable-gpios = <&gpio26 2 0>;

        regulators {
          pavdd {
            regulator-name = "rtq6752-pavdd";
            regulator-min-microvolt = <5000000>;
            regulator-max-microvolt = <7300000>;
            regulator-boot-on;
          };
          navdd {
            regulator-name = "rtq6752-navdd";
            regulator-min-microvolt = <5000000>;
            regulator-max-microvolt = <7300000>;
            regulator-boot-on;
          };
        };
      };
    };
```
