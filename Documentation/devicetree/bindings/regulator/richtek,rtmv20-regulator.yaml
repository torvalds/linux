## Documentation/devicetree/bindings/regulator/rohm,bd9576-regulator.yaml
```yaml
# SPDX-License-Identifier: GPL-2.0-only OR BSD-2-Clause
%YAML 1.2
---
$id: http://devicetree.org/schemas/regulator/rohm,bd9576-regulator.yaml#
$schema: http://devicetree.org/meta-schemas/core.yaml#

title: ROHM BD9576 and BD9573 Power Management Integrated Circuit regulators

maintainers:
  - Matti Vaittinen <mazziesaccount@gmail.com>

description: |
  This module is part of the ROHM BD9576 MFD device. For more details
  see Documentation/devicetree/bindings/mfd/rohm,bd9576-pmic.yaml.

  The regulator controller is represented as a sub-node of the PMIC node
  on the device tree.

  The valid names for BD9576 regulator nodes are
  regulator-vd50, regulator-vd18, regulator-vdddr, regulator-vd10,
  regulator-voutl1, regulator-vouts1

patternProperties:
  "^regulator-.+$":
    type: object
    description:
      Properties for single regulator.
    $ref: regulator.yaml#

    properties:
      rohm,ocw-fet-ron-micro-ohms:
        description: |
          External FET's ON-resistance. Required if VoutS1 OCP/OCW is
          to be set.

    required:
      - regulator-name

    unevaluatedProperties: false
additionalProperties: false
```

## Documentation/devicetree/bindings/regulator/rohm,bd96801-regulator.yaml
```yaml
# SPDX-License-Identifier: GPL-2.0-only OR BSD-2-Clause
%YAML 1.2
---
$id: http://devicetree.org/schemas/regulator/rohm,bd96801-regulator.yaml#
$schema: http://devicetree.org/meta-schemas/core.yaml#

title: ROHM BD96801 Power Management Integrated Circuit regulators

maintainers:
  - Matti Vaittinen <matti.vaittinen@fi.rohmeurope.com>

description:
  This module is part of the ROHM BD96801 MFD device. For more details
  see Documentation/devicetree/bindings/mfd/rohm,bd96801-pmic.yaml.

  The regulator controller is represented as a sub-node of the PMIC node
  on the device tree.

  Regulator nodes should be named to buck_<number> and ldo_<number>.
  The valid names for BD96801 regulator nodes are
  buck1, buck2, buck3, buck4, ldo5, ldo6, ldo7

patternProperties:
  "^ldo[5-7]$":
    type: object
    description:
      Properties for single LDO regulator.
    $ref: regulator.yaml#

    properties:
      rohm,initial-voltage-microvolt:
        description:
          Initial voltage for regulator. Voltage can be tuned +/-150 mV from
          this value. NOTE, This can be modified via I2C only when PMIC is in
          STBY state.
        minimum: 300000
        maximum: 3300000

    unevaluatedProperties: false

  "^buck[1-4]$":
    type: object
    description:
      Properties for single BUCK regulator.
    $ref: regulator.yaml#

    properties:
      rohm,initial-voltage-microvolt:
        description:
          Initial voltage for regulator. Voltage can be tuned +/-150 mV from
          this value. NOTE, This can be modified via I2C only when PMIC is in
          STBY state.
        minimum: 500000
        maximum: 3300000

      rohm,keep-on-stby:
        description:
          Keep the regulator powered when PMIC transitions to STBY state.
        type: boolean

    unevaluatedProperties: false

additionalProperties: false
```

## Documentation/devicetree/bindings/regulator/rohm,bd96802-regulator.yaml
```yaml
# SPDX-License-Identifier: GPL-2.0-only OR BSD-2-Clause
%YAML 1.2
---
$id: http://devicetree.org/schemas/regulator/rohm,bd96802-regulator.yaml#
$schema: http://devicetree.org/meta-schemas/core.yaml#

title: ROHM BD96802 Power Management Integrated Circuit regulators

maintainers:
  - Matti Vaittinen <matti.vaittinen@fi.rohmeurope.com>

description:
  This module is part of the ROHM BD96802 MFD device. For more details
  see Documentation/devicetree/bindings/mfd/rohm,bd96802-pmic.yaml.

  The regulator controller is represented as a sub-node of the PMIC node
  on the device tree.

  Regulator nodes should be named to buck1 and buck2.

patternProperties:
  "^buck[1-2]$":
    type: object
    description:
      Properties for single BUCK regulator.
    $ref: regulator.yaml#

    properties:
      rohm,initial-voltage-microvolt:
        description:
          Initial voltage for regulator. Voltage can be tuned +/-150 mV from
          this value. NOTE, This can be modified via I2C only when PMIC is in
          STBY state.
        minimum: 500000
        maximum: 3300000

      rohm,keep-on-stby:
        description:
          Keep the regulator powered when PMIC transitions to STBY state.
        type: boolean

    unevaluatedProperties: false

additionalProperties: false
```

## Documentation/devicetree/bindings/regulator/rohm,pmic-states.yaml
```yaml
# SPDX-License-Identifier: GPL-2.0-only OR BSD-2-Clause
%YAML 1.2
---
$id: http://devicetree.org/schemas/regulator/rohm,pmic-states.yaml#
$schema: http://devicetree.org/meta-schemas/core.yaml#

title: ROHM PMICs' hardware state machine descriptions

maintainers:
  - Matti Vaittinen <mazziesaccount@gmail.com>

description:
  Many of the ROHM PMICs have internal state-machine designed to provide
  correct voltages for different SOC states. In many cases the states and
  transitions are SOC specific, but ones described here can be found from a
  few of the different ROHM PMICs.

properties:
  rohm,dvs-run-voltage:
    description:
      PMIC "RUN" state voltage in uV when PMIC HW states are used. 0 means the
      regulator should be disabled at RUN state. Some regulators do not support
      setting HW state specific voltage but do support enable/disable control.
      For them any positive value means the regulator should be enabled without
      touching the voltage.
    $ref: /schemas/types.yaml#/definitions/uint32

  rohm,dvs-suspend-voltage:
    description:
      PMIC "SUSPEND" state voltage in uV when PMIC HW states are used. 0 means
      the regulator should be disabled at SUSPEND state. Some regulators do not
      support setting HW state specific voltage but do support enable/disable
      control. For them any positive value means the regulator should be
      enabled without touching the voltage.
    $ref: /schemas/types.yaml#/definitions/uint32

  rohm,dvs-idle-voltage:
    description:
      PMIC "IDLE" state voltage in uV. 0 means the regulator should be disabled
      at IDLE state. Some regulators do not support setting HW state specific
      voltage but do support enable/disable control. For them any positive
      value means the regulator should be enabled without touching the voltage.
    $ref: /schemas/types.yaml#/definitions/uint32

  rohm,dvs-lpsr-voltage:
    description:
      PMIC "LPSR" state voltage in uV when PMIC HW states are used. 0 means the
      regulator should be disabled at LPSR state. Some regulators do not
      support setting HW state specific voltage but do support enable/disable
      control. For them any positive value means the regulator should be
      enabled without touching the voltage. Some PMICs' documentation may refer
      to this state as a "deep-idle state".
    $ref: /schemas/types.yaml#/definitions/uint32

# The schema is expected to be reference by PMIC schemas, which may introduce
# other properties that must be allowed.
additionalProperties: true
```

## Documentation/devicetree/bindings/regulator/rt5025-regulator.txt
```
Richtek RT5025 of regulators

Required properties:
For rt5025 regulators/LDOs
- compatible:
  - "rt,rt5025-dcdc1" for Buck1
  - "rt,rt5025-dcdc2" for Buck2
  - "rt,rt5025-dcdc3" for Buck3
  - "rt,rt5025-dcdc4" for Buck4/Boost
  - "rt,rt5025-ldo1" for Ldo1
  - "rt,rt5025-ldo2" for Ldo2
  - "rt,rt5025-ldo3" for Ldo3
  - "rt,rt5025-ldo4" for Ldo4
  - "rt,rt5025-ldo5" for Ldo5
  - "rt,rt5025-ldo6" for Ldo6

Example:

	rt5025-dcdc1: regulator_0@0 {
		compatible = "rt,rt5025-dcdc1";
		cell-index = <0>;
		regulator-min-microvolt  = < 700000>;
		regulator-max-microvolt  = <2275000>;
		rt,ramp_sel = <0x00>;
		rt,allow_mode_mask;
		qcom,consumer-supplies = "rt5025-dcdc1", "";
	};
```

## Documentation/devicetree/bindings/regulator/s5m8767-regulator.txt
```
* Samsung S5M8767 Voltage and Current Regulator

The Samsung S5M8767 is a multi-function device which includes voltage and
current regulators, rtc, charger controller and other sub-blocks. It is
interfaced to the host controller using a i2c interface. Each sub-block is
addressed by the host system using different i2c slave address. This document
describes the bindings for 'pmic' sub-block of s5m8767.

Required properties:
- compatible: Should be "samsung,s5m8767-pmic".
- reg: Specifies the i2c slave address of the pmic block. It should be 0x66.

- s5m8767,pmic-buck2-dvs-voltage: A set of 8 voltage values in micro-volt (uV)
  units for buck2 when changing voltage using gpio dvs. Refer to [1] below
  for additional information.

- s5m8767,pmic-buck3-dvs-voltage: A set of 8 voltage values in micro-volt (uV)
  units for buck3 when changing voltage using gpio dvs. Refer to [1] below
  for additional information.

- s5m8767,pmic-buck4-dvs-voltage: A set of 8 voltage values in micro-volt (uV)
  units for buck4 when changing voltage using gpio dvs. Refer to [1] below
  for additional information.

- s5m8767,pmic-buck-ds-gpios: GPIO specifiers for three host gpio's used
  for selecting GPIO DVS lines. It is one-to-one mapped to dvs gpio lines.

[1] If none of the 's5m8767,pmic-buck[2/3/4]-uses-gpio-dvs' optional
    property is specified, the 's5m8767,pmic-buck[2/3/4]-dvs-voltage'
    property should specify atleast one voltage level (which would be a
    safe operating voltage).

    If either of the 's5m8767,pmic-buck[2/3/4]-uses-gpio-dvs' optional
    property is specified, then all the eight voltage values for the
    's5m8767,pmic-buck[2/3/4]-dvs-voltage' should be specified.

Optional properties:
- interrupt-parent: Specifies the phandle of the interrupt controller to which
  the interrupts from s5m8767 are delivered to.
- interrupts: Interrupt specifiers for two interrupt sources.
  - First interrupt specifier is for 'irq1' interrupt.
  - Second interrupt specifier is for 'alert' interrupt.
- s5m8767,pmic-buck2-uses-gpio-dvs: 'buck2' can be controlled by gpio dvs.
- s5m8767,pmic-buck3-uses-gpio-dvs: 'buck3' can be controlled by gpio dvs.
- s5m8767,pmic-buck4-uses-gpio-dvs: 'buck4' can be controlled by gpio dvs.

Additional properties required if either of the optional properties are used:

- s5m8767,pmic-buck234-default-dvs-idx: Default voltage setting selected from
  the possible 8 options selectable by the dvs gpios. The value of this
  property should be between 0 and 7. If not specified or if out of range, the
  default value of this property is set to 0.

- s5m8767,pmic-buck-dvs-gpios: GPIO specifiers for three host gpio's used
  for dvs. The format of the gpio specifier depends in the gpio controller.

Regulators: The regulators of s5m8767 that have to be instantiated should be
included in a sub-node named 'regulators'. Regulator nodes included in this
sub-node should be of the format as listed below.

	regulator_name {
		ldo1_reg: LDO1 {
			regulator-name = "VDD_ALIVE_1.0V";
			regulator-min-microvolt = <1100000>;
			regulator-max-microvolt = <1100000>;
			regulator-always-on;
			regulator-boot-on;
			op_mode = <1>; /* Normal Mode */
		};
	};
The above regulator entries are defined in regulator bindings documentation
except these properties:
	- op_mode: describes the different operating modes of the LDO's with
		power mode change in SOC. The different possible values are,
		0 - always off mode
		1 - on in normal mode
		2 - low power mode
		3 - suspend mode
	- s5m8767,pmic-ext-control-gpios: (optional) GPIO specifier for one
		GPIO controlling this regulator (enable/disable); This is
		valid only for buck9.

The following are the names of the regulators that the s5m8767 pmic block
supports. Note: The 'n' in LDOn and BUCKn represents the LDO or BUCK number
as per the datasheet of s5m8767.

	- LDOn
		  - valid values for n are 1 to 28
		  - Example: LDO1, LDO2, LDO28
	- BUCKn
		  - valid values for n are 1 to 9.
		  - Example: BUCK1, BUCK2, BUCK9

The bindings inside the regulator nodes use the standard regulator bindings
which are documented elsewhere.

Example:

	s5m8767_pmic@66 {
		compatible = "samsung,s5m8767-pmic";
		reg = <0x66>;

		s5m8767,pmic-buck2-uses-gpio-dvs;
		s5m8767,pmic-buck3-uses-gpio-dvs;
		s5m8767,pmic-buck4-uses-gpio-dvs;

		s5m8767,pmic-buck-default-dvs-idx = <0>;

		s5m8767,pmic-buck-dvs-gpios = <&gpx0 0 0>, /* DVS1 */
						 <&gpx0 1 0>, /* DVS2 */
						 <&gpx0 2 0>; /* DVS3 */

		s5m8767,pmic-buck-ds-gpios = <&gpx2 3 0>, /* SET1 */
						<&gpx2 4 0>, /* SET2 */
						<&gpx2 5 0>; /* SET3 */

		s5m8767,pmic-buck2-dvs-voltage = <1350000>, <1300000>,
						 <1250000>, <1200000>,
						 <1150000>, <1100000>,
						 <1000000>, <950000>;

		s5m8767,pmic-buck3-dvs-voltage = <1100000>, <1100000>,
						 <1100000>, <1100000>,
						 <1000000>, <1000000>,
						 <1000000>, <1000000>;

		s5m8767,pmic-buck4-dvs-voltage = <1200000>, <1200000>,
						 <1200000>, <1200000>,
						 <1200000>, <1200000>,
						 <1200000>, <1200000>;

		regulators {
			ldo1_reg: LDO1 {
				regulator-name = "VDD_ABB_3.3V";
				regulator-min-microvolt = <3300000>;
				regulator-max-microvolt = <3300000>;
				op_mode = <1>; /* Normal Mode */
			};

			ldo2_reg: LDO2 {
				regulator-name = "VDD_ALIVE_1.1V";
				regulator-min-microvolt = <1100000>;
				regulator-max-microvolt = <1100000>;
				regulator-always-on;
			};

			buck1_reg: BUCK1 {
				regulator-name = "VDD_MIF_1.2V";
				regulator-min-microvolt = <950000>;
				regulator-max-microvolt = <1350000>;
				regulator-always-on;
				regulator-boot-on;
			};

			vemmc_reg: BUCK9 {
				regulator-name = "VMEM_VDD_2.8V";
				regulator-min-microvolt = <2800000>;
				regulator-max-microvolt = <2800000>;
				op_mode = <3>; /* Standby Mode */
				s5m8767,pmic-ext-control-gpios = <&gpk0 2 0>;
			};
		};
	};
```
