## Documentation/devicetree/bindings/regulator/rohm,bd71837-regulator.yaml
```yaml
# SPDX-License-Identifier: GPL-2.0-only OR BSD-2-Clause
%YAML 1.2
---
$id: http://devicetree.org/schemas/regulator/rohm,bd71837-regulator.yaml#
$schema: http://devicetree.org/meta-schemas/core.yaml#

title: ROHM BD71837 Power Management Integrated Circuit regulators

maintainers:
  - Matti Vaittinen <mazziesaccount@gmail.com>

description: |
  List of regulators provided by this controller. BD71837 regulators node
  should be sub node of the BD71837 MFD node. See BD71837 MFD bindings at
  Documentation/devicetree/bindings/mfd/rohm,bd71837-pmic.yaml
  Regulator nodes should be named to BUCK_<number> and LDO_<number>. The
  definition for each of these nodes is defined using the standard
  binding for regulators at
  Documentation/devicetree/bindings/regulator/regulator.txt.
  Note that if BD71837 starts at RUN state you probably want to use
  regulator-boot-on at least for BUCK6 and BUCK7 so that those are not
  disabled by driver at startup. LDO5 and LDO6 are supplied by those and
  if they are disabled at startup the voltage monitoring for LDO5/LDO6 will
  cause PMIC to reset.

# The valid names for BD71837 regulator nodes are:
# BUCK1, BUCK2, BUCK3, BUCK4, BUCK5, BUCK6, BUCK7, BUCK8
# LDO1, LDO2, LDO3, LDO4, LDO5, LDO6, LDO7

patternProperties:
  "^LDO[1-7]$":
    type: object
    $ref: regulator.yaml#
    description:
      Properties for single LDO regulator.

    properties:
      regulator-name:
        pattern: "^ldo[1-7]$"
        description:
          should be "ldo1", ..., "ldo7"

    unevaluatedProperties: false

  "^BUCK[1-8]$":
    type: object
    $ref: regulator.yaml#
    description:
      Properties for single BUCK regulator.

    properties:
      regulator-name:
        pattern: "^buck[1-8]$"
        description:
          should be "buck1", ..., "buck8"

      rohm,dvs-run-voltage:
        $ref: /schemas/types.yaml#/definitions/uint32
        minimum: 0
        maximum: 1300000
        description:
          PMIC default "RUN" state voltage in uV. See below table for
          bucks which support this. 0 means disabled.

      rohm,dvs-idle-voltage:
        $ref: /schemas/types.yaml#/definitions/uint32
        minimum: 0
        maximum: 1300000
        description:
          PMIC default "IDLE" state voltage in uV. See below table for
          bucks which support this. 0 means disabled.

      rohm,dvs-suspend-voltage:
        $ref: /schemas/types.yaml#/definitions/uint32
        minimum: 0
        maximum: 1300000
        description:
          PMIC default "SUSPEND" state voltage in uV. See below table for
          bucks which support this. 0 means disabled.

        # Supported default DVS states:
        #
        # BD71837:
        # buck | dvs-run-voltage | dvs-idle-voltage | dvs-suspend-voltage
        # ----------------------------------------------------------------
        # 1    | supported       | supported        | supported
        # ----------------------------------------------------------------
        # 2    | supported       | supported        | not supported
        # ----------------------------------------------------------------
        # 3    | supported       | not supported    | not supported
        # ----------------------------------------------------------------
        # 4    | supported       | not supported    | not supported
        # ----------------------------------------------------------------
        # rest | not supported   | not supported    | not supported

      # BD71837 power outputs can either be controlled by the PMIC internal
      # hardware state machine or by software. If you need regulators to be
      # turned ON/OFF for example based on PMIC_STBY_REQ line (which toggles
      # PMIC HW state machine) - then you should set this property.
      # Tradeoff is that then SW can't control the ON/OFF state for this
      # regulator (other than invoking a PMIC state change).
      rohm,no-regulator-enable-control:
        description: |
          Enable/Disable control of this regulator must be left to the
          PMIC hardware state machine.
        type: boolean

      # Setups where regulator (especially the buck8) output voltage is scaled
      # by adding external connection where some other regulator output is
      # connected to feedback-pin (over suitable resistors) is getting popular
      # amongst users of BD71837. (This allows for example scaling down the
      # buck8 voltages to suit lover GPU voltages for projects where buck8 is
      # (ab)used to supply power for GPU.
      #
      # So we allow describing this external connection from DT and scale the
      # voltages accordingly. This is what the connection should look like:
      #
      # |---------------|
      # |       buck 8  |-------+----->Vout
      # |               |       |
      # |---------------|       |
      #        |                |
      #        |                |
      #        +-------+--R2----+
      #                |
      #                R1
      #                |
      #        V FB-pull-up
      #
      # Here the buck output is sifted according to formula:
      #
      # Vout_o = Vo - (Vpu - Vo)*R2/R1
      # Linear_step = step_orig*(R1+R2)/R1
      #
      # where:
      # Vout_o is adjusted voltage output at vsel reg value 0
      # Vo is original voltage output at vsel reg value 0
      # Vpu is the pull-up voltage V FB-pull-up in the picture
      # R1 and R2 are resistor values.

      rohm,fb-pull-up-microvolt:
        description:
          Feedback-pin has pull-up connection to adjust voltage range. This is
          the used pull-up voltage before R1.

      rohm,feedback-pull-up-r1-ohms:
        description:
          Feedback-pin has pull-up connection to adjust voltage range. This is
          the used R1 resistor.

      rohm,feedback-pull-up-r2-ohms:
        description:
          Feedback-pin has pull-up connection to adjust voltage range. This is
          the used R2 resistor.

    required:
      - regulator-name

    unevaluatedProperties: false

additionalProperties: false
```

## Documentation/devicetree/bindings/regulator/rohm,bd71847-regulator.yaml
```yaml
# SPDX-License-Identifier: GPL-2.0-only OR BSD-2-Clause
%YAML 1.2
---
$id: http://devicetree.org/schemas/regulator/rohm,bd71847-regulator.yaml#
$schema: http://devicetree.org/meta-schemas/core.yaml#

title: ROHM BD71847 and BD71850 Power Management Integrated Circuit regulators

maintainers:
  - Matti Vaittinen <mazziesaccount@gmail.com>

description: |
  List of regulators provided by this controller. BD71847 regulators node
  should be sub node of the BD71847 MFD node. See BD71847 MFD bindings at
  Documentation/devicetree/bindings/mfd/rohm,bd71847-pmic.yaml
  Regulator nodes should be named to BUCK_<number> and LDO_<number>. The
  definition for each of these nodes is defined using the standard
  binding for regulators at
  Documentation/devicetree/bindings/regulator/regulator.txt.
  Note that if BD71847 starts at RUN state you probably want to use
  regulator-boot-on at least for BUCK5. LDO6 is supplied by it and it must
  not be disabled by driver at startup. If BUCK5 is disabled at startup the
  voltage monitoring for LDO5/LDO6 can cause PMIC to reset.

#The valid names for BD71847 regulator nodes are:
#BUCK1, BUCK2, BUCK3, BUCK4, BUCK5, BUCK6
#LDO1, LDO2, LDO3, LDO4, LDO5, LDO6

patternProperties:
  "^LDO[1-6]$":
    type: object
    $ref: regulator.yaml#
    description:
      Properties for single LDO regulator.

    properties:
      regulator-name:
        pattern: "^ldo[1-6]$"
        description:
          should be "ldo1", ..., "ldo6"

    unevaluatedProperties: false

  "^BUCK[1-6]$":
    type: object
    $ref: regulator.yaml#
    description:
      Properties for single BUCK regulator.

    properties:
      regulator-name:
        pattern: "^buck[1-6]$"
        description:
          should be "buck1", ..., "buck6"

      rohm,dvs-run-voltage:
        $ref: "/schemas/types.yaml#/definitions/uint32"
        minimum: 0
        maximum: 1300000
        description:
          PMIC default "RUN" state voltage in uV. See below table for
          bucks which support this. 0 means disabled.

      rohm,dvs-idle-voltage:
        $ref: "/schemas/types.yaml#/definitions/uint32"
        minimum: 0
        maximum: 1300000
        description:
          PMIC default "IDLE" state voltage in uV. See below table for
          bucks which support this. 0 means disabled.

      rohm,dvs-suspend-voltage:
        $ref: "/schemas/types.yaml#/definitions/uint32"
        minimum: 0
        maximum: 1300000
        description:
          PMIC default "SUSPEND" state voltage in uV. See below table for
          bucks which support this. 0 means disabled.

        # Supported default DVS states:
        #
        # BD71847:
        # buck | dvs-run-voltage | dvs-idle-voltage | dvs-suspend-voltage
        # ----------------------------------------------------------------
        # 1    | supported       | supported        | supported
        # ----------------------------------------------------------------
        # 2    | supported       | supported        | not supported
        # ----------------------------------------------------------------
        # rest | not supported   | not supported    | not supported

      # BD718(47/50) power outputs can either be controlled by the PMIC internal
      # hardware state machine or by software. If you need regulators to be
      # turned ON/OFF for example based on PMIC_STBY_REQ line (which toggles
      # PMIC HW state machine) - then you should set this property.
      # Tradeoff is that then SW can't control the ON/OFF state for this
      # regulator (other than invoking a PMIC state change).
      rohm,no-regulator-enable-control:
        description: |
          Enable/Disable control of this regulator must be left to the
          PMIC hardware state machine.
        type: boolean

      # Setups where regulator (especially the buck8) output voltage is scaled
      # by adding external connection where some other regulator output is
      # connected to feedback-pin (over suitable resistors) is getting popular
      # amongst users of BD71837. (This allows for example scaling down the
      # buck8 voltages to suit lover GPU voltages for projects where buck8 is
      # (ab)used to supply power for GPU.
      #
      # So we allow describing this external connection from DT and scale the
      # voltages accordingly. This is what the connection should look like:
      #
      # |---------------|
      # |       buck 8  |-------+----->Vout
      # |               |       |
      # |---------------|       |
      #        |                |
      #        |                |
      #        +-------+--R2----+
      #                |
      #                R1
      #                |
      #        V FB-pull-up
      #
      # Here the buck output is sifted according to formula:
      #
      # Vout_o = Vo - (Vpu - Vo)*R2/R1
      # Linear_step = step_orig*(R1+R2)/R1
      #
      # where:
      # Vout_o is adjusted voltage output at vsel reg value 0
      # Vo is original voltage output at vsel reg value 0
      # Vpu is the pull-up voltage V FB-pull-up in the picture
      # R1 and R2 are resistor values.

      rohm,fb-pull-up-microvolt:
        description:
          Feedback-pin has pull-up connection to adjust voltage range. This is
          the used pull-up voltage before R1.

      rohm,feedback-pull-up-r1-ohms:
        description:
          Feedback-pin has pull-up connection to adjust voltage range. This is
          the used R1 resistor.

      rohm,feedback-pull-up-r2-ohms:
        description:
          Feedback-pin has pull-up connection to adjust voltage range. This is
          the used R2 resistor.

    required:
      - regulator-name

    unevaluatedProperties: false

additionalProperties: false
```

## Documentation/devicetree/bindings/regulator/rohm,bd72720-regulator.yaml
```yaml
# SPDX-License-Identifier: GPL-2.0-only OR BSD-2-Clause
%YAML 1.2
---
$id: http://devicetree.org/schemas/regulator/rohm,bd72720-regulator.yaml#
$schema: http://devicetree.org/meta-schemas/core.yaml#

title: ROHM BD72720 Power Management Integrated Circuit regulators

maintainers:
  - Matti Vaittinen <mazziesaccount@gmail.com>

description: |
  This module is part of the ROHM BD72720 MFD device. For more details
  see Documentation/devicetree/bindings/mfd/rohm,bd72720-pmic.yaml.

  The regulator controller is represented as a sub-node of the PMIC node
  on the device tree.

  Regulator nodes should be named to BUCK_<number> and LDO_<number>.
  The valid names for BD72720 regulator nodes are
  buck1, buck2, buck3, buck4, buck5, buck6, buck7, buck8, buck9, buck10
  ldo1, ldo2, ldo3, ldo4, ldo5, ldo6, ldo7, ldo8, ldo9, ldo10, ldo11

patternProperties:
  "^ldo([1-9]|1[0-1])$":
    type: object
    description:
      Properties for single LDO regulator.
    allOf:
      - $ref: regulator.yaml#
      - $ref: rohm,pmic-states.yaml#

    properties:
      regulator-name:
        pattern: "^ldo([1-9]|1[0-1])$"

      rohm,dvs-run-voltage:
        minimum: 0
        maximum: 3300000

      rohm,dvs-idle-voltage:
        minimum: 0
        maximum: 3300000

      rohm,dvs-suspend-voltage:
        minimum: 0
        maximum: 3300000

      rohm,dvs-lpsr-voltage:
        minimum: 0
        maximum: 3300000

        # Supported default DVS states:
        #     ldo        |    run     |   idle    | suspend   | lpsr
        # --------------------------------------------------------------
        # 1, 2, 3, and 4 | supported  | supported | supported | supported
        # --------------------------------------------------------------
        # 5 - 11         |                    supported (*)
        # --------------------------------------------------------------
        #
        # (*) All states use same voltage but have own enable / disable
        #      settings. Voltage 0 can be specified for a state to make
        #      regulator disabled on that state.

    unevaluatedProperties: false

  "^buck([1-9]|10)$":
    type: object
    description:
      Properties for single BUCK regulator.
    allOf:
      - $ref: regulator.yaml#
      - $ref: rohm,pmic-states.yaml#

    properties:
      regulator-name:
        pattern: "^buck([1-9]|10)$"

      rohm,ldon-head-microvolt:
        description:
          Set this on boards where BUCK10 is used to supply LDOs 1-4. The bucki
          voltage will be changed by the PMIC to follow the LDO output voltages
          with the offset voltage given here. This will improve the LDO efficiency.
        minimum: 50000
        maximum: 300000

      rohm,dvs-run-voltage:
        minimum: 0
        maximum: 3300000

      rohm,dvs-idle-voltage:
        minimum: 0
        maximum: 3300000

      rohm,dvs-suspend-voltage:
        minimum: 0
        maximum: 3300000

      rohm,dvs-lpsr-voltage:
        minimum: 0
        maximum: 3300000

        # Supported default DVS states:
        #     buck       |    run     |   idle    | suspend   | lpsr
        # --------------------------------------------------------------
        # 1, 2, 3, and 4 | supported  | supported | supported | supported
        # --------------------------------------------------------------
        # 5 - 10    |                    supported (*)
        # --------------------------------------------------------------
        #
        # (*) All states use same voltage but have own enable / disable
        #      settings. Voltage 0 can be specified for a state to make
        #      regulator disabled on that state.

    required:
      - regulator-name

    unevaluatedProperties: false

additionalProperties: false
```
