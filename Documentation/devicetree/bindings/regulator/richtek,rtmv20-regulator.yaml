## Documentation/devicetree/bindings/regulator/samsung,s2mpa01.txt
```
Binding for Samsung S2MPA01 regulator block
===========================================

This is a part of device tree bindings for S2M family multi-function devices.
More information can be found in bindings/mfd/sec-core.txt file.

The S2MPA01 device provide buck and LDO regulators.

To register these with regulator framework instantiate under main device node
a sub-node named "regulators" with more sub-nodes for each regulator using the
common regulator binding documented in:
 - Documentation/devicetree/bindings/regulator/regulator.txt


Names of regulators supported by S2MPA01 device:
	- LDOn
		  - valid values for n are 1 to 26
		  - Example: LDO1, LD02, LDO26
	- BUCKn
		  - valid values for n are 1 to 10.
		  - Example: BUCK1, BUCK2, BUCK9
Note: The 'n' in LDOn and BUCKn represents the LDO or BUCK number
as per the datasheet of device.


Optional properties of buck regulator nodes under "regulators" sub-node:
 - regulator-ramp-delay: ramp delay in uV/us. May be 6250, 12500
   (default), 25000, or 50000. May be 0 for disabling the ramp delay on
   BUCK{1,2,3,4}.

   In the absence of the regulator-ramp-delay property, the default ramp
   delay will be used.

   Note: Some bucks share the ramp rate setting i.e. same ramp value
   will be set for a particular group of bucks so provide the same
   regulator-ramp-delay value for them.
   Groups sharing ramp rate:
    - buck{1,6},
    - buck{2,4},
    - buck{8,9,10}.

Example:

	s2mpa01_pmic@66 {
		compatible = "samsung,s2mpa01-pmic";
		reg = <0x66>;

		regulators {
			ldo1_reg: LDO1 {
				regulator-name = "VDD_ALIVE";
				regulator-min-microvolt = <1000000>;
				regulator-max-microvolt = <1000000>;
			};

			ldo2_reg: LDO2 {
				regulator-name = "VDDQ_MMC2";
				regulator-min-microvolt = <2800000>;
				regulator-max-microvolt = <2800000>;
				regulator-always-on;
			};

			buck1_reg: BUCK1 {
				regulator-name = "vdd_mif";
				regulator-min-microvolt = <950000>;
				regulator-max-microvolt = <1350000>;
				regulator-always-on;
				regulator-boot-on;
			};

			buck2_reg: BUCK2 {
				regulator-name = "vdd_arm";
				regulator-min-microvolt = <950000>;
				regulator-max-microvolt = <1350000>;
				regulator-always-on;
				regulator-boot-on;
				regulator-ramp-delay = <50000>;
			};
		};
	};
```

## Documentation/devicetree/bindings/regulator/samsung,s2mpa01.yaml
```yaml
# SPDX-License-Identifier: GPL-2.0-only OR BSD-2-Clause
%YAML 1.2
---
$id: http://devicetree.org/schemas/regulator/samsung,s2mpa01.yaml#
$schema: http://devicetree.org/meta-schemas/core.yaml#

title: Samsung S2MPA01 Power Management IC regulators

maintainers:
  - Krzysztof Kozlowski <krzysztof.kozlowski@canonical.com>

description: |
  This is a part of device tree bindings for S2M and S5M family of Power
  Management IC (PMIC).

  The S2MPA01 provides buck and LDO regulators.

  See also Documentation/devicetree/bindings/mfd/samsung,s2mpa01.yaml for
  additional information and example.

patternProperties:
  # 26 LDOs
  "^LDO([1-9]|1[0-9]|2[0-6])$":
    type: object
    $ref: regulator.yaml#
    unevaluatedProperties: false
    description:
      Properties for single LDO regulator.

    required:
      - regulator-name

  # 10 bucks
  "^BUCK([1-9]|10)$":
    type: object
    $ref: regulator.yaml#
    unevaluatedProperties: false
    description:
      Properties for single BUCK regulator.

    properties:
      regulator-ramp-delay:
        enum: [0, 6250, 12500, 25000, 50000]
        default: 12500
        description: |
          May be 0 for disabling the ramp delay on BUCK{1,2,3,4}.

          In the absence of the regulator-ramp-delay property, the default ramp
          delay will be used.

          Note: Some bucks share the ramp rate setting i.e. same ramp value
          will be set for a particular group of bucks so provide the same
          regulator-ramp-delay value for them.
          Groups sharing ramp rate:
            * buck{1,6},
            * buck{2,4},
            * buck{8,9,10}.

    required:
      - regulator-name

additionalProperties: false
```

## Documentation/devicetree/bindings/regulator/samsung,s2mpg10-regulator.yaml
```yaml
# SPDX-License-Identifier: GPL-2.0-only OR BSD-2-Clause
%YAML 1.2
---
$id: http://devicetree.org/schemas/regulator/samsung,s2mpg10-regulator.yaml#
$schema: http://devicetree.org/meta-schemas/core.yaml#

title: Samsung S2MPG10 Power Management IC regulators

maintainers:
  - André Draszik <andre.draszik@linaro.org>

description: |
  This is part of the device tree bindings for the S2MG10 Power Management IC
  (PMIC).

  The S2MPG10 PMIC provides 10 buck and 31 LDO regulators.

  See also Documentation/devicetree/bindings/mfd/samsung,s2mps11.yaml for
  additional information and example.

properties:
  # 1 LDO with possible (but limited) external control
  ldo20m:
    type: object
    $ref: regulator.yaml#
    unevaluatedProperties: false
    description:
      Properties for a single LDO regulator.

    allOf:
      - $ref: "#/$defs/s2mpg10-ext-control"

    properties:
      regulator-ramp-delay: false

      samsung,ext-control:
        minimum: 11

patternProperties:
  # 10 bucks
  "^buck([1-9]|10)m$":
    type: object
    $ref: regulator.yaml#
    unevaluatedProperties: false
    description:
      Properties for a single buck regulator.

    allOf:
      - $ref: "#/$defs/s2mpg10-ext-control"

    properties:
      regulator-ramp-delay:
        enum: [6250, 12500, 25000]
        default: 6250

      samsung,ext-control:
        maximum: 10

  # 12 standard LDOs
  "^ldo(2[1-9]?|3[0-1])m$":
    type: object
    $ref: regulator.yaml#
    unevaluatedProperties: false
    description:
      Properties for single LDO regulator.

    properties:
      regulator-ramp-delay: false

  # 12 LDOs with possible external control
  "^ldo([3-689]|1[046-9])m$":
    type: object
    $ref: regulator.yaml#
    unevaluatedProperties: false
    description:
      Properties for a single LDO regulator.

    allOf:
      - $ref: "#/$defs/s2mpg10-ext-control"

    properties:
      regulator-ramp-delay: false

      samsung,ext-control:
        maximum: 10

  # 6 LDOs with ramp support, 5 out of those with possible external control
  "^ldo(1[1235]?|7)m$":
    type: object
    $ref: regulator.yaml#
    unevaluatedProperties: false
    description:
      Properties for a single LDO regulator.

    allOf:
      - $ref: "#/$defs/s2mpg10-ext-control"

    properties:
      regulator-ramp-delay:
        enum: [6250, 12500]
        default: 6250

      samsung,ext-control:
        maximum: 10

$defs:
  s2mpg10-ext-control:
    properties:
      samsung,ext-control:
        description: |
          These rails can be controlled via one of several possible external
          (hardware) signals. If so, this property configures the signal the PMIC
          should monitor. For S2MPG10 rails where external control is possible other
          than ldo20m, the following values generally corresponding to the
          respective on-chip pin are valid:
            - 0 # S2MPG10_EXTCTRL_PWREN - PWREN pin
            - 1 # S2MPG10_EXTCTRL_PWREN_MIF - PWREN_MIF pin
            - 2 # S2MPG10_EXTCTRL_AP_ACTIVE_N - ~AP_ACTIVE_N pin
            - 3 # S2MPG10_EXTCTRL_CPUCL1_EN - CPUCL1_EN pin
            - 4 # S2MPG10_EXTCTRL_CPUCL1_EN2 - CPUCL1_EN & PWREN pins
            - 5 # S2MPG10_EXTCTRL_CPUCL2_EN - CPUCL2_EN pin
            - 6 # S2MPG10_EXTCTRL_CPUCL2_EN2 - CPUCL2_E2 & PWREN pins
            - 7 # S2MPG10_EXTCTRL_TPU_EN - TPU_EN pin
            - 8 # S2MPG10_EXTCTRL_TPU_EN2 - TPU_EN & ~AP_ACTIVE_N pins
            - 9 # S2MPG10_EXTCTRL_TCXO_ON - TCXO_ON pin
            - 10 # S2MPG10_EXTCTRL_TCXO_ON2 - TCXO_ON & ~AP_ACTIVE_N pins

          For S2MPG10 ldo20m, the following values are valid
            - 11 # S2MPG10_EXTCTRL_LDO20M_EN2 - VLDO20M_EN & LDO20M_SFR
            - 12 # S2MPG10_EXTCTRL_LDO20M_EN - VLDO20M_EN pin

        $ref: /schemas/types.yaml#/definitions/uint32
        minimum: 0
        maximum: 12

      enable-gpios:
        description:
          For rails where external control is done via a GPIO, this optional
          property describes the GPIO line used.

    dependentRequired:
      enable-gpios: [ "samsung,ext-control" ]

allOf:
  # Bucks 8, 9, and LDO 1 can not be controlled externally - above definition
  # allows it and we deny it here. This approach reduces repetition.
  - if:
      anyOf:
        - required: [buck8m]
        - required: [buck9m]
        - required: [ldo1m]
    then:
      patternProperties:
        "^(buck[8-9]|ldo1)m$":
          properties:
            samsung,ext-control: false

additionalProperties: false
```

## Documentation/devicetree/bindings/regulator/samsung,s2mpg11-regulator.yaml
```yaml
# SPDX-License-Identifier: GPL-2.0-only OR BSD-2-Clause
%YAML 1.2
---
$id: http://devicetree.org/schemas/regulator/samsung,s2mpg11-regulator.yaml#
$schema: http://devicetree.org/meta-schemas/core.yaml#

title: Samsung S2MPG11 Power Management IC regulators

maintainers:
  - André Draszik <andre.draszik@linaro.org>

description: |
  This is part of the device tree bindings for the S2MG11 Power Management IC
  (PMIC).

  The S2MPG11 PMIC provides 12 buck, 1 buck-boost, and 15 LDO regulators.

  See also Documentation/devicetree/bindings/mfd/samsung,s2mps11.yaml for
  additional information and example.

properties:
  buckboost:
    type: object
    $ref: regulator.yaml#
    unevaluatedProperties: false
    description:
      Properties for the buck-boost regulator.

    properties:
      regulator-ramp-delay: false

patternProperties:
  # 12 bucks
  "^buck(([1-9]|10)s|[ad])$":
    type: object
    $ref: regulator.yaml#
    unevaluatedProperties: false
    description:
      Properties for a single buck regulator.

    allOf:
      - $ref: "#/$defs/s2mpg11-ext-control"

    properties:
      regulator-ramp-delay:
        enum: [6250, 12500, 25000]
        default: 6250

  # 11 standard LDOs
  "^ldo([3-79]|1[01245])s$":
    type: object
    $ref: regulator.yaml#
    unevaluatedProperties: false
    description:
      Properties for a single LDO regulator.

    properties:
      regulator-ramp-delay: false

  # 2 LDOs with possible external control
  "^ldo(8|13)s$":
    type: object
    $ref: regulator.yaml#
    unevaluatedProperties: false
    description:
      Properties for single LDO regulator.

    allOf:
      - $ref: "#/$defs/s2mpg11-ext-control"

    properties:
      regulator-ramp-delay: false

  # 2 LDOs with ramp support and possible external control
  "^ldo[12]s$":
    type: object
    $ref: regulator.yaml#
    unevaluatedProperties: false
    description:
      Properties for a single LDO regulator.

    allOf:
      - $ref: "#/$defs/s2mpg11-ext-control"

    properties:
      regulator-ramp-delay:
        enum: [6250, 12500]
        default: 6250

$defs:
  s2mpg11-ext-control:
    properties:
      samsung,ext-control:
        description: |
          These rails can be controlled via one of several possible external
          (hardware) signals. If so, this property configures the signal the PMIC
          should monitor. The following values generally corresponding to the
          respective on-chip pin are valid:
            - 0 # S2MPG11_EXTCTRL_PWREN - PWREN pin
            - 1 # S2MPG11_EXTCTRL_PWREN_MIF - PWREN_MIF pin
            - 2 # S2MPG11_EXTCTRL_AP_ACTIVE_N - ~AP_ACTIVE_N pin
            - 3 # S2MPG11_EXTCTRL_G3D_EN - G3D_EN pin
            - 4 # S2MPG11_EXTCTRL_G3D_EN2 - G3D_EN & ~AP_ACTIVE_N pins
            - 5 # S2MPG11_EXTCTRL_AOC_VDD - AOC_VDD pin
            - 6 # S2MPG11_EXTCTRL_AOC_RET - AOC_RET pin
            - 7 # S2MPG11_EXTCTRL_UFS_EN - UFS_EN pin
            - 8 # S2MPG11_EXTCTRL_LDO13S_EN - VLDO13S_EN pin

        $ref: /schemas/types.yaml#/definitions/uint32
        minimum: 0
        maximum: 8

      enable-gpios:
        description:
          For rails where external control is done via a GPIO, this optional
          property describes the GPIO line used.

    dependentRequired:
      enable-gpios: [ "samsung,ext-control" ]

allOf:
  # Bucks 4, 6, 7 and 10 can not be controlled externally - above definition
  # allows it and we deny it here. This approach reduces repetition.
  - if:
      anyOf:
        - required: [buck4s]
        - required: [buck6s]
        - required: [buck7s]
        - required: [buck10s]
    then:
      patternProperties:
        "^buck([467]|10)s$":
          properties:
            samsung,ext-control: false

additionalProperties: false
```

## Documentation/devicetree/bindings/regulator/samsung,s2mps11.txt
```
Binding for Samsung S2M family regulator block
==============================================

This is a part of device tree bindings for S2M family multi-function devices.
More information can be found in bindings/mfd/sec-core.txt file.

The S2MPS11/13/14/15 and S2MPU02 devices provide buck and LDO regulators.

To register these with regulator framework instantiate under main device node
a sub-node named "regulators" with more sub-nodes for each regulator using the
common regulator binding documented in:
 - Documentation/devicetree/bindings/regulator/regulator.txt


Names of regulators supported by different devices:
	- LDOn
		  - valid values for n are:
			- S2MPS11: 1 to 38
			- S2MPS13: 1 to 40
			- S2MPS14: 1 to 25
			- S2MPS15: 1 to 27
			- S2MPU02: 1 to 28
		  - Example: LDO1, LDO2, LDO28
	- BUCKn
		  - valid values for n are:
			- S2MPS11: 1 to 10
			- S2MPS13: 1 to 10
			- S2MPS14: 1 to 5
			- S2MPS15: 1 to 10
			- S2MPU02: 1 to 7
		  - Example: BUCK1, BUCK2, BUCK9
Note: The 'n' in LDOn and BUCKn represents the LDO or BUCK number
as per the datasheet of device.


Optional properties of the nodes under "regulators" sub-node:
 - regulator-ramp-delay: ramp delay in uV/us. May be 6250, 12500,
   25000 (default) or 50000.

   Additionally S2MPS11 supports disabling ramp delay for BUCK{2,3,4,6}
   by setting it to <0>.

   Note: On S2MPS11 some bucks share the ramp rate setting i.e. same ramp value
   will be set for a particular group of bucks so provide the same
   regulator-ramp-delay value for them.
   Groups sharing ramp rate:
    - buck{1,6},
    - buck{3,4},
    - buck{7,8,10}.

 - samsung,ext-control-gpios: On S2MPS14 the LDO10, LDO11 and LDO12 can be
   configured to external control over GPIO. To turn this feature on this
   property must be added to the regulator sub-node:
    - samsung,ext-control-gpios: GPIO specifier for one GPIO
                                 controlling this regulator (enable/disable)
  Example:
	LDO12 {
		regulator-name = "V_EMMC_2.8V";
		regulator-min-microvolt = <2800000>;
		regulator-max-microvolt = <2800000>;
		samsung,ext-control-gpios = <&gpk0 2 0>;
	};


Example:

	s2mps11_pmic@66 {
		compatible = "samsung,s2mps11-pmic";
		reg = <0x66>;

		regulators {
			ldo1_reg: LDO1 {
				regulator-name = "VDD_ABB_3.3V";
				regulator-min-microvolt = <3300000>;
				regulator-max-microvolt = <3300000>;
			};

			ldo2_reg: LDO2 {
				regulator-name = "VDD_ALIVE_1.1V";
				regulator-min-microvolt = <1100000>;
				regulator-max-microvolt = <1100000>;
				regulator-always-on;
			};

			buck1_reg: BUCK1 {
				regulator-name = "vdd_mif";
				regulator-min-microvolt = <950000>;
				regulator-max-microvolt = <1350000>;
				regulator-always-on;
				regulator-boot-on;
			};

			buck2_reg: BUCK2 {
				regulator-name = "vdd_arm";
				regulator-min-microvolt = <950000>;
				regulator-max-microvolt = <1350000>;
				regulator-always-on;
				regulator-boot-on;
				regulator-ramp-delay = <50000>;
			};
		};
	};
```
