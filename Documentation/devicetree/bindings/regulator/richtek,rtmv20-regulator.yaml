## Documentation/devicetree/bindings/regulator/samsung,s2mps14.yaml
```yaml
# SPDX-License-Identifier: GPL-2.0-only OR BSD-2-Clause
%YAML 1.2
---
$id: http://devicetree.org/schemas/regulator/samsung,s2mps14.yaml#
$schema: http://devicetree.org/meta-schemas/core.yaml#

title: Samsung S2MPS14 Power Management IC regulators

maintainers:
  - Krzysztof Kozlowski <krzk@kernel.org>

description: |
  This is a part of device tree bindings for S2M and S5M family of Power
  Management IC (PMIC).

  The S2MPS14 provides buck and LDO regulators.

  See also Documentation/devicetree/bindings/mfd/samsung,s2mps11.yaml for
  additional information and example.

patternProperties:
  # 25 LDOs, without LDO10-12
  "^LDO([1-9]|1[3-9]|2[0-5])$":
    type: object
    $ref: regulator.yaml#
    unevaluatedProperties: false
    description:
      Properties for single LDO regulator.

    required:
      - regulator-name

  "^LDO(1[0-2])$":
    type: object
    $ref: regulator.yaml#
    unevaluatedProperties: false
    description:
      Properties for single LDO regulator.

    properties:
      samsung,ext-control-gpios:
        maxItems: 1
        description:
          LDO10, LDO11 and LDO12 can be configured to external control over
          GPIO.

    required:
      - regulator-name

  # 5 bucks
  "^BUCK[1-5]$":
    type: object
    $ref: regulator.yaml#
    unevaluatedProperties: false
    description:
      Properties for single BUCK regulator.

    required:
      - regulator-name

additionalProperties: false
```
