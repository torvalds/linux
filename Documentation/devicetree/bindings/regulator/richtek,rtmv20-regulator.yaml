## Documentation/devicetree/bindings/regulator/rk860x-regulator.yaml
```yaml
# SPDX-License-Identifier: (GPL-2.0-only OR BSD-2-Clause)
%YAML 1.2
---
$id: http://devicetree.org/schemas/regulator/rk860x-regulator.yaml#
$schema: http://devicetree.org/meta-schemas/core.yaml#

title: Rockchip Rk860x voltage regulator

maintainers:
  - Elaine Zhang <zhangqing@rock-chips.com>

description: |
  Rockchip RK860X Digitally Programmable Buck Regulator.
  The RK860X is a step-down switching voltage regulator that
  delivers a digitally programmable output from an input voltage supply
  of 2.5V to 5.5V. The output voltage is programmed through an I2C interface.

allOf:
  - $ref: regulator.yaml#

properties:
  $nodename:
    pattern: "^rk860[0-3]@[0-9a-f]"
  compatible:
    const: rockchip,rk860x

  reg:
    maxItems: 1

  vin-supply:
    description: Input supply phandle

  vsel:
    minItems: 1
    maxItems: 1
    description: |
      GPIO pin used for DVS voltage selection or used to control enable status of regulator.

  rockchip,suspend-voltage-selector:
    maxItems: 1
    description: |
      The polarity of vsel pin.

  limit-microvolt:
    description: |
      The limit of voltage setting.

required:
  - compatible
  - reg

unevaluatedProperties: false

examples:
  - |
    i2c {
        #address-cells = <1>;
        #size-cells = <0>;

        vdd_cpu: rk8600@40{
            compatible = "rockchip,rk860x";
            reg = <0x40>;
            vin-supply = <&vcc5v0_sys>;
            regulator-compatible = "rk860x-reg";
            regulator-name = "vdd_cpu";
            regulator-min-microvolt = <712500>;
            regulator-max-microvolt = <1390000>;
            regulator-init-microvolt = <900000>;
            regulator-ramp-delay = <2300>;
            rockchip,suspend-voltage-selector = <1>;
            regulator-boot-on;
            regulator-always-on;
            regulator-state-mem {
                regulator-off-in-suspend;
            };
        };
    };
```

## Documentation/devicetree/bindings/regulator/rohm,bd70528-regulator.txt
```
ROHM BD70528 Power Management Integrated Circuit regulator bindings

Required properties:
 - regulator-name: should be "buck1", "buck2", "buck3", "ldo1", "ldo2", "ldo3",
		   "led_ldo1", "led_ldo2"

List of regulators provided by this controller. BD70528 regulators node
should be sub node of the BD70528 MFD node. See BD70528 MFD bindings at
Documentation/devicetree/bindings/mfd/rohm,bd70528-pmic.txt

The valid names for BD70528 regulator nodes are:
BUCK1, BUCK2, BUCK3, LDO1, LDO2, LDO3, LED_LDO1, LED_LDO2

Optional properties:
- Any optional property defined in bindings/regulator/regulator.txt

Example:
regulators {
	buck1: BUCK1 {
		regulator-name = "buck1";
		regulator-min-microvolt = <1200000>;
		regulator-max-microvolt = <3400000>;
		regulator-boot-on;
		regulator-ramp-delay = <125>;
	};
	buck2: BUCK2 {
		regulator-name = "buck2";
		regulator-min-microvolt = <1200000>;
		regulator-max-microvolt = <3300000>;
		regulator-boot-on;
		regulator-ramp-delay = <125>;
	};
	buck3: BUCK3 {
		regulator-name = "buck3";
		regulator-min-microvolt = <800000>;
		regulator-max-microvolt = <1800000>;
		regulator-boot-on;
		regulator-ramp-delay = <250>;
	};
	ldo1: LDO1 {
		regulator-name = "ldo1";
		regulator-min-microvolt = <1650000>;
		regulator-max-microvolt = <3300000>;
		regulator-boot-on;
	};
	ldo2: LDO2 {
		regulator-name = "ldo2";
		regulator-min-microvolt = <1650000>;
		regulator-max-microvolt = <3300000>;
		regulator-boot-on;
	};

	ldo3: LDO3 {
		regulator-name = "ldo3";
		regulator-min-microvolt = <1650000>;
		regulator-max-microvolt = <3300000>;
	};
	led_ldo1: LED_LDO1 {
		regulator-name = "led_ldo1";
		regulator-min-microvolt = <200000>;
		regulator-max-microvolt = <300000>;
	};
	led_ldo2: LED_LDO2 {
		regulator-name = "led_ldo2";
		regulator-min-microvolt = <200000>;
		regulator-max-microvolt = <300000>;
	};
};
```

## Documentation/devicetree/bindings/regulator/rohm,bd71815-regulator.yaml
```yaml
# SPDX-License-Identifier: GPL-2.0-only OR BSD-2-Clause
%YAML 1.2
---
$id: http://devicetree.org/schemas/regulator/rohm,bd71815-regulator.yaml#
$schema: http://devicetree.org/meta-schemas/core.yaml#

title: ROHM BD71815 Power Management Integrated Circuit regulators

maintainers:
  - Matti Vaittinen <matti.vaittinen@fi.rohmeurope.com>

description: |
  This module is part of the ROHM BD718215 MFD device. For more details
  see Documentation/devicetree/bindings/mfd/rohm,bd71815-pmic.yaml.

  The regulator controller is represented as a sub-node of the PMIC node
  on the device tree.

  The valid names for BD71815 regulator nodes are
  buck1, buck2, buck3, buck4, buck5,
  ldo1, ldo2, ldo3, ldo4, ldo5,
  ldodvref, ldolpsr, wled

properties:
  wled:
    type: object
    description:
      properties for wled regulator
    $ref: regulator.yaml#
    unevaluatedProperties: false

    properties:
      regulator-name:
        const: wled

patternProperties:
  "^((ldo|buck)[1-5]|ldolpsr|ldodvref)$":
    type: object
    description:
      Properties for single LDO/BUCK regulator.
    $ref: regulator.yaml#

    properties:
      regulator-name:
        pattern: "^((ldo|buck)[1-5]|ldolpsr|ldodvref)$"
        description:
          should be "ldo1", ..., "ldo5", "buck1", ..., "buck5" and "ldolpsr"
          for ldolpsr regulator, "ldodvref" for ldodvref reglator.

      rohm,vsel-gpios:
        description:
          GPIO used to control ldo4 state (when ldo4 is controlled by GPIO).

      rohm,dvs-run-voltage:
        description:
          PMIC "RUN" state voltage in uV when PMIC HW states are used. See
          comments below for bucks/LDOs which support this. 0 means
          regulator should be disabled at RUN state.
        $ref: "/schemas/types.yaml#/definitions/uint32"
        minimum: 0
        maximum: 3300000

      rohm,dvs-snvs-voltage:
        description:
          Whether to keep regulator enabled at "SNVS" state or not.
          0 means regulator should be disabled at SNVS state, non zero voltage
          keeps regulator enabled. BD71815 does not change voltage level
          when PMIC transitions to SNVS.SNVS voltage depends on the previous
          state (from which the PMIC transitioned to SNVS).
        $ref: "/schemas/types.yaml#/definitions/uint32"
        minimum: 0
        maximum: 3300000

      rohm,dvs-suspend-voltage:
        description:
          PMIC "SUSPEND" state voltage in uV when PMIC HW states are used. See
          comments below for bucks/LDOs which support this. 0 means
          regulator should be disabled at SUSPEND state.
        $ref: "/schemas/types.yaml#/definitions/uint32"
        minimum: 0
        maximum: 3300000

      rohm,dvs-lpsr-voltage:
        description:
          PMIC "LPSR" state voltage in uV when PMIC HW states are used. See
          comments below for bucks/LDOs which support this. 0 means
          regulator should be disabled at LPSR state.
        $ref: "/schemas/types.yaml#/definitions/uint32"
        minimum: 0
        maximum: 3300000

        # Bucks 1 and 2 support giving separate voltages for operational states
        # (RUN /CLEAN according to data-sheet) and non operational states
        # (LPSR/SUSPEND). The voltage is automatically changed when HW
        # state changes. Omitting these properties from bucks 1 and 2 leave
        # buck voltages to not be toggled by HW state. Enable status may still
        # be toggled by state changes depending on HW default settings.
        #
        # Bucks 3-5 and ldos 1-5 support setting the RUN state voltage here.
        # Given RUN voltage is used at all states if regulator is enabled at
        # given state.
        # Values given for other states are regarded as enable/disable at
        # given state (see below).
        #
        # All regulators except WLED support specifying enable/disable status
        # for each of the HW states (RUN/SNVS/SUSPEND/LPSR). HW defaults can
        # be overridden by setting voltage to 0 (regulator disabled at given
        # state) or non-zero (regulator enabled at given state). Please note
        # that setting non zero voltages for bucks 1/2 will also enable voltage
        # changes according to state change.

    required:
      - regulator-name

    unevaluatedProperties: false

additionalProperties: false
```

## Documentation/devicetree/bindings/regulator/rohm,bd71828-regulator.yaml
```yaml
# SPDX-License-Identifier: GPL-2.0-only OR BSD-2-Clause
%YAML 1.2
---
$id: http://devicetree.org/schemas/regulator/rohm,bd71828-regulator.yaml#
$schema: http://devicetree.org/meta-schemas/core.yaml#

title: ROHM BD71828 Power Management Integrated Circuit regulators

maintainers:
  - Matti Vaittinen <matti.vaittinen@fi.rohmeurope.com>

description: |
  This module is part of the ROHM BD71828 MFD device. For more details
  see Documentation/devicetree/bindings/mfd/rohm,bd71828-pmic.yaml.

  The regulator controller is represented as a sub-node of the PMIC node
  on the device tree.

  Regulator nodes should be named to BUCK_<number> and LDO_<number>.
  The valid names for BD71828 regulator nodes are
  BUCK1, BUCK2, BUCK3, BUCK4, BUCK5, BUCK6, BUCK7
  LDO1, LDO2, LDO3, LDO4, LDO5, LDO6, LDO7

patternProperties:
  "^LDO[1-7]$":
    type: object
    description:
      Properties for single LDO regulator.
    $ref: regulator.yaml#

    properties:
      regulator-name:
        pattern: "^ldo[1-7]$"
        description:
          should be "ldo1", ..., "ldo7"

    unevaluatedProperties: false

  "^BUCK[1-7]$":
    type: object
    description:
      Properties for single BUCK regulator.
    $ref: regulator.yaml#

    properties:
      regulator-name:
        pattern: "^buck[1-7]$"
        description:
          should be "buck1", ..., "buck7"

      rohm,dvs-run-voltage:
        description:
          PMIC default "RUN" state voltage in uV. See below table for
          bucks which support this. 0 means disabled.
        $ref: "/schemas/types.yaml#/definitions/uint32"
        minimum: 0
        maximum: 3300000

      rohm,dvs-idle-voltage:
        description:
          PMIC default "IDLE" state voltage in uV. See below table for
          bucks which support this. 0 means disabled.
        $ref: "/schemas/types.yaml#/definitions/uint32"
        minimum: 0
        maximum: 3300000

      rohm,dvs-suspend-voltage:
        description:
          PMIC default "SUSPEND" state voltage in uV. See below table for
          bucks which support this. 0 means disabled.
        $ref: "/schemas/types.yaml#/definitions/uint32"
        minimum: 0
        maximum: 3300000

      rohm,dvs-lpsr-voltage:
        description:
          PMIC default "LPSR" state voltage in uV. See below table for
          bucks which support this. 0 means disabled.
        $ref: "/schemas/types.yaml#/definitions/uint32"
        minimum: 0
        maximum: 3300000

        # Supported default DVS states:
        #     buck       |    run     |   idle    | suspend  | lpsr
        #--------------------------------------------------------------
        # 1, 2, 6, and 7 | supported  | supported | supported (*)
        #--------------------------------------------------------------
        # 3, 4, and 5    |                    supported (**)
        #--------------------------------------------------------------
        #
        #(*)  LPSR and SUSPEND states use same voltage but both states have own
        #     enable /
        #     disable settings. Voltage 0 can be specified for a state to make
        #     regulator disabled on that state.
        #
        #(**) All states use same voltage but have own enable / disable
        #     settings. Voltage 0 can be specified for a state to make
        #     regulator disabled on that state.

    required:
      - regulator-name

    unevaluatedProperties: false

additionalProperties: false
```

## Documentation/devicetree/bindings/regulator/rohm,bd71837-regulator.txt
```
ROHM BD71837 Power Management Integrated Circuit (PMIC) regulator bindings

Required properties:
 - regulator-name: should be "buck1", ..., "buck8" and "ldo1", ..., "ldo7"

List of regulators provided by this controller. BD71837 regulators node
should be sub node of the BD71837 MFD node. See BD71837 MFD bindings at
Documentation/devicetree/bindings/mfd/rohm,bd71837-pmic.txt
Regulator nodes should be named to BUCK_<number> and LDO_<number>. The
definition for each of these nodes is defined using the standard
binding for regulators at
Documentation/devicetree/bindings/regulator/regulator.txt.
Note that if BD71837 starts at RUN state you probably want to use
regulator-boot-on at least for BUCK6 and BUCK7 so that those are not
disabled by driver at startup. LDO5 and LDO6 are supplied by those and
if they are disabled at startup the voltage monitoring for LDO5/LDO6 will
cause PMIC to reset.

The valid names for regulator nodes are:
BUCK1, BUCK2, BUCK3, BUCK4, BUCK5, BUCK6, BUCK7, BUCK8
LDO1, LDO2, LDO3, LDO4, LDO5, LDO6, LDO7

Optional properties:
- Any optional property defined in bindings/regulator/regulator.txt

Example:
regulators {
	buck1: BUCK1 {
		regulator-name = "buck1";
		regulator-min-microvolt = <700000>;
		regulator-max-microvolt = <1300000>;
		regulator-boot-on;
		regulator-ramp-delay = <1250>;
	};
	buck2: BUCK2 {
		regulator-name = "buck2";
		regulator-min-microvolt = <700000>;
		regulator-max-microvolt = <1300000>;
		regulator-boot-on;
		regulator-always-on;
		regulator-ramp-delay = <1250>;
	};
	buck3: BUCK3 {
		regulator-name = "buck3";
		regulator-min-microvolt = <700000>;
		regulator-max-microvolt = <1300000>;
		regulator-boot-on;
	};
	buck4: BUCK4 {
		regulator-name = "buck4";
		regulator-min-microvolt = <700000>;
		regulator-max-microvolt = <1300000>;
		regulator-boot-on;
	};
	buck5: BUCK5 {
		regulator-name = "buck5";
		regulator-min-microvolt = <700000>;
		regulator-max-microvolt = <1350000>;
		regulator-boot-on;
	};
	buck6: BUCK6 {
		regulator-name = "buck6";
		regulator-min-microvolt = <3000000>;
		regulator-max-microvolt = <3300000>;
		regulator-boot-on;
	};
	buck7: BUCK7 {
		regulator-name = "buck7";
		regulator-min-microvolt = <1605000>;
		regulator-max-microvolt = <1995000>;
		regulator-boot-on;
	};
	buck8: BUCK8 {
		regulator-name = "buck8";
		regulator-min-microvolt = <800000>;
		regulator-max-microvolt = <1400000>;
	};

	ldo1: LDO1 {
		regulator-name = "ldo1";
		regulator-min-microvolt = <3000000>;
		regulator-max-microvolt = <3300000>;
		regulator-boot-on;
	};
	ldo2: LDO2 {
		regulator-name = "ldo2";
		regulator-min-microvolt = <900000>;
		regulator-max-microvolt = <900000>;
		regulator-boot-on;
	};
	ldo3: LDO3 {
		regulator-name = "ldo3";
		regulator-min-microvolt = <1800000>;
		regulator-max-microvolt = <3300000>;
	};
	ldo4: LDO4 {
		regulator-name = "ldo4";
		regulator-min-microvolt = <900000>;
		regulator-max-microvolt = <1800000>;
	};
	ldo5: LDO5 {
		regulator-name = "ldo5";
		regulator-min-microvolt = <1800000>;
		regulator-max-microvolt = <3300000>;
	};
	ldo6: LDO6 {
		regulator-name = "ldo6";
		regulator-min-microvolt = <900000>;
		regulator-max-microvolt = <1800000>;
	};
	ldo7_reg: LDO7 {
		regulator-name = "ldo7";
		regulator-min-microvolt = <1800000>;
		regulator-max-microvolt = <3300000>;
	};
};
```
