## Documentation/devicetree/bindings/regulator/mt6360-regulator.yaml
```yaml
# SPDX-License-Identifier: (GPL-2.0 OR BSD-2-Clause)
%YAML 1.2
---
$id: http://devicetree.org/schemas/regulator/mt6360-regulator.yaml#
$schema: http://devicetree.org/meta-schemas/core.yaml#

title: MT6360 Regulator from MediaTek Integrated

maintainers:
  - Gene Chen <gene_chen@richtek.com>

description: |
  list of regulators provided by this controller, must be named
  after their hardware counterparts buck1/2 or ldo1/2/3/5/6/7

properties:
  compatible:
    const: mediatek,mt6360-regulator

  LDO_VIN1-supply:
    description: Input supply phandle(s) for LDO1/2/3
  LDO_VIN2-supply:
    description: Input supply phandle(s) for LDO5
  LDO_VIN3-supply:
    description: Input supply phandle(s) for LDO6/7

patternProperties:
  "^buck[12]$":
    $ref: "regulator.yaml#"
    unevaluatedProperties: false

  "^ldo[123567]$":
    $ref: "regulator.yaml#"
    unevaluatedProperties: false

required:
  - compatible

additionalProperties: false

examples:
  - |
    #include <dt-bindings/interrupt-controller/irq.h>
    #include <dt-bindings/regulator/mediatek,mt6360-regulator.h>
    regulator {
      compatible = "mediatek,mt6360-regulator";
      LDO_VIN3-supply = <&BUCK2>;
      buck1 {
        regulator-name = "mt6360,buck1";
        regulator-min-microvolt = <300000>;
        regulator-max-microvolt = <1300000>;
        regulator-allowed-modes = <MT6360_OPMODE_NORMAL
             MT6360_OPMODE_LP
             MT6360_OPMODE_ULP>;
      };
      BUCK2: buck2 {
        regulator-name = "mt6360,buck2";
        regulator-min-microvolt = <300000>;
        regulator-max-microvolt = <1300000>;
        regulator-allowed-modes = <MT6360_OPMODE_NORMAL
             MT6360_OPMODE_LP
             MT6360_OPMODE_ULP>;
      };
      ldo6 {
        regulator-name = "mt6360,ldo6";
        regulator-min-microvolt = <500000>;
        regulator-max-microvolt = <2100000>;
        regulator-allowed-modes = <MT6360_OPMODE_NORMAL
             MT6360_OPMODE_LP>;
      };
      ldo7 {
        regulator-name = "mt6360,ldo7";
        regulator-min-microvolt = <500000>;
        regulator-max-microvolt = <2100000>;
        regulator-allowed-modes = <MT6360_OPMODE_NORMAL
             MT6360_OPMODE_LP>;
      };
      ldo1 {
        regulator-name = "mt6360,ldo1";
        regulator-min-microvolt = <1200000>;
        regulator-max-microvolt = <3600000>;
        regulator-allowed-modes = <MT6360_OPMODE_NORMAL
             MT6360_OPMODE_LP>;
      };
      ldo2 {
        regulator-name = "mt6360,ldo2";
        regulator-min-microvolt = <1200000>;
        regulator-max-microvolt = <3600000>;
        regulator-allowed-modes = <MT6360_OPMODE_NORMAL
             MT6360_OPMODE_LP>;
      };
      ldo3 {
        regulator-name = "mt6360,ldo3";
        regulator-min-microvolt = <1200000>;
        regulator-max-microvolt = <3600000>;
        regulator-allowed-modes = <MT6360_OPMODE_NORMAL
             MT6360_OPMODE_LP>;
      };
      ldo5 {
        regulator-name = "mt6360,ldo5";
        regulator-min-microvolt = <2700000>;
        regulator-max-microvolt = <3600000>;
        regulator-allowed-modes = <MT6360_OPMODE_NORMAL
             MT6360_OPMODE_LP>;
      };
    };
...
```

## Documentation/devicetree/bindings/regulator/mt6380-regulator.txt
```
MediaTek MT6380 Regulator

All voltage regulators provided by the MT6380 PMIC are described as the
subnodes of the MT6380 regulators node. Each regulator is named according
to its regulator type, buck-<name> and ldo-<name>. The definition for each
of these nodes is defined using the standard binding for regulators at
Documentation/devicetree/bindings/regulator/regulator.txt.

The valid names for regulators are:
BUCK:
  buck-core1, buck-vcore, buck-vrf
LDO:
  ldo-vm ,ldo-va , ldo-vphy, ldo-vddr, ldo-vt

Example:

	regulators {
		compatible = "mediatek,mt6380-regulator";

		mt6380_vcpu_reg: buck-vcore1 {
			regulator-name = "vcore1";
			regulator-min-microvolt = < 600000>;
			regulator-max-microvolt = <1393750>;
			regulator-ramp-delay = <6250>;
			regulator-always-on;
			regulator-boot-on;
		};

		mt6380_vcore_reg: buck-vcore {
			regulator-name = "vcore";
			regulator-min-microvolt = <600000>;
			regulator-max-microvolt = <1393750>;
			regulator-ramp-delay = <6250>;
		};

		mt6380_vrf_reg: buck-vrf {
			regulator-name = "vrf";
			regulator-min-microvolt = <1200000>;
			regulator-max-microvolt = <1575000>;
			regulator-ramp-delay = <0>;
			regulator-always-on;
			regulator-boot-on;
		};

		mt6380_vm_reg: ldo-vm {
			regulator-name = "vm";
			regulator-min-microvolt = <1050000>;
			regulator-max-microvolt = <1400000>;
			regulator-ramp-delay = <0>;
			regulator-always-on;
			regulator-boot-on;
		};

		mt6380_va_reg: ldo-va {
			regulator-name = "va";
			regulator-min-microvolt = <2200000>;
			regulator-max-microvolt = <3300000>;
			regulator-ramp-delay = <0>;
			regulator-always-on;
			regulator-boot-on;
		};

		mt6380_vphy_reg: ldo-vphy {
			regulator-name = "vphy";
			regulator-min-microvolt = <1800000>;
			regulator-max-microvolt = <1800000>;
			regulator-ramp-delay = <0>;
			regulator-always-on;
			regulator-boot-on;
		};

		mt6380_vddr_reg: ldo-vddr {
			regulator-name = "vddr";
			regulator-min-microvolt = <1240000>;
			regulator-max-microvolt = <1840000>;
			regulator-ramp-delay = <0>;
			regulator-always-on;
			regulator-boot-on;
		};

		mt6380_vt_reg: ldo-vt {
			regulator-name = "vt";
			regulator-min-microvolt = <2200000>;
			regulator-max-microvolt = <3300000>;
			regulator-ramp-delay = <0>;
			regulator-always-on;
			regulator-boot-on;
		};
	};
```

## Documentation/devicetree/bindings/regulator/mt6397-regulator.txt
```
Mediatek MT6397 Regulator

Required properties:
- compatible: "mediatek,mt6397-regulator"
- mt6397regulator: List of regulators provided by this controller. It is named
  according to its regulator type, buck_<name> and ldo_<name>.
  The definition for each of these nodes is defined using the standard binding
  for regulators at Documentation/devicetree/bindings/regulator/regulator.txt.

The valid names for regulators are::
BUCK:
  buck_vpca15, buck_vpca7, buck_vsramca15, buck_vsramca7, buck_vcore, buck_vgpu,
  buck_vdrm, buck_vio18
LDO:
  ldo_vtcxo, ldo_va28, ldo_vcama, ldo_vio28, ldo_vusb, ldo_vmc, ldo_vmch,
  ldo_vemc3v3, ldo_vgp1, ldo_vgp2, ldo_vgp3, ldo_vgp4, ldo_vgp5, ldo_vgp6,
  ldo_vibr

Example:
	pmic {
		compatible = "mediatek,mt6397";

		mt6397regulator: mt6397regulator {
			compatible = "mediatek,mt6397-regulator";

			mt6397_vpca15_reg: buck_vpca15 {
				regulator-compatible = "buck_vpca15";
				regulator-name = "vpca15";
				regulator-min-microvolt = < 850000>;
				regulator-max-microvolt = <1350000>;
				regulator-ramp-delay = <12500>;
				regulator-enable-ramp-delay = <200>;
			};

			mt6397_vpca7_reg: buck_vpca7 {
				regulator-compatible = "buck_vpca7";
				regulator-name = "vpca7";
				regulator-min-microvolt = < 850000>;
				regulator-max-microvolt = <1350000>;
				regulator-ramp-delay = <12500>;
				regulator-enable-ramp-delay = <115>;
			};

			mt6397_vsramca15_reg: buck_vsramca15 {
				regulator-compatible = "buck_vsramca15";
				regulator-name = "vsramca15";
				regulator-min-microvolt = < 850000>;
				regulator-max-microvolt = <1350000>;
				regulator-ramp-delay = <12500>;
				regulator-enable-ramp-delay = <115>;

			};

			mt6397_vsramca7_reg: buck_vsramca7 {
				regulator-compatible = "buck_vsramca7";
				regulator-name = "vsramca7";
				regulator-min-microvolt = < 850000>;
				regulator-max-microvolt = <1350000>;
				regulator-ramp-delay = <12500>;
				regulator-enable-ramp-delay = <115>;

			};

			mt6397_vcore_reg: buck_vcore {
				regulator-compatible = "buck_vcore";
				regulator-name = "vcore";
				regulator-min-microvolt = < 850000>;
				regulator-max-microvolt = <1350000>;
				regulator-ramp-delay = <12500>;
				regulator-enable-ramp-delay = <115>;
			};

			mt6397_vgpu_reg: buck_vgpu {
				regulator-compatible = "buck_vgpu";
				regulator-name = "vgpu";
				regulator-min-microvolt = < 700000>;
				regulator-max-microvolt = <1350000>;
				regulator-ramp-delay = <12500>;
				regulator-enable-ramp-delay = <115>;
			};

			mt6397_vdrm_reg: buck_vdrm {
				regulator-compatible = "buck_vdrm";
				regulator-name = "vdrm";
				regulator-min-microvolt = < 800000>;
				regulator-max-microvolt = <1400000>;
				regulator-ramp-delay = <12500>;
				regulator-enable-ramp-delay = <500>;
			};

			mt6397_vio18_reg: buck_vio18 {
				regulator-compatible = "buck_vio18";
				regulator-name = "vio18";
				regulator-min-microvolt = <1500000>;
				regulator-max-microvolt = <2120000>;
				regulator-ramp-delay = <12500>;
				regulator-enable-ramp-delay = <500>;
			};

			mt6397_vtcxo_reg: ldo_vtcxo {
				regulator-compatible = "ldo_vtcxo";
				regulator-name = "vtcxo";
				regulator-min-microvolt = <2800000>;
				regulator-max-microvolt = <2800000>;
				regulator-enable-ramp-delay = <90>;
			};

			mt6397_va28_reg: ldo_va28 {
				regulator-compatible = "ldo_va28";
				regulator-name = "va28";
				/* fixed output 2.8 V */
				regulator-enable-ramp-delay = <218>;
			};

			mt6397_vcama_reg: ldo_vcama {
				regulator-compatible = "ldo_vcama";
				regulator-name = "vcama";
				regulator-min-microvolt = <1500000>;
				regulator-max-microvolt = <2800000>;
				regulator-enable-ramp-delay = <218>;
			};

			mt6397_vio28_reg: ldo_vio28 {
				regulator-compatible = "ldo_vio28";
				regulator-name = "vio28";
				/* fixed output 2.8 V */
				regulator-enable-ramp-delay = <240>;
			};

			mt6397_usb_reg: ldo_vusb {
				regulator-compatible = "ldo_vusb";
				regulator-name = "vusb";
				/* fixed output 3.3 V */
				regulator-enable-ramp-delay = <218>;
			};

			mt6397_vmc_reg: ldo_vmc {
				regulator-compatible = "ldo_vmc";
				regulator-name = "vmc";
				regulator-min-microvolt = <1800000>;
				regulator-max-microvolt = <3300000>;
				regulator-enable-ramp-delay = <218>;
			};

			mt6397_vmch_reg: ldo_vmch {
				regulator-compatible = "ldo_vmch";
				regulator-name = "vmch";
				regulator-min-microvolt = <3000000>;
				regulator-max-microvolt = <3300000>;
				regulator-enable-ramp-delay = <218>;
			};

			mt6397_vemc_3v3_reg: ldo_vemc3v3 {
				regulator-compatible = "ldo_vemc3v3";
				regulator-name = "vemc_3v3";
				regulator-min-microvolt = <3000000>;
				regulator-max-microvolt = <3300000>;
				regulator-enable-ramp-delay = <218>;
			};

			mt6397_vgp1_reg: ldo_vgp1 {
				regulator-compatible = "ldo_vgp1";
				regulator-name = "vcamd";
				regulator-min-microvolt = <1220000>;
				regulator-max-microvolt = <3300000>;
				regulator-enable-ramp-delay = <240>;
			};

			mt6397_vgp2_reg: ldo_vgp2 {
				egulator-compatible = "ldo_vgp2";
				regulator-name = "vcamio";
				regulator-min-microvolt = <1000000>;
				regulator-max-microvolt = <3300000>;
				regulator-enable-ramp-delay = <218>;
			};

			mt6397_vgp3_reg: ldo_vgp3 {
				regulator-compatible = "ldo_vgp3";
				regulator-name = "vcamaf";
				regulator-min-microvolt = <1200000>;
				regulator-max-microvolt = <3300000>;
				regulator-enable-ramp-delay = <218>;
			};

			mt6397_vgp4_reg: ldo_vgp4 {
				regulator-compatible = "ldo_vgp4";
				regulator-name = "vgp4";
				regulator-min-microvolt = <1200000>;
				regulator-max-microvolt = <3300000>;
				regulator-enable-ramp-delay = <218>;
			};

			mt6397_vgp5_reg: ldo_vgp5 {
				regulator-compatible = "ldo_vgp5";
				regulator-name = "vgp5";
				regulator-min-microvolt = <1200000>;
				regulator-max-microvolt = <3000000>;
				regulator-enable-ramp-delay = <218>;
			};

			mt6397_vgp6_reg: ldo_vgp6 {
				regulator-compatible = "ldo_vgp6";
				regulator-name = "vgp6";
				regulator-min-microvolt = <1200000>;
				regulator-max-microvolt = <3300000>;
				regulator-enable-ramp-delay = <218>;
			};

			mt6397_vibr_reg: ldo_vibr {
				regulator-compatible = "ldo_vibr";
				regulator-name = "vibr";
				regulator-min-microvolt = <1200000>;
				regulator-max-microvolt = <3300000>;
				regulator-enable-ramp-delay = <218>;
			};
		};
	};
```

## Documentation/devicetree/bindings/regulator/nvidia,tegra-regulators-coupling.txt
```
NVIDIA Tegra Regulators Coupling
================================

NVIDIA Tegra SoC's have a mandatory voltage-coupling between regulators.
Thus on Tegra20 there are 3 coupled regulators and on NVIDIA Tegra30
there are 2.

Tegra20 voltage coupling
------------------------

On Tegra20 SoC's there are 3 coupled regulators: CORE, RTC and CPU.
The CORE and RTC voltages shall be in a range of 170mV from each other
and they both shall be higher than the CPU voltage by at least 120mV.

Tegra30 voltage coupling
------------------------

On Tegra30 SoC's there are 2 coupled regulators: CORE and CPU. The CORE
and CPU voltages shall be in a range of 300mV from each other and CORE
voltage shall be higher than the CPU by N mV, where N depends on the CPU
voltage.

Required properties:
- nvidia,tegra-core-regulator: Boolean property that designates regulator
  as the "Core domain" voltage regulator.
- nvidia,tegra-rtc-regulator: Boolean property that designates regulator
  as the "RTC domain" voltage regulator.
- nvidia,tegra-cpu-regulator: Boolean property that designates regulator
  as the "CPU domain" voltage regulator.

Example:

	pmic {
		regulators {
			core_vdd_reg: core {
				regulator-name = "vdd_core";
				regulator-min-microvolt = <950000>;
				regulator-max-microvolt = <1300000>;
				regulator-coupled-with = <&rtc_vdd_reg &cpu_vdd_reg>;
				regulator-coupled-max-spread = <170000 550000>;

				nvidia,tegra-core-regulator;
			};

			rtc_vdd_reg: rtc {
				regulator-name = "vdd_rtc";
				regulator-min-microvolt = <950000>;
				regulator-max-microvolt = <1300000>;
				regulator-coupled-with = <&core_vdd_reg &cpu_vdd_reg>;
				regulator-coupled-max-spread = <170000 550000>;

				nvidia,tegra-rtc-regulator;
			};

			cpu_vdd_reg: cpu {
				regulator-name = "vdd_cpu";
				regulator-min-microvolt = <750000>;
				regulator-max-microvolt = <1125000>;
				regulator-coupled-with = <&core_vdd_reg &rtc_vdd_reg>;
				regulator-coupled-max-spread = <550000 550000>;

				nvidia,tegra-cpu-regulator;
			};
		};
	};
```
