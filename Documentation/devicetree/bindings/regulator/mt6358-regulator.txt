## Documentation/devicetree/bindings/regulator/nxp,pf8x00-regulator.yaml
```yaml
# SPDX-License-Identifier: (GPL-2.0-only OR BSD-2-Clause)
%YAML 1.2
---
$id: http://devicetree.org/schemas/regulator/nxp,pf8x00-regulator.yaml#
$schema: http://devicetree.org/meta-schemas/core.yaml#

title: NXP PF8100/PF8121A/PF8200 PMIC regulators

maintainers:
  - Jagan Teki <jagan@amarulasolutions.com>
  - Troy Kisky <troy.kisky@boundarydevices.com>

description: |
  PF8100/PF8121A/PF8200 is a PMIC designed for highperformance consumer
  applications. It features seven high efficiency buck converters, four
  linear and one vsnvs regulators. It has built-in one time programmable
  fuse bank for device configurations.

properties:
  compatible:
    enum:
      - nxp,pf8100
      - nxp,pf8121a
      - nxp,pf8200

  reg:
    maxItems: 1

  regulators:
    type: object
    description: |
      list of regulators provided by this controller

    patternProperties:
      "^ldo[1-4]$":
        type: object
        $ref: regulator.yaml#
        description:
          Properties for single LDO regulator.

        unevaluatedProperties: false

      "^buck[1-7]$":
        type: object
        $ref: regulator.yaml#
        description:
          Properties for single BUCK regulator.

        properties:
          nxp,ilim-ma:
            $ref: /schemas/types.yaml#/definitions/uint32
            minimum: 2100
            maximum: 4500
            deprecated: true
            description:
              BUCK regulators current limit in mA.
              This property is deprecated, please use
              "regulator-max-microamp" instead.

              Listed current limits in mA are,
              2100 (default)
              2600
              3000
              4500

          nxp,phase-shift:
            $ref: /schemas/types.yaml#/definitions/uint32
            default: 0
            enum: [ 0, 45, 90, 135, 180, 225, 270, 315 ]
            description:
              BUCK regulators phase shift control in degrees.

        unevaluatedProperties: false

    properties:
      vsnvs:
        type: object
        $ref: regulator.yaml#
        description:
          Properties for single VSNVS regulator.

        unevaluatedProperties: false

    additionalProperties: false

required:
  - compatible
  - reg
  - regulators

additionalProperties: false

examples:
  - |
    i2c {
        #address-cells = <1>;
        #size-cells = <0>;

        pmic@8 {
            compatible = "nxp,pf8100";
            reg = <0x08>;

            regulators {
                reg_ldo1: ldo1 {
                    regulator-always-on;
                    regulator-boot-on;
                    regulator-max-microvolt = <5000000>;
                    regulator-min-microvolt = <1500000>;
                };

                reg_ldo2: ldo2 {
                    regulator-always-on;
                    regulator-boot-on;
                    regulator-max-microvolt = <5000000>;
                    regulator-min-microvolt = <1500000>;
                };

                reg_ldo3: ldo3 {
                    regulator-always-on;
                    regulator-boot-on;
                    regulator-max-microvolt = <5000000>;
                    regulator-min-microvolt = <1500000>;
                };

                reg_ldo4: ldo4 {
                    regulator-always-on;
                    regulator-boot-on;
                    regulator-max-microvolt = <5000000>;
                    regulator-min-microvolt = <1500000>;
                };

                reg_buck1: buck1 {
                    nxp,ilim-ma = <4500>;
                    regulator-always-on;
                    regulator-boot-on;
                    regulator-max-microvolt = <1800000>;
                    regulator-min-microvolt =  <400000>;
                };

                reg_buck2: buck2 {
                    regulator-always-on;
                    regulator-boot-on;
                    regulator-max-microvolt = <1800000>;
                    regulator-min-microvolt =  <400000>;
                };

                reg_buck3: buck3 {
                    regulator-always-on;
                    regulator-boot-on;
                    regulator-max-microvolt = <1800000>;
                    regulator-min-microvolt =  <400000>;
                };

                reg_buck4: buck4 {
                    regulator-always-on;
                    regulator-boot-on;
                    regulator-max-microvolt = <1800000>;
                    regulator-min-microvolt =  <400000>;
                };

                reg_buck5: buck5 {
                    regulator-always-on;
                    regulator-boot-on;
                    regulator-max-microvolt = <1800000>;
                    regulator-min-microvolt =  <400000>;
                };

                reg_buck6: buck6 {
                    regulator-always-on;
                    regulator-boot-on;
                    regulator-max-microvolt = <1800000>;
                    regulator-min-microvolt =  <400000>;
                };

                reg_buck7: buck7 {
                    regulator-always-on;
                    regulator-boot-on;
                    regulator-max-microvolt = <3300000>;
                    regulator-min-microvolt = <3300000>;
                };

                reg_vsnvs: vsnvs {
                    regulator-always-on;
                    regulator-boot-on;
                    regulator-max-microvolt = <3300000>;
                    regulator-min-microvolt = <1800000>;
                };
            };
        };
    };
```

## Documentation/devicetree/bindings/regulator/onnn,fan53880.yaml
```yaml
# SPDX-License-Identifier: GPL-2.0-only OR BSD-2-Clause
%YAML 1.2
---
$id: http://devicetree.org/schemas/regulator/onnn,fan53880.yaml#
$schema: http://devicetree.org/meta-schemas/core.yaml#

title: Onsemi FAN53880 PMIC

maintainers:
  - Christoph Fritz <chf.fritz@googlemail.com>

description: |
  The FAN53880 is an I2C porgrammable power management IC (PMIC)
  that contains a BUCK (step-down converter), four low dropouts (LDO)
  and one BOOST (step-up converter) output. It is designed for mobile
  power applications.

properties:
  $nodename:
    pattern: "pmic@[0-9a-f]{1,2}"
  compatible:
    enum:
      - onnn,fan53880

  reg:
    maxItems: 1

  VIN12-supply:
    description: Input supply phandle(s) for LDO1 and LDO2

  VIN3-supply:
    description: Input supply phandle(s) for LDO3

  VIN4-supply:
    description: Input supply phandle(s) for LDO4

  PVIN-supply:
    description: Input supply phandle(s) for BUCK and BOOST

  regulators:
    type: object
    $ref: regulator.yaml#
    description: |
      list of regulators provided by this controller, must be named
      after their hardware counterparts LDO[1-4], BUCK and BOOST

    patternProperties:
      "^LDO[1-4]$":
        type: object
        $ref: regulator.yaml#

      "^BUCK|BOOST$":
        type: object
        $ref: regulator.yaml#

    additionalProperties: false

required:
  - compatible
  - reg
  - regulators

additionalProperties: false

examples:
  - |
    i2c {
        #address-cells = <1>;
        #size-cells = <0>;

        pmic@35 {
            compatible = "onnn,fan53880";
            reg = <0x35>;

            PVIN-supply = <&fixreg_example_vcc>;

            regulators {
                BUCK {
                    regulator-min-microvolt = <1200000>;
                    regulator-max-microvolt = <1200000>;
                };
            };
       };
     };
...
```

## Documentation/devicetree/bindings/regulator/palmas-pmic.txt
```
* palmas regulator IP block devicetree bindings

The tps659038 for the AM57x class have OTP spins that
have different part numbers but the same functionality. There
is not a need to add the OTP spins to the palmas driver. The
spin devices should use the tps659038 as it's compatible value.
This is the list of those devices:
tps659037

Required properties:
- compatible : Should be from the list
  ti,twl6035-pmic
  ti,twl6036-pmic
  ti,twl6037-pmic
  ti,tps65913-pmic
  ti,tps65914-pmic
  ti,tps65917-pmic
  ti,tps659038-pmic
and also the generic series names
  ti,palmas-pmic
- interrupts : The interrupt number and the type which can be looked up here:
	       arch/arm/boot/dts/include/dt-bindings/interrupt-controller/irq.h
- interrupts-name: The names of the individual interrupts.

Optional properties:
- ti,ldo6-vibrator : ldo6 is in vibrator mode

Optional nodes:
- regulators : Must contain a sub-node per regulator from the list below.
	       Each sub-node should contain the constraints and initialization
	       information for that regulator. See regulator.txt for a
	       description of standard properties for these sub-nodes.
	       Additional custom properties  are listed below.

	       For ti,palmas-pmic - smps12, smps123, smps3 depending on OTP,
	       smps45, smps457, smps7 depending on variant, smps6, smps[8-9],
	       smps10_out2, smps10_out1, ldo[1-9], ldoln, ldousb.

	       Optional sub-node properties:
	       ti,warm-reset - maintain voltage during warm reset(boolean)
	       ti,roof-floor - This takes as optional argument on platform supporting
	       the rail from desired external control. If there is no argument then
	       it will be assume that it is controlled by NSLEEP pin.
	       The valid value for external pins are:
			ENABLE1 then 1,
			ENABLE2 then 2 or
			NSLEEP then 3.
	       ti,mode-sleep - mode to adopt in pmic sleep 0 - off, 1 - auto,
	       2 - eco, 3 - forced pwm
	       ti,smps-range - OTP has the wrong range set for the hardware so override
	       0 - low range, 1 - high range.

- ti,system-power-controller: Telling whether or not this pmic is controlling
			      the system power.

Example:

#include <dt-bindings/interrupt-controller/irq.h>

pmic {
	compatible = "ti,twl6035-pmic", "ti,palmas-pmic";
	interrupt-parent = <&palmas>;
	interrupts = <14 IRQ_TYPE_NONE>;
	interrupts-name = "short-irq";

	ti,ldo6-vibrator;

	ti,system-power-controller;

	regulators {
		smps12_reg : smps12 {
			regulator-name = "smps12";
			regulator-min-microvolt = < 600000>;
			regulator-max-microvolt = <1500000>;
			regulator-always-on;
			regulator-boot-on;
			ti,warm-reset;
			ti,roof-floor = <1>; /* ENABLE1 control */
			ti,mode-sleep = <0>;
			ti,smps-range = <1>;
		};

		ldo1_reg: ldo1 {
			regulator-name = "ldo1";
			regulator-min-microvolt = <2800000>;
			regulator-max-microvolt = <2800000>;
		};
	};
};
```

## Documentation/devicetree/bindings/regulator/pbias-regulator.txt
```
PBIAS internal regulator for SD card dual voltage i/o pads on OMAP SoCs.

Required properties:
- compatible:
  - should be "ti,pbias-dra7" for DRA7
  - should be "ti,pbias-omap2" for OMAP2
  - should be "ti,pbias-omap3" for OMAP3
  - should be "ti,pbias-omap4" for OMAP4
  - should be "ti,pbias-omap5" for OMAP5
  - "ti,pbias-omap" is deprecated
- reg: pbias register offset from syscon base and size of pbias register.
- syscon : phandle of the system control module
- regulator-name : should be
			pbias_mmc_omap2430 for OMAP2430, OMAP3 SoCs
			pbias_sim_omap3 for OMAP3 SoCs
			pbias_mmc_omap4 for OMAP4 SoCs
			pbias_mmc_omap5 for OMAP5 and DRA7 SoC

Optional properties:
- Any optional property defined in bindings/regulator/regulator.txt

Example:

		pbias_regulator: pbias_regulator {
			compatible = "ti,pbias-omap";
			reg = <0 0x4>;
			syscon = <&omap5_padconf_global>;
			pbias_mmc_reg: pbias_mmc_omap5 {
				regulator-name = "pbias_mmc_omap5";
				regulator-min-microvolt = <1800000>;
				regulator-max-microvolt = <3000000>;
			};
```
