## Documentation/devicetree/bindings/regulator/qcom,qca6390-pmu.yaml
```yaml
# SPDX-License-Identifier: (GPL-2.0 OR BSD-2-Clause)
%YAML 1.2
---
$id: http://devicetree.org/schemas/regulator/qcom,qca6390-pmu.yaml#
$schema: http://devicetree.org/meta-schemas/core.yaml#

title: Qualcomm Technologies, Inc. QCA6390 PMU Regulators

maintainers:
  - Bartosz Golaszewski <bartosz.golaszewski@linaro.org>

description:
  The QCA6390 package contains discrete modules for WLAN and Bluetooth. They
  are powered by the Power Management Unit (PMU) that takes inputs from the
  host and provides LDO outputs. This document describes this module.

properties:
  compatible:
    enum:
      - qcom,qca6390-pmu
      - qcom,wcn7850-pmu

  vdd-supply:
    description: VDD supply regulator handle

  vddaon-supply:
    description: VDD_AON supply regulator handle

  vdddig-supply:
    description: VDD_DIG supply regulator handle

  vddpmu-supply:
    description: VDD_PMU supply regulator handle

  vddio1p2-supply:
    description: VDD_IO_1P2 supply regulator handle

  vddrfa0p95-supply:
    description: VDD_RFA_0P95 supply regulator handle

  vddrfa1p2-supply:
    description: VDD_RFA_1P2 supply regulator handle

  vddrfa1p3-supply:
    description: VDD_RFA_1P3 supply regulator handle

  vddrfa1p8-supply:
    description: VDD_RFA_1P8 supply regulator handle

  vddrfa1p9-supply:
    description: VDD_RFA_1P9 supply regulator handle

  vddpcie1p3-supply:
    description: VDD_PCIE_1P3 supply regulator handle

  vddpcie1p9-supply:
    description: VDD_PCIE_1P9 supply regulator handle

  vddio-supply:
    description: VDD_IO supply regulator handle

  wlan-enable-gpios:
    maxItems: 1
    description: GPIO line enabling the ATH11K WLAN module supplied by the PMU

  bt-enable-gpios:
    maxItems: 1
    description: GPIO line enabling the ATH11K Bluetooth module supplied by the PMU

  clocks:
    maxItems: 1
    description: Reference clock handle

  regulators:
    type: object
    description:
      LDO outputs of the PMU

    patternProperties:
      "^ldo[0-9]$":
        $ref: regulator.yaml#
        type: object
        unevaluatedProperties: false

    additionalProperties: false

required:
  - compatible
  - regulators

allOf:
  - if:
      properties:
        compatible:
          contains:
            const: qcom,qca6390-pmu
    then:
      required:
        - vddaon-supply
        - vddpmu-supply
        - vddrfa0p95-supply
        - vddrfa1p3-supply
        - vddrfa1p9-supply
        - vddpcie1p3-supply
        - vddpcie1p9-supply
        - vddio-supply
  - if:
      properties:
        compatible:
          contains:
            const: qcom,wcn7850-pmu
    then:
      required:
        - vdd-supply
        - vddio-supply
        - vddaon-supply
        - vdddig-supply
        - vddrfa1p2-supply
        - vddrfa1p8-supply

additionalProperties: false

examples:
  - |
    #include <dt-bindings/gpio/gpio.h>
    pmu {
        compatible = "qcom,qca6390-pmu";

        pinctrl-names = "default";
        pinctrl-0 = <&bt_en_state>, <&wlan_en_state>;

        vddaon-supply = <&vreg_s6a_0p95>;
        vddpmu-supply = <&vreg_s2f_0p95>;
        vddrfa0p95-supply = <&vreg_s2f_0p95>;
        vddrfa1p3-supply = <&vreg_s8c_1p3>;
        vddrfa1p9-supply = <&vreg_s5a_1p9>;
        vddpcie1p3-supply = <&vreg_s8c_1p3>;
        vddpcie1p9-supply = <&vreg_s5a_1p9>;
        vddio-supply = <&vreg_s4a_1p8>;

        wlan-enable-gpios = <&tlmm 20 GPIO_ACTIVE_HIGH>;
        bt-enable-gpios = <&tlmm 21 GPIO_ACTIVE_HIGH>;

        regulators {
            vreg_pmu_rfa_cmn: ldo0 {
                regulator-name = "vreg_pmu_rfa_cmn";
            };

            vreg_pmu_aon_0p59: ldo1 {
                regulator-name = "vreg_pmu_aon_0p59";
            };

            vreg_pmu_wlcx_0p8: ldo2 {
                regulator-name = "vreg_pmu_wlcx_0p8";
            };

            vreg_pmu_wlmx_0p85: ldo3 {
                regulator-name = "vreg_pmu_wlmx_0p85";
            };

            vreg_pmu_btcmx_0p85: ldo4 {
                regulator-name = "vreg_pmu_btcmx_0p85";
            };

            vreg_pmu_rfa_0p8: ldo5 {
                regulator-name = "vreg_pmu_rfa_0p8";
            };

            vreg_pmu_rfa_1p2: ldo6 {
                regulator-name = "vreg_pmu_rfa_1p2";
            };

            vreg_pmu_rfa_1p7: ldo7 {
                regulator-name = "vreg_pmu_rfa_1p7";
            };

            vreg_pmu_pcie_0p9: ldo8 {
                regulator-name = "vreg_pmu_pcie_0p9";
            };

            vreg_pmu_pcie_1p8: ldo9 {
                regulator-name = "vreg_pmu_pcie_1p8";
            };
        };
    };
```

## Documentation/devicetree/bindings/regulator/qcom,rpm-regulator.yaml
```yaml
# SPDX-License-Identifier: (GPL-2.0 OR BSD-2-Clause)
%YAML 1.2
---
$id: http://devicetree.org/schemas/regulator/qcom,rpm-regulator.yaml#
$schema: http://devicetree.org/meta-schemas/core.yaml#

title: Qualcomm RPM regulator

description:
  The Qualcomm RPM regulator is modelled as a subdevice of the RPM.

  Please refer to Documentation/devicetree/bindings/soc/qcom/qcom,rpm.yaml
  for information regarding the RPM node.

  The regulator node houses sub-nodes for each regulator within the device.
  Each sub-node is identified using the node's name, with valid values listed
  for each of the pmics below.

  For pm8058 l0, l1, l2, l3, l4, l5, l6, l7, l8, l9, l10, l11, l12, l13, l14, l15,
  l16, l17, l18, l19, l20, l21, l22, l23, l24, l25, s0, s1, s2, s3, s4,
  lvs0, lvs1, ncp

  For pm8901 l0, l1, l2, l3, l4, l5, l6, s0, s1, s2, s3, s4, lvs0, lvs1, lvs2, lvs3,
  mvs

  For pm8921 s1, s2, s3, s4, s7, s8, l1, l2, l3, l4, l5, l6, l7, l8, l9, l10, l11,
  l12, l14, l15, l16, l17, l18, l21, l22, l23, l24, l25, l26, l27, l28,
  l29, lvs1, lvs2, lvs3, lvs4, lvs5, lvs6, lvs7, usb-switch, hdmi-switch,
  ncp

  For pm8018 s1, s2, s3, s4, s5, l1, l2, l3, l4, l5, l6, l7, l8, l9, l10, l11,
  l12, l14, lvs1

  For smb208 s1a, s1b, s2a, s2b

maintainers:
  - Bjorn Andersson <andersson@kernel.org>

properties:
  compatible:
    enum:
      - qcom,rpm-pm8058-regulators
      - qcom,rpm-pm8901-regulators
      - qcom,rpm-pm8921-regulators
      - qcom,rpm-pm8018-regulators
      - qcom,rpm-smb208-regulators

patternProperties:
  ".*-supply$":
    description: Input supply phandle(s) for this node

  "^((s|l|lvs)[0-9]*)|(s[1-2][a-b])|(ncp)|(mvs)|(usb-switch)|(hdmi-switch)$":
    description: List of regulators and its properties
    $ref: regulator.yaml#
    unevaluatedProperties: false
    properties:
      bias-pull-down:
        description: enable pull down of the regulator when inactive
        type: boolean

      qcom,switch-mode-frequency:
        description: Frequency (Hz) of the switch-mode power supply
        $ref: /schemas/types.yaml#/definitions/uint32
        enum:
          - 19200000
          - 9600000
          - 6400000
          - 4800000
          - 3840000
          - 3200000
          - 2740000
          - 2400000
          - 2130000
          - 1920000
          - 1750000
          - 1600000
          - 1480000
          - 1370000
          - 1280000
          - 1200000

      qcom,force-mode:
        description: Indicates that the regulator should be forced to a particular mode
        $ref: /schemas/types.yaml#/definitions/uint32
        enum:
          - 0 # QCOM_RPM_FORCE_MODE_NONE do not force any mode
          - 1 # QCOM_RPM_FORCE_MODE_LPM force into low power mode
          - 2 # QCOM_RPM_FORCE_MODE_HPM force into high power mode
          - 3 # QCOM_RPM_FORCE_MODE_AUTO allow regulator to automatically select its own mode
              # based on realtime current draw, only for pm8921 smps and ftsmps

      qcom,power-mode-hysteretic:
        description: select that the power supply should operate in hysteretic mode,
          instead of the default pwm mode
        type: boolean

additionalProperties: false

required:
  - compatible

examples:
  - |
    #include <dt-bindings/mfd/qcom-rpm.h>
    regulators {
      compatible = "qcom,rpm-pm8921-regulators";
      vdd_l1_l2_l12_l18-supply = <&pm8921_s4>;

      s1 {
        regulator-min-microvolt = <1225000>;
        regulator-max-microvolt = <1225000>;

        bias-pull-down;

        qcom,switch-mode-frequency = <3200000>;
      };

      pm8921_s4: s4 {
        regulator-min-microvolt = <1800000>;
        regulator-max-microvolt = <1800000>;

        qcom,switch-mode-frequency = <1600000>;
        bias-pull-down;

        qcom,force-mode = <QCOM_RPM_FORCE_MODE_AUTO>;
      };
    };
...
```

## Documentation/devicetree/bindings/regulator/qcom,rpmh-regulator.txt
```
Qualcomm Technologies, Inc. RPMh Regulators

rpmh-regulator devices support PMIC regulator management via the Voltage
Regulator Manager (VRM) and Oscillator Buffer (XOB) RPMh accelerators.  The APPS
processor communicates with these hardware blocks via a Resource State
Coordinator (RSC) using command packets.  The VRM allows changing three
parameters for a given regulator: enable state, output voltage, and operating
mode.  The XOB allows changing only a single parameter for a given regulator:
its enable state.  Despite its name, the XOB is capable of controlling the
enable state of any PMIC peripheral.  It is used for clock buffers, low-voltage
switches, and LDO/SMPS regulators which have a fixed voltage and mode.

=======================
Required Node Structure
=======================

RPMh regulators must be described in two levels of device nodes.  The first
level describes the PMIC containing the regulators and must reside within an
RPMh device node.  The second level describes each regulator within the PMIC
which is to be used on the board.  Each of these regulators maps to a single
RPMh resource.

The names used for regulator nodes must match those supported by a given PMIC.
Supported regulator node names:
	PM8998:		smps1 - smps13, ldo1 - ldo28, lvs1 - lvs2
	PMI8998:	bob
	PM8005:		smps1 - smps4

========================
First Level Nodes - PMIC
========================

- compatible
	Usage:      required
	Value type: <string>
	Definition: Must be one of: "qcom,pm8998-rpmh-regulators",
		    "qcom,pmi8998-rpmh-regulators" or
		    "qcom,pm8005-rpmh-regulators".

- qcom,pmic-id
	Usage:      required
	Value type: <string>
	Definition: RPMh resource name suffix used for the regulators found on
		    this PMIC.  Typical values: "a", "b", "c", "d", "e", "f".

- vdd-s1-supply
- vdd-s2-supply
- vdd-s3-supply
- vdd-s4-supply
	Usage:      optional (PM8998 and PM8005 only)
	Value type: <phandle>
	Definition: phandle of the parent supply regulator of one or more of the
		    regulators for this PMIC.

- vdd-s5-supply
- vdd-s6-supply
- vdd-s7-supply
- vdd-s8-supply
- vdd-s9-supply
- vdd-s10-supply
- vdd-s11-supply
- vdd-s12-supply
- vdd-s13-supply
- vdd-l1-l27-supply
- vdd-l2-l8-l17-supply
- vdd-l3-l11-supply
- vdd-l4-l5-supply
- vdd-l6-supply
- vdd-l7-l12-l14-l15-supply
- vdd-l9-supply
- vdd-l10-l23-l25-supply
- vdd-l13-l19-l21-supply
- vdd-l16-l28-supply
- vdd-l18-l22-supply
- vdd-l20-l24-supply
- vdd-l26-supply
- vin-lvs-1-2-supply
	Usage:      optional (PM8998 only)
	Value type: <phandle>
	Definition: phandle of the parent supply regulator of one or more of the
		    regulators for this PMIC.

- vdd-bob-supply
	Usage:      optional (PMI8998 only)
	Value type: <phandle>
	Definition: BOB regulator parent supply phandle

===============================
Second Level Nodes - Regulators
===============================

- qcom,always-wait-for-ack
	Usage:      optional
	Value type: <empty>
	Definition: Boolean flag which indicates that the application processor
		    must wait for an ACK or a NACK from RPMh for every request
		    sent for this regulator including those which are for a
		    strictly lower power state.

Other properties defined in Documentation/devicetree/bindings/regulator/regulator.txt
may also be used.  regulator-initial-mode and regulator-allowed-modes may be
specified for VRM regulators using mode values from
include/dt-bindings/regulator/qcom,rpmh-regulator.h.  regulator-allow-bypass
may be specified for BOB type regulators managed via VRM.
regulator-allow-set-load may be specified for LDO type regulators managed via
VRM.

========
Examples
========

#include <dt-bindings/regulator/qcom,rpmh-regulator.h>

&apps_rsc {
	pm8998-rpmh-regulators {
		compatible = "qcom,pm8998-rpmh-regulators";
		qcom,pmic-id = "a";

		vdd-l7-l12-l14-l15-supply = <&pm8998_s5>;

		smps2 {
			regulator-min-microvolt = <1100000>;
			regulator-max-microvolt = <1100000>;
		};

		pm8998_s5: smps5 {
			regulator-min-microvolt = <1904000>;
			regulator-max-microvolt = <2040000>;
		};

		ldo7 {
			regulator-min-microvolt = <1800000>;
			regulator-max-microvolt = <1800000>;
			regulator-initial-mode = <RPMH_REGULATOR_MODE_HPM>;
			regulator-allowed-modes =
				<RPMH_REGULATOR_MODE_LPM
				 RPMH_REGULATOR_MODE_HPM>;
			regulator-allow-set-load;
		};

		lvs1 {
			regulator-min-microvolt = <1800000>;
			regulator-max-microvolt = <1800000>;
		};
	};

	pmi8998-rpmh-regulators {
		compatible = "qcom,pmi8998-rpmh-regulators";
		qcom,pmic-id = "b";

		bob {
			regulator-min-microvolt = <3312000>;
			regulator-max-microvolt = <3600000>;
			regulator-allowed-modes =
				<RPMH_REGULATOR_MODE_AUTO
				 RPMH_REGULATOR_MODE_HPM>;
			regulator-initial-mode = <RPMH_REGULATOR_MODE_AUTO>;
		};
	};
};
```
