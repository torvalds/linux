## Documentation/devicetree/bindings/regulator/max77650-regulator.txt
```
Regulator driver for MAX77650 PMIC from Maxim Integrated.

This module is part of the MAX77650 MFD device. For more details
see Documentation/devicetree/bindings/mfd/max77650.txt.

The regulator controller is represented as a sub-node of the PMIC node
on the device tree.

The device has a single LDO regulator and a SIMO buck-boost regulator with
three independent power rails.

Required properties:
--------------------
- compatible:		Must be "maxim,max77650-regulator"

Each rail must be instantiated under the regulators subnode of the top PMIC
node. Up to four regulators can be defined. For standard regulator properties
refer to Documentation/devicetree/bindings/regulator/regulator.txt.

Available regulator compatible strings are: "ldo", "sbb0", "sbb1", "sbb2".

Example:
--------

	regulators {
		compatible = "maxim,max77650-regulator";

		max77650_ldo: regulator@0 {
			regulator-compatible = "ldo";
			regulator-name = "max77650-ldo";
			regulator-min-microvolt = <1350000>;
			regulator-max-microvolt = <2937500>;
		};

		max77650_sbb0: regulator@1 {
			regulator-compatible = "sbb0";
			regulator-name = "max77650-sbb0";
			regulator-min-microvolt = <800000>;
			regulator-max-microvolt = <1587500>;
		};
	};
```

## Documentation/devicetree/bindings/regulator/max77650-regulator.yaml
```yaml
# SPDX-License-Identifier: GPL-2.0
%YAML 1.2
---
$id: http://devicetree.org/schemas/regulator/max77650-regulator.yaml#
$schema: http://devicetree.org/meta-schemas/core.yaml#

title: Regulator driver for MAX77650 PMIC from Maxim Integrated.

maintainers:
  - Bartosz Golaszewski <bgolaszewski@baylibre.com>

description: |
  This module is part of the MAX77650 MFD device. For more details
  see Documentation/devicetree/bindings/mfd/max77650.yaml.

  The regulator controller is represented as a sub-node of the PMIC node
  on the device tree.

  The device has a single LDO regulator and a SIMO buck-boost regulator with
  three independent power rails.

properties:
  compatible:
    const: maxim,max77650-regulator

patternProperties:
  "^regulator@[0-3]$":
    $ref: "regulator.yaml#"

required:
  - compatible
```

## Documentation/devicetree/bindings/regulator/max77686.txt
```
Binding for Maxim MAX77686 regulators

This is a part of the device tree bindings of MAX77686 multi-function device.
More information can be found in ../mfd/max77686.txt file.

The MAX77686 PMIC has 9 high-efficiency Buck and 26 Low-DropOut (LDO)
regulators that can be controlled over I2C.

Following properties should be present in main device node of the MFD chip.

Optional node:
- voltage-regulators : The regulators of max77686 have to be instantiated
  under subnode named "voltage-regulators" using the following format.

	regulator_name {
		regulator-compatible = LDOn/BUCKn
		standard regulator constraints....
	};
	refer Documentation/devicetree/bindings/regulator/regulator.txt

  The regulator node's name should be initialized with a string
to get matched with their hardware counterparts as follow:

	-LDOn 	:	for LDOs, where n can lie in range 1 to 26.
			example: LDO1, LDO2, LDO26.
	-BUCKn 	:	for BUCKs, where n can lie in range 1 to 9.
			example: BUCK1, BUCK5, BUCK9.

  Regulators which can be turned off during system suspend:
	-LDOn	:	2, 6-8, 10-12, 14-16,
	-BUCKn	:	1-4.
  Use standard regulator bindings for it ('regulator-off-in-suspend').

  LDO20, LDO21, LDO22, BUCK8 and BUCK9 can be configured to GPIO enable
  control. To turn this feature on this property must be added to the regulator
  sub-node:
	- maxim,ena-gpios :	one GPIO specifier enable control (the gpio
				flags are actually ignored and always
				ACTIVE_HIGH is used)

Example:

	max77686: pmic@09 {
		compatible = "maxim,max77686";
		interrupt-parent = <&wakeup_eint>;
		interrupts = <26 IRQ_TYPE_NONE>;
		reg = <0x09>;

		voltage-regulators {
			ldo11_reg: LDO11 {
				regulator-name = "vdd_ldo11";
				regulator-min-microvolt = <1900000>;
				regulator-max-microvolt = <1900000>;
				regulator-always-on;
			};

			buck1_reg: BUCK1 {
				regulator-name = "vdd_mif";
				regulator-min-microvolt = <950000>;
				regulator-max-microvolt = <1300000>;
				regulator-always-on;
				regulator-boot-on;
			};

			buck9_reg: BUCK9 {
				regulator-name = "CAM_ISP_CORE_1.2V";
				regulator-min-microvolt = <1000000>;
				regulator-max-microvolt = <1200000>;
				maxim,ena-gpios = <&gpm0 3 GPIO_ACTIVE_HIGH>;
			};
	};
```

## Documentation/devicetree/bindings/regulator/max77802.txt
```
Binding for Maxim MAX77802 regulators

This is a part of device tree bindings of MAX77802 multi-function device.
More information can be found in bindings/mfd/max77802.txt file.

The MAX77802 PMIC has 10 high-efficiency Buck and 32 Low-dropout (LDO)
regulators that can be controlled over I2C.

Following properties should be present in main device node of the MFD chip.

Optional properties:
- inb1-supply:  The input supply for BUCK1
- inb2-supply:  The input supply for BUCK2
- inb3-supply:  The input supply for BUCK3
- inb4-supply:  The input supply for BUCK4
- inb5-supply:  The input supply for BUCK5
- inb6-supply:  The input supply for BUCK6
- inb7-supply:  The input supply for BUCK7
- inb8-supply:  The input supply for BUCK8
- inb9-supply:  The input supply for BUCK9
- inb10-supply: The input supply for BUCK10
- inl1-supply:  The input supply for LDO8 and LDO15
- inl2-supply:  The input supply for LDO17, LDO27, LDO30 and LDO35
- inl3-supply:  The input supply for LDO3, LDO5, LDO6 and LDO7
- inl4-supply:  The input supply for LDO10, LDO11, LDO13 and LDO14
- inl5-supply:  The input supply for LDO9 and LDO19
- inl6-supply:  The input supply for LDO4, LDO21, LDO24 and LDO33
- inl7-supply:  The input supply for LDO18, LDO20, LDO28 and LDO29
- inl9-supply:  The input supply for LDO12, LDO23, LDO25, LDO26, LDO32 and LDO34
- inl10-supply: The input supply for LDO1 and LDO2

Optional nodes:
- regulators : The regulators of max77802 have to be instantiated
  under subnode named "regulators" using the following format.

	regulator-name {
		standard regulator constraints....
	};
	refer Documentation/devicetree/bindings/regulator/regulator.txt

The regulator node name should be initialized with a string to get matched
with their hardware counterparts as follow. The valid names are:

	-LDOn 	:	for LDOs, where n can lie in ranges 1-15, 17-21, 23-30
			and 32-35.
			example: LDO1, LDO2, LDO35.
	-BUCKn 	:	for BUCKs, where n can lie in range 1 to 10.
			example: BUCK1, BUCK5, BUCK10.

The max77802 regulator supports two different operating modes: Normal and Low
Power Mode. Some regulators support the modes to be changed at startup or by
the consumers during normal operation while others only support to change the
mode during system suspend. The standard regulator suspend states binding can
be used to configure the regulator operating mode.

The regulators that support the standard "regulator-initial-mode" property,
changing their mode during normal operation are: LDOs 1, 3, 20 and 21.

The possible values for "regulator-initial-mode" and "regulator-mode" are:
	1: Normal regulator voltage output mode.
	3: Low Power which reduces the quiescent current down to only 1uA

The list of valid modes are defined in the dt-bindings/clock/maxim,max77802.h
header and can be included by device tree source files.

The standard "regulator-mode" property can only be used for regulators that
support changing their mode to Low Power Mode during suspend. These regulators
are: BUCKs 2-4 and LDOs 1-35. Also, it only takes effect if the regulator has
been enabled for the given suspend state using "regulator-on-in-suspend" and
has not been disabled for that state using "regulator-off-in-suspend".

Example:

	max77802@09 {
		compatible = "maxim,max77802";
		interrupt-parent = <&wakeup_eint>;
		interrupts = <26 0>;
		reg = <0x09>;
		#address-cells = <1>;
		#size-cells = <0>;

		inb1-supply = <&parent_reg>;

		regulators {
			ldo1_reg: LDO1 {
				regulator-name = "vdd_1v0";
				regulator-min-microvolt = <1000000>;
				regulator-max-microvolt = <1000000>;
				regulator-always-on;
				regulator-initial-mode = <MAX77802_OPMODE_LP>;
			};

			ldo11_reg: LDO11 {
				regulator-name = "vdd_ldo11";
				regulator-min-microvolt = <1900000>;
				regulator-max-microvolt = <1900000>;
				regulator-always-on;
				regulator-state-mem {
					regulator-on-in-suspend;
					regulator-mode = <MAX77802_OPMODE_LP>;
				};
			};

			buck1_reg: BUCK1 {
				regulator-name = "vdd_mif";
				regulator-min-microvolt = <950000>;
				regulator-max-microvolt = <1300000>;
				regulator-always-on;
				regulator-boot-on;
			};
	};
```

## Documentation/devicetree/bindings/regulator/max8660.txt
```
Maxim MAX8660 voltage regulator

Required properties:
- compatible: must be one of "maxim,max8660", "maxim,max8661"
- reg: I2C slave address, usually 0x34
- any required generic properties defined in regulator.txt

Example:

	i2c_master {
		max8660@34 {
			compatible = "maxim,max8660";
			reg = <0x34>;

			regulators {
				regulator@0 {
					regulator-compatible= "V3(DCDC)";
					regulator-min-microvolt = <725000>;
					regulator-max-microvolt = <1800000>;
				};

				regulator@1 {
					regulator-compatible= "V4(DCDC)";
					regulator-min-microvolt = <725000>;
					regulator-max-microvolt = <1800000>;
				};

				regulator@2 {
					regulator-compatible= "V5(LDO)";
					regulator-min-microvolt = <1700000>;
					regulator-max-microvolt = <2000000>;
				};

				regulator@3 {
					regulator-compatible= "V6(LDO)";
					regulator-min-microvolt = <1800000>;
					regulator-max-microvolt = <3300000>;
				};

				regulator@4 {
					regulator-compatible= "V7(LDO)";
					regulator-min-microvolt = <1800000>;
					regulator-max-microvolt = <3300000>;
				};
			};
		};
	};
```

## Documentation/devicetree/bindings/regulator/max8660.yaml
```yaml
# SPDX-License-Identifier: GPL-2.0
%YAML 1.2
---
$id: http://devicetree.org/schemas/regulator/max8660.yaml#
$schema: http://devicetree.org/meta-schemas/core.yaml#

title: Maxim MAX8660 voltage regulator

maintainers:
  - Daniel Mack <zonque@gmail.com>

properties:
  $nodename:
    pattern: "pmic@[0-9a-f]{1,2}"
  compatible:
    enum:
      - maxim,max8660
      - maxim,max8661

  reg:
    maxItems: 1

  regulators:
    type: object

    patternProperties:
      "regulator-.+":
        $ref: "regulator.yaml#"

    additionalProperties: false

additionalProperties: false

examples:
  - |
    i2c {
      #address-cells = <1>;
      #size-cells = <0>;

      pmic@34 {
        compatible = "maxim,max8660";
        reg = <0x34>;

        regulators {
          regulator-V3 {
            regulator-compatible= "V3(DCDC)";
            regulator-min-microvolt = <725000>;
            regulator-max-microvolt = <1800000>;
          };

          regulator-V4 {
            regulator-compatible= "V4(DCDC)";
            regulator-min-microvolt = <725000>;
            regulator-max-microvolt = <1800000>;
          };

          regulator-V5 {
            regulator-compatible= "V5(LDO)";
            regulator-min-microvolt = <1700000>;
            regulator-max-microvolt = <2000000>;
          };

          regulator-V6 {
            regulator-compatible= "V6(LDO)";
            regulator-min-microvolt = <1800000>;
            regulator-max-microvolt = <3300000>;
          };

          regulator-V7 {
            regulator-compatible= "V7(LDO)";
            regulator-min-microvolt = <1800000>;
            regulator-max-microvolt = <3300000>;
          };
        };
      };
    };
...
```

## Documentation/devicetree/bindings/regulator/max8893.yaml
```yaml
# SPDX-License-Identifier: GPL-2.0
%YAML 1.2
---
$id: http://devicetree.org/schemas/regulator/max8893.yaml#
$schema: http://devicetree.org/meta-schemas/core.yaml#

title: Regulator driver for MAX8893 PMIC from Maxim Integrated.

maintainers:
  - Sergey Larin <cerg2010cerg2010@mail.ru>

description: |
  The device has 5 LDO regulators and a single BUCK regulator.
  Programming is done through I2C bus.

properties:
  compatible:
    const: maxim,max8893

  reg:
    maxItems: 1

  regulators:
    type: object

    patternProperties:
      "^(ldo[1-5]|buck)$":
        $ref: "regulator.yaml#"

    additionalProperties: false

additionalProperties: false

required:
  - compatible
  - reg
  - regulators

examples:
  - |
    i2c {
            #address-cells = <1>;
            #size-cells = <0>;

            pmic@3e {
                    compatible = "maxim,max8893";
                    reg = <0x3e>;

                    regulators {
                            /* Front camera - s5k6aafx, back - m5mo */
                            /* Numbers used to indicate the sequence */
                            front_1_back_1: buck {
                                    regulator-name = "cam_isp_core_1v2";
                                    regulator-min-microvolt = <1200000>;
                                    regulator-max-microvolt = <1200000>;
                            };

                            front_4_back_5: ldo1 {
                                    regulator-name = "vt_io_1v8,cam_isp_1v8";
                                    regulator-min-microvolt = <1800000>;
                                    regulator-max-microvolt = <1800000>;
                            };

                            front_3_back_4: ldo2 {
                                    regulator-name = "vt_core_1v5";
                                    regulator-min-microvolt = <1500000>;
                                    regulator-max-microvolt = <1500000>;
                            };

                            front_5_back_6: ldo3 {
                                    regulator-name = "vt_cam_1v8,vt_sensor_io_1v8";
                                    regulator-min-microvolt = <1800000>;
                                    regulator-max-microvolt = <1800000>;
                            };

                            ldo4 {
                                    /* not used */
                            };

                            back_7: ldo5 {
                                    regulator-name = "cam_sensor_io_1v8";
                                    regulator-min-microvolt = <1800000>;
                                    regulator-max-microvolt = <1800000>;
                            };
                    };
            };
    };
...
```
