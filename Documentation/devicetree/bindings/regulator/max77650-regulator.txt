## Documentation/devicetree/bindings/regulator/maxim,max20411.yaml
```yaml
# SPDX-License-Identifier: (GPL-2.0 OR BSD-2-Clause)
%YAML 1.2
---
$id: http://devicetree.org/schemas/regulator/maxim,max20411.yaml#
$schema: http://devicetree.org/meta-schemas/core.yaml#

title: Maxim Integrated MAX20411 Step-Down DC-DC Converter

maintainers:
  - Bjorn Andersson <andersson@kernel.org>

description:
  The MAX20411 is a high-efficiency, DC-DC step-down converter. It provides
  configurable output voltage in the range of 0.5V to 1.275V, configurable over
  I2C.

allOf:
  - $ref: regulator.yaml#

properties:
  compatible:
    const: maxim,max20411

  reg:
    maxItems: 1

  enable-gpios:
    description: GPIO connected to the EN pin, active high

  vdd-supply:
    description: Input supply for the device (VDD pin, 3.0V to 5.5V)

required:
  - compatible
  - reg
  - enable-gpios

unevaluatedProperties: false

examples:
  - |
    #include <dt-bindings/gpio/gpio.h>

    i2c {
        #address-cells = <1>;
        #size-cells = <0>;

        regulator@39 {
            compatible = "maxim,max20411";
            reg = <0x39>;

            enable-gpios = <&gpio 2 GPIO_ACTIVE_HIGH>;

            regulator-min-microvolt = <800000>;
            regulator-max-microvolt = <1000000>;
        };
    };
...
```

## Documentation/devicetree/bindings/regulator/maxim,max77620-regulator.yaml
```yaml
# SPDX-License-Identifier: (GPL-2.0-only OR BSD-2-Clause)
%YAML 1.2
---
$id: http://devicetree.org/schemas/regulator/maxim,max77620-regulator.yaml#
$schema: http://devicetree.org/meta-schemas/core.yaml#

title: Regulator for MAX77620 Power management IC from Maxim Semiconductor.

maintainers:
  - Svyatoslav Ryhel <clamor95@gmail.com>

description:
  Device has multiple DCDC(sd[0-3]) and LDOs(ldo[0-8]). The input supply
  of these regulators are defined under parent device node. Details of
  regulator properties are defined as child node under sub-node "regulators"
  which is child node of device node.

patternProperties:
  "^in-(sd[0-3]|ldo(0-1|2|3-5|4-6|7-8))-supply$":
    $ref: /schemas/types.yaml#/definitions/phandle
    description: Input supply for DCDC or LDO

  "^(sd[0-3]|ldo[0-8])$":
    type: object
    $ref: /schemas/regulator/regulator.yaml#
    unevaluatedProperties: false

    properties:
      maxim,active-fps-source:
        $ref: /schemas/types.yaml#/definitions/uint32
        description: |
          FPS source for the GPIOs to get enabled/disabled when system is in
          active state. Valid values are:
          - MAX77620_FPS_SRC_0: FPS source is FPS0.
          - MAX77620_FPS_SRC_1: FPS source is FPS1
          - MAX77620_FPS_SRC_2: FPS source is FPS2
          - MAX77620_FPS_SRC_NONE: GPIO is not controlled by FPS events and
                                   it gets enabled/disabled by register access.
          Absence of this property will leave the FPS configuration register
          for that GPIO to default configuration.

      maxim,active-fps-power-up-slot:
        $ref: /schemas/types.yaml#/definitions/uint32
        description:
          Sequencing event slot number on which the GPIO get enabled when
          master FPS input event set to HIGH. This is applicable if FPS source
          is selected as FPS0, FPS1 or FPS2.
        enum: [0, 1, 2, 3, 4, 5, 6, 7]

      maxim,active-fps-power-down-slot:
        $ref: /schemas/types.yaml#/definitions/uint32
        description:
          Sequencing event slot number on which the GPIO get disabled when
          master FPS input event set to LOW. This is applicable if FPS source
          is selected as FPS0, FPS1 or FPS2.
        enum: [0, 1, 2, 3, 4, 5, 6, 7]

      maxim,suspend-fps-source:
        $ref: /schemas/types.yaml#/definitions/uint32
        description:
          This is same as property "maxim,active-fps-source" but value get
          configured when system enters in to suspend state.

      maxim,suspend-fps-power-up-slot:
        $ref: /schemas/types.yaml#/definitions/uint32
        description:
          This is same as property "maxim,active-fps-power-up-slot" but this
          value get configured into FPS configuration register when system
          enters into suspend. This is applicable if suspend state FPS source
          is selected as FPS0, FPS1 or FPS2.
        enum: [0, 1, 2, 3, 4, 5, 6, 7]

      maxim,suspend-fps-power-down-slot:
        $ref: /schemas/types.yaml#/definitions/uint32
        description:
          This is same as property "maxim,active-fps-power-down-slot" but this
          value get configured into FPS configuration register when system
          enters into suspend. This is applicable if suspend state FPS source
          is selected as FPS0, FPS1 or FPS2.
        enum: [0, 1, 2, 3, 4, 5, 6, 7]

      maxim,ramp-rate-setting:
        $ref: /schemas/types.yaml#/definitions/uint32
        description: |
          Ramp rate(uV/us) setting to be configured to the device. The platform
          may have different ramp rate than advertised ramp rate if it has design
          variation from Maxim's recommended. On this case, platform specific
          ramp rate is used for ramp time calculation and this property is used
          for device register configurations. The measured ramp rate of platform
          is provided by the regulator-ramp-delay.

          Maxim Max77620 supports following ramp delay:
            SD: 13.75mV/us, 27.5mV/us, 55mV/us
            LDOs: 5mV/us, 100mV/us
        enum: [5000, 13750, 27500, 55000, 100000]

additionalProperties: false

# see maxim,max77620.yaml for an example
```

## Documentation/devicetree/bindings/regulator/maxim,max77686.yaml
```yaml
# SPDX-License-Identifier: GPL-2.0-only OR BSD-2-Clause
%YAML 1.2
---
$id: http://devicetree.org/schemas/regulator/maxim,max77686.yaml#
$schema: http://devicetree.org/meta-schemas/core.yaml#

title: Maxim MAX77686 Power Management IC regulators

maintainers:
  - Chanwoo Choi <cw00.choi@samsung.com>
  - Krzysztof Kozlowski <krzysztof.kozlowski@canonical.com>

description: |
  This is a part of device tree bindings for Maxim MAX77686 Power Management
  Integrated Circuit (PMIC).

  The Maxim MAX77686 provides high-efficiency Buck and 26 Low-DropOut (LDO)
  regulators.

  See also Documentation/devicetree/bindings/mfd/maxim,max77686.yaml for
  additional information and example.

patternProperties:
  # 26 LDOs
  "^LDO([1-9]|1[0-9]|2[3-6])$":
    type: object
    $ref: regulator.yaml#
    unevaluatedProperties: false
    description: |
      Properties for single LDO regulator.
      Regulators which can be turned off during system suspend:
        LDO2, LDO6-8, LDO10-12, LDO14-16

    required:
      - regulator-name

  # LDO20-LDO22 with maxim,ena-gpios
  "^LDO2[0-2]$":
    type: object
    $ref: regulator.yaml#
    unevaluatedProperties: false
    description: |
      Properties for single LDO regulator.

    properties:
      maxim,ena-gpios:
        maxItems: 1
        description: |
          GPIO specifier to enable the GPIO control (on/off) for regulator.

    required:
      - regulator-name

  # 9 bucks
  "^BUCK[1-7]$":
    type: object
    $ref: regulator.yaml#
    unevaluatedProperties: false
    description: |
      Properties for single BUCK regulator.
      Regulators which can be turned off during system suspend:
      BUCK[1-4]

    required:
      - regulator-name

  "^BUCK[89]$":
    type: object
    $ref: regulator.yaml#
    unevaluatedProperties: false
    description: |
      Properties for single BUCK regulator.

    properties:
      maxim,ena-gpios:
        maxItems: 1
        description: |
          GPIO specifier to enable the GPIO control (on/off) for regulator.

    required:
      - regulator-name

additionalProperties: false
```

## Documentation/devicetree/bindings/regulator/maxim,max77693.yaml
```yaml
# SPDX-License-Identifier: GPL-2.0-only OR BSD-2-Clause
%YAML 1.2
---
$id: http://devicetree.org/schemas/regulator/maxim,max77693.yaml#
$schema: http://devicetree.org/meta-schemas/core.yaml#

title: Maxim MAX77693 MicroUSB and Companion Power Management IC regulators

maintainers:
  - Chanwoo Choi <cw00.choi@samsung.com>
  - Krzysztof Kozlowski <krzk@kernel.org>

description: |
  This is a part of device tree bindings for Maxim MAX77693 MicroUSB Integrated
  Circuit (MUIC).

  See also Documentation/devicetree/bindings/mfd/maxim,max77693.yaml for
  additional information and example.

properties:
  CHARGER:
    type: object
    $ref: regulator.yaml#
    additionalProperties: false
    description: |
      Current regulator.

    properties:
      regulator-name: true
      regulator-always-on: true
      regulator-boot-on: true
      regulator-min-microamp:
        minimum: 60000
      regulator-max-microamp:
        maximum: 2580000

    required:
      - regulator-name

patternProperties:
  "^ESAFEOUT[12]$":
    type: object
    $ref: regulator.yaml#
    additionalProperties: false
    description: |
      Safeout LDO regulator.

    properties:
      regulator-name: true
      regulator-always-on: true
      regulator-boot-on: true
      regulator-min-microvolt:
        minimum: 3300000
      regulator-max-microvolt:
        maximum: 4950000

    required:
      - regulator-name

additionalProperties: false
```

## Documentation/devicetree/bindings/regulator/maxim,max77802.yaml
```yaml
# SPDX-License-Identifier: GPL-2.0-only OR BSD-2-Clause
%YAML 1.2
---
$id: http://devicetree.org/schemas/regulator/maxim,max77802.yaml#
$schema: http://devicetree.org/meta-schemas/core.yaml#

title: Maxim MAX77802 Power Management IC regulators

maintainers:
  - Javier Martinez Canillas <javier@dowhile0.org>
  - Krzysztof Kozlowski <krzysztof.kozlowski@canonical.com>

description: |
  This is a part of device tree bindings for Maxim MAX77802 Power Management
  Integrated Circuit (PMIC).

  The Maxim MAX77686 provides 10 high-efficiency Buck and 32 Low-DropOut (LDO)
  regulators.

  See also Documentation/devicetree/bindings/mfd/maxim,max77802.yaml for
  additional information and example.

  Certain regulators support "regulator-initial-mode" and "regulator-mode".
  The valid modes list is defined in the dt-bindings/regulator/maxim,max77802.h
  and their meaning is::
    1 - Normal regulator voltage output mode.
    3 - Low Power which reduces the quiescent current down to only 1uA

  The standard "regulator-mode" property can only be used for regulators that
  support changing their mode to Low Power Mode during suspend. These
  regulators are:: bucks 2-4 and LDOs 1-35. Also, it only takes effect if the
  regulator has been enabled for the given suspend state using
  "regulator-on-in-suspend" and has not been disabled for that state using
  "regulator-off-in-suspend".

patternProperties:
  # LDO1, LDO3, LDO20, LDO21
  "^LDO([13]|2[01])$":
    type: object
    $ref: regulator.yaml#
    unevaluatedProperties: false
    description:
      LDOs supporting the regulator-initial-mode property and changing their
      mode during normal operation.

  # LDO2, LDO4-15, LDO17-19, LDO23-30, LDO32-35
  "^LDO([24-9]|1[0-5789]|2[3-9]|3[02345])$":
    type: object
    $ref: regulator.yaml#
    unevaluatedProperties: false
    description:
      LDOs supporting the regulator-mode property (changing mode to Low Power
      Mode during suspend).

    properties:
      regulator-initial-mode: false

  # buck2-4
  "^BUCK[2-4]$":
    type: object
    $ref: regulator.yaml#
    unevaluatedProperties: false
    description:
      bucks supporting the regulator-mode property (changing mode to Low Power
      Mode during suspend).

    properties:
      regulator-initial-mode: false

  # buck1, buck5-10
  "^BUCK([15-9]|10)$":
    type: object
    $ref: regulator.yaml#
    unevaluatedProperties: false

    properties:
      regulator-initial-mode: false

    patternProperties:
      regulator-state-(standby|mem|disk):
        type: object
        properties:
          regulator-mode: false

additionalProperties: false
```

## Documentation/devicetree/bindings/regulator/maxim,max77826.yaml
```yaml
# SPDX-License-Identifier: GPL-2.0-only OR BSD-2-Clause
%YAML 1.2
---
$id: http://devicetree.org/schemas/regulator/maxim,max77826.yaml#
$schema: http://devicetree.org/meta-schemas/core.yaml#

title: Maxim Integrated MAX77826 PMIC

maintainers:
  - Iskren Chernev <iskren.chernev@gmail.com>

properties:
  $nodename:
    pattern: "pmic@[0-9a-f]{1,2}"
  compatible:
    enum:
      - maxim,max77826

  reg:
    maxItems: 1

  regulators:
    type: object
    allOf:
      - $ref: regulator.yaml#
    description: |
      list of regulators provided by this controller, must be named
      after their hardware counterparts LDO[1-15], BUCK and BUCKBOOST

    patternProperties:
      "^LDO([1-9]|1[0-5])$":
        type: object
        allOf:
          - $ref: regulator.yaml#

      "^BUCK|BUCKBOOST$":
        type: object
        allOf:
          - $ref: regulator.yaml#

    additionalProperties: false

required:
  - compatible
  - reg
  - regulators

additionalProperties: false

examples:
  - |
    i2c {
        #address-cells = <1>;
        #size-cells = <0>;

        pmic@69 {
            compatible = "maxim,max77826";
            reg = <0x69>;

            regulators {
                LDO2 {
                    regulator-min-microvolt = <650000>;
                    regulator-max-microvolt = <3587500>;
                };
            };
       };
     };
...
```

## Documentation/devicetree/bindings/regulator/maxim,max77838.yaml
```yaml
# SPDX-License-Identifier: GPL-2.0-only OR BSD-2-Clause
%YAML 1.2
---
$id: http://devicetree.org/schemas/regulator/maxim,max77838.yaml#
$schema: http://devicetree.org/meta-schemas/core.yaml#

title: Maxim Integrated MAX77838 PMIC

maintainers:
  - Ivaylo Ivanov <ivo.ivanov.ivanov1@gmail.com>

properties:
  $nodename:
    pattern: "pmic@[0-9a-f]{1,2}"
  compatible:
    enum:
      - maxim,max77838

  reg:
    maxItems: 1

  regulators:
    type: object
    $ref: regulator.yaml#
    description: |
      list of regulators provided by this controller, must be named
      after their hardware counterparts ldo[1-4] and buck

    properties:
      buck:
        type: object
        $ref: regulator.yaml#
        unevaluatedProperties: false

    patternProperties:
      "^ldo([1-4])$":
        type: object
        $ref: regulator.yaml#
        unevaluatedProperties: false

    additionalProperties: false

required:
  - compatible
  - reg
  - regulators

additionalProperties: false

examples:
  - |
    i2c {
        #address-cells = <1>;
        #size-cells = <0>;

        pmic@60 {
            compatible = "maxim,max77838";
            reg = <0x60>;

            regulators {
                ldo2 {
                    regulator-min-microvolt = <1800000>;
                    regulator-max-microvolt = <1800000>;
                };
            };
       };
     };
...
```
