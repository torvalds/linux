## Documentation/devicetree/bindings/regulator/max8907.txt
```
MAX8907 regulator

Required properties:
- compatible: "maxim,max8907"
- reg: I2C slave address
- interrupts: The interrupt output of the controller
- mbatt-supply: The input supply for MBATT, BBAT, SDBY, VRTC.
- in-v1-supply: The input supply for SD1.
- in-v2-supply: The input supply for SD2.
- in-v3-supply: The input supply for SD3.
- in1-supply: The input supply for LDO1.
...
- in20-supply: The input supply for LDO20.
- regulators: A node that houses a sub-node for each regulator within the
  device. Each sub-node is identified using the node's name (or the deprecated
  regulator-compatible property if present), with valid values listed below.
  The content of each sub-node is defined by the standard binding for
  regulators; see regulator.txt.

Optional properties:
- maxim,system-power-controller: Boolean property indicating that the PMIC
  controls the overall system power.

The valid names for regulators are:

  sd1, sd2, sd3, ldo1, ldo2, ldo3, ldo4, ldo5, ldo6, ldo7, ldo8, ldo9, ldo10,
  ldo11, ldo12, ldo13, ldo14, ldo15, ldo16, ldo17, ldo18, ldo19, ldo20, out5v,
  out33v, bbat, sdby, vrtc.

Example:

		max8907@3c {
			compatible = "maxim,max8907";
			reg = <0x3c>;
			interrupts = <0 86 0x4>;

			maxim,system-power-controller;

			mbatt-supply = <&some_reg>;
			in-v1-supply = <&mbatt_reg>;
			...
			in1-supply = <&mbatt_reg>;
			...

			regulators {
				mbatt_reg: mbatt {
					regulator-name = "vbat_pmu";
					regulator-min-microvolt = <5000000>;
					regulator-max-microvolt = <5000000>;
					regulator-always-on;
				};

				sd1 {
					regulator-name = "nvvdd_sv1,vdd_cpu_pmu";
					regulator-min-microvolt = <1000000>;
					regulator-max-microvolt = <1000000>;
					regulator-always-on;
				};

				sd2 {
					regulator-name = "nvvdd_sv2,vdd_core";
					regulator-min-microvolt = <1200000>;
					regulator-max-microvolt = <1200000>;
					regulator-always-on;
				};
...
			};
		};
	};
```

## Documentation/devicetree/bindings/regulator/max8925-regulator.txt
```
Max8925 Voltage regulators

Required nodes:
-nodes:
  - SDV1 for SDV SDV1
  - SDV2 for SDV SDV2
  - SDV3 for SDV SDV3
  - LDO1 for LDO LDO1
  - LDO2 for LDO LDO2
  - LDO3 for LDO LDO3
  - LDO4 for LDO LDO4
  - LDO5 for LDO LDO5
  - LDO6 for LDO LDO6
  - LDO7 for LDO LDO7
  - LDO8 for LDO LDO8
  - LDO9 for LDO LDO9
  - LDO10 for LDO LDO10
  - LDO11 for LDO LDO11
  - LDO12 for LDO LDO12
  - LDO13 for LDO LDO13
  - LDO14 for LDO LDO14
  - LDO15 for LDO LDO15
  - LDO16 for LDO LDO16
  - LDO17 for LDO LDO17
  - LDO18 for LDO LDO18
  - LDO19 for LDO LDO19
  - LDO20 for LDO LDO20

Optional properties:
- Any optional property defined in bindings/regulator/regulator.txt

Example:

	SDV1 {
		regulator-min-microvolt = <637500>;
		regulator-max-microvolt = <1425000>;
		regulator-boot-on;
		regulator-always-on;
	};
```

## Documentation/devicetree/bindings/regulator/max8952.txt
```
Maxim MAX8952 voltage regulator

Required properties:
- compatible: must be equal to "maxim,max8952"
- reg: I2C slave address, usually 0x60
- max8952,dvs-mode-microvolt: array of 4 integer values defining DVS voltages
  in microvolts. All values must be from range <770000, 1400000>
- any required generic properties defined in regulator.txt

Optional properties:
- max8952,vid-gpios: array of two GPIO pins used for DVS voltage selection
- max8952,en-gpio: GPIO used to control enable status of regulator
- max8952,default-mode: index of default DVS voltage, from <0, 3> range
- max8952,sync-freq: sync frequency, must be one of following values:
    - 0: 26 MHz
    - 1: 13 MHz
    - 2: 19.2 MHz
  Defaults to 26 MHz if not specified.
- max8952,ramp-speed: voltage ramp speed, must be one of following values:
    - 0: 32mV/us
    - 1: 16mV/us
    - 2: 8mV/us
    - 3: 4mV/us
    - 4: 2mV/us
    - 5: 1mV/us
    - 6: 0.5mV/us
    - 7: 0.25mV/us
  Defaults to 32mV/us if not specified.
- any available generic properties defined in regulator.txt

Example:

	vdd_arm_reg: pmic@60 {
		compatible = "maxim,max8952";
		reg = <0x60>;

		/* max8952-specific properties */
		max8952,vid-gpios = <&gpx0 3 0>, <&gpx0 4 0>;
		max8952,en-gpio = <&gpx0 1 0>;
		max8952,default-mode = <0>;
		max8952,dvs-mode-microvolt = <1250000>, <1200000>,
						<1050000>, <950000>;
		max8952,sync-freq = <0>;
		max8952,ramp-speed = <0>;

		/* generic regulator properties */
		regulator-name = "vdd_arm";
		regulator-min-microvolt = <770000>;
		regulator-max-microvolt = <1400000>;
		regulator-always-on;
		regulator-boot-on;
	};
```

## Documentation/devicetree/bindings/regulator/max8973-regulator.txt
```
* Maxim MAX8973 Voltage Regulator

Required properties:

- compatible:	must be one of following:
			"maxim,max8973"
			"maxim,max77621".
- reg:		the i2c slave address of the regulator. It should be 0x1b.

Any standard regulator properties can be used to configure the single max8973
DCDC.

Optional properties:

-maxim,externally-enable: boolean, externally control the regulator output
		enable/disable.
-maxim,enable-gpio: GPIO for enable control. If the valid GPIO is provided
		then externally enable control will be considered.
-maxim,dvs-gpio: GPIO which is connected to DVS pin of device.
-maxim,dvs-default-state: Default state of GPIO during initialisation.
		1 for HIGH and 0 for LOW.
-maxim,enable-remote-sense: boolean, enable reote sense.
-maxim,enable-falling-slew-rate: boolean, enable falling slew rate.
-maxim,enable-active-discharge: boolean: enable active discharge.
-maxim,enable-frequency-shift: boolean, enable 9% frequency shift.
-maxim,enable-bias-control: boolean, enable bias control. By enabling this
		startup delay can be reduce to 20us from 220us.

Example:

	max8973@1b {
		compatible = "maxim,max8973";
		reg = <0x1b>;

		regulator-min-microvolt = <935000>;
		regulator-max-microvolt = <1200000>;
		regulator-boot-on;
		regulator-always-on;
	};
```

## Documentation/devicetree/bindings/regulator/max8997-regulator.txt
```
* Maxim MAX8997 Voltage and Current Regulator

The Maxim MAX8997 is a multi-function device which includes volatage and
current regulators, rtc, charger controller and other sub-blocks. It is
interfaced to the host controller using a i2c interface. Each sub-block is
addressed by the host system using different i2c slave address. This document
describes the bindings for 'pmic' sub-block of max8997.

Required properties:
- compatible: Should be "maxim,max8997-pmic".
- reg: Specifies the i2c slave address of the pmic block. It should be 0x66.

- max8997,pmic-buck1-dvs-voltage: A set of 8 voltage values in micro-volt (uV)
  units for buck1 when changing voltage using gpio dvs. Refer to [1] below
  for additional information.

- max8997,pmic-buck2-dvs-voltage: A set of 8 voltage values in micro-volt (uV)
  units for buck2 when changing voltage using gpio dvs. Refer to [1] below
  for additional information.

- max8997,pmic-buck5-dvs-voltage: A set of 8 voltage values in micro-volt (uV)
  units for buck5 when changing voltage using gpio dvs. Refer to [1] below
  for additional information.

[1] If none of the 'max8997,pmic-buck[1/2/5]-uses-gpio-dvs' optional
    property is specified, the 'max8997,pmic-buck[1/2/5]-dvs-voltage'
    property should specify atleast one voltage level (which would be a
    safe operating voltage).

    If either of the 'max8997,pmic-buck[1/2/5]-uses-gpio-dvs' optional
    property is specified, then all the eight voltage values for the
    'max8997,pmic-buck[1/2/5]-dvs-voltage' should be specified.

Optional properties:
- interrupt-parent: Specifies the phandle of the interrupt controller to which
  the interrupts from max8997 are delivered to.
- interrupts: Interrupt specifiers for two interrupt sources.
  - First interrupt specifier is for 'irq1' interrupt.
  - Second interrupt specifier is for 'alert' interrupt.
- max8997,pmic-buck1-uses-gpio-dvs: 'buck1' can be controlled by gpio dvs.
- max8997,pmic-buck2-uses-gpio-dvs: 'buck2' can be controlled by gpio dvs.
- max8997,pmic-buck5-uses-gpio-dvs: 'buck5' can be controlled by gpio dvs.

Additional properties required if either of the optional properties are used:
- max8997,pmic-ignore-gpiodvs-side-effect: When GPIO-DVS mode is used for
  multiple bucks, changing the voltage value of one of the bucks may affect
  that of another buck, which is the side effect of the change (set_voltage).
  Use this property to ignore such side effects and change the voltage.

- max8997,pmic-buck125-default-dvs-idx: Default voltage setting selected from
  the possible 8 options selectable by the dvs gpios. The value of this
  property should be between 0 and 7. If not specified or if out of range, the
  default value of this property is set to 0.

- max8997,pmic-buck125-dvs-gpios: GPIO specifiers for three host gpio's used
  for dvs. The format of the gpio specifier depends in the gpio controller.

Regulators: The regulators of max8997 that have to be instantiated should be
included in a sub-node named 'regulators'. Regulator nodes included in this
sub-node should be of the format as listed below.

	regulator_name {
		standard regulator bindings here
	};

The following are the names of the regulators that the max8997 pmic block
supports. Note: The 'n' in LDOn and BUCKn represents the LDO or BUCK number
as per the datasheet of max8997.

	- LDOn
		  - valid values for n are 1 to 18 and 21
		  - Example: LDO0, LD01, LDO2, LDO21
	- BUCKn
		  - valid values for n are 1 to 7.
		  - Example: BUCK1, BUCK2, BUCK3, BUCK7

	- ENVICHG: Battery Charging Current Monitor Output. This is a fixed
		   voltage type regulator

	- ESAFEOUT1: (ldo19)
	- ESAFEOUT2: (ld020)

	- CHARGER_CV: main battery charger voltage control
	- CHARGER: main battery charger current control
	- CHARGER_TOPOFF: end of charge current threshold level

The bindings inside the regulator nodes use the standard regulator bindings
which are documented elsewhere.

Example:

	max8997_pmic@66 {
		compatible = "maxim,max8997-pmic";
		interrupt-parent = <&wakeup_eint>;
		reg = <0x66>;
		interrupts = <4 0>, <3 0>;

		max8997,pmic-buck1-uses-gpio-dvs;
		max8997,pmic-buck2-uses-gpio-dvs;
		max8997,pmic-buck5-uses-gpio-dvs;

		max8997,pmic-ignore-gpiodvs-side-effect;
		max8997,pmic-buck125-default-dvs-idx = <0>;

		max8997,pmic-buck125-dvs-gpios = <&gpx0 0 1 0 0>, /* SET1 */
						 <&gpx0 1 1 0 0>, /* SET2 */
						 <&gpx0 2 1 0 0>; /* SET3 */

		max8997,pmic-buck1-dvs-voltage = <1350000>, <1300000>,
						 <1250000>, <1200000>,
						 <1150000>, <1100000>,
						 <1000000>, <950000>;

		max8997,pmic-buck2-dvs-voltage = <1100000>, <1100000>,
						 <1100000>, <1100000>,
						 <1000000>, <1000000>,
						 <1000000>, <1000000>;

		max8997,pmic-buck5-dvs-voltage = <1200000>, <1200000>,
						 <1200000>, <1200000>,
						 <1200000>, <1200000>,
						 <1200000>, <1200000>;

		regulators {
			ldo1_reg: LDO1 {
				regulator-name = "VDD_ABB_3.3V";
				regulator-min-microvolt = <3300000>;
				regulator-max-microvolt = <3300000>;
			};

			ldo2_reg: LDO2 {
				regulator-name = "VDD_ALIVE_1.1V";
				regulator-min-microvolt = <1100000>;
				regulator-max-microvolt = <1100000>;
				regulator-always-on;
			};

			buck1_reg: BUCK1 {
				regulator-name = "VDD_ARM_1.2V";
				regulator-min-microvolt = <950000>;
				regulator-max-microvolt = <1350000>;
				regulator-always-on;
				regulator-boot-on;
			};
		};
	};
```

## Documentation/devicetree/bindings/regulator/maxim,max14577.yaml
```yaml
# SPDX-License-Identifier: GPL-2.0-only OR BSD-2-Clause
%YAML 1.2
---
$id: http://devicetree.org/schemas/regulator/maxim,max14577.yaml#
$schema: http://devicetree.org/meta-schemas/core.yaml#

title: Maxim MAX14577/MAX77836 MicroUSB and Companion Power Management IC regulators

maintainers:
  - Krzysztof Kozlowski <krzk@kernel.org>

description: |
  This is a part of device tree bindings for Maxim MAX14577/MAX77836 MicroUSB
  Integrated Circuit (MUIC).

  See also Documentation/devicetree/bindings/mfd/maxim,max14577.yaml for
  additional information and example.

properties:
  compatible:
    enum:
      - maxim,max14577-regulator
      - maxim,max77836-regulator

  CHARGER:
    type: object
    $ref: regulator.yaml#
    unevaluatedProperties: false
    description: |
      Current regulator.

    properties:
      regulator-min-microvolt: false
      regulator-max-microvolt: false

  SAFEOUT:
    type: object
    $ref: regulator.yaml#
    unevaluatedProperties: false
    description: |
      Safeout LDO regulator (fixed voltage).

    properties:
      regulator-min-microamp: false
      regulator-max-microamp: false
      regulator-min-microvolt:
        const: 4900000
      regulator-max-microvolt:
        const: 4900000

patternProperties:
  "^LDO[12]$":
    type: object
    $ref: regulator.yaml#
    unevaluatedProperties: false
    description: |
      Current regulator.

    properties:
      regulator-min-microamp: false
      regulator-max-microamp: false
      regulator-min-microvolt:
        minimum: 800000
      regulator-max-microvolt:
        maximum: 3950000

allOf:
  - if:
      properties:
        compatible:
          contains:
            const: maxim,max14577-regulator
    then:
      properties:
        LDO1: false
        LDO2: false

additionalProperties: false
```

## Documentation/devicetree/bindings/regulator/maxim,max20086.yaml
```yaml
# SPDX-License-Identifier: (GPL-2.0 OR BSD-2-Clause)
%YAML 1.2
---
$id: http://devicetree.org/schemas/regulator/maxim,max20086.yaml#
$schema: http://devicetree.org/meta-schemas/core.yaml#

title: Maxim Integrated MAX20086-MAX20089 Camera Power Protector

maintainers:
  - Laurent Pinchart <laurent.pinchart@ideasonboard.com>

description: |
  The MAX20086-MAX20089 are dual/quad camera power protectors, designed to
  deliver power over coax for radar and camera modules. They support
  software-configurable output switching and monitoring. The output voltage and
  current limit are fixed by the hardware design.

properties:
  compatible:
    enum:
      - maxim,max20086
      - maxim,max20087
      - maxim,max20088
      - maxim,max20089

  reg:
    maxItems: 1

  enable-gpios:
    maxItems: 1
    description: GPIO connected to the EN pin, active high

  in-supply:
    description: Input supply for the camera outputs (IN pin, 3.0V to 15.0V)

  vdd-supply:
    description: Input supply for the device (VDD pin, 3.0V to 5.5V)

  regulators:
    type: object

    patternProperties:
      "^OUT[1-4]$":
        type: object
        $ref: regulator.yaml#
        unevaluatedProperties: false

    additionalProperties: false

required:
  - compatible
  - reg
  - in-supply
  - vdd-supply
  - regulators

allOf:
  - if:
      properties:
        compatible:
          contains:
            enum:
              - maxim,max20088
              - maxim,max20089
    then:
      properties:
        regulators:
          properties:
            OUT3: false
            OUT4: false

additionalProperties: false

examples:
  - |
    #include <dt-bindings/gpio/gpio.h>

    i2c {
        #address-cells = <1>;
        #size-cells = <0>;

        regulator@28 {
            compatible = "maxim,max20087";
            reg = <0x28>;

            in-supply = <&reg_12v0>;
            vdd-supply = <&reg_3v3>;

            enable-gpios = <&gpio 108 GPIO_ACTIVE_HIGH>;

            regulators {
                OUT1 {
                    regulator-name = "VOUT1";
                };
                OUT2 {
                    regulator-name = "VOUT2";
                };
                OUT3 {
                    regulator-name = "VOUT3";
                };
                OUT4 {
                    regulator-name = "VOUT4";
                };
            };
        };
    };
...
```
