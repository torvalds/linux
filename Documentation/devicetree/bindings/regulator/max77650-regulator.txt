## Documentation/devicetree/bindings/regulator/maxim,max77843.yaml
```yaml
# SPDX-License-Identifier: GPL-2.0-only OR BSD-2-Clause
%YAML 1.2
---
$id: http://devicetree.org/schemas/regulator/maxim,max77843.yaml#
$schema: http://devicetree.org/meta-schemas/core.yaml#

title: Maxim MAX77843 MicroUSB and Companion Power Management IC regulators

maintainers:
  - Krzysztof Kozlowski <krzysztof.kozlowski@canonical.com>

description: |
  This is a part of device tree bindings for Maxim MAX77843 MicroUSB Integrated
  Circuit (MUIC).

  See also Documentation/devicetree/bindings/mfd/maxim,max77843.yaml for
  additional information and example.

properties:
  compatible:
    const: maxim,max77843-regulator

  CHARGER:
    type: object
    $ref: regulator.yaml#
    additionalProperties: false
    description: |
      Current regulator.

    properties:
      regulator-name: true
      regulator-always-on: true
      regulator-boot-on: true
      regulator-min-microamp:
        minimum: 100000
      regulator-max-microamp:
        maximum: 3150000

    required:
      - regulator-name

patternProperties:
  "^SAFEOUT[12]$":
    type: object
    $ref: regulator.yaml#
    additionalProperties: false
    description: |
      Safeout LDO regulator.

    properties:
      regulator-name: true
      regulator-always-on: true
      regulator-boot-on: true
      regulator-min-microvolt:
        minimum: 3300000
      regulator-max-microvolt:
        maximum: 4950000

    required:
      - regulator-name

required:
  - compatible

additionalProperties: false
```

## Documentation/devicetree/bindings/regulator/maxim,max8952.yaml
```yaml
# SPDX-License-Identifier: GPL-2.0-only OR BSD-2-Clause
%YAML 1.2
---
$id: http://devicetree.org/schemas/regulator/maxim,max8952.yaml#
$schema: http://devicetree.org/meta-schemas/core.yaml#

title: Maxim MAX8952 voltage regulator

maintainers:
  - Krzysztof Kozlowski <krzysztof.kozlowski@canonical.com>

allOf:
  - $ref: regulator.yaml#

properties:
  compatible:
    const: maxim,max8952

  max8952,default-mode:
    $ref: /schemas/types.yaml#/definitions/uint32
    enum: [0, 1, 2, 3]
    description: |
      index of default DVS voltage

  max8952,dvs-mode-microvolt:
    minItems: 4
    maxItems: 4
    items:
      minimum: 770000
      maximum: 1400000
    description: |
      Array of 4 integer values defining DVS voltages in microvolts. All values
      must be from range <770000, 1400000>.

  max8952,en-gpio:
    maxItems: 1
    description: |
      GPIO used to control enable status of regulator

  max8952,ramp-speed:
    $ref: /schemas/types.yaml#/definitions/uint32
    enum: [0, 1, 2, 3, 4, 5, 6, 7]
    default: 0
    description: |
      Voltage ramp speed, values map to:
       - 0: 32mV/us
       - 1: 16mV/us
       - 2: 8mV/us
       - 3: 4mV/us
       - 4: 2mV/us
       - 5: 1mV/us
       - 6: 0.5mV/us
       - 7: 0.25mV/us
      Defaults to 32mV/us if not specified.

  max8952,sync-freq:
    $ref: /schemas/types.yaml#/definitions/uint32
    enum: [0, 1, 2]
    default: 0
    description: |
      Sync frequency, values map to:
       - 0: 26 MHz
       - 1: 13 MHz
       - 2: 19.2 MHz
      Defaults to 26 MHz if not specified.

  max8952,vid-gpios:
    minItems: 2
    maxItems: 2
    description: |
      Array of two GPIO pins used for DVS voltage selection

  reg:
    maxItems: 1

required:
  - compatible
  - max8952,dvs-mode-microvolt
  - reg

unevaluatedProperties: false

examples:
  - |
    #include <dt-bindings/gpio/gpio.h>

    i2c {
        #address-cells = <1>;
        #size-cells = <0>;

        pmic@60 {
            compatible = "maxim,max8952";
            reg = <0x60>;

            max8952,vid-gpios = <&gpx0 3 GPIO_ACTIVE_HIGH>,
                                <&gpx0 4 GPIO_ACTIVE_HIGH>;
            max8952,default-mode = <0>;
            max8952,dvs-mode-microvolt = <1250000>, <1200000>,
                                         <1050000>, <950000>;
            max8952,sync-freq = <0>;
            max8952,ramp-speed = <0>;

            regulator-name = "VARM_1.2V_C210";
            regulator-min-microvolt = <770000>;
            regulator-max-microvolt = <1400000>;
            regulator-always-on;
            regulator-boot-on;
        };
    };
```

## Documentation/devicetree/bindings/regulator/maxim,max8973.yaml
```yaml
# SPDX-License-Identifier: GPL-2.0-only
%YAML 1.2
---
$id: http://devicetree.org/schemas/regulator/maxim,max8973.yaml#
$schema: http://devicetree.org/meta-schemas/core.yaml#

title: Maxim MAX8973/MAX77621 voltage regulator

maintainers:
  - Krzysztof Kozlowski <krzk@kernel.org>

allOf:
  - $ref: regulator.yaml#

properties:
  compatible:
    enum:
      - maxim,max8973
      - maxim,max77621

  junction-warn-millicelsius:
    description: |
      Junction warning temperature threshold in millicelsius. If die
      temperature crosses this level then device generates the warning
      interrupts.
      Please note that thermal functionality is only supported on MAX77621. The
      supported threshold warning temperature for MAX77621 are 120 degC and 140
      degC.

  maxim,dvs-gpio:
    maxItems: 1
    description: |
      GPIO which is connected to DVS pin of device.

  maxim,dvs-default-state:
    $ref: /schemas/types.yaml#/definitions/uint32
    enum: [0, 1]
    description: |
      Default state of GPIO during initialisation.
      1 for HIGH and 0 for LOW.

  maxim,externally-enable:
    type: boolean
    description: |
      Externally control the regulator output enable/disable.

  maxim,enable-gpio:
    maxItems: 1
    description: |
      GPIO for enable control. If the valid GPIO is provided then externally
      enable control will be considered.

  maxim,enable-remote-sense:
    type: boolean
    description: Enable remote sense.

  maxim,enable-falling-slew-rate:
    type: boolean
    description: Enable falling slew rate.

  maxim,enable-active-discharge:
    type: boolean
    description: Eable active discharge.

  maxim,enable-frequency-shift:
    type: boolean
    description: Enable 9% frequency shift.

  maxim,enable-bias-control:
    type: boolean
    description: |
      Enable bias control which can reduce the startup delay to 20us from 220us.

  maxim,enable-etr:
    type: boolean
    description: Enable Enhanced Transient Response.

  maxim,enable-high-etr-sensitivity:
    type: boolean
    description: |
      Enhanced transient response circuit is enabled and set for high
      sensitivity. If this property is available then etr will be enable
      default.
      Enhanced transient response (ETR) will affect the configuration of CKADV.

  reg:
    maxItems: 1

  interrupts:
    maxItems: 1

required:
  - compatible
  - reg

unevaluatedProperties: false

examples:
  - |
    i2c {
        #address-cells = <1>;
        #size-cells = <0>;

        regulator@1b {
            compatible = "maxim,max8973";
            reg = <0x1b>;

            regulator-min-microvolt = <935000>;
            regulator-max-microvolt = <1200000>;
            regulator-boot-on;
            regulator-always-on;
        };
    };

  - |
    #include <dt-bindings/gpio/gpio.h>
    #include <dt-bindings/interrupt-controller/irq.h>

    i2c {
        #address-cells = <1>;
        #size-cells = <0>;

        regulator@1b {
            compatible = "maxim,max77621";
            reg = <0x1b>;
            interrupts = <1 IRQ_TYPE_LEVEL_LOW>;

            regulator-always-on;
            regulator-boot-on;
            regulator-min-microvolt = <800000>;
            regulator-max-microvolt = <1231250>;
            regulator-name = "PPVAR_CPU";
            regulator-ramp-delay = <12500>;
            maxim,dvs-default-state = <1>;
            maxim,enable-active-discharge;
            maxim,enable-bias-control;
            maxim,enable-etr;
            maxim,enable-gpio = <&pmic 5 GPIO_ACTIVE_HIGH>;
            maxim,externally-enable;
        };
    };
```
