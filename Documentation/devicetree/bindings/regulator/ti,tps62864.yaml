## Documentation/devicetree/bindings/regulator/ti,tps62864.yaml
```yaml
# SPDX-License-Identifier: (GPL-2.0-only OR BSD-2-Clause)
%YAML 1.2
---
$id: http://devicetree.org/schemas/regulator/ti,tps62864.yaml#
$schema: http://devicetree.org/meta-schemas/core.yaml#

title: TI TPS62864/TPS6286/TPS62868/TPS62869 voltage regulator

maintainers:
  - Vincent Whitchurch <vincent.whitchurch@axis.com>

properties:
  compatible:
    enum:
      - ti,tps62864
      - ti,tps62866
      - ti,tps62868
      - ti,tps62869

  reg:
    maxItems: 1

  regulators:
    type: object

    patternProperties:
      "SW":
        type: object
        $ref: regulator.yaml#

    additionalProperties: false

required:
  - compatible
  - reg
  - regulators

additionalProperties: false

examples:
  - |
    #include <dt-bindings/regulator/ti,tps62864.h>
    i2c {
      #address-cells = <1>;
      #size-cells = <0>;

      regulator@48 {
        compatible = "ti,tps62864";
        reg = <0x48>;

        regulators {
          SW {
            regulator-name = "+0.85V";
            regulator-min-microvolt = <800000>;
            regulator-max-microvolt = <890000>;
            regulator-initial-mode = <TPS62864_MODE_FPWM>;
          };
        };
      };
    };

...
```

## Documentation/devicetree/bindings/regulator/ti,tps62870.yaml
```yaml
# SPDX-License-Identifier: (GPL-2.0-only OR BSD-2-Clause)
%YAML 1.2
---
$id: http://devicetree.org/schemas/regulator/ti,tps62870.yaml#
$schema: http://devicetree.org/meta-schemas/core.yaml#

title: TI TPS62870/TPS62871/TPS62872/TPS62873 voltage regulator

maintainers:
  - Mårten Lindahl <marten.lindahl@axis.com>

allOf:
  - $ref: regulator.yaml#

properties:
  compatible:
    enum:
      - ti,tps62870
      - ti,tps62871
      - ti,tps62872
      - ti,tps62873

  reg:
    maxItems: 1

  regulator-initial-mode:
    enum: [ 1, 2 ]
    description: 1 - Forced PWM mode, 2 - Low power mode

required:
  - compatible
  - reg

unevaluatedProperties: false

examples:
  - |
    i2c {
      #address-cells = <1>;
      #size-cells = <0>;

      regulator@41 {
        compatible = "ti,tps62873";
        reg = <0x41>;
        regulator-name = "+0.75V";
        regulator-min-microvolt = <400000>;
        regulator-max-microvolt = <1675000>;
        regulator-initial-mode = <1>;
      };
    };

...
```

## Documentation/devicetree/bindings/regulator/ti,tps65132.yaml
```yaml
# SPDX-License-Identifier: GPL-2.0-only OR BSD-2-Clause
%YAML 1.2
---
$id: http://devicetree.org/schemas/regulator/ti,tps65132.yaml#
$schema: http://devicetree.org/meta-schemas/core.yaml#

title: TI TPS65132 Dual Output Power Regulators

maintainers:
  - devicetree@vger.kernel.org

description: |
  The TPS65132 is designed to supply positive/negative driven applications.

  Datasheet is available at:
  https://www.ti.com/lit/gpn/tps65132

properties:
  compatible:
    enum:
      - ti,tps65132

  reg:
    maxItems: 1

  vin-supply: true

patternProperties:
  "^out[pn]$":
    type: object
    $ref: regulator.yaml#
    unevaluatedProperties: false
    description:
      Properties for single regulator.

    properties:
      enable-gpios:
        maxItems: 1
        description:
          GPIO specifier to enable the GPIO control (on/off) for regulator.

      active-discharge-gpios:
        maxItems: 1
        description:
          GPIO specifier to actively discharge the delay mechanism.

      ti,active-discharge-time-us:
        description: Regulator active discharge time in microseconds.

    dependencies:
      active-discharge-gpios: [ 'ti,active-discharge-time-us' ]

required:
  - compatible
  - reg

additionalProperties: false

examples:
  - |
    #include <dt-bindings/gpio/gpio.h>

    i2c {
        #address-cells = <1>;
        #size-cells = <0>;

        regulator@3e {
            compatible = "ti,tps65132";
            reg = <0x3e>;
            vin-supply = <&supply>;

            outp {
                regulator-name = "outp";
                regulator-boot-on;
                regulator-always-on;
                enable-gpios = <&gpio 23 GPIO_ACTIVE_HIGH>;
            };

            outn {
                regulator-name = "outn";
                regulator-boot-on;
                regulator-always-on;
                regulator-active-discharge = <0>;
                enable-gpios = <&gpio 40 GPIO_ACTIVE_HIGH>;
            };
        };
    };
```

## Documentation/devicetree/bindings/regulator/ti,tps65185.yaml
```yaml
# SPDX-License-Identifier: GPL-2.0-only OR BSD-2-Clause
%YAML 1.2
---
$id: http://devicetree.org/schemas/regulator/ti,tps65185.yaml#
$schema: http://devicetree.org/meta-schemas/core.yaml#

title: TI TPS65185 Power Management Integrated Circuit

maintainers:
  - Andreas Kemnade <andreas@kemnade.info>

description:
  TPS65185 is a Power Management IC to provide Power for EPDs with one 3.3V
  switch, 2 symmetric LDOs behind 2 DC/DC converters, and one unsymmetric
  regulator for a compensation voltage.

properties:
  compatible:
    const: ti,tps65185

  reg:
    maxItems: 1

  enable-gpios:
    description:
      PWRUP pin
    maxItems: 1

  pwr-good-gpios:
    maxItems: 1

  vcom-ctrl-gpios:
    maxItems: 1

  wakeup-gpios:
    maxItems: 1

  vin-supply: true

  interrupts:
    maxItems: 1

  regulators:
    type: object
    additionalProperties: false
    patternProperties:
      "^(vcom|vposneg|v3p3)$":
        unevaluatedProperties: false
        type: object
        $ref: /schemas/regulator/regulator.yaml

required:
  - compatible
  - reg
  - pwr-good-gpios
  - vin-supply

additionalProperties: false

examples:
  - |
    #include <dt-bindings/gpio/gpio.h>
    #include <dt-bindings/interrupt-controller/irq.h>
    i2c {
        #address-cells = <1>;
        #size-cells = <0>;

        pmic@18 {
            compatible = "ti,tps65185";
            reg = <0x18>;
            pinctrl-names = "default";
            pinctrl-0 = <&pinctrl_tps65185_gpio>;
            pwr-good-gpios = <&gpio2 7 GPIO_ACTIVE_HIGH>;
            vcom-ctrl-gpios = <&gpio2 9 GPIO_ACTIVE_HIGH>;
            enable-gpios = <&gpio2 8 GPIO_ACTIVE_HIGH>;
            wakeup-gpios = <&gpio2 5 GPIO_ACTIVE_HIGH>;
            vin-supply = <&epdc_pmic_supply>;
            interrupts-extended = <&gpio2 0 IRQ_TYPE_LEVEL_LOW>;

            regulators {
                vcom {
                    regulator-name = "vcom";
                };

                vposneg {
                    regulator-name = "vposneg";
                    regulator-min-microvolt = <15000000>;
                    regulator-max-microvolt = <15000000>;
                };

                v3p3 {
                    regulator-name = "v3p3";
                };
            };
        };
    };
```

## Documentation/devicetree/bindings/regulator/ti,tps65219.yaml
```yaml
# SPDX-License-Identifier: GPL-2.0-only OR BSD-2-Clause
%YAML 1.2
---
$id: http://devicetree.org/schemas/regulator/ti,tps65219.yaml#
$schema: http://devicetree.org/meta-schemas/core.yaml#

title: TI TPS65214/TPS65215/TPS65219 Power Management Integrated Circuit

maintainers:
  - Jerome Neanne <jerome.neanne@baylibre.com>

description: |
  Regulator nodes should be named to buck<number> and ldo<number>.

  TI TPS65219 is a Power Management IC with 3 Buck regulators, 4 Low
  Drop-out Regulators (LDOs), 1 GPIO, 2 GPOs, and power-button.

  TI TPS65215 is a derivative of TPS65219 with 3 Buck regulators, 2 Low
  Drop-out Regulators (LDOs), 1 GPIO, 1 GPO, and power-button.

  TI TPS65214 is a derivative of TPS65219 with 3 Buck regulators, 2 Low
  Drop-out Regulators (LDOs), 1 GPIO, 1 GPO, and power-button.

properties:
  compatible:
    enum:
      - ti,tps65214
      - ti,tps65215
      - ti,tps65219

  reg:
    maxItems: 1

  system-power-controller:
    type: boolean
    description: Optional property that indicates that this device is
      controlling system power.

  interrupts:
    description: Short-circuit, over-current, under-voltage for regulators, PB interrupts.
    maxItems: 1

  interrupt-controller: true

  '#interrupt-cells':
    description: Specifies the PIN numbers and Flags, as defined in
      include/dt-bindings/interrupt-controller/irq.h
    const: 1

  ti,power-button:
    type: boolean
    description: |
      Optional property that sets the EN/PB/VSENSE pin to be a
      power-button.
      TPS65219 has a multipurpose pin called EN/PB/VSENSE that can be either
      1. EN in which case it functions as an enable pin.
      2. VSENSE which compares the voltages and triggers an automatic
      on/off request.
      3. PB in which case it can be configured to trigger an interrupt
      to the SoC.
      ti,power-button reflects the last one of those options
      where the board has a button wired to the pin and triggers
      an interrupt on pressing it.

  regulators:
    type: object
    description: |
      list of regulators provided by this controller

    patternProperties:
      "^ldo[1-4]$":
        type: object
        $ref: regulator.yaml#
        description:
          Properties for single LDO regulator.

        unevaluatedProperties: false

      "^buck[1-3]$":
        type: object
        $ref: regulator.yaml#
        description:
          Properties for single BUCK regulator.

        unevaluatedProperties: false

    additionalProperties: false

patternProperties:
  "^buck[1-3]-supply$":
    description: Input supply phandle of one regulator.

  "^ldo[1-4]-supply$":
    description: Input supply phandle of one regulator.

required:
  - compatible
  - reg
  - interrupts
  - regulators

additionalProperties: false

allOf:
  - if:
      properties:
        compatible:
          contains:
            enum:
              - ti,tps65214
              - ti,tps65215
    then:
      properties:
        regulators:
          patternProperties:
            "^ldo[3-4]$": false

examples:
  - |
    #include <dt-bindings/interrupt-controller/arm-gic.h>
    i2c {
        #address-cells = <1>;
        #size-cells = <0>;

        tps65219: pmic@30 {
            compatible = "ti,tps65219";
            reg = <0x30>;
            buck1-supply = <&vcc_3v3_sys>;
            buck2-supply = <&vcc_3v3_sys>;
            buck3-supply = <&vcc_3v3_sys>;
            ldo1-supply = <&vcc_3v3_sys>;
            ldo2-supply = <&buck2_reg>;
            ldo3-supply = <&vcc_3v3_sys>;
            ldo4-supply = <&vcc_3v3_sys>;

            pinctrl-0 = <&pmic_irq_pins_default>;

            interrupt-parent = <&gic500>;
            interrupts = <GIC_SPI 224 IRQ_TYPE_LEVEL_HIGH>;
            ti,power-button;

            regulators {
                buck1_reg: buck1 {
                    regulator-name = "VDD_CORE";
                    regulator-min-microvolt = <750000>;
                    regulator-max-microvolt = <750000>;
                    regulator-boot-on;
                    regulator-always-on;
                };

                buck2_reg: buck2 {
                    regulator-name = "VCC1V8";
                    regulator-min-microvolt = <1800000>;
                    regulator-max-microvolt = <1800000>;
                    regulator-boot-on;
                    regulator-always-on;
                };

                buck3_reg: buck3 {
                    regulator-name = "VDD_LPDDR4";
                    regulator-min-microvolt = <1100000>;
                    regulator-max-microvolt = <1100000>;
                    regulator-boot-on;
                    regulator-always-on;
                };

                ldo1_reg: ldo1 {
                    regulator-name = "VDDSHV_SD_IO_PMIC";
                    regulator-min-microvolt = <33000000>;
                    regulator-max-microvolt = <33000000>;
                };

                ldo2_reg: ldo2 {
                    regulator-name = "VDDAR_CORE";
                    regulator-min-microvolt = <850000>;
                    regulator-max-microvolt = <850000>;
                    regulator-boot-on;
                    regulator-always-on;
                };

                ldo3_reg: ldo3 {
                    regulator-name = "VDDA_1V8";
                    regulator-min-microvolt = <18000000>;
                    regulator-max-microvolt = <18000000>;
                    regulator-boot-on;
                    regulator-always-on;
                };

                ldo4_reg: ldo4 {
                    regulator-name = "VDD_PHY_2V5";
                    regulator-min-microvolt = <25000000>;
                    regulator-max-microvolt = <25000000>;
                    regulator-boot-on;
                    regulator-always-on;
                };
            };
        };
    };
```
