## Documentation/devicetree/bindings/regulator/tps65217.txt
```
TPS65217 family of regulators

Required properties:
- compatible: "ti,tps65217"
- reg: I2C slave address
- regulators: list of regulators provided by this controller, must be named
  after their hardware counterparts: dcdc[1-3] and ldo[1-4]
- regulators: This is the list of child nodes that specify the regulator
  initialization data for defined regulators. Not all regulators for the given
  device need to be present. The definition for each of these nodes is defined
  using the standard binding for regulators found at
  Documentation/devicetree/bindings/regulator/regulator.txt.

  The valid names for regulators are:
  tps65217: dcdc1, dcdc2, dcdc3, ldo1, ldo2, ldo3 and ldo4

Each regulator is defined using the standard binding for regulators.

Example:

	tps: tps@24 {
		compatible = "ti,tps65217";

		regulators {
			dcdc1_reg: dcdc1 {
				regulator-min-microvolt = <900000>;
				regulator-max-microvolt = <1800000>;
				regulator-boot-on;
				regulator-always-on;
			};

			dcdc2_reg: dcdc2 {
				regulator-min-microvolt = <900000>;
				regulator-max-microvolt = <3300000>;
				regulator-boot-on;
				regulator-always-on;
			};

			dcdc3_reg: dcc3 {
				regulator-min-microvolt = <900000>;
				regulator-max-microvolt = <1500000>;
				regulator-boot-on;
				regulator-always-on;
			};

			ldo1_reg: ldo1 {
				regulator-min-microvolt = <1000000>;
				regulator-max-microvolt = <3300000>;
				regulator-boot-on;
				regulator-always-on;
			};

			ldo2_reg: ldo2 {
				regulator-min-microvolt = <900000>;
				regulator-max-microvolt = <3300000>;
				regulator-boot-on;
				regulator-always-on;
			};

			ldo3_reg: ldo3 {
				regulator-min-microvolt = <1800000>;
				regulator-max-microvolt = <3300000>;
				regulator-boot-on;
				regulator-always-on;
			};

			ldo4_reg: ldo4 {
				regulator-min-microvolt = <1800000>;
				regulator-max-microvolt = <3300000>;
				regulator-boot-on;
				regulator-always-on;
			};
		};
	};
```

## Documentation/devicetree/bindings/regulator/tps65218.txt
```
TPS65218 family of regulators

Required properties:
- compatible: "ti,tps65218"
- reg: I2C slave address

- List of regulators provided by this controller, must be named
  after their hardware counterparts: dcdc[1-6] and ldo1
- This is the list of child nodes that specify the regulator
  initialization data for defined regulators. Not all regulators for the given
  device need to be present. The definition for each of these nodes is defined
  using the standard binding for regulators found at ./regulator.txt.

  The valid names for regulators are:
  tps65217: regulator-dcdc1, regulator-dcdc2, regulator-dcdc3, regulator-dcdc4,
  regulator-dcdc5, regulator-dcdc6, regulator-ldo1, regulator-ls3.
  Each regulator is defined using the standard binding for regulators.

Example:
tps65218: tps65218@24 {
	reg = <0x24>;
	compatible = "ti,tps65218";
	interrupts = <GIC_SPI 7 IRQ_TYPE_NONE>; /* NMIn */
	interrupt-controller;
	#interrupt-cells = <2>;

	dcdc1: regulator-dcdc1 {
		regulator-name = "vdd_core";
		regulator-min-microvolt = <912000>;
		regulator-max-microvolt = <1144000>;
		regulator-boot-on;
		regulator-always-on;
	};

	dcdc2: regulator-dcdc2 {
		regulator-name = "vdd_mpu";
		regulator-min-microvolt = <912000>;
		regulator-max-microvolt = <1378000>;
		regulator-boot-on;
		regulator-always-on;
	};

	dcdc3: regulator-dcdc3 {
		regulator-name = "vdcdc3";
		regulator-min-microvolt = <1500000>;
		regulator-max-microvolt = <1500000>;
		regulator-boot-on;
		regulator-always-on;
	};

	dcdc5: regulator-dcdc5 {
		regulator-name = "v1_0bat";
		regulator-min-microvolt = <1000000>;
		regulator-max-microvolt = <1000000>;
		regulator-boot-on;
		regulator-always-on;
	};

	dcdc6: regulator-dcdc6 {
		regulator-name = "v1_8bat";
		regulator-min-microvolt = <1800000>;
		regulator-max-microvolt = <1800000>;
		regulator-boot-on;
		regulator-always-on;
	};

	ldo1: regulator-ldo1 {
		regulator-min-microvolt = <1800000>;
		regulator-max-microvolt = <1800000>;
		regulator-boot-on;
		regulator-always-on;
	};

	ls3: regulator-ls3 {
		regulator-min-microvolt = <100000>;
		regulator-max-microvolt = <1000000>;
	};
};
```

## Documentation/devicetree/bindings/regulator/tps6586x.txt
```
TPS6586x family of regulators

Required properties:
- compatible: "ti,tps6586x"
- reg: I2C slave address
- interrupts: the interrupt outputs of the controller
- #gpio-cells: number of cells to describe a GPIO
- gpio-controller: mark the device as a GPIO controller
- regulators: A node that houses a sub-node for each regulator within the
  device. Each sub-node is identified using the node's name (or the deprecated
  regulator-compatible property if present), with valid values listed below.
  The content of each sub-node is defined by the standard binding for
  regulators; see regulator.txt.
  sys, sm[0-2], ldo[0-9] and ldo_rtc
- sys-supply: The input supply for SYS.
- vin-sm0-supply: The input supply for the SM0.
- vin-sm1-supply: The input supply for the SM1.
- vin-sm2-supply: The input supply for the SM2.
- vinldo01-supply: The input supply for the LDO1 and LDO2
- vinldo23-supply: The input supply for the LDO2 and LDO3
- vinldo4-supply: The input supply for the LDO4
- vinldo678-supply: The input supply for the LDO6, LDO7 and LDO8
- vinldo9-supply: The input supply for the LDO9

Optional properties:
- ti,system-power-controller: Telling whether or not this pmic is controlling
  the system power.

Each regulator is defined using the standard binding for regulators.

Note: LDO5 and LDO_RTC is supplied by SYS regulator internally and driver
      take care of making proper parent child relationship.

Example:

	pmu: tps6586x@34 {
		compatible = "ti,tps6586x";
		reg = <0x34>;
		interrupts = <0 88 0x4>;

		#gpio-cells = <2>;
		gpio-controller;

		ti,system-power-controller;

		sys-supply = <&some_reg>;
		vin-sm0-supply = <&some_reg>;
		vin-sm1-supply = <&some_reg>;
		vin-sm2-supply = <&some_reg>;
		vinldo01-supply = <...>;
		vinldo23-supply = <...>;
		vinldo4-supply = <...>;
		vinldo678-supply = <...>;
		vinldo9-supply = <...>;

		regulators {
			sys_reg: sys {
				regulator-name = "vdd_sys";
				regulator-boot-on;
				regulator-always-on;
			};

			sm0_reg: sm0 {
				regulator-min-microvolt = < 725000>;
				regulator-max-microvolt = <1500000>;
				regulator-boot-on;
				regulator-always-on;
			};

			sm1_reg: sm1 {
				regulator-min-microvolt = < 725000>;
				regulator-max-microvolt = <1500000>;
				regulator-boot-on;
				regulator-always-on;
			};

			sm2_reg: sm2 {
				regulator-min-microvolt = <3000000>;
				regulator-max-microvolt = <4550000>;
				regulator-boot-on;
				regulator-always-on;
			};

			ldo0_reg: ldo0 {
				regulator-name = "PCIE CLK";
				regulator-min-microvolt = <3300000>;
				regulator-max-microvolt = <3300000>;
			};

			ldo1_reg: ldo1 {
				regulator-min-microvolt = < 725000>;
				regulator-max-microvolt = <1500000>;
			};

			ldo2_reg: ldo2 {
				regulator-min-microvolt = < 725000>;
				regulator-max-microvolt = <1500000>;
			};

			ldo3_reg: ldo3 {
				regulator-min-microvolt = <1250000>;
				regulator-max-microvolt = <3300000>;
			};

			ldo4_reg: ldo4 {
				regulator-min-microvolt = <1700000>;
				regulator-max-microvolt = <2475000>;
			};

			ldo5_reg: ldo5 {
				regulator-min-microvolt = <1250000>;
				regulator-max-microvolt = <3300000>;
			};

			ldo6_reg: ldo6 {
				regulator-min-microvolt = <1250000>;
				regulator-max-microvolt = <3300000>;
			};

			ldo7_reg: ldo7 {
				regulator-min-microvolt = <1250000>;
				regulator-max-microvolt = <3300000>;
			};

			ldo8_reg: ldo8 {
				regulator-min-microvolt = <1250000>;
				regulator-max-microvolt = <3300000>;
			};

			ldo9_reg: ldo9 {
				regulator-min-microvolt = <1250000>;
				regulator-max-microvolt = <3300000>;
			};
		};
	};
```

## Documentation/devicetree/bindings/regulator/twl-regulator.txt
```
TWL family of regulators

Required properties:
For twl6030 regulators/LDOs
- compatible:
  - "ti,twl6030-vaux1" for VAUX1 LDO
  - "ti,twl6030-vaux2" for VAUX2 LDO
  - "ti,twl6030-vaux3" for VAUX3 LDO
  - "ti,twl6030-vmmc" for VMMC LDO
  - "ti,twl6030-vpp" for VPP LDO
  - "ti,twl6030-vusim" for VUSIM LDO
  - "ti,twl6030-vana" for VANA LDO
  - "ti,twl6030-vcxio" for VCXIO LDO
  - "ti,twl6030-vdac" for VDAC LDO
  - "ti,twl6030-vusb" for VUSB LDO
  - "ti,twl6030-v1v8" for V1V8 LDO
  - "ti,twl6030-v2v1" for V2V1 LDO
  - "ti,twl6030-vdd1" for VDD1 SMPS
  - "ti,twl6030-vdd2" for VDD2 SMPS
  - "ti,twl6030-vdd3" for VDD3 SMPS
For twl6032 regulators/LDOs
- compatible:
  - "ti,twl6032-ldo1" for LDO1 LDO
  - "ti,twl6032-ldo2" for LDO2 LDO
  - "ti,twl6032-ldo3" for LDO3 LDO
  - "ti,twl6032-ldo4" for LDO4 LDO
  - "ti,twl6032-ldo5" for LDO5 LDO
  - "ti,twl6032-ldo6" for LDO6 LDO
  - "ti,twl6032-ldo7" for LDO7 LDO
  - "ti,twl6032-ldoln" for LDOLN LDO
  - "ti,twl6032-ldousb" for LDOUSB LDO
  - "ti,twl6032-smps3" for SMPS3 SMPS
  - "ti,twl6032-smps4" for SMPS4 SMPS
  - "ti,twl6032-vio" for VIO SMPS
For twl4030 regulators/LDOs
- compatible:
  - "ti,twl4030-vaux1" for VAUX1 LDO
  - "ti,twl4030-vaux2" for VAUX2 LDO
  - "ti,twl5030-vaux2" for VAUX2 LDO
  - "ti,twl4030-vaux3" for VAUX3 LDO
  - "ti,twl4030-vaux4" for VAUX4 LDO
  - "ti,twl4030-vmmc1" for VMMC1 LDO
  - "ti,twl4030-vmmc2" for VMMC2 LDO
  - "ti,twl4030-vpll1" for VPLL1 LDO
  - "ti,twl4030-vpll2" for VPLL2 LDO
  - "ti,twl4030-vsim" for VSIM LDO
  - "ti,twl4030-vdac" for VDAC LDO
  - "ti,twl4030-vintana2" for VINTANA2 LDO
  - "ti,twl4030-vio" for VIO LDO
  - "ti,twl4030-vdd1" for VDD1 SMPS
  - "ti,twl4030-vdd2" for VDD2 SMPS
  - "ti,twl4030-vintana1" for VINTANA1 LDO
  - "ti,twl4030-vintdig" for VINTDIG LDO
  - "ti,twl4030-vusb1v5" for VUSB1V5 LDO
  - "ti,twl4030-vusb1v8" for VUSB1V8 LDO
  - "ti,twl4030-vusb3v1" for VUSB3V1 LDO

Optional properties:
- Any optional property defined in bindings/regulator/regulator.txt
For twl4030 regulators/LDOs:
 - regulator-initial-mode:
  - 0x08 - Sleep mode, the nominal output voltage is maintained with low power
           consumption with low load current capability.
  - 0x0e - Active mode, the regulator can deliver its nominal output voltage
           with full-load current capability.

Example:

	xyz: regulator@0 {
		compatible = "ti,twl6030-vaux1";
		regulator-min-microvolt  = <1000000>;
		regulator-max-microvolt  = <3000000>;
	};

For twl6030 regulators/LDOs:

 - ti,retain-on-reset: Does not turn off the supplies during warm
                       reset. Could be needed for VMMC, as TWL6030
                       reset sequence for this signal does not comply
                       with the SD specification.
```

## Documentation/devicetree/bindings/regulator/uniphier-regulator.txt
```
Socionext UniPhier Regulator Controller

This describes the devicetree bindings for regulator controller implemented
on Socionext UniPhier SoCs.

USB3 Controller
---------------

This regulator controls VBUS and belongs to USB3 glue layer. Before using
the regulator, it is necessary to control the clocks and resets to enable
this layer. These clocks and resets should be described in each property.

Required properties:
- compatible: Should be
    "socionext,uniphier-pro4-usb3-regulator" - for Pro4 SoC
    "socionext,uniphier-pro5-usb3-regulator" - for Pro5 SoC
    "socionext,uniphier-pxs2-usb3-regulator" - for PXs2 SoC
    "socionext,uniphier-ld20-usb3-regulator" - for LD20 SoC
    "socionext,uniphier-pxs3-usb3-regulator" - for PXs3 SoC
- reg: Specifies offset and length of the register set for the device.
- clocks: A list of phandles to the clock gate for USB3 glue layer.
	According to the clock-names, appropriate clocks are required.
- clock-names: Should contain
    "gio", "link" - for Pro4 and Pro5 SoCs
    "link"        - for others
- resets: A list of phandles to the reset control for USB3 glue layer.
	According to the reset-names, appropriate resets are required.
- reset-names: Should contain
    "gio", "link" - for Pro4 and Pro5 SoCs
    "link"        - for others

See Documentation/devicetree/bindings/regulator/regulator.txt
for more details about the regulator properties.

Example:

	usb-glue@65b00000 {
		compatible = "socionext,uniphier-ld20-dwc3-glue",
			     "simple-mfd";
		#address-cells = <1>;
		#size-cells = <1>;
		ranges = <0 0x65b00000 0x400>;

		usb_vbus0: regulators@100 {
			compatible = "socionext,uniphier-ld20-usb3-regulator";
			reg = <0x100 0x10>;
			clock-names = "link";
			clocks = <&sys_clk 14>;
			reset-names = "link";
			resets = <&sys_rst 14>;
		};

		phy {
			...
			phy-supply = <&usb_vbus0>;
		};
		...
	};
```

## Documentation/devicetree/bindings/regulator/vctrl-regulator.yaml
```yaml
# SPDX-License-Identifier: GPL-2.0-only OR BSD-2-Clause
%YAML 1.2
---
$id: http://devicetree.org/schemas/regulator/vctrl-regulator.yaml#
$schema: http://devicetree.org/meta-schemas/core.yaml#

title: Voltage controlled regulators

maintainers:
  - Heiko Stuebner <heiko@sntech.de>

allOf:
  - $ref: regulator.yaml#

properties:
  compatible:
    const: vctrl-regulator

  ctrl-supply:
    description: Regulator supplying the control voltage

  ctrl-voltage-range:
    description:
      Array of two integer values describing the range (min/max) of the
      control voltage. The values specify the control voltage needed to
      generate the corresponding regulator-min/max-microvolt output
      voltage.
    minItems: 2
    maxItems: 2
    $ref: /schemas/types.yaml#/definitions/uint32-array

  min-slew-down-rate:
    description:
      Describes how slowly the regulator voltage will decay down in the
      worst case (lightest expected load). Specified in uV / us (like
      main regulator ramp rate). This value is required when
      ovp-threshold-percent is specified.
    $ref: /schemas/types.yaml#/definitions/uint32

  ovp-threshold-percent:
    description:
      Overvoltage protection (OVP) threshold of the regulator in percent.
      Some regulators have an OVP circuitry which shuts down the regulator
      when the actual output voltage deviates beyond a certain margin from
      the expected value for a given control voltage. On larger voltage
      decreases this can occur undesiredly since the output voltage does
      not adjust immediately to changes in the control voltage. To avoid
      this situation the vctrl driver breaks down larger voltage decreases
      into multiple steps, where each step is within the OVP threshold.
    minimum: 0
    maximum: 100

unevaluatedProperties: false

dependencies:
  ovp-threshold-percent: [ min-slew-down-rate ]

required:
  - compatible
  - ctrl-supply
  - ctrl-voltage-range
  - regulator-min-microvolt
  - regulator-max-microvolt

examples:
  - |
    vctrl-reg {
            compatible = "vctrl-regulator";
            regulator-name = "vctrl_reg";

            ctrl-supply = <&ctrl_reg>;
            ctrl-voltage-range = <200000 500000>;

            min-slew-down-rate = <225>;
            ovp-threshold-percent = <16>;

            regulator-min-microvolt = <800000>;
            regulator-max-microvolt = <1500000>;
    };
...
```
