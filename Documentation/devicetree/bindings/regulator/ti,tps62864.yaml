## Documentation/devicetree/bindings/regulator/vctrl.txt
```
Bindings for Voltage controlled regulators
==========================================

Required properties:
--------------------
- compatible		  : must be "vctrl-regulator".
- regulator-min-microvolt : smallest voltage consumers may set
- regulator-max-microvolt : largest voltage consumers may set
- ctrl-supply		  : The regulator supplying the control voltage.
- ctrl-voltage-range	  : an array of two integer values describing the range
			    (min/max) of the control voltage. The values specify
			    the control voltage needed to generate the corresponding
			    regulator-min/max-microvolt output voltage.

Optional properties:
--------------------
- ovp-threshold-percent	: overvoltage protection (OVP) threshold of the
			  regulator in percent. Some regulators have an OVP
			  circuitry which shuts down the regulator when the
			  actual output voltage deviates beyond a certain
			  margin from the expected value for a given control
			  voltage. On larger voltage decreases this can occur
			  undesiredly since the output voltage does not adjust
			  inmediately to changes in the control voltage. To
			  avoid this situation the vctrl driver breaks down
			  larger voltage decreases into multiple steps, where
			  each step is within the OVP threshold.
- min-slew-down-rate	: Describes how slowly the regulator voltage will decay
			  down in the worst case (lightest expected load).
			  Specified in uV / us (like main regulator ramp rate).
			  This value is required when ovp-threshold-percent is
			  specified.

Example:

	vctrl-reg {
		compatible = "vctrl-regulator";
		regulator-name = "vctrl_reg";

		ctrl-supply = <&ctrl_reg>;

		regulator-min-microvolt = <800000>;
		regulator-max-microvolt = <1500000>;

		ctrl-voltage-range = <200000 500000>;

		min-slew-down-rate = <225>;
		ovp-threshold-percent = <16>;
	};
```

## Documentation/devicetree/bindings/regulator/vexpress.txt
```
Versatile Express voltage regulators
------------------------------------

Requires node properties:
- "compatible" value: "arm,vexpress-volt"
- "arm,vexpress-sysreg,func" when controlled via vexpress-sysreg
  (see Documentation/devicetree/bindings/arm/vexpress-sysreg.txt
  for more details)

Required regulator properties:
- "regulator-name"
- "regulator-always-on"

Optional regulator properties:
- "regulator-min-microvolt"
- "regulator-max-microvolt"

See Documentation/devicetree/bindings/regulator/regulator.txt
for more details about the regulator properties.

When no "regulator-[min|max]-microvolt" properties are defined,
the device is treated as fixed (or rather "read-only") regulator.

Example:
	volt@0 {
		compatible = "arm,vexpress-volt";
		arm,vexpress-sysreg,func = <2 0>;
		regulator-name = "Cores";
		regulator-min-microvolt = <800000>;
		regulator-max-microvolt = <1050000>;
		regulator-always-on;
	};
```

## Documentation/devicetree/bindings/regulator/vqmmc-ipq4019-regulator.yaml
```yaml
# SPDX-License-Identifier: GPL-2.0
%YAML 1.2
---
$id: http://devicetree.org/schemas/regulator/vqmmc-ipq4019-regulator.yaml#
$schema: http://devicetree.org/meta-schemas/core.yaml#

title: Qualcomm IPQ4019 VQMMC SD LDO regulator

maintainers:
  - Robert Marko <robert.marko@sartura.hr>

description: |
  Qualcomm IPQ4019 SoC-s feature a built a build SD/EMMC controller,
  in order to support both 1.8 and 3V I/O voltage levels an LDO
  controller is also embedded.

allOf:
  - $ref: "regulator.yaml#"

properties:
  compatible:
    const: qcom,vqmmc-ipq4019-regulator

  reg:
    maxItems: 1

required:
  - compatible
  - reg

unevaluatedProperties: false

examples:
  - |
    regulator@1948000 {
      compatible = "qcom,vqmmc-ipq4019-regulator";
      reg = <0x01948000 0x4>;
      regulator-name = "vqmmc";
      regulator-min-microvolt = <1500000>;
      regulator-max-microvolt = <3000000>;
      regulator-always-on;
    };
...
```

## Documentation/devicetree/bindings/regulator/wlf,arizona.yaml
```yaml
# SPDX-License-Identifier: GPL-2.0-only OR BSD-2-Clause
%YAML 1.2
---
$id: http://devicetree.org/schemas/regulator/wlf,arizona.yaml#
$schema: http://devicetree.org/meta-schemas/core.yaml#

title: Cirrus Logic/Wolfson Microelectronics Arizona/Madera class audio SoCs

maintainers:
  - patches@opensource.cirrus.com

description: |
  These devices are audio SoCs with extensive digital capabilities and a
  range of analogue I/O.

  This document lists regulator specific bindings, see the primary binding
  document. For Wolfson Microelectronic Arizona codecs ../mfd/wlf,arizona.yaml
  and for Cirrus Logic Madera codecs ../mfd/madera.txt

properties:
  wlf,ldoena:
    description:
      GPIO specifier for the GPIO controlling LDOENA.
    $ref: /schemas/types.yaml#/definitions/phandle-array
    maxItems: 1

  ldo1:
    description:
      Initial data for the LDO1 regulator.
    $ref: regulator.yaml#
    type: object

  micvdd:
    description:
      Initial data for the MICVDD regulator.
    $ref: regulator.yaml#
    type: object

additionalProperties: true
```

## Documentation/devicetree/bindings/remoteproc/amlogic,meson-mx-ao-arc.yaml
```yaml
# SPDX-License-Identifier: (GPL-2.0-only OR BSD-2-Clause)
%YAML 1.2
---
$id: "http://devicetree.org/schemas/remoteproc/amlogic,meson-mx-ao-arc.yaml#"
$schema: "http://devicetree.org/meta-schemas/core.yaml#"

title: Amlogic Meson AO ARC Remote Processor

description:
  Amlogic Meson6, Meson8, Meson8b and Meson8m2 SoCs embed an ARC core
  controller for always-on operations, typically used for managing
  system suspend. Meson6 and older use a ARC core based on the ARCv1
  ISA, while Meson8, Meson8b and Meson8m2 use an ARC EM4 (ARCv2 ISA)
  core.

maintainers:
  - Martin Blumenstingl <martin.blumenstingl@googlemail.com>

properties:
  compatible:
    items:
      - enum:
          - amlogic,meson8-ao-arc
          - amlogic,meson8b-ao-arc
      - const: amlogic,meson-mx-ao-arc

  firmware-name:
    $ref: /schemas/types.yaml#/definitions/string
    description:
      The name of the firmware which should be loaded for this remote
      processor.

  reg:
    description:
      Address ranges of the remap and CPU control addresses for the
      remote processor.
    minItems: 2

  reg-names:
    items:
      - const: remap
      - const: cpu

  resets:
    minItems: 1

  clocks:
    minItems: 1

  sram:
    $ref: /schemas/types.yaml#/definitions/phandle
    description:
      phandles to a reserved SRAM region which is used as the memory of
      the ARC core. The region should be defined as child nodes of the
      AHB SRAM node as per the generic bindings in
      Documentation/devicetree/bindings/sram/sram.yaml

  amlogic,secbus2:
    $ref: /schemas/types.yaml#/definitions/phandle
    description:
      A phandle to the SECBUS2 region which contains some configuration
      bits of this remote processor

required:
  - compatible
  - reg
  - reg-names
  - resets
  - clocks
  - sram
  - amlogic,secbus2

additionalProperties: false

examples:
  - |
    remoteproc@1c {
      compatible= "amlogic,meson8-ao-arc", "amlogic,meson-mx-ao-arc";
      reg = <0x1c 0x8>, <0x38 0x8>;
      reg-names = "remap", "cpu";
      resets = <&media_cpu_reset>;
      clocks = <&media_cpu_clock>;
      sram = <&ahb_sram_ao_arc>;
      amlogic,secbus2 = <&secbus2>;
    };

...
```

## Documentation/devicetree/bindings/remoteproc/fsl,imx-rproc.yaml
```yaml
# SPDX-License-Identifier: (GPL-2.0 OR BSD-2-Clause)
%YAML 1.2
---
$id: http://devicetree.org/schemas/remoteproc/fsl,imx-rproc.yaml#
$schema: http://devicetree.org/meta-schemas/core.yaml#

title: NXP i.MX Co-Processor

description:
  This binding provides support for ARM Cortex M4 Co-processor found on some NXP iMX SoCs.

maintainers:
  - Peng Fan <peng.fan@nxp.com>

properties:
  compatible:
    enum:
      - fsl,imx6sx-cm4
      - fsl,imx7d-cm4
      - fsl,imx7ulp-cm4
      - fsl,imx8mm-cm4
      - fsl,imx8mn-cm7
      - fsl,imx8mn-cm7-mmio
      - fsl,imx8mp-cm7
      - fsl,imx8mp-cm7-mmio
      - fsl,imx8mq-cm4
      - fsl,imx8qm-cm4
      - fsl,imx8qxp-cm4
      - fsl,imx8ulp-cm33
      - fsl,imx93-cm33

  clocks:
    maxItems: 1

  syscon:
    $ref: /schemas/types.yaml#/definitions/phandle
    description:
      Phandle to syscon block which provide access to System Reset Controller

  mbox-names:
    items:
      - const: tx
      - const: rx
      - const: rxdb

  mboxes:
    description:
      This property is required only if the rpmsg/virtio functionality is used.
      List of <&phandle type channel> - 1 channel for TX, 1 channel for RX, 1 channel for RXDB.
      (see mailbox/fsl,mu.yaml)
    minItems: 1
    maxItems: 3

  memory-region:
    description:
      If present, a phandle for a reserved memory area that used for vdev buffer,
      resource table, vring region and others used by remote processor.
    minItems: 1
    maxItems: 32

  power-domains:
    minItems: 2
    maxItems: 8

  fsl,auto-boot:
    $ref: /schemas/types.yaml#/definitions/flag
    description:
      Indicate whether need to load the default firmware and start the remote
      processor automatically.

  fsl,entry-address:
    $ref: /schemas/types.yaml#/definitions/uint32
    description:
      Specify CPU entry address for SCU enabled processor.

  fsl,iomuxc-gpr:
    $ref: /schemas/types.yaml#/definitions/phandle
    description:
      Phandle to IOMUXC GPR block which provide access to CM7 CPUWAIT bit.

  fsl,resource-id:
    $ref: /schemas/types.yaml#/definitions/uint32
    description:
      This property is to specify the resource id of the remote processor in SoC
      which supports SCFW

required:
  - compatible

allOf:
  - if:
      properties:
        compatible:
          not:
            contains:
              enum:
                - fsl,imx8mn-cm7-mmio
                - fsl,imx8mp-cm7-mmio
    then:
      properties:
        fsl,iomuxc-gpr: false

  - if:
      properties:
        compatible:
          contains:
            enum:
              - fsl,imx8qxp-cm4
              - fsl,imx8qm-cm4
    then:
      required:
        - power-domains
    else:
      properties:
        power-domains: false

additionalProperties: false

examples:
  - |
    #include <dt-bindings/clock/imx7d-clock.h>
    m4_reserved_sysmem1: cm4@80000000 {
      reg = <0x80000000 0x80000>;
    };

    m4_reserved_sysmem2: cm4@81000000 {
      reg = <0x81000000 0x80000>;
    };

    imx7d-cm4 {
      compatible = "fsl,imx7d-cm4";
      memory-region = <&m4_reserved_sysmem1>, <&m4_reserved_sysmem2>;
      syscon = <&src>;
      clocks = <&clks IMX7D_ARM_M4_ROOT_CLK>;
    };

  - |
    #include <dt-bindings/clock/imx8mm-clock.h>

    imx8mm-cm4 {
      compatible = "fsl,imx8mm-cm4";
      clocks = <&clk IMX8MM_CLK_M4_DIV>;
      mbox-names = "tx", "rx", "rxdb";
      mboxes = <&mu 0 1
                &mu 1 1
                &mu 3 1>;
      memory-region = <&vdev0buffer>, <&vdev0vring0>, <&vdev0vring1>, <&rsc_table>;
      syscon = <&src>;
    };
...
```

## Documentation/devicetree/bindings/remoteproc/imx-rproc.txt
```
NXP iMX6SX/iMX7D Co-Processor Bindings
----------------------------------------

This binding provides support for ARM Cortex M4 Co-processor found on some
NXP iMX SoCs.

Required properties:
- compatible		Should be one of:
				"fsl,imx7d-cm4"
				"fsl,imx6sx-cm4"
- clocks		Clock for co-processor (See: ../clock/clock-bindings.txt)
- syscon		Phandle to syscon block which provide access to
			System Reset Controller

Optional properties:
- memory-region		list of phandels to the reserved memory regions.
			(See: ../reserved-memory/reserved-memory.txt)

Example:
	m4_reserved_sysmem1: cm4@80000000 {
		reg = <0x80000000 0x80000>;
	};

	m4_reserved_sysmem2: cm4@81000000 {
		reg = <0x81000000 0x80000>;
	};

	imx7d-cm4 {
		compatible	= "fsl,imx7d-cm4";
		memory-region	= <&m4_reserved_sysmem1>, <&m4_reserved_sysmem2>;
		syscon		= <&src>;
		clocks		= <&clks IMX7D_ARM_M4_ROOT_CLK>;
	};
```
