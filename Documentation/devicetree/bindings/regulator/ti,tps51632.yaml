## Documentation/devicetree/bindings/soc/mobileye/mobileye,eyeq7h-olb.yaml
```yaml
# SPDX-License-Identifier: (GPL-2.0 OR BSD-2-Clause)
%YAML 1.2
---
$id: http://devicetree.org/schemas/soc/mobileye/mobileye,eyeq7h-olb.yaml#
$schema: http://devicetree.org/meta-schemas/core.yaml#

title: Mobileye EyeQ7H SoC system controller

maintainers:
  - Benoît Monin <benoit.monin@bootlin.com>
  - Grégory Clement <gregory.clement@bootlin.com>
  - Théo Lebrun <theo.lebrun@bootlin.com>
  - Vladimir Kondratiev <vladimir.kondratiev@mobileye.com>

description:
  OLB ("Other Logic Block") is a hardware system controller grouping
  smaller blocks. Clocks and resets are generated by those blocks and
  used by internal controllers of the SoC. The EyeQ7H SoC hosts 14
  different OLB.

properties:
  compatible:
    items:
      - enum:
          - mobileye,eyeq7h-acc0-olb
          - mobileye,eyeq7h-acc1-olb
          - mobileye,eyeq7h-ddr0-olb
          - mobileye,eyeq7h-ddr1-olb
          - mobileye,eyeq7h-east-olb
          - mobileye,eyeq7h-mips0-olb
          - mobileye,eyeq7h-mips1-olb
          - mobileye,eyeq7h-mips2-olb
          - mobileye,eyeq7h-periph-east-olb
          - mobileye,eyeq7h-periph-west-olb
          - mobileye,eyeq7h-south-olb
          - mobileye,eyeq7h-west-olb
          - mobileye,eyeq7h-xnn0-olb
          - mobileye,eyeq7h-xnn1-olb
      - const: syscon

  reg:
    maxItems: 1

  '#reset-cells':
    description:
      First cell is domain and optional if compatible has a single reset domain.
      Second cell is reset index inside that domain.
    enum: [ 1, 2 ]

  '#clock-cells':
    const: 1

  clocks:
    minItems: 1
    maxItems: 2

  clock-names:
    minItems: 1
    maxItems: 2

required:
  - compatible
  - reg
  - '#clock-cells'
  - clocks
  - clock-names

allOf:
  - if:
      properties:
        compatible:
          contains:
            enum:
              - mobileye,eyeq7h-ddr0-olb
              - mobileye,eyeq7h-ddr1-olb
              - mobileye,eyeq7h-mips0-olb
              - mobileye,eyeq7h-mips1-olb
              - mobileye,eyeq7h-mips2-olb
              - mobileye,eyeq7h-periph-east-olb
              - mobileye,eyeq7h-south-olb
    then:
      properties:
        clocks:
          items:
            - description: Reference input clock.
        clock-names:
          items:
            - const: ref

  - if:
      properties:
        compatible:
          contains:
            enum:
              - mobileye,eyeq7h-east-olb
              - mobileye,eyeq7h-west-olb
    then:
      properties:
        clocks:
          items:
            - description: Reference input clock from the main oscillator.
            - description: 100MHz reference input clock.
        clock-names:
          items:
            - const: ref
            - const: ref_100p0

  - if:
      properties:
        compatible:
          contains:
            enum:
              - mobileye,eyeq7h-acc0-olb
              - mobileye,eyeq7h-acc1-olb
              - mobileye,eyeq7h-periph-west-olb
              - mobileye,eyeq7h-xnn0-olb
              - mobileye,eyeq7h-xnn1-olb
    then:
      properties:
        clocks:
          items:
            - description: 100MHz reference input clock.
            - description: 106.6MHz reference input clock.
        clock-names:
          items:
            - const: ref_100p0
            - const: ref_106p6

  - if:
      properties:
        compatible:
          contains:
            enum:
              - mobileye,eyeq7h-ddr0-olb
              - mobileye,eyeq7h-ddr1-olb
              - mobileye,eyeq7h-east-olb
              - mobileye,eyeq7h-periph-east-olb
              - mobileye,eyeq7h-periph-west-olb
              - mobileye,eyeq7h-west-olb
    then:
      properties:
        '#reset-cells':
          const: 1
      required:
        - '#reset-cells'

  - if:
      properties:
        compatible:
          contains:
            enum:
              - mobileye,eyeq7h-acc0-olb
              - mobileye,eyeq7h-acc1-olb
              - mobileye,eyeq7h-south-olb
              - mobileye,eyeq7h-xnn0-olb
              - mobileye,eyeq7h-xnn1-olb
    then:
      properties:
        '#reset-cells':
          const: 2
      required:
        - '#reset-cells'

  - if:
      properties:
        compatible:
          contains:
            enum:
              - mobileye,eyeq7h-mips0-olb
              - mobileye,eyeq7h-mips1-olb
              - mobileye,eyeq7h-mips2-olb
    then:
      properties:
        '#reset-cells': false

additionalProperties: false

examples:
  - |
    soc {
      #address-cells = <2>;
      #size-cells = <2>;

      system-controller0@45000000 {
        compatible = "mobileye,eyeq7h-acc0-olb", "syscon";
        reg = <0x0 0x45000000 0x0 0x1000>;
        #reset-cells = <2>;
        #clock-cells = <1>;
        clocks = <&olb_south 7>, <&olb_east 5>;
        clock-names = "ref_100p0", "ref_106p6";
      };
    };
```

## Documentation/devicetree/bindings/soc/starfive/starfive,jhb100-syscon.yaml
```yaml
# SPDX-License-Identifier: (GPL-2.0 OR BSD-2-Clause)
%YAML 1.2
---
$id: http://devicetree.org/schemas/soc/starfive/starfive,jhb100-syscon.yaml#
$schema: http://devicetree.org/meta-schemas/core.yaml#

title: StarFive JHB100 SoC system controller

maintainers:
  - Kevin Xie <kevin.xie@starfivetech.com>
  - Changhuang Liang <changhuang.liang@starfivetech.com>

description:
  The StarFive JHB100 SoC system controller contains MMIO registers used by
  other hardware modules (e.g., PLL, eMMC, PCIe). These modules access
  specific register offsets, bit masks, and shifts within the system
  controller region for configuration and status.

properties:
  compatible:
    items:
      - enum:
          - starfive,jhb100-b2h-syscon
          - starfive,jhb100-gpu-syscon
          - starfive,jhb100-h2b-syscon
          - starfive,jhb100-host-syscon
          - starfive,jhb100-husb-syscon
          - starfive,jhb100-husbcmn-syscon
          - starfive,jhb100-husbd-syscon
          - starfive,jhb100-npu-syscon
          - starfive,jhb100-pcieep-ecsr-syscon
          - starfive,jhb100-pcierp-ecsr-syscon
          - starfive,jhb100-pcierp-syscon
          - starfive,jhb100-per0-syscon
          - starfive,jhb100-per1-syscon
          - starfive,jhb100-per2-syscon
          - starfive,jhb100-per3-syscon
          - starfive,jhb100-sfc-filter-syscon
          - starfive,jhb100-strap-syscon
          - starfive,jhb100-sys0-syscon
          - starfive,jhb100-sys1-syscon
          - starfive,jhb100-sys2-syscon
          - starfive,jhb100-usb-syscon
          - starfive,jhb100-vout-syscon
      - const: syscon

  reg:
    maxItems: 1

  clocks:
    maxItems: 1

  '#clock-cells':
    const: 1

  '#reset-cells':
    const: 1

required:
  - compatible
  - reg

allOf:
  - if:
      properties:
        compatible:
          contains:
            enum:
              - starfive,jhb100-per0-syscon
              - starfive,jhb100-per1-syscon
              - starfive,jhb100-sys0-syscon
    then:
      required:
        - clocks
        - '#clock-cells'
    else:
      properties:
        clocks: false
        '#clock-cells': false

  - if:
      properties:
        compatible:
          contains:
            const: starfive,jhb100-pcierp-syscon
    then:
      required:
        - '#reset-cells'
    else:
      properties:
        '#reset-cells': false

additionalProperties: false

examples:
  - |
    syscon@13010000 {
        compatible = "starfive,jhb100-sys0-syscon", "syscon";
        reg = <0x13010000 0x2000>;
        clocks = <&osc>;
        #clock-cells = <1>;
    };

    syscon@13014000 {
        compatible = "starfive,jhb100-sys1-syscon", "syscon";
        reg = <0x13014000 0x4000>;
    };

    syscon@11719000 {
        compatible = "starfive,jhb100-pcierp-syscon", "syscon";
        reg = <0x11719000 0x1000>;
        #reset-cells = <1>;
    };

...
```

## Documentation/devicetree/bindings/sound/airoha,an7581-afe.yaml
```yaml
# SPDX-License-Identifier: (GPL-2.0-only OR BSD-2-Clause)
%YAML 1.2
---
$id: http://devicetree.org/schemas/sound/airoha,an7581-afe.yaml#
$schema: http://devicetree.org/meta-schemas/core.yaml#

title: Airoha AFE PCM controller for AN7581

maintainers:
  - Christian Marangi <ansuelsmth@gmail.com>

properties:
  compatible:
    const: airoha,an7581-afe

  reg:
    maxItems: 1

  interrupts:
    maxItems: 1

required:
  - compatible
  - reg
  - interrupts

additionalProperties: false

examples:
  - |
    #include <dt-bindings/interrupt-controller/arm-gic.h>
    #include <dt-bindings/interrupt-controller/irq.h>

    afe@1fbe2200 {
        compatible = "airoha,an7581-afe";
        reg = <0x1fbe2200 0x9000>;

        interrupts = <GIC_SPI 48 IRQ_TYPE_LEVEL_HIGH>;
    };

...
```

## Documentation/devicetree/bindings/sound/airoha,an7581-wm8960.yaml
```yaml
# SPDX-License-Identifier: (GPL-2.0-only OR BSD-2-Clause)
%YAML 1.2
---
$id: http://devicetree.org/schemas/sound/airoha,an7581-wm8960.yaml#
$schema: http://devicetree.org/meta-schemas/core.yaml#

title: Airoha AN7581 sound card with WM8960 codec

maintainers:
  - Christian Marangi <ansuelsmth@gmail.com>

allOf:
  - $ref: sound-card-common.yaml#

properties:
  compatible:
    const: airoha,an7581-wm8960-sound

  platform:
    type: object

    additionalProperties: false

    properties:
      sound-dai:
        items:
          - description: The phandle of AN7581 platform.

    required:
      - sound-dai

  codec:
    type: object

    additionalProperties: false

    properties:
      sound-dai:
        items:
          - description: The phandle of WM8960 i2c codec.

    required:
      - sound-dai

required:
  - compatible
  - audio-routing
  - platform
  - codec

unevaluatedProperties: false

examples:
  - |
    sound {
        compatible = "airoha,an7581-wm8960-sound";
        model = "an7581-wm8960";
        audio-routing =
            "Headphone", "HP_L",
            "Headphone", "HP_R",
            "LINPUT1", "AMIC",
            "RINPUT1", "AMIC";

        platform {
            sound-dai = <&afe>;
        };

        codec {
            sound-dai = <&wm8960>;
        };
    };
```
