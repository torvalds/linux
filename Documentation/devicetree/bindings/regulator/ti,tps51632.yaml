## Documentation/devicetree/bindings/rtc/sii,s35390a.yaml
```yaml
# SPDX-License-Identifier: (GPL-2.0-only OR BSD-2-Clause)
%YAML 1.2
---
$id: http://devicetree.org/schemas/rtc/sii,s35390a.yaml#
$schema: http://devicetree.org/meta-schemas/core.yaml#

title: S-35390A 2-wire real-time clock

maintainers:
  - Markus Probst <markus.probst@posteo.de>

description:
  The S-35390A is a CMOS 2-wire real-time clock IC which operates with the
  very low current consumption in the wide range of operation voltage.

allOf:
  - $ref: rtc.yaml#

properties:
  compatible:
    const: sii,s35390a

  reg:
    maxItems: 1

  interrupts:
    minItems: 1
    maxItems: 2
    description: Supports up to 2 interrupt lines via the INT1 and INT2 pins.

  interrupt-names:
    minItems: 1
    maxItems: 2
    items:
      enum:
        - int1
        - int2

  wakeup-parent: true

  wakeup-source: true

  "#clock-cells":
    const: 1

patternProperties:
  "^pins":
    type: object
    additionalProperties: false

    patternProperties:
      "-pins$":
        $ref: /schemas/pinctrl/pinmux-node.yaml#
        additionalProperties: false

        properties:
          pins:
            minItems: 1
            items:
              enum:
                - int1
                - int2

          function:
            description: |
              Pin function:
              - ignore:  Preserve the previous state.
              - disable: Disable pin output.
              - wakeup:  Output wakes up the system.
              - clock:   Output clock pulse.
              - pmin1:   Minute periodical output with 50% duty.
              - pmin2:   Minute periodical output L for 7.81 ms.
                         Can only be used with pin int1.
            enum:
              - ignore
              - disable
              - wakeup
              - clock
              - pmin1
              - pmin2

        required:
          - pins
          - function

required:
  - compatible
  - reg

unevaluatedProperties: false

examples:
  - |
    i2c {
        #address-cells = <1>;
        #size-cells = <0>;

        rtc@30 {
            compatible = "sii,s35390a";
            reg = <0x30>;
            pinctrl-0 = <&rtc_pins_default>;
            pinctrl-names = "default";

            interrupt-names = "int1";
            interrupts = <23>;

            rtc_pins_default: pins {
              int1-pins {
                pins = "int1";
                function = "wakeup";
              };
              int2-pins {
                pins = "int2";
                function = "disable";
              };
            };
        };
    };
```

## Documentation/devicetree/bindings/rtc/ti,omap-rtc.yaml
```yaml
# SPDX-License-Identifier: (GPL-2.0-only OR BSD-2-Clause)
%YAML 1.2
---
$id: http://devicetree.org/schemas/rtc/ti,omap-rtc.yaml#
$schema: http://devicetree.org/meta-schemas/core.yaml#

title: Texas Instruments OMAP Real Time Clock

maintainers:
  - Keerthy <j-keerthy@ti.com>
  - Afzal Mohammed <afzal@ti.com>

description:
  The OMAP RTC is a year/month/day/hours/minutes/seconds BCD clock with
  century-range alarm matching, driven by the 32kHz clock.

properties:
  compatible:
    oneOf:
      - const: ti,da830-rtc
      - items:
          - const: ti,am3352-rtc
          - const: ti,da830-rtc
      - items:
          - const: ti,am4372-rtc
          - const: ti,am3352-rtc
          - const: ti,da830-rtc

  reg:
    maxItems: 1

  interrupts:
    minItems: 2
    maxItems: 2

  system-power-controller:
    type: boolean
    description:
      Indicates that this RTC controls system power via the pmic_power_en pin.

  clocks:
    minItems: 1
    maxItems: 2

  clock-names:
    minItems: 1
    items:
      - enum: [ext-clk, int-clk]
      - const: int-clk

  pinctrl-0:
    description:
      Phandle to pin configuration for the external wakeup pins.

  pinctrl-names:
    minItems: 1

  ti,hwmods:
    $ref: /schemas/types.yaml#/definitions/string
    description:
      Name of the hwmod associated with the RTC.
    const: rtc
    deprecated: true

patternProperties:
  "^ext-wakeup(-[0-9]+)?$":
    type: object

    description:
      Child node describing external wakeup pin configuration.

    properties:
      pins:
        pattern: '^ext_wakeup[0-3]$'

      input-enable:
        type: boolean
        description:
          Enables the external wakeup input on the selected pin.

      ti,active-high:
        type: boolean
        description:
          Sets the wakeup input polarity to active high. By default the
          input is active low.

    required:
      - pins

    additionalProperties: false

required:
  - compatible
  - reg
  - interrupts

allOf:
  - $ref: rtc.yaml#
  - if:
      not:
        properties:
          compatible:
            contains:
              const: ti,am3352-rtc
    then:
      properties:
        system-power-controller: false
      patternProperties:
        "^ext-wakeup(-[0-9]+)?$": false

unevaluatedProperties: false

examples:
  - |
    rtc@23000 {
        compatible = "ti,da830-rtc";
        reg = <0x23000 0x1000>;
        interrupts = <19>, <19>;
        clocks = <&clk_32768_ck>;
        clock-names = "int-clk";
    };

  - |
    rtc@0 {
        compatible = "ti,am3352-rtc", "ti,da830-rtc";
        reg = <0x0 0x1000>;
        interrupts = <75>, <76>;
        system-power-controller;
        clocks = <&clk_32k_rtc>, <&clk_32768_ck>;
        clock-names = "ext-clk", "int-clk";

        pinctrl-0 = <&ext_wakeup>;
        pinctrl-names = "default";

        ext-wakeup {
            pins = "ext_wakeup0";
            input-enable;
            ti,active-high;
        };
    };
```

## Documentation/devicetree/bindings/rtc/ti,palmas-rtc.yaml
```yaml
# SPDX-License-Identifier: (GPL-2.0-only OR BSD-2-Clause)
%YAML 1.2
---
$id: http://devicetree.org/schemas/rtc/ti,palmas-rtc.yaml#
$schema: http://devicetree.org/meta-schemas/core.yaml#

title: Texas Instruments Palmas RTC

maintainers:
  - Eduard Bostina <egbostina@gmail.com>

allOf:
  - $ref: /schemas/rtc/rtc.yaml#

properties:
  compatible:
    const: ti,palmas-rtc

  interrupts:
    maxItems: 1

  wakeup-source: true

  ti,backup-battery-chargeable:
    type: boolean
    description:
      The backup battery can be chargeable or non-chargeable. This flag
      indicates whether the battery is chargeable. If present, the driver
      can enable charging.

  ti,backup-battery-charge-high-current:
    type: boolean
    description:
      Enable high current charging in the backup battery.
      Device supports the < 100uA and > 100uA charging. The high current will
      be > 100uA. Absence of this property will charge battery to lower
      current i.e. < 100uA.

required:
  - compatible
  - interrupts

unevaluatedProperties: false

examples:
  - |
    pmic {
        #address-cells = <1>;
        #size-cells = <0>;

        rtc {
            compatible = "ti,palmas-rtc";
            interrupts = <8 0>;
            ti,backup-battery-chargeable;
            ti,backup-battery-charge-high-current;
        };
    };
```

## Documentation/devicetree/bindings/soc/cix/cix,sky1-audss-cru.yaml
```yaml
# SPDX-License-Identifier: (GPL-2.0-only OR BSD-2-Clause)
%YAML 1.2
---
$id: http://devicetree.org/schemas/soc/cix/cix,sky1-audss-cru.yaml#
$schema: http://devicetree.org/meta-schemas/core.yaml#

title: Cix Sky1 audio subsystem clock and reset unit

maintainers:
  - Joakim Zhang <joakim.zhang@cixtech.com>

description: |
  The Cix Sky1 Audio Subsystem (AUDSS) Clock and Reset Unit (CRU) groups
  audio-related clock muxing, gating and block-level software reset control
  in a single register block.

  A single device node exposes both the clock controller and software reset
  lines. The clock driver registers as a platform driver; the reset controller
  is registered by an auxiliary driver bound from the clock driver.

  Four SoC-level reference clocks listed in clocks/clock-names feed the AUDSS
  clock tree. Internal AUDSS clocks are exposed via #clock-cells; indices are
  defined in include/dt-bindings/clock/cix,sky1-audss-cru.h.

  Block-level software reset indices are exposed via #reset-cells; indices
  are defined in include/dt-bindings/reset/cix,sky1-audss-cru.h.

  The SoC syscon NoC (or bus) reset is described via resets. The audio
  subsystem power domain is described via power-domains.

properties:
  compatible:
    const: cix,sky1-audss-cru

  reg:
    maxItems: 1

  '#clock-cells':
    const: 1
    description:
      Clock indices are defined in include/dt-bindings/clock/cix,sky1-audss-cru.h.

  '#reset-cells':
    const: 1
    description:
      Reset indices are defined in include/dt-bindings/reset/cix,sky1-audss-cru.h.

  clocks:
    items:
      - description: I2S parent clock for sampling rates multiple of 8kHz.
      - description: I2S parent clock for sampling rates multiple of 11.025kHz.
      - description: Clock feeding most devices in AUDSS (NOC, DSP, SRAM, HDA, DMAC, I2S, and mailbox).
      - description: Clock feeding HDA, timer and watchdog, which is a dedicated 48 MHz clock.

  clock-names:
    items:
      - const: x8k
      - const: x11k
      - const: sys
      - const: 48m

  power-domains:
    maxItems: 1

  resets:
    maxItems: 1

required:
  - compatible
  - reg
  - '#clock-cells'
  - '#reset-cells'
  - clocks
  - clock-names
  - power-domains
  - resets

additionalProperties: false

examples:
  - |
    audss_cru: clock-controller@7110000 {
        compatible = "cix,sky1-audss-cru";
        reg = <0x7110000 0x10000>;
        #clock-cells = <1>;
        #reset-cells = <1>;
        clocks = <&scmi_clk 76>, <&scmi_clk 78>,
                 <&scmi_clk 70>, <&scmi_clk 71>;
        clock-names = "x8k", "x11k", "sys", "48m";
        power-domains = <&smc_devpd 0>;
        resets = <&s5_syscon 31>;
    };
```

## Documentation/devicetree/bindings/soc/hisilicon/hisilicon,hip05-cpld.yaml
```yaml
# SPDX-License-Identifier: GPL-2.0-only OR BSD-2-Clause
%YAML 1.2
---
$id: http://devicetree.org/schemas/soc/hisilicon/hisilicon,hip05-cpld.yaml#
$schema: http://devicetree.org/meta-schemas/core.yaml#

title: HiSilicon HIP05 CPLD registers

maintainers:
  - Wei Xu <xuwei5@hisilicon.com>

properties:
  compatible:
    const: hisilicon,hip05-cpld

  reg:
    maxItems: 1

required:
  - compatible
  - reg

additionalProperties: false

examples:
  - |
    local-bus {
        #address-cells = <2>;
        #size-cells = <1>;

        cpld@100000000 {
            compatible = "hisilicon,hip05-cpld";
            reg = <0x1 0x0 0x100>;
        };
    };
```

## Documentation/devicetree/bindings/soc/imx/fsl,imx-iomuxc-gpr.yaml
```yaml
# SPDX-License-Identifier: (GPL-2.0 OR BSD-2-Clause)
%YAML 1.2
---
$id: http://devicetree.org/schemas/soc/imx/fsl,imx-iomuxc-gpr.yaml#
$schema: http://devicetree.org/meta-schemas/core.yaml#

title: Freescale IOMUX Controller General Purpose Registers

maintainers:
  - Peng Fan <peng.fan@nxp.com>

description:
  i.MX Processors have an IOMUXC General Purpose Register group for
  various System Settings

properties:
  compatible:
    oneOf:
      - items:
          - enum:
              - fsl,imx6q-iomuxc-gpr
              - fsl,imx8mq-iomuxc-gpr
          - const: syscon
          - const: simple-mfd
      - items:
          - enum:
              - fsl,imx6sl-iomuxc-gpr
              - fsl,imx6sll-iomuxc-gpr
              - fsl,imx6ul-iomuxc-gpr
          - const: fsl,imx6q-iomuxc-gpr
          - const: syscon
      - items:
          - enum:
              - fsl,imx6sx-iomuxc-gpr
              - fsl,imx7d-iomuxc-gpr
          - const: fsl,imx6q-iomuxc-gpr
          - const: syscon
          - const: simple-mfd
      - items:
          - enum:
              - fsl,imx53-iomuxc-gpr
              - fsl,imx8mm-iomuxc-gpr
              - fsl,imx8mn-iomuxc-gpr
              - fsl,imx8mp-iomuxc-gpr
          - const: syscon

  reg:
    maxItems: 1

  '#address-cells':
    const: 1

  '#size-cells':
    const: 1

  ranges: true

  mux-controller:
    type: object
    $ref: /schemas/mux/reg-mux.yaml

  bridge@18:
    type: object
    $ref: /schemas/display/bridge/fsl,ldb.yaml#
    unevaluatedProperties: false

patternProperties:
  "^ipu[12]_csi[01]_mux$":
    type: object
    $ref: /schemas/media/video-mux.yaml

allOf:
  - if:
      properties:
        compatible:
          not:
            contains:
              const: fsl,imx6q-iomuxc-gpr
    then:
      patternProperties:
        '^ipu[12]_csi[01]_mux$': false

  - if:
      properties:
        compatible:
          not:
            contains:
              const: fsl,imx6sx-iomuxc-gpr
    then:
      properties:
        bridge@18: false
        '#address-cells': false
        '#size-cells': false
        ranges: false

additionalProperties: false

required:
  - compatible
  - reg

examples:
  # Pinmux controller node
  - |
    iomuxc_gpr: syscon@30340000 {
        compatible = "fsl,imx8mq-iomuxc-gpr", "syscon", "simple-mfd";
        reg = <0x30340000 0x10000>;

        mux: mux-controller {
            compatible = "mmio-mux";
            #mux-control-cells = <1>;
            mux-reg-masks = <0x34 0x00000004>; /* MIPI_MUX_SEL */
        };
    };

  - |
    #include <dt-bindings/clock/imx6sx-clock.h>

    syscon@20e4000 {
        compatible = "fsl,imx6sx-iomuxc-gpr", "fsl,imx6q-iomuxc-gpr", "syscon", "simple-mfd";
        reg = <0x020e4000 0x4000>;
        #address-cells = <1>;
        #size-cells = <1>;
        ranges;

        bridge@18 {
            compatible = "fsl,imx6sx-ldb";
            reg = <0x18 0x4>;
            clocks = <&clks IMX6SX_CLK_LDB_DI0>;
            clock-names = "ldb";

            ports {
                #address-cells = <1>;
                #size-cells = <0>;

                port@0 {
                    reg = <0>;

                    endpoint {
                    };
                };

                port@1 {
                    reg = <1>;

                    endpoint {
                    };
                };
            };
        };
    };
...
```

## Documentation/devicetree/bindings/soc/mediatek/mediatek,mt2701-g3dsys.yaml
```yaml
# SPDX-License-Identifier: (GPL-2.0-only OR BSD-2-Clause)
%YAML 1.2
---
$id: http://devicetree.org/schemas/soc/mediatek/mediatek,mt2701-g3dsys.yaml#
$schema: http://devicetree.org/meta-schemas/core.yaml#

title: MediaTek G3D System Controller

maintainers:
  - Sean Wang <sean.wang@mediatek.com>
  - Ryder Lee <ryder.lee@mediatek.com>

description: |
  The MediaTek G3D system controller provides clocks and reset control
  for the GPU subsystem on MediaTek SoCs.

properties:
  compatible:
    oneOf:
      - items:
          - const: mediatek,mt2701-g3dsys
          - const: syscon
      - items:
          - const: mediatek,mt7623-g3dsys
          - const: mediatek,mt2701-g3dsys
          - const: syscon

  reg:
    maxItems: 1

  "#clock-cells":
    const: 1

  "#reset-cells":
    const: 1

required:
  - compatible
  - reg
  - "#clock-cells"
  - "#reset-cells"

additionalProperties: false

examples:
  - |
     soc {
       #address-cells = <2>;
       #size-cells = <2>;
       g3dsys: syscon@13000000 {
         compatible = "mediatek,mt7623-g3dsys",
                      "mediatek,mt2701-g3dsys",
                      "syscon";
         reg = <0 0x13000000 0 0x200>;
         #clock-cells = <1>;
         #reset-cells = <1>;
       };
     };
```
