## Documentation/devicetree/bindings/regulator/ti,tps51632.yaml
```yaml
# SPDX-License-Identifier: (GPL-2.0-only OR BSD-2-Clause)
%YAML 1.2
---
$id: http://devicetree.org/schemas/regulator/ti,tps51632.yaml#
$schema: http://devicetree.org/meta-schemas/core.yaml#

title: Texas Instruments TPS51632 Voltage regulators

maintainers:
  - Laxman Dewangan <ldewangan@nvidia.com>

allOf:
  - $ref: regulator.yaml#

properties:
  compatible:
    const: ti,tps51632

  reg:
    maxItems: 1

  ti,enable-pwm-dvfs:
    description: Enable the DVFS voltage control through the PWM interface.
    type: boolean

  ti,dvfs-step-20mV:
    description:
      The 20mV step voltage when PWM DVFS enabled. Missing this will set 10mV
      step voltage in PWM DVFS mode. In normal mode, the voltage step is 10mV
      as per datasheet.
    type: boolean

required:
  - compatible
  - reg

unevaluatedProperties: false

examples:
  - |
    i2c {
        #address-cells = <1>;
        #size-cells = <0>;

        tps51632@43 {
            compatible = "ti,tps51632";
            reg =  <0x43>;
            regulator-name = "tps51632-vout";
            regulator-min-microvolt = <500000>;
            regulator-max-microvolt = <1500000>;
            regulator-boot-on;
            ti,enable-pwm-dvfs;
            ti,dvfs-step-20mV;
        };
    };
```

## Documentation/devicetree/bindings/regulator/ti,tps65023.yaml
```yaml
# SPDX-License-Identifier: (GPL-2.0-only OR BSD-2-Clause)
%YAML 1.2
---
$id: http://devicetree.org/schemas/regulator/ti,tps65023.yaml#
$schema: http://devicetree.org/meta-schemas/core.yaml#

title: Texas Instruments TPS65023 Regulator

maintainers:
  - Eduard Bostina <egbostina@gmail.com>

properties:
  compatible:
    enum:
      - ti,tps65020
      - ti,tps65021
      - ti,tps65023

  reg:
    maxItems: 1

  regulators:
    type: object
    description: >
      List of child nodes that specify the regulator initialization data.
      Must be named after their hardware counterparts: VDCDC[1-3] and LDO[1-2].

    patternProperties:
      "^(VDCDC[1-3]|LDO[1-2])$":
        type: object
        $ref: regulator.yaml#
        unevaluatedProperties: false

    additionalProperties: false

required:
  - compatible
  - reg
  - regulators

additionalProperties: false

examples:
  - |
    i2c {
        #address-cells = <1>;
        #size-cells = <0>;

        tps65023@48 {
            compatible = "ti,tps65023";
            reg = <0x48>;

            regulators {
                VDCDC1 {
                    regulator-name = "vdd_mpu";
                    regulator-always-on;
                    regulator-min-microvolt = <1200000>;
                    regulator-max-microvolt = <1200000>;
                };

                VDCDC2 {
                    regulator-name = "vdd_core";
                    regulator-always-on;
                    regulator-min-microvolt = <3300000>;
                    regulator-max-microvolt = <3300000>;
                };

                VDCDC3 {
                    regulator-name = "vdd_io";
                    regulator-always-on;
                    regulator-min-microvolt = <1800000>;
                    regulator-max-microvolt = <1800000>;
                };

                LDO1 {
                    regulator-name = "vdd_usb18";
                    regulator-always-on;
                    regulator-min-microvolt = <1800000>;
                    regulator-max-microvolt = <1800000>;
                };

                LDO2 {
                    regulator-name = "vdd_usb33";
                    regulator-always-on;
                    regulator-min-microvolt = <3300000>;
                    regulator-max-microvolt = <3300000>;
                };
            };
        };
    };
```

## Documentation/devicetree/bindings/regulator/ti,tps6586x.yaml
```yaml
# SPDX-License-Identifier: GPL-2.0-only OR BSD-2-Clause
%YAML 1.2
---
$id: http://devicetree.org/schemas/regulator/ti,tps6586x.yaml#
$schema: http://devicetree.org/meta-schemas/core.yaml#

title: TI TPS6586x family of regulators

maintainers:
  - Thierry Reding <thierry.reding@avionic-design.de>

properties:
  compatible:
    const: ti,tps6586x

  reg:
    maxItems: 1

  interrupts:
    maxItems: 1

  "#gpio-cells":
    const: 2

  gpio-controller: true

  sys-supply:
    description: The input supply for SYS.

  ti,system-power-controller:
    type: boolean
    description:
      Whether or not this PMIC is controlling the system power.

  regulators:
    type: object
    additionalProperties: false
    description:
      list of regulators provided by this controller, LDO5 and LDO_RTC is
      supplied by SYS regulator internally and driver take care of making
      proper parent child relationship.

    properties:
      sys:
        type: object
        $ref: regulator.yaml#
        unevaluatedProperties: false

    patternProperties:
      "^ldo([0-9]|_rtc)$":
        type: object
        allOf:
          - $ref: /schemas/regulator/regulator.yaml#
          - $ref: /schemas/regulator/nvidia,tegra-regulators-coupling.yaml#
        unevaluatedProperties: false

      "^sm[0-2]$":
        type: object
        allOf:
          - $ref: /schemas/regulator/regulator.yaml#
          - $ref: /schemas/regulator/nvidia,tegra-regulators-coupling.yaml#
        unevaluatedProperties: false

patternProperties:
  "^vin-sm[0-2]-supply$":
    description: The input supply for the corresponding SM (SM0, SM1, or SM2).

  "^vinldo(01|23|4|678|9)-supply$":
    description: The input supply for the corresponding LDO or group of LDOs.

required:
  - compatible
  - reg
  - interrupts
  - regulators
  - "#gpio-cells"
  - gpio-controller
  - sys-supply
  - vin-sm0-supply
  - vin-sm1-supply
  - vin-sm2-supply
  - vinldo01-supply
  - vinldo23-supply
  - vinldo4-supply
  - vinldo678-supply
  - vinldo9-supply

additionalProperties: false

examples:
  - |
    i2c {
      #address-cells = <1>;
      #size-cells = <0>;

      pmic@34 {
          compatible = "ti,tps6586x";
          reg = <0x34>;
          interrupts = <0 88 0x4>;

          #gpio-cells = <2>;
          gpio-controller;

          ti,system-power-controller;

          sys-supply = <&vdd_5v0_sys>;
          vin-sm0-supply = <&sys_reg>;
          vin-sm1-supply = <&sys_reg>;
          vin-sm2-supply = <&sys_reg>;
          vinldo01-supply = <&sm2_reg>;
          vinldo23-supply = <&sm2_reg>;
          vinldo4-supply = <&sm2_reg>;
          vinldo678-supply = <&sm2_reg>;
          vinldo9-supply = <&sm2_reg>;

          regulators {
              sys {
                  regulator-name = "vdd_sys";
                  regulator-boot-on;
                  regulator-always-on;
              };

              sm0 {
                  regulator-min-microvolt = < 725000>;
                  regulator-max-microvolt = <1500000>;
                  regulator-boot-on;
                  regulator-always-on;
              };

              sm1 {
                  regulator-min-microvolt = < 725000>;
                  regulator-max-microvolt = <1500000>;
                  regulator-boot-on;
                  regulator-always-on;
              };

              sm2 {
                  regulator-min-microvolt = <3000000>;
                  regulator-max-microvolt = <4550000>;
                  regulator-boot-on;
                  regulator-always-on;
              };

              ldo0 {
                  regulator-name = "PCIE CLK";
                  regulator-min-microvolt = <3300000>;
                  regulator-max-microvolt = <3300000>;
              };

              ldo1 {
                  regulator-min-microvolt = < 725000>;
                  regulator-max-microvolt = <1500000>;
              };

              ldo2 {
                  regulator-min-microvolt = < 725000>;
                  regulator-max-microvolt = <1500000>;
              };

              ldo3 {
                  regulator-min-microvolt = <1250000>;
                  regulator-max-microvolt = <3300000>;
              };

              ldo4 {
                  regulator-min-microvolt = <1700000>;
                  regulator-max-microvolt = <2475000>;
              };

              ldo5 {
                  regulator-min-microvolt = <1250000>;
                  regulator-max-microvolt = <3300000>;
              };

              ldo6 {
                  regulator-min-microvolt = <1250000>;
                  regulator-max-microvolt = <3300000>;
              };

              ldo7 {
                  regulator-min-microvolt = <1250000>;
                  regulator-max-microvolt = <3300000>;
              };

              ldo8 {
                  regulator-min-microvolt = <1250000>;
                  regulator-max-microvolt = <3300000>;
              };

              ldo9 {
                  regulator-min-microvolt = <1250000>;
                  regulator-max-microvolt = <3300000>;
              };
          };
      };
    };
```

## Documentation/devicetree/bindings/remoteproc/amd,bram-rproc.yaml
```yaml
# SPDX-License-Identifier: (GPL-2.0-only OR BSD-2-Clause)
%YAML 1.2
---
$id: http://devicetree.org/schemas/remoteproc/amd,bram-rproc.yaml#
$schema: http://devicetree.org/meta-schemas/core.yaml#

title: AMD MicroBlaze/V BRAM-based Remote Processor

maintainers:
  - Ben Levinsky <ben.levinsky@amd.com>

description: |
  Soft-core processor subsystem instantiated in AMD programmable logic and
  using dual-port BRAM for firmware storage and execution.

  Hardware Architecture:

    Host (PS)                        Programmable Logic (PL)
    =========                        ======================

    AXI Interface -----------------> AXI BRAM Controller (Host Port)
                                             |
                                             | Port A
                                             v
                                     +-----------------+
                                     |  Dual-Port BRAM |
                                     | (shared memory) |
                                     +-----------------+
                                             ^
                                             | Port B
                                             |
                                     AXI BRAM Controller (Soft-core Port)
                                             ^
                                             | LMB
                                             |
                                     Soft-core CPU (MicroBlaze/V)

    GPIO --------------------------> Proc Sys Reset ----> CPU Reset Signal

    Clock -------------------------> Clock Distribution -> CPU Clock

  Memory Architecture:

    The dual-port BRAM allows simultaneous access from both processors:
      - Port A: Connected to the host AXI BRAM controller for firmware loading
      - Port B: Connected to the soft-core local memory bus for execution

  The reg property describes the executable BRAM window in the processor-local
  address space. The parent bus node translates that window to the system
  physical address space by using standard devicetree address translation
  through ranges. A clock input and a reset GPIO control the subsystem.

properties:
  compatible:
    oneOf:
      - const: xlnx,zynqmp-bram-rproc
      - items:
          - enum:
              - amd,versal2-bram-rproc
              - xlnx,versal-bram-rproc
              - xlnx,versal-net-bram-rproc
          - const: xlnx,zynqmp-bram-rproc

  reg:
    maxItems: 1
    description:
      Processor-local address and size of the BRAM firmware memory window,
      as seen by the soft-core processor (typically 0x0 for reset vector).
      The parent bus ranges property must translate this window to the
      corresponding system physical address.

  clocks:
    maxItems: 1
    description:
      Clock input for the soft-core processor subsystem.

  firmware-name:
    maxItems: 1
    description:
      Name of the firmware ELF file to load.

  reset-gpios:
    maxItems: 1
    description:
      GPIO specifier controlling the soft-core reset input.

required:
  - compatible
  - reg
  - clocks
  - reset-gpios

additionalProperties: false

examples:
  - |
    #include <dt-bindings/gpio/gpio.h>
    remoteproc@0 {
      compatible = "xlnx,zynqmp-bram-rproc";
      reg = <0x0 0x40000>;
      clocks = <&pl_clk>;
      firmware-name = "firmware.elf";
      reset-gpios = <&gpio0 0 GPIO_ACTIVE_LOW>;
    };
...
```
