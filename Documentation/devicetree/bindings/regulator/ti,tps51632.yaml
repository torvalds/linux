## Documentation/devicetree/bindings/remoteproc/qcom,nord-pas.yaml
```yaml
# SPDX-License-Identifier: GPL-2.0 OR BSD-2-Clause
%YAML 1.2
---
$id: http://devicetree.org/schemas/remoteproc/qcom,nord-pas.yaml#
$schema: http://devicetree.org/meta-schemas/core.yaml#

title: Qualcomm Nord SoC Peripheral Authentication Service

maintainers:
  - Shawn Guo <shengchao.guo@oss.qualcomm.com>

description:
  Qualcomm Nord SoC Peripheral Authentication Service loads and boots firmware
  on the Qualcomm DSP Hexagon cores.

properties:
  compatible:
    enum:
      - qcom,nord-adsp-pas
      - qcom,nord-cdsp0-pas
      - qcom,nord-cdsp1-pas
      - qcom,nord-cdsp2-pas
      - qcom,nord-cdsp3-pas

  power-domains:
    minItems: 2
    items:
      - description: CX power domain
      - description: MX power domain
      - description: NSP power domain

  power-domain-names:
    minItems: 2
    items:
      - const: cx
      - const: mx
      - const: nsp

  reg:
    maxItems: 1

  clocks:
    items:
      - description: XO clock

  clock-names:
    items:
      - const: xo

  qcom,qmp:
    $ref: /schemas/types.yaml#/definitions/phandle
    description: Reference to the AOSS side-channel message RAM.

  smd-edge: false

  firmware-name:
    items:
      - description: Firmware name of the Hexagon core
      - description: Firmware name of the Hexagon Devicetree

  memory-region:
    items:
      - description: Memory region for main Firmware authentication
      - description: Memory region for Devicetree Firmware authentication

  interrupts:
    items:
      - description: Watchdog interrupt
      - description: Fatal interrupt
      - description: Ready interrupt
      - description: Handover interrupt
      - description: Stop acknowledge interrupt
      - description: Shutdown acknowledge interrupt

  interrupt-names:
    items:
      - const: wdog
      - const: fatal
      - const: ready
      - const: handover
      - const: stop-ack
      - const: shutdown-ack

  qcom,smem-states:
    maxItems: 1
    description: States used by the AP to signal the Hexagon core

  qcom,smem-state-names:
    maxItems: 1
    description: The names of the state bits used for SMP2P output

required:
  - compatible
  - reg
  - memory-region

allOf:
  - $ref: /schemas/remoteproc/qcom,pas-common.yaml#
  - if:
      properties:
        compatible:
          enum:
            - qcom,nord-adsp-pas
    then:
      properties:
        power-domains:
          maxItems: 2
        power-domain-names:
          maxItems: 2
    else:
      properties:
        power-domains:
          minItems: 3
        power-domain-names:
          minItems: 3

unevaluatedProperties: false

examples:
  - |
    #include <dt-bindings/clock/qcom,rpmh.h>
    #include <dt-bindings/interrupt-controller/arm-gic.h>
    #include <dt-bindings/interrupt-controller/irq.h>
    #include <dt-bindings/mailbox/qcom-ipcc.h>
    #include <dt-bindings/power/qcom,rpmhpd.h>
    #define IPCC_MPROC_ADSP0

    remoteproc@4c00000 {
        compatible = "qcom,nord-adsp-pas";
        reg = <0x04c00000 0x10000>;

        clocks = <&rpmhcc RPMH_CXO_CLK>;
        clock-names = "xo";

        interrupts-extended = <&intc GIC_SPI 159 IRQ_TYPE_EDGE_RISING>,
                              <&smp2p_adsp_in 0 IRQ_TYPE_EDGE_RISING>,
                              <&smp2p_adsp_in 1 IRQ_TYPE_EDGE_RISING>,
                              <&smp2p_adsp_in 2 IRQ_TYPE_EDGE_RISING>,
                              <&smp2p_adsp_in 3 IRQ_TYPE_EDGE_RISING>,
                              <&smp2p_adsp_in 7 IRQ_TYPE_EDGE_RISING>;
        interrupt-names = "wdog",
                          "fatal",
                          "ready",
                          "handover",
                          "stop-ack",
                          "shutdown-ack";

        memory-region = <&hpass_dsp0_mem>, <&hpass_dsp0_dtb_mem>;

        firmware-name = "qcom/nord/adsp.mbn",
                        "qcom/nord/adsp_dtb.mbn";

        power-domains = <&rpmhpd RPMHPD_CX>,
                        <&rpmhpd RPMHPD_MX>;
        power-domain-names = "cx",
                             "mx";

        qcom,qmp = <&aoss_qmp>;
        qcom,smem-states = <&smp2p_adsp_out 0>;
        qcom,smem-state-names = "stop";

        glink-edge {
            interrupts-extended = <&ipcc IPCC_MPROC_ADSP0
                                         IPCC_MPROC_SIGNAL_GLINK_QMP
                                         IRQ_TYPE_EDGE_RISING>;
            mboxes = <&ipcc IPCC_MPROC_ADSP0 IPCC_MPROC_SIGNAL_GLINK_QMP>;

            label = "adsp";
            qcom,remote-pid = <2>;

            /* ... */
        };
    };
```

## Documentation/devicetree/bindings/remoteproc/ti,am3352-wkup-m3.yaml
```yaml
# SPDX-License-Identifier: (GPL-2.0-only OR BSD-2-Clause)
%YAML 1.2
---
$id: http://devicetree.org/schemas/remoteproc/ti,am3352-wkup-m3.yaml#
$schema: http://devicetree.org/meta-schemas/core.yaml#

title: TI AM33xx/AM43xx Wakeup M3 Remote Processor

maintainers:
  - Suman Anna <s-anna@ti.com>
  - Bhargav Joshi <j.bhargav.u@gmail.com>

description:
  The TI AM33xx and AM43xx family of devices use a small Cortex M3 co-processor
  (commonly referred to as Wakeup M3 or CM3) to help with various low power
  tasks that cannot be controlled from the MPU. This CM3 processor requires a
  firmware binary to accomplish this. A wkup_m3 device node is used to
  represent the Wakeup M3 processor instance within the SoC. It is added as a
  child node of the parent interconnect bus (l4_wkup) through which it is
  accessible to the MPU.

properties:
  compatible:
    enum:
      - ti,am3352-wkup-m3
      - ti,am4372-wkup-m3

  reg:
    items:
      - description: Address range for UMEM
      - description: Address range for DMEM

  reg-names:
    items:
      - const: umem
      - const: dmem

  ti,pm-firmware:
    $ref: /schemas/types.yaml#/definitions/string
    description:
      Name of firmware file to be used for loading and booting the wkup_m3
      remote processor.

  resets:
    maxItems: 1

  reset-names:
    items:
      - const: rstctrl

  ti,hwmods:
    $ref: /schemas/types.yaml#/definitions/string
    deprecated: true
    description:
      Name of the hwmod associated with the wkupm3 device.

required:
  - compatible
  - reg
  - reg-names
  - ti,pm-firmware

dependencies:
  resets: [reset-names]
  reset-names: [resets]

additionalProperties: false

examples:
  - |
    target-module@0 {
        compatible = "ti,sysc-omap4", "ti,sysc";
        reg = <0x0 0x4>;
        reg-names = "rev";
        #address-cells = <1>;
        #size-cells = <1>;
        ranges = <0x00000000 0x00000000 0x4000>,
                 <0x00080000 0x00080000 0x2000>;

        cpu@0 {
            compatible = "ti,am3352-wkup-m3";
            reg = <0x00000000 0x4000>,
                  <0x00080000 0x2000>;
            reg-names = "umem", "dmem";
            resets = <&prm_wkup 3>;
            reset-names = "rstctrl";
            ti,pm-firmware = "am335x-pm-firmware.elf";
        };
    };
```

## Documentation/devicetree/bindings/reset/qcom,shikra-audiocore-csr.yaml
```yaml
# SPDX-License-Identifier: (GPL-2.0-only OR BSD-2-Clause)
%YAML 1.2
---
$id: http://devicetree.org/schemas/reset/qcom,shikra-audiocore-csr.yaml#
$schema: http://devicetree.org/meta-schemas/core.yaml#

title: Audio Core CSR for Qualcomm Shikra SoC

maintainers:
  - Imran Shaik <imran.shaik@oss.qualcomm.com>

description: |
  Audio Core CSR module provides the resets on Qualcomm Shikra SoC platform.

  See also:
  - include/dt-bindings/clock/qcom,shikra-audiocorecc.h

properties:
  compatible:
    const: qcom,shikra-audiocore-csr

  reg:
    maxItems: 1

  '#reset-cells':
    const: 1

required:
  - compatible
  - reg
  - '#reset-cells'

additionalProperties: false

examples:
  - |
    reset-controller@a0b4000 {
      compatible = "qcom,shikra-audiocore-csr";
      reg = <0x0a0b4000 0x1000>;
      #reset-cells = <1>;
    };
...
```

## Documentation/devicetree/bindings/rtc/microchip,pic32mzda-rtc.yaml
```yaml
# SPDX-License-Identifier: (GPL-2.0-only OR BSD-2-Clause)
%YAML 1.2
---
$id: http://devicetree.org/schemas/rtc/microchip,pic32mzda-rtc.yaml#
$schema: http://devicetree.org/meta-schemas/core.yaml#

title: Microchip PIC32 Real Time Clock and Calendar

maintainers:
  - Alexandre Belloni <alexandre.belloni@bootlin.com>

description: |
  The Microchip PIC32 Real Time Clock and Calendar (RTCC) keeps time in hours,
  minutes, seconds, and one half second. It also provides a calendar with
  weekday, date, month, and year, along with a configurable alarm.

allOf:
  - $ref: rtc.yaml#

properties:
  compatible:
    const: microchip,pic32mzda-rtc

  reg:
    maxItems: 1

  interrupts:
    maxItems: 1

  clocks:
    maxItems: 1

required:
  - compatible
  - reg
  - interrupts
  - clocks

additionalProperties: false

examples:
  - |
    #include <dt-bindings/interrupt-controller/irq.h>

    rtc@1f8c0000 {
        compatible = "microchip,pic32mzda-rtc";
        reg = <0x1f8c0000 0x60>;
        interrupts = <166 IRQ_TYPE_EDGE_RISING>;
        clocks = <&PBCLK6>;
    };
```

## Documentation/devicetree/bindings/rtc/renesas,rzn1-rtc.yaml
```yaml
# SPDX-License-Identifier: (GPL-2.0-only OR BSD-2-Clause)
%YAML 1.2
---
$id: http://devicetree.org/schemas/rtc/renesas,rzn1-rtc.yaml#
$schema: http://devicetree.org/meta-schemas/core.yaml#

title: Renesas RZ/N1 SoCs Real-Time Clock

maintainers:
  - Miquel Raynal <miquel.raynal@bootlin.com>

properties:
  compatible:
    oneOf:
      - items:
          - enum:
              - renesas,r9a06g032-rtc # RZ/N1D
          - const: renesas,rzn1-rtc   # RZ/N1

      - const: renesas,r9a09g077-rtc  # RZ/T2H

      - items:
          - const: renesas,r9a09g087-rtc  # RZ/N2H
          - const: renesas,r9a09g077-rtc  # RZ/T2H

      - const: renesas,r8a78000-rtc   # R-Car X5H

  reg:
    maxItems: 1

  interrupts:
    minItems: 3
    maxItems: 3

  interrupt-names:
    items:
      - const: alarm
      - const: timer
      - const: pps

  clocks:
    minItems: 1
    maxItems: 2

  clock-names:
    minItems: 1
    items:
      - const: hclk
      - const: xtal

  power-domains:
    maxItems: 1

  resets:
    maxItems: 1

required:
  - compatible
  - reg
  - clocks
  - clock-names
  - power-domains

allOf:
  - $ref: rtc.yaml#

  - if:
      properties:
        compatible:
          contains:
            enum:
              - renesas,r8a78000-rtc
              - renesas,r9a09g077-rtc
              - renesas,r9a09g087-rtc
    then:
      properties:
        clocks:
          minItems: 2
        clock-names:
          minItems: 2

  - if:
      properties:
        compatible:
          contains:
            const: renesas,r8a78000-rtc
    then:
      properties:
        interrupts: false
        interrupt-names: false
      required:
        - resets
    else:
      properties:
        resets: false
      required:
        - interrupts
        - interrupt-names

unevaluatedProperties: false

examples:
  - |
    #include <dt-bindings/interrupt-controller/arm-gic.h>
    #include <dt-bindings/clock/r9a06g032-sysctrl.h>
    rtc@40006000 {
        compatible = "renesas,r9a06g032-rtc", "renesas,rzn1-rtc";
        reg = <0x40006000 0x1000>;
        interrupts = <GIC_SPI 66 IRQ_TYPE_EDGE_RISING>,
                     <GIC_SPI 67 IRQ_TYPE_EDGE_RISING>,
                     <GIC_SPI 68 IRQ_TYPE_EDGE_RISING>;
        interrupt-names = "alarm", "timer", "pps";
        clocks = <&sysctrl R9A06G032_HCLK_RTC>;
        clock-names = "hclk";
        power-domains = <&sysctrl>;
    };
```

## Documentation/devicetree/bindings/rtc/ricoh,r2223x.yaml
```yaml
# SPDX-License-Identifier: (GPL-2.0-only OR BSD-2-Clause)
%YAML 1.2
---
$id: http://devicetree.org/schemas/rtc/ricoh,r2223x.yaml#
$schema: http://devicetree.org/meta-schemas/core.yaml#

title: Ricoh R2223x Real-Time Clock

maintainers:
  - Heiko Schocher <hs@nabladev.com>

allOf:
  - $ref: rtc.yaml#

properties:
  compatible:
    const: ricoh,r2223x

  reg:
    maxItems: 1

  interrupts:
    maxItems: 1

  "#clock-cells":
    const: 0

  ricoh,eco-mode:
    type: boolean
    description:
      Put the RTC into eco mode, which lowers its current consumption while
      running from the backup supply. Set this on boards where the RTC is
      expected to keep time on a small backup cell.

  start-year: true

required:
  - compatible
  - reg

additionalProperties: false

examples:
  - |
    #include <dt-bindings/interrupt-controller/irq.h>

    i2c {
        #address-cells = <1>;
        #size-cells = <0>;

        rtc@32 {
            compatible = "ricoh,r2223x";
            reg = <0x32>;
            interrupts = <6 IRQ_TYPE_EDGE_FALLING>;
            #clock-cells = <0>;
            ricoh,eco-mode;
        };
    };
```

## Documentation/devicetree/bindings/rtc/rtc-cmos.yaml
```yaml
# SPDX-License-Identifier: (GPL-2.0-only OR BSD-2-Clause)
%YAML 1.2
---
$id: http://devicetree.org/schemas/rtc/rtc-cmos.yaml#
$schema: http://devicetree.org/meta-schemas/core.yaml#

title: Motorola mc146818 compatible RTC

maintainers:
  - Alexandre Belloni <alexandre.belloni@bootlin.com>

properties:
  compatible:
    oneOf:
      - const: motorola,mc146818

      - items:
          - const: intel,ce4100-rtc
          - const: motorola,mc146818

  reg:
    maxItems: 1

  interrupts:
    maxItems: 1

  ctrl-reg:
    $ref: /schemas/types.yaml#/definitions/uint32
    description:
      Initial value of the control register
      (also known as Register B).

  freq-reg:
    $ref: /schemas/types.yaml#/definitions/uint32
    description:
      Initial value of the frequency register
      (also known as Register A).

required:
  - compatible
  - reg

allOf:
  - $ref: rtc.yaml#

unevaluatedProperties: false

examples:
  - |
    bus {
        #address-cells = <2>;
        #size-cells = <1>;

        rtc@1,70 {
            compatible = "motorola,mc146818";
            reg = <0x1 0x70 0x2>;

            interrupts = <8 3>;

            ctrl-reg = <2>;
            freq-reg = <0x26>;
        };
    };
```
