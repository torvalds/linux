## Documentation/devicetree/bindings/gpio/brcm,brcmstb-gpio.yaml
```yaml
# SPDX-License-Identifier: (GPL-2.0-only OR BSD-2-Clause)
%YAML 1.2
---
$id: http://devicetree.org/schemas/gpio/brcm,brcmstb-gpio.yaml#
$schema: http://devicetree.org/meta-schemas/core.yaml#

title: Broadcom STB "UPG GIO" GPIO controller

description: >
  The controller's registers are organized as sets of eight 32-bit
  registers with each set controlling a bank of up to 32 pins.  A single
  interrupt is shared for all of the banks handled by the controller.

maintainers:
  - Doug Berger <opendmb@gmail.com>
  - Florian Fainelli <f.fainelli@gmail.com>

properties:
  compatible:
    items:
      - enum:
          - brcm,bcm7445-gpio
      - const: brcm,brcmstb-gpio

  reg:
    maxItems: 1
    description: >
      Define the base and range of the I/O address space containing
      the brcmstb GPIO controller registers

  "#gpio-cells":
    const: 2
    description: >
      The first cell is the pin number (within the controller's
      pin space), and the second is used for the following:
      bit[0]: polarity (0 for active-high, 1 for active-low)

  gpio-controller: true

  brcm,gpio-bank-widths:
    $ref: /schemas/types.yaml#/definitions/uint32-array
    description: >
      Number of GPIO lines for each bank.  Number of elements must
      correspond to number of banks suggested by the 'reg' property.

  interrupts:
    maxItems: 1
    description: >
      The interrupt shared by all GPIO lines for this controller.

  "#interrupt-cells":
    const: 2
    description: |
      The first cell is the GPIO number, the second should specify
      flags.  The following subset of flags is supported:
      - bits[3:0] trigger type and level flags
        1 = low-to-high edge triggered
        2 = high-to-low edge triggered
        4 = active high level-sensitive
        8 = active low level-sensitive
      Valid combinations are 1, 2, 3, 4, 8.

  interrupt-controller: true

  wakeup-source:
    type: boolean
    description: >
      GPIOs for this controller can be used as a wakeup source

required:
  - compatible
  - reg
  - gpio-controller
  - "#gpio-cells"
  - "brcm,gpio-bank-widths"

additionalProperties: false

examples:
  - |
    upg_gio: gpio@f040a700 {
        #gpio-cells = <2>;
        #interrupt-cells = <2>;
        compatible = "brcm,bcm7445-gpio", "brcm,brcmstb-gpio";
        gpio-controller;
        interrupt-controller;
        reg = <0xf040a700 0x80>;
        interrupt-parent = <&irq0_intc>;
        interrupts = <0x6>;
        brcm,gpio-bank-widths = <32 32 32 24>;
    };

    upg_gio_aon: gpio@f04172c0 {
        #gpio-cells = <2>;
        #interrupt-cells = <2>;
        compatible = "brcm,bcm7445-gpio", "brcm,brcmstb-gpio";
        gpio-controller;
        interrupt-controller;
        reg = <0xf04172c0 0x40>;
        interrupt-parent = <&irq0_aon_intc>;
        interrupts = <0x6>;
        wakeup-source;
        brcm,gpio-bank-widths = <18 4>;
    };
```

## Documentation/devicetree/bindings/gpio/brcm,kona-gpio.txt
```
Broadcom Kona Family GPIO
=========================

This GPIO driver is used in the following Broadcom SoCs:
  BCM11130, BCM11140, BCM11351, BCM28145, BCM28155

The Broadcom GPIO Controller IP can be configured prior to synthesis to
support up to 8 banks of 32 GPIOs where each bank has its own IRQ. The
GPIO controller only supports edge, not level, triggering of interrupts.

Required properties
-------------------

- compatible: "brcm,bcm11351-gpio", "brcm,kona-gpio"
- reg: Physical base address and length of the controller's registers.
- interrupts: The interrupt outputs from the controller. There is one GPIO
  interrupt per GPIO bank. The number of interrupts listed depends on the
  number of GPIO banks on the SoC. The interrupts must be ordered by bank,
  starting with bank 0. There is always a 1:1 mapping between banks and
  IRQs.
- #gpio-cells: Should be <2>. The first cell is the pin number, the second
  cell is used to specify optional parameters:
  - bit 0 specifies polarity (0 for normal, 1 for inverted)
  See also "gpio-specifier" in .../devicetree/bindings/gpio/gpio.txt.
- #interrupt-cells: Should be <2>. The first cell is the GPIO number. The
  second cell is used to specify flags. The following subset of flags is
  supported:
  - trigger type (bits[1:0]):
      1 = low-to-high edge triggered.
      2 = high-to-low edge triggered.
      3 = low-to-high or high-to-low edge triggered
      Valid values are 1, 2, 3
  See also .../devicetree/bindings/interrupt-controller/interrupts.txt.
- gpio-controller: Marks the device node as a GPIO controller.
- interrupt-controller: Marks the device node as an interrupt controller.

Example:
	gpio: gpio@35003000 {
		compatible = "brcm,bcm11351-gpio", "brcm,kona-gpio";
		reg = <0x35003000 0x800>;
		interrupts =
		       <GIC_SPI 106 IRQ_TYPE_LEVEL_HIGH
			GIC_SPI 115 IRQ_TYPE_LEVEL_HIGH
			GIC_SPI 114 IRQ_TYPE_LEVEL_HIGH
			GIC_SPI 113 IRQ_TYPE_LEVEL_HIGH
			GIC_SPI 112 IRQ_TYPE_LEVEL_HIGH
			GIC_SPI 111 IRQ_TYPE_LEVEL_HIGH>;
		#gpio-cells = <2>;
		#interrupt-cells = <2>;
		gpio-controller;
		interrupt-controller;
	};
```

## Documentation/devicetree/bindings/gpio/brcm,kona-gpio.yaml
```yaml
# SPDX-License-Identifier: GPL-2.0-only OR BSD-2-Clause
%YAML 1.2
---
$id: http://devicetree.org/schemas/gpio/brcm,kona-gpio.yaml#
$schema: http://devicetree.org/meta-schemas/core.yaml#

title: Broadcom Kona family GPIO controller

description:
  The Broadcom GPIO Controller IP can be configured prior to synthesis to
  support up to 8 banks of 32 GPIOs where each bank has its own IRQ. The
  GPIO controller only supports edge, not level, triggering of interrupts.

maintainers:
  - Ray Jui <rjui@broadcom.com>

properties:
  compatible:
    items:
      - enum:
          - brcm,bcm11351-gpio
          - brcm,bcm21664-gpio
          - brcm,bcm23550-gpio
      - const: brcm,kona-gpio

  reg:
    maxItems: 1

  interrupts:
    minItems: 4
    maxItems: 6
    description:
      The interrupt outputs from the controller. There is one GPIO interrupt
      per GPIO bank. The number of interrupts listed depends on the number of
      GPIO banks on the SoC. The interrupts must be ordered by bank, starting
      with bank 0. There is always a 1:1 mapping between banks and IRQs.

  '#gpio-cells':
    const: 2

  '#interrupt-cells':
    const: 2

  gpio-controller: true

  interrupt-controller: true

required:
  - compatible
  - reg
  - interrupts
  - '#gpio-cells'
  - '#interrupt-cells'
  - gpio-controller
  - interrupt-controller

allOf:
  - if:
      properties:
        compatible:
          contains:
            const: brcm,bcm11351-gpio
    then:
      properties:
        interrupts:
          minItems: 6
  - if:
      properties:
        compatible:
          contains:
            enum:
              - brcm,bcm21664-gpio
              - brcm,bcm23550-gpio
    then:
      properties:
        interrupts:
          maxItems: 4

additionalProperties: false

examples:
  - |
    #include <dt-bindings/interrupt-controller/arm-gic.h>
    #include <dt-bindings/interrupt-controller/irq.h>

    gpio@35003000 {
        compatible = "brcm,bcm11351-gpio", "brcm,kona-gpio";
        reg = <0x35003000 0x800>;
        interrupts = <GIC_SPI 106 IRQ_TYPE_LEVEL_HIGH>,
                     <GIC_SPI 115 IRQ_TYPE_LEVEL_HIGH>,
                     <GIC_SPI 114 IRQ_TYPE_LEVEL_HIGH>,
                     <GIC_SPI 113 IRQ_TYPE_LEVEL_HIGH>,
                     <GIC_SPI 112 IRQ_TYPE_LEVEL_HIGH>,
                     <GIC_SPI 111 IRQ_TYPE_LEVEL_HIGH>;
        #gpio-cells = <2>;
        #interrupt-cells = <2>;
        gpio-controller;
        interrupt-controller;
    };
...
```

## Documentation/devicetree/bindings/gpio/brcm,xgs-iproc-gpio.yaml
```yaml
# SPDX-License-Identifier: (GPL-2.0 OR BSD-2-Clause)
%YAML 1.2
---
$id: http://devicetree.org/schemas/gpio/brcm,xgs-iproc-gpio.yaml#
$schema: http://devicetree.org/meta-schemas/core.yaml#

title: Broadcom XGS iProc GPIO controller

maintainers:
  - Chris Packham <chris.packham@alliedtelesis.co.nz>

description: |
  This controller is the Chip Common A GPIO present on a number of Broadcom
  switch ASICs with integrated SoCs.

properties:
  compatible:
    const: brcm,iproc-gpio-cca

  reg:
    items:
      - description: the I/O address containing the GPIO controller
                     registers.
      - description: the I/O address containing the Chip Common A interrupt
                     registers.

  gpio-controller: true

  '#gpio-cells':
      const: 2

  ngpios:
    minimum: 0
    maximum: 32

  interrupt-controller: true

  '#interrupt-cells':
    const: 2

  interrupts:
    maxItems: 1

required:
  - compatible
  - reg
  - "#gpio-cells"
  - gpio-controller

additionalProperties: false

dependencies:
  interrupt-controller: [ interrupts ]

examples:
  - |
    #include <dt-bindings/interrupt-controller/irq.h>
    #include <dt-bindings/interrupt-controller/arm-gic.h>
    gpio@18000060 {
        compatible = "brcm,iproc-gpio-cca";
        #gpio-cells = <2>;
        reg = <0x18000060 0x50>,
              <0x18000000 0x50>;
        ngpios = <12>;
        gpio-controller;
        interrupt-controller;
        #interrupt-cells = <2>;
        interrupts = <GIC_SPI 91 IRQ_TYPE_LEVEL_HIGH>;
    };


...
```

## Documentation/devicetree/bindings/gpio/cavium,octeon-3860-gpio.yaml
```yaml
# SPDX-License-Identifier: (GPL-2.0-only OR BSD-2-Clause)
%YAML 1.2
---
$id: http://devicetree.org/schemas/cavium,octeon-3860-gpio.yaml#
$schema: http://devicetree.org/meta-schemas/core.yaml#

title: Cavium Octeon 3860 GPIO controller

maintainers:
  - Bartosz Golaszewski <brgl@bgdev.pl>

properties:
  compatible:
    const: cavium,octeon-3860-gpio

  reg:
    maxItems: 1

  gpio-controller: true

  '#gpio-cells':
    const: 2

  interrupt-controller: true

  '#interrupt-cells':
    const: 2

  interrupts:
    maxItems: 16

required:
  - compatible
  - reg
  - gpio-controller
  - '#gpio-cells'
  - interrupt-controller
  - '#interrupt-cells'
  - interrupts

additionalProperties: false

examples:
  - |
    bus {
        #address-cells = <2>;
        #size-cells = <2>;

        gpio@1070000000800 {
            compatible = "cavium,octeon-3860-gpio";
            reg = <0x10700 0x00000800 0x0 0x100>;
            gpio-controller;
            #gpio-cells = <2>;
            interrupt-controller;
            #interrupt-cells = <2>;
            /* The GPIO pin connect to 16 consecutive CUI bits */
            interrupts = <0 16>, <0 17>, <0 18>, <0 19>,
                        <0 20>, <0 21>, <0 22>, <0 23>,
                        <0 24>, <0 25>, <0 26>, <0 27>,
                        <0 28>, <0 29>, <0 30>, <0 31>;
        };
    };
```

## Documentation/devicetree/bindings/gpio/cavium-octeon-gpio.txt
```
* General Purpose Input Output (GPIO) bus.

Properties:
- compatible: "cavium,octeon-3860-gpio"

  Compatibility with all cn3XXX, cn5XXX and cn6XXX SOCs.

- reg: The base address of the GPIO unit's register bank.

- gpio-controller: This is a GPIO controller.

- #gpio-cells: Must be <2>.  The first cell is the GPIO pin.

- interrupt-controller: The GPIO controller is also an interrupt
  controller, many of its pins may be configured as an interrupt
  source.

- #interrupt-cells: Must be <2>.  The first cell is the GPIO pin
   connected to the interrupt source.  The second cell is the interrupt
   triggering protocol and may have one of four values:
   1 - edge triggered on the rising edge.
   2 - edge triggered on the falling edge
   4 - level triggered active high.
   8 - level triggered active low.

- interrupts: Interrupt routing for each pin.

Example:

	gpio-controller@1070000000800 {
		#gpio-cells = <2>;
		compatible = "cavium,octeon-3860-gpio";
		reg = <0x10700 0x00000800 0x0 0x100>;
		gpio-controller;
		/* Interrupts are specified by two parts:
		 * 1) GPIO pin number (0..15)
		 * 2) Triggering (1 - edge rising
		 *		  2 - edge falling
		 *		  4 - level active high
		 *		  8 - level active low)
		 */
		interrupt-controller;
		#interrupt-cells = <2>;
		/* The GPIO pin connect to 16 consecutive CUI bits */
		interrupts = <0 16>, <0 17>, <0 18>, <0 19>,
			     <0 20>, <0 21>, <0 22>, <0 23>,
			     <0 24>, <0 25>, <0 26>, <0 27>,
			     <0 28>, <0 29>, <0 30>, <0 31>;
	};
```
