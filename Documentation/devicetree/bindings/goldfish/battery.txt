## Documentation/devicetree/bindings/goldfish/battery.txt
```
Android Goldfish Battery

Android goldfish battery device generated by android emulator.

Required properties:

- compatible : should contain "google,goldfish-battery" to match emulator
- reg        : <registers mapping>
- interrupts : <interrupt mapping>

Example:

	goldfish_battery@9020000 {
		compatible = "google,goldfish-battery";
		reg = <0x9020000 0x1000>;
		interrupts = <0x3>;
	};
```

## Documentation/devicetree/bindings/goldfish/events.txt
```
Android Goldfish Events Keypad

Android goldfish events keypad device generated by android emulator.

Required properties:

- compatible : should contain "google,goldfish-events-keypad" to match emulator
- reg        : <registers mapping>
- interrupts : <interrupt mapping>

Example:

	goldfish-events@9040000 {
		compatible = "google,goldfish-events-keypad";
		reg = <0x9040000 0x1000>;
		interrupts = <0x5>;
	};
```

## Documentation/devicetree/bindings/goldfish/pipe.txt
```
Android Goldfish QEMU Pipe

Android pipe virtual device generated by android emulator.

Required properties:

- compatible : should contain "google,android-pipe" to match emulator
- reg        : <registers mapping>
- interrupts : <interrupt mapping>

Example:

	android_pipe@a010000 {
		compatible = "google,android-pipe";
		reg = <ff018000 0x2000>;
		interrupts = <0x12>;
	};
```

## Documentation/devicetree/bindings/goldfish/tty.txt
```
Android Goldfish TTY

Android goldfish tty device generated by android emulator.

Required properties:

- compatible : should contain "google,goldfish-tty" to match emulator
- reg        : <registers mapping>
- interrupts : <interrupt mapping>

Example:

	goldfish_tty@1f004000 {
		compatible = "google,goldfish-tty";
		reg = <0x1f004000 0x1000>;
		interrupts = <0xc>;
	};
```

## Documentation/devicetree/bindings/gpio/8xxx_gpio.txt
```
GPIO controllers on MPC8xxx SoCs

This is for the non-QE/CPM/GUTs GPIO controllers as found on
8349, 8572, 8610 and compatible.

Every GPIO controller node must have #gpio-cells property defined,
this information will be used to translate gpio-specifiers.
See bindings/gpio/gpio.txt for details of how to specify GPIO
information for devices.

The GPIO module usually is connected to the SoC's internal interrupt
controller, see bindings/interrupt-controller/interrupts.txt (the
interrupt client nodes section) for details how to specify this GPIO
module's interrupt.

The GPIO module may serve as another interrupt controller (cascaded to
the SoC's internal interrupt controller).  See the interrupt controller
nodes section in bindings/interrupt-controller/interrupts.txt for
details.

Required properties:
- compatible:		"fsl,<chip>-gpio" followed by "fsl,mpc8349-gpio"
			for 83xx, "fsl,mpc8572-gpio" for 85xx, or
			"fsl,mpc8610-gpio" for 86xx.
- #gpio-cells:		Should be two. The first cell is the pin number
			and the second cell is used to specify optional
			parameters (currently unused).
- interrupt-parent:	Phandle for the interrupt controller that
			services interrupts for this device.
- interrupts:		Interrupt mapping for GPIO IRQ.
- gpio-controller:	Marks the port as GPIO controller.

Optional properties:
- interrupt-controller:	Empty boolean property which marks the GPIO
			module as an IRQ controller.
- #interrupt-cells:	Should be two.  Defines the number of integer
			cells required to specify an interrupt within
			this interrupt controller.  The first cell
			defines the pin number, the second cell
			defines additional flags (trigger type,
			trigger polarity).  Note that the available
			set of trigger conditions supported by the
			GPIO module depends on the actual SoC.

Example of gpio-controller nodes for a MPC8347 SoC:

	gpio1: gpio-controller@c00 {
		#gpio-cells = <2>;
		compatible = "fsl,mpc8347-gpio", "fsl,mpc8349-gpio";
		reg = <0xc00 0x100>;
		interrupt-parent = <&ipic>;
		interrupts = <74 0x8>;
		gpio-controller;
		interrupt-controller;
		#interrupt-cells = <2>;
	};

	gpio2: gpio-controller@d00 {
		#gpio-cells = <2>;
		compatible = "fsl,mpc8347-gpio", "fsl,mpc8349-gpio";
		reg = <0xd00 0x100>;
		interrupt-parent = <&ipic>;
		interrupts = <75 0x8>;
		gpio-controller;
	};

Example of a peripheral using the GPIO module as an IRQ controller:

	funkyfpga@0 {
		compatible = "funky-fpga";
		...
		interrupt-parent = <&gpio1>;
		interrupts = <4 3>;
	};
```

## Documentation/devicetree/bindings/gpio/abilis,tb10x-gpio.txt
```
* Abilis TB10x GPIO controller

Required Properties:
- compatible: Should be "abilis,tb10x-gpio"
- reg: Address and length of the register set for the device
- gpio-controller: Marks the device node as a gpio controller.
- #gpio-cells: Should be <2>. The first cell is the pin number and the
  second cell is used to specify optional parameters:
   - bit 0 specifies polarity (0 for normal, 1 for inverted).
- abilis,ngpio: the number of GPIO pins this driver controls.

Optional Properties:
- interrupt-controller: Marks the device node as an interrupt controller.
- #interrupt-cells: Should be <1>. Interrupts are triggered on both edges.
- interrupts: Defines the interrupt line connecting this GPIO controller to
  its parent interrupt controller.
- interrupt-parent: Defines the parent interrupt controller.

GPIO ranges are specified as described in
Documentation/devicetree/bindings/gpio/gpio.txt

Example:

	gpioa: gpio@ff140000 {
		compatible = "abilis,tb10x-gpio";
		interrupt-controller;
		#interrupt-cells = <1>;
		interrupt-parent = <&tb10x_ictl>;
		interrupts = <27 2>;
		reg = <0xFF140000 0x1000>;
		gpio-controller;
		#gpio-cells = <2>;
		abilis,ngpio = <3>;
		gpio-ranges = <&iomux 0 0 0>;
		gpio-ranges-group-names = "gpioa_pins";
	};
```

## Documentation/devicetree/bindings/gpio/abilis,tb10x-gpio.yaml
```yaml
# SPDX-License-Identifier: (GPL-2.0-only OR BSD-2-Clause)
%YAML 1.2
---
$id: http://devicetree.org/schemas/gpio/abilis,tb10x-gpio.yaml#
$schema: http://devicetree.org/meta-schemas/core.yaml#

title: Abilis TB10x GPIO controller

maintainers:
  - Christian Ruppert <christian.ruppert@abilis.com>

properties:
  compatible:
    const: abilis,tb10x-gpio

  reg:
    maxItems: 1

  gpio-controller: true

  '#gpio-cells':
    const: 2

  gpio-ranges: true

  gpio-ranges-group-names: true

  interrupt-controller: true

  '#interrupt-cells':
    const: 1
    description: Interrupts are triggered on both edges

  interrupts:
    maxItems: 1

  abilis,ngpio:
    description: Number of GPIO pins this driver controls
    $ref: /schemas/types.yaml#/definitions/uint32

required:
  - compatible
  - reg
  - gpio-controller
  - '#gpio-cells'
  - abilis,ngpio

additionalProperties: false

examples:
  - |
    gpio@ff140000 {
        compatible = "abilis,tb10x-gpio";
        interrupt-controller;
        #interrupt-cells = <1>;
        interrupts = <27 2>;
        reg = <0xff140000 0x1000>;
        gpio-controller;
        #gpio-cells = <2>;
        abilis,ngpio = <3>;
        gpio-ranges = <&iomux 0 0 0>;
        gpio-ranges-group-names = "gpioa_pins";
    };
```

## Documentation/devicetree/bindings/gpio/adi,ds4520-gpio.yaml
```yaml
# SPDX-License-Identifier: (GPL-2.0-only OR BSD-2-Clause)
%YAML 1.2
---
$id: http://devicetree.org/schemas/gpio/adi,ds4520-gpio.yaml#
$schema: http://devicetree.org/meta-schemas/core.yaml#

title: DS4520 I2C GPIO expander

maintainers:
  - Okan Sahin <okan.sahin@analog.com>

properties:
  compatible:
    enum:
      - adi,ds4520-gpio

  reg:
    maxItems: 1

  gpio-controller: true

  "#gpio-cells":
    const: 2

  ngpios:
    minimum: 1
    maximum: 9

required:
  - compatible
  - reg
  - gpio-controller
  - "#gpio-cells"
  - ngpios

additionalProperties: false

examples:
  - |
    i2c {
        #address-cells = <1>;
        #size-cells = <0>;

        gpio@50 {
            compatible = "adi,ds4520-gpio";
            reg = <0x50>;
            ngpios = <9>;
            gpio-controller;
            #gpio-cells = <2>;
        };
    };
```

## Documentation/devicetree/bindings/gpio/airoha,en7523-gpio.yaml
```yaml
# SPDX-License-Identifier: GPL-2.0-only OR BSD-2-Clause
%YAML 1.2
---
$id: http://devicetree.org/schemas/gpio/airoha,en7523-gpio.yaml#
$schema: http://devicetree.org/meta-schemas/core.yaml#

title: Airoha EN7523 GPIO controller

maintainers:
  - John Crispin <john@phrozen.org>

description: |
  Airoha's GPIO controller on their ARM EN7523 SoCs consists of two banks of 32
  GPIOs.

properties:
  $nodename:
    pattern: "^gpio@[0-9a-f]+$"

  compatible:
    items:
      - const: airoha,en7523-gpio

  reg:
    description: |
      The first tuple points to the input register.
      The second and third tuple point to the direction registers
      The fourth tuple points to the output register
    maxItems: 4

  "#gpio-cells":
    const: 2

  gpio-controller: true

required:
  - compatible
  - reg
  - "#gpio-cells"
  - gpio-controller

additionalProperties: false

examples:
  - |
    gpio0: gpio@1fbf0200 {
        compatible = "airoha,en7523-gpio";
        reg = <0x1fbf0204 0x4>,
              <0x1fbf0200 0x4>,
              <0x1fbf0220 0x4>,
              <0x1fbf0214 0x4>;
        gpio-controller;
        #gpio-cells = <2>;
    };

    gpio1: gpio@1fbf0270 {
        compatible = "airoha,en7523-gpio";
        reg = <0x1fbf0270 0x4>,
              <0x1fbf0260 0x4>,
              <0x1fbf0264 0x4>,
              <0x1fbf0278 0x4>;
        gpio-controller;
        #gpio-cells = <2>;
    };

...
```

## Documentation/devicetree/bindings/gpio/altr-pio-1.0.yaml
```yaml
# SPDX-License-Identifier: (GPL-2.0-only OR BSD-2-Clause)
%YAML 1.2
---
$id: http://devicetree.org/schemas/gpio/altr-pio-1.0.yaml#
$schema: http://devicetree.org/meta-schemas/core.yaml#

title: Altera GPIO controller

maintainers:
  - Dinh Nguyen <dinguyen@kernel.org>
  - Marek Vasut <marex@denx.de>
  - Mathieu Malaterre <malat@debian.org>
  - Tien Hock Loh <thloh@altera.com>

properties:
  compatible:
    const: altr,pio-1.0

  reg:
    maxItems: 1

  gpio-controller: true

  "#gpio-cells":
    const: 2
    description:
      First cell is the GPIO offset number. Second cell is reserved and
      currently unused.

  interrupts:
    maxItems: 1

  interrupt-controller: true

  "#interrupt-cells":
    const: 2

  altr,ngpio:
    $ref: /schemas/types.yaml#/definitions/uint32
    description: Width of the GPIO bank.
    default: 32

  altr,interrupt-type:
    $ref: /schemas/types.yaml#/definitions/uint32
    description: >
      Specifies the interrupt trigger type synthesized by hardware.
      Values defined in <dt-bindings/interrupt-controller/irq.h>.
    enum: [1, 2, 3, 4]

required:
  - compatible
  - reg
  - gpio-controller
  - "#gpio-cells"
  - interrupts
  - interrupt-controller
  - "#interrupt-cells"

additionalProperties: false

examples:
  - |
    #include <dt-bindings/interrupt-controller/irq.h>

    gpio@ff200000 {
        compatible = "altr,pio-1.0";
        reg = <0xff200000 0x10>;
        interrupts = <45 4>;
        interrupt-controller;
        #interrupt-cells = <2>;
        gpio-controller;
        #gpio-cells = <2>;
        altr,ngpio = <32>;
        altr,interrupt-type = <IRQ_TYPE_EDGE_RISING>;
    };
```

## Documentation/devicetree/bindings/gpio/apm,xgene-gpio-sb.yaml
```yaml
# SPDX-License-Identifier: (GPL-2.0-only OR BSD-2-Clause)
%YAML 1.2
---
$id: http://devicetree.org/schemas/apm,xgene-gpio-sb.yaml#
$schema: http://devicetree.org/meta-schemas/core.yaml#

title: APM X-Gene Standby GPIO controller

maintainers:
  - Khuong Dinh <khuong@os.amperecomputing.com>

description: |
  This is a gpio controller in the standby domain. It also supports interrupt in
  some particular pins which are sourced to its parent interrupt controller
  as diagram below:
                                +-----------------+
                                | X-Gene standby  |
                                | GPIO controller +------ GPIO_0
    +------------+              |                 | ...
    | Parent IRQ | EXT_INT_0    |                 +------ GPIO_8/EXT_INT_0
    | controller | (SPI40)      |                 | ...
    | (GICv2)    +--------------+                 +------ GPIO_[N+8]/EXT_INT_N
    |            |   ...        |                 |
    |            | EXT_INT_N    |                 +------ GPIO_[N+9]
    |            | (SPI[40 + N])|                 | ...
    |            +--------------+                 +------ GPIO_MAX
    +------------+              +-----------------+

properties:
  compatible:
    const: apm,xgene-gpio-sb

  reg:
    maxItems: 1

  '#gpio-cells':
    const: 2

  gpio-controller: true

  interrupts:
    description:
      List of interrupt specifiers for EXT_INT_0 through EXT_INT_N. The first
      entry must correspond to EXT_INT_0.

  '#interrupt-cells':
    const: 2
    description:
      First cell selects EXT_INT_N (0-N), second cell specifies flags

  interrupt-controller: true

  apm,nr-gpios:
    $ref: /schemas/types.yaml#/definitions/uint32
    description: Number of GPIO pins

  apm,nr-irqs:
    $ref: /schemas/types.yaml#/definitions/uint32
    description: Number of interrupt pins

  apm,irq-start:
    $ref: /schemas/types.yaml#/definitions/uint32
    description: Lowest GPIO pin supporting interrupts

required:
  - compatible
  - reg
  - '#gpio-cells'
  - gpio-controller
  - interrupts
  - '#interrupt-cells'
  - interrupt-controller

additionalProperties: false

examples:
  - |
    gpio@17001000 {
        compatible = "apm,xgene-gpio-sb";
        reg = <0x17001000 0x400>;
        #gpio-cells = <2>;
        gpio-controller;
        interrupts = <0x0 0x28 0x1>,
                     <0x0 0x29 0x1>,
                     <0x0 0x2a 0x1>,
                     <0x0 0x2b 0x1>,
                     <0x0 0x2c 0x1>,
                     <0x0 0x2d 0x1>;
        #interrupt-cells = <2>;
        interrupt-controller;
        apm,nr-gpios = <22>;
        apm,nr-irqs = <6>;
        apm,irq-start = <8>;
    };
```

## Documentation/devicetree/bindings/gpio/apple,smc-gpio.yaml
```yaml
# SPDX-License-Identifier: (GPL-2.0-only OR BSD-2-Clause)
%YAML 1.2
---
$id: http://devicetree.org/schemas/gpio/apple,smc-gpio.yaml#
$schema: http://devicetree.org/meta-schemas/core.yaml#

title: Apple Mac System Management Controller GPIO

maintainers:
  - Sven Peter <sven@kernel.org>

description:
  Apple Mac System Management Controller GPIO block.

properties:
  compatible:
    const: apple,smc-gpio

  gpio-controller: true

  '#gpio-cells':
    const: 2

required:
  - compatible
  - gpio-controller
  - '#gpio-cells'

additionalProperties: false
```
