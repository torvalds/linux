## Documentation/devicetree/bindings/gpio/aspeed,ast2400-gpio.yaml
```yaml
# SPDX-License-Identifier: (GPL-2.0 OR BSD-2-Clause)
%YAML 1.2
---
$id: http://devicetree.org/schemas/gpio/aspeed,ast2400-gpio.yaml#
$schema: http://devicetree.org/meta-schemas/core.yaml#

title: Aspeed GPIO controller

maintainers:
  - Andrew Jeffery <andrew@codeconstruct.com.au>

properties:
  compatible:
    enum:
      - aspeed,ast2400-gpio
      - aspeed,ast2500-gpio
      - aspeed,ast2600-gpio
      - aspeed,ast2700-gpio

  reg:
    maxItems: 1

  clocks:
    maxItems: 1
    description: The clock to use for debounce timings

  gpio-controller: true
  gpio-line-names:
    minItems: 12
    maxItems: 232

  gpio-ranges: true

  "#gpio-cells":
    const: 2

  interrupts:
    maxItems: 1

  interrupt-controller: true

  "#interrupt-cells":
    const: 2

  ngpios:
    minimum: 12
    maximum: 232

patternProperties:
  "-hog(-[0-9]+)?$":
    type: object
    required:
      - gpio-hog

required:
  - compatible
  - reg
  - interrupts
  - interrupt-controller
  - "#interrupt-cells"
  - gpio-controller
  - "#gpio-cells"

allOf:
  - if:
      properties:
        compatible:
          contains:
            const: aspeed,ast2400-gpio
    then:
      properties:
        gpio-line-names:
          minItems: 220
          maxItems: 220
        ngpios:
          const: 220
  - if:
      properties:
        compatible:
          contains:
            const: aspeed,ast2500-gpio
    then:
      properties:
        gpio-line-names:
          minItems: 232
          maxItems: 232
        ngpios:
          const: 232
  - if:
      properties:
        compatible:
          contains:
            const: aspeed,ast2600-gpio
    then:
      properties:
        gpio-line-names:
          minItems: 36
          maxItems: 208
        ngpios:
          enum: [ 36, 208 ]
      required:
        - ngpios
  - if:
      properties:
        compatible:
          contains:
            const: aspeed,ast2700-gpio
    then:
      properties:
        gpio-line-names:
          minItems: 12
          maxItems: 216
        ngpios:
          enum: [ 12, 216 ]
      required:
        - ngpios

additionalProperties: false

examples:
  - |
    gpio@1e780000 {
        compatible = "aspeed,ast2400-gpio";
        reg = <0x1e780000 0x1000>;
        interrupts = <20>;
        interrupt-controller;
        #interrupt-cells = <2>;
        gpio-controller;
        #gpio-cells = <2>;
    };
  - |
    gpio: gpio@1e780000 {
        compatible = "aspeed,ast2500-gpio";
        reg = <0x1e780000 0x200>;
        interrupts = <20>;
        interrupt-controller;
        #interrupt-cells = <2>;
        gpio-controller;
        #gpio-cells = <2>;
        gpio-ranges = <&pinctrl 0 0 232>;
    };
  - |
    #include <dt-bindings/clock/ast2600-clock.h>
    #include <dt-bindings/interrupt-controller/arm-gic.h>
    #include <dt-bindings/interrupt-controller/irq.h>
    gpio0: gpio@1e780000 {
        compatible = "aspeed,ast2600-gpio";
        reg = <0x1e780000 0x400>;
        clocks = <&syscon ASPEED_CLK_APB2>;
        interrupts = <GIC_SPI 40 IRQ_TYPE_LEVEL_HIGH>;
        interrupt-controller;
        #interrupt-cells = <2>;
        #gpio-cells = <2>;
        gpio-controller;
        gpio-ranges = <&pinctrl 0 0 208>;
        ngpios = <208>;
    };
    gpio1: gpio@1e780800 {
        compatible = "aspeed,ast2600-gpio";
        reg = <0x1e780800 0x800>;
        clocks = <&syscon ASPEED_CLK_APB1>;
        interrupts = <GIC_SPI 11 IRQ_TYPE_LEVEL_HIGH>;
        interrupt-controller;
        #interrupt-cells = <2>;
        gpio-controller;
        #gpio-cells = <2>;
        gpio-ranges = <&pinctrl 0 208 36>;
        ngpios = <36>;
    };
```

## Documentation/devicetree/bindings/gpio/aspeed,sgpio.yaml
```yaml
# SPDX-License-Identifier: (GPL-2.0-only OR BSD-2-Clause)
%YAML 1.2
---
$id: http://devicetree.org/schemas/gpio/aspeed,sgpio.yaml#
$schema: http://devicetree.org/meta-schemas/core.yaml#

title: Aspeed SGPIO controller

maintainers:
  - Andrew Jeffery <andrew@aj.id.au>

description:
  This SGPIO controller is for ASPEED AST2400, AST2500 and AST2600 SoC,
  AST2600 have two sgpio master one with 128 pins another one with 80 pins,
  AST2500/AST2400 have one sgpio master with 80 pins. Each of the Serial
  GPIO pins can be programmed to support the following options
  - Support interrupt option for each input port and various interrupt
    sensitivity option (level-high, level-low, edge-high, edge-low)
  - Support reset tolerance option for each output port
  - Directly connected to APB bus and its shift clock is from APB bus clock
    divided by a programmable value.
  - Co-work with external signal-chained TTL components (74LV165/74LV595)

properties:
  compatible:
    enum:
      - aspeed,ast2400-sgpio
      - aspeed,ast2500-sgpio
      - aspeed,ast2600-sgpiom

  reg:
    maxItems: 1

  gpio-controller: true

  '#gpio-cells':
    const: 2

  interrupts:
    maxItems: 1

  interrupt-controller: true

  clocks:
    maxItems: 1

  ngpios: true

  bus-frequency: true

required:
  - compatible
  - reg
  - gpio-controller
  - '#gpio-cells'
  - interrupts
  - interrupt-controller
  - ngpios
  - clocks
  - bus-frequency

additionalProperties: false

examples:
  - |
    #include <dt-bindings/clock/aspeed-clock.h>
    sgpio: sgpio@1e780200 {
        #gpio-cells = <2>;
        compatible = "aspeed,ast2500-sgpio";
        gpio-controller;
        interrupts = <40>;
        reg = <0x1e780200 0x0100>;
        clocks = <&syscon ASPEED_CLK_APB>;
        interrupt-controller;
        ngpios = <80>;
        bus-frequency = <12000000>;
    };
```

## Documentation/devicetree/bindings/gpio/atmel,at91rm9200-gpio.yaml
```yaml
# SPDX-License-Identifier: (GPL-2.0-only OR BSD-2-Clause)
%YAML 1.2
---
$id: http://devicetree.org/schemas/gpio/atmel,at91rm9200-gpio.yaml#
$schema: http://devicetree.org/meta-schemas/core.yaml#

title: Microchip GPIO controller (PIO)

maintainers:
  - Manikandan Muralidharan <manikandan.m@microchip.com>

properties:
  compatible:
    oneOf:
      - items:
          - enum:
              - atmel,at91sam9x5-gpio
              - microchip,sam9x60-gpio
          - const: atmel,at91rm9200-gpio
      - items:
          - enum:
              - microchip,sam9x7-gpio
          - const: microchip,sam9x60-gpio
          - const: atmel,at91rm9200-gpio
      - items:
          - const: atmel,at91rm9200-gpio

  reg:
    maxItems: 1

  interrupts:
    maxItems: 1

  interrupt-controller: true

  "#interrupt-cells":
    const: 2

  gpio-controller: true
  gpio-line-names: true

  "#gpio-cells":
    const: 2

  clocks:
    maxItems: 1

  "#gpio-lines":
    description:
      Number of gpio, 32 by default if absent
    maxItems: 1
    default: 32

required:
  - compatible
  - reg
  - interrupts
  - interrupt-controller
  - "#interrupt-cells"
  - gpio-controller
  - "#gpio-cells"
  - clocks

additionalProperties: false

examples:
  - |
    #include <dt-bindings/clock/at91.h>
    #include <dt-bindings/interrupt-controller/irq.h>

    gpio@fffff400 {
            compatible = "atmel,at91rm9200-gpio";
            reg = <0xfffff400 0x200>;
            interrupts = <2 IRQ_TYPE_LEVEL_HIGH 1>;
            #gpio-cells = <2>;
            gpio-controller;
            interrupt-controller;
            #interrupt-cells = <2>;
            clocks = <&pmc PMC_TYPE_PERIPHERAL 2>;
    };
...
```

## Documentation/devicetree/bindings/gpio/blaize,blzp1600-gpio.yaml
```yaml
# SPDX-License-Identifier: (GPL-2.0 OR BSD-2-Clause)
%YAML 1.2
---
$id: http://devicetree.org/schemas/gpio/blaize,blzp1600-gpio.yaml#
$schema: http://devicetree.org/meta-schemas/core.yaml#

title: Blaize BLZP1600 GPIO controller

description:
  Blaize BLZP1600 GPIO controller is an implementation of the VeriSilicon
  APB GPIO v0.2 IP block. It has 32 ports each of which are intended to be
  represented as child nodes with the generic GPIO-controller properties
  as described in this binding's file.

maintainers:
  - Nikolaos Pasaloukos <nikolaos.pasaloukos@blaize.com>
  - James Cowgill <james.cowgill@blaize.com>
  - Matt Redfearn <matt.redfearn@blaize.com>
  - Neil Jones <neil.jones@blaize.com>

properties:
  $nodename:
    pattern: "^gpio@[0-9a-f]+$"

  compatible:
    enum:
      - blaize,blzp1600-gpio

  reg:
    maxItems: 1

  gpio-controller: true

  '#gpio-cells':
    const: 2

  ngpios:
    default: 32
    minimum: 1
    maximum: 32

  interrupts:
    maxItems: 1

  gpio-line-names: true

  interrupt-controller: true

  '#interrupt-cells':
    const: 2

required:
  - compatible
  - reg
  - gpio-controller
  - '#gpio-cells'

dependencies:
  interrupt-controller: [ interrupts ]

additionalProperties: false

examples:
  - |
    #include <dt-bindings/interrupt-controller/arm-gic.h>

    gpio: gpio@4c0000 {
      compatible = "blaize,blzp1600-gpio";
      reg = <0x004c0000 0x1000>;
      gpio-controller;
      #gpio-cells = <2>;
      ngpios = <32>;
      interrupt-controller;
      #interrupt-cells = <2>;
      interrupts = <GIC_SPI 3 IRQ_TYPE_LEVEL_HIGH>;
    };
...
```

## Documentation/devicetree/bindings/gpio/brcm,bcm6345-gpio.txt
```
Bindings for the Broadcom's brcm,bcm6345-gpio memory-mapped GPIO controllers.

These bindings can be used on any BCM63xx SoC. However, BCM6338 and BCM6345
are the only ones which don't need a pinctrl driver.
BCM6338 have 8-bit data and dirout registers, where GPIO state can be read
and/or written, and the direction changed from input to output.
BCM6345 have 16-bit data and dirout registers, where GPIO state can be read
and/or written, and the direction changed from input to output.

Required properties:
	- compatible: should be "brcm,bcm6345-gpio"
	- reg-names: must contain
		"dat" - data register
		"dirout" - direction (output) register
	- reg: address + size pairs describing the GPIO register sets;
		order must correspond with the order of entries in reg-names
	- #gpio-cells: must be set to 2. The first cell is the pin number and
			the second cell is used to specify the gpio polarity:
			0 = active high
			1 = active low
	- gpio-controller: Marks the device node as a gpio controller.

Optional properties:
	- native-endian: use native endian memory.

Examples:
	- BCM6338:
	gpio: gpio-controller@fffe0407 {
		compatible = "brcm,bcm6345-gpio";
		reg-names = "dirout", "dat";
		reg = <0xfffe0407 1>, <0xfffe040f 1>;

		#gpio-cells = <2>;
		gpio-controller;
	};

	- BCM6345:
	gpio: gpio-controller@fffe0406 {
		compatible = "brcm,bcm6345-gpio";
		reg-names = "dirout", "dat";
		reg = <0xfffe0406 2>, <0xfffe040a 2>;
		native-endian;

		#gpio-cells = <2>;
		gpio-controller;
	};
```

## Documentation/devicetree/bindings/gpio/brcm,bcm63xx-gpio.yaml
```yaml
# SPDX-License-Identifier: GPL-2.0-only OR BSD-2-Clause
%YAML 1.2
---
$id: http://devicetree.org/schemas/gpio/brcm,bcm63xx-gpio.yaml#
$schema: http://devicetree.org/meta-schemas/core.yaml#

title: Broadcom BCM63xx GPIO controller

maintainers:
  - Álvaro Fernández Rojas <noltari@gmail.com>
  - Jonas Gorski <jonas.gorski@gmail.com>

description: |+
  Bindings for Broadcom's BCM63xx memory-mapped GPIO controllers.

  These bindings can be used on any BCM63xx SoC. However, BCM6338 and BCM6345
  are the only ones which don't need a pinctrl driver.

  BCM6338 have 8-bit data and dirout registers, where GPIO state can be read
  and/or written, and the direction changed from input to output.
  BCM6318, BCM6328, BCM6358, BCM6362, BCM6368 and BCM63268 have 32-bit data
  and dirout registers, where GPIO state can be read and/or written, and the
  direction changed from input to output.

properties:
  compatible:
    enum:
      - brcm,bcm6318-gpio
      - brcm,bcm6328-gpio
      - brcm,bcm6358-gpio
      - brcm,bcm6362-gpio
      - brcm,bcm6368-gpio
      - brcm,bcm63268-gpio

  gpio-controller: true

  "#gpio-cells":
    const: 2

  gpio-ranges:
    maxItems: 1

  native-endian: true

  reg:
    maxItems: 2

  reg-names:
    items:
      - const: dirout
      - const: dat

required:
  - compatible
  - reg
  - reg-names
  - gpio-controller
  - '#gpio-cells'

additionalProperties: false

examples:
  - |
    gpio@0 {
      compatible = "brcm,bcm63268-gpio";
      reg-names = "dirout", "dat";
      reg = <0x0 0x8>, <0x8 0x8>;

      gpio-controller;
      gpio-ranges = <&pinctrl 0 0 52>;
      #gpio-cells = <2>;
    };
```

## Documentation/devicetree/bindings/gpio/brcm,brcmstb-gpio.txt
```
Broadcom STB "UPG GIO" GPIO controller

The controller's registers are organized as sets of eight 32-bit
registers with each set controlling a bank of up to 32 pins.  A single
interrupt is shared for all of the banks handled by the controller.

Required properties:

- compatible:
    Must be "brcm,brcmstb-gpio"

- reg:
    Define the base and range of the I/O address space containing
    the brcmstb GPIO controller registers

- #gpio-cells:
    Should be <2>.  The first cell is the pin number (within the controller's
    pin space), and the second is used for the following:
    bit[0]: polarity (0 for active-high, 1 for active-low)

- gpio-controller:
    Specifies that the node is a GPIO controller.

- brcm,gpio-bank-widths:
    Number of GPIO lines for each bank.  Number of elements must
    correspond to number of banks suggested by the 'reg' property.

Optional properties:

- interrupts:
    The interrupt shared by all GPIO lines for this controller.

- interrupts-extended:
    Alternate form of specifying interrupts and parents that allows for
    multiple parents.  This takes precedence over 'interrupts' and
    'interrupt-parent'.  Wakeup-capable GPIO controllers often route their
    wakeup interrupt lines through a different interrupt controller than the
    primary interrupt line, making this property necessary.

- #interrupt-cells:
    Should be <2>.  The first cell is the GPIO number, the second should specify
    flags.  The following subset of flags is supported:
    - bits[3:0] trigger type and level flags
        1 = low-to-high edge triggered
        2 = high-to-low edge triggered
        4 = active high level-sensitive
        8 = active low level-sensitive
      Valid combinations are 1, 2, 3, 4, 8.
    See also Documentation/devicetree/bindings/interrupt-controller/interrupts.txt

- interrupt-controller:
    Marks the device node as an interrupt controller

- wakeup-source:
    GPIOs for this controller can be used as a wakeup source

Example:
	upg_gio: gpio@f040a700 {
		#gpio-cells = <2>;
		#interrupt-cells = <2>;
		compatible = "brcm,bcm7445-gpio", "brcm,brcmstb-gpio";
		gpio-controller;
		interrupt-controller;
		reg = <0xf040a700 0x80>;
		interrupt-parent = <&irq0_intc>;
		interrupts = <0x6>;
		brcm,gpio-bank-widths = <32 32 32 24>;
	};

	upg_gio_aon: gpio@f04172c0 {
		#gpio-cells = <2>;
		#interrupt-cells = <2>;
		compatible = "brcm,bcm7445-gpio", "brcm,brcmstb-gpio";
		gpio-controller;
		interrupt-controller;
		reg = <0xf04172c0 0x40>;
		interrupt-parent = <&irq0_aon_intc>;
		interrupts = <0x6>;
		interrupts-extended = <&irq0_aon_intc 0x6>,
			<&aon_pm_l2_intc 0x5>;
		wakeup-source;
		brcm,gpio-bank-widths = <18 4>;
	};
```
