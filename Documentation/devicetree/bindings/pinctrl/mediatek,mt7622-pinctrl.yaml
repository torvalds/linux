## Documentation/devicetree/bindings/pinctrl/microchip,pic64gx-pinctrl-gpio2.yaml
```yaml
# SPDX-License-Identifier: GPL-2.0-only OR BSD-2-Clause
%YAML 1.2
---
$id: http://devicetree.org/schemas/pinctrl/microchip,pic64gx-pinctrl-gpio2.yaml#
$schema: http://devicetree.org/meta-schemas/core.yaml#

title: Microchip PIC64GX GPIO2 Mux

maintainers:
  - Conor Dooley <conor.dooley@microchip.com>

description:
  The "GPIO2 Mux" determines whether GPIO2 or select other functions are
  available on package pins on PIC64GX. Some of these functions must be
  mapped to this mux via iomux0 for settings here to have any impact.

properties:
  compatible:
    const: microchip,pic64gx-pinctrl-gpio2

  reg:
    maxItems: 1

  pinctrl-use-default: true

patternProperties:
  '^mux-':
    type: object
    $ref: pinmux-node.yaml
    additionalProperties: false

    properties:
      function:
        description:
          A string containing the name of the function to mux to the group.
        enum: [ mdio0, mdio1, spi0, can0, pcie, qspi, uart3, uart4, can1, uart2, gpio ]

      groups:
        description:
          An array of strings. Each string contains the name of a group.
        items:
          enum: [ mdio0, mdio1, spi0, can0, pcie, qspi, uart3, uart4, can1, uart2,
                  gpio_mdio0, gpio_mdio1, gpio_spi0, gpio_can0, gpio_pcie,
                  gpio_qspi, gpio_uart3, gpio_uart4, gpio_can1, gpio_uart2 ]

    required:
      - function
      - groups

required:
  - compatible
  - reg

additionalProperties: false

examples:
  - |
    pinctrl@41000000 {
      compatible = "microchip,pic64gx-pinctrl-gpio2";
      reg = <0x41000000 0x4>;
      pinctrl-use-default;
      pinctrl-names = "default";
      pinctrl-0 = <&mdio0_gpio2>, <&mdio1_gpio2>, <&spi0_gpio2>, <&qspi_gpio2>,
                  <&uart3_gpio2>, <&uart4_gpio2>, <&can1_gpio2>, <&can0_gpio2>,
                  <&uart2_gpio2>;

      mux-gpio2 {
        function = "gpio";
        groups = "gpio_mdio1", "gpio_spi0", "gpio_can0", "gpio_pcie",
                 "gpio_qspi", "gpio_uart3", "gpio_uart4", "gpio_can1";
      };
    };

...
```

## Documentation/devicetree/bindings/pinctrl/microchip,sparx5-sgpio.yaml
```yaml
# SPDX-License-Identifier: GPL-2.0-only OR BSD-2-Clause
%YAML 1.2
---
$id: http://devicetree.org/schemas/pinctrl/microchip,sparx5-sgpio.yaml#
$schema: http://devicetree.org/meta-schemas/core.yaml#

title: Microsemi/Microchip Serial GPIO controller

maintainers:
  - Lars Povlsen <lars.povlsen@microchip.com>

description: |
  By using a serial interface, the SIO controller significantly extend
  the number of available GPIOs with a minimum number of additional
  pins on the device. The primary purpose of the SIO controllers is to
  connect control signals from SFP modules and to act as an LED
  controller.

properties:
  $nodename:
    pattern: "^gpio@[0-9a-f]+$"

  compatible:
    enum:
      - microchip,sparx5-sgpio
      - mscc,ocelot-sgpio
      - mscc,luton-sgpio

  "#address-cells":
    const: 1

  "#size-cells":
    const: 0

  reg:
    maxItems: 1

  clocks:
    maxItems: 1

  microchip,sgpio-port-ranges:
    description: This is a sequence of tuples, defining intervals of
      enabled ports in the serial input stream. The enabled ports must
      match the hardware configuration in order for signals to be
      properly written/read to/from the controller holding
      registers. Being tuples, then number of arguments must be
      even. The tuples mast be ordered (low, high) and are
      inclusive.
    $ref: /schemas/types.yaml#/definitions/uint32-matrix
    items:
      items:
        - description: |
            "low" indicates start bit number of range
          minimum: 0
          maximum: 31
        - description: |
            "high" indicates end bit number of range
          minimum: 0
          maximum: 31
    minItems: 1
    maxItems: 32

  bus-frequency:
    description: The sgpio controller frequency (Hz). This dictates
      the serial bitstream speed, which again affects the latency in
      getting control signals back and forth between external shift
      registers. The speed must be no larger than half the system
      clock, and larger than zero.
    default: 12500000

patternProperties:
  "^gpio@[0-1]$":
    type: object
    properties:
      compatible:
        const: microchip,sparx5-sgpio-bank

      reg:
        description: |
          The GPIO bank number. "0" is designates the input pin bank,
          "1" the output bank.
        maxItems: 1

      gpio-controller: true

      '#gpio-cells':
        description: |
         Specifies the pin (port and bit) and flags. Note that the
         SGIO pin is defined by *2* numbers, a port number between 0
         and 31, and a bit index, 0 to 3. The maximum bit number is
         controlled indirectly by the "ngpios" property: (ngpios/32).
        const: 3

      interrupts:
        description: Specifies the sgpio IRQ (in parent controller)
        maxItems: 1

      interrupt-controller: true

      '#interrupt-cells':
        description:
          Specifies the pin (port and bit) and flags, as defined in
          defined in include/dt-bindings/interrupt-controller/irq.h
        const: 3

      ngpios:
        description: The numbers of GPIO's exposed. This must be a
          multiple of 32.
        minimum: 32
        maximum: 128

    required:
      - compatible
      - reg
      - gpio-controller
      - '#gpio-cells'
      - ngpios

    additionalProperties: false

additionalProperties: false

required:
  - compatible
  - reg
  - clocks
  - microchip,sgpio-port-ranges
  - "#address-cells"
  - "#size-cells"

examples:
  - |
    #include <dt-bindings/interrupt-controller/arm-gic.h>
    sgpio2: gpio@1101059c {
      #address-cells = <1>;
      #size-cells = <0>;
      compatible = "microchip,sparx5-sgpio";
      clocks = <&sys_clk>;
      pinctrl-0 = <&sgpio2_pins>;
      pinctrl-names = "default";
      reg = <0x1101059c 0x118>;
      microchip,sgpio-port-ranges = <0 0>, <16 18>, <28 31>;
      bus-frequency = <25000000>;
      sgpio_in2: gpio@0 {
        reg = <0>;
        compatible = "microchip,sparx5-sgpio-bank";
        gpio-controller;
        #gpio-cells = <3>;
        ngpios = <96>;
        interrupts = <GIC_SPI 19 IRQ_TYPE_LEVEL_HIGH>;
        interrupt-controller;
        #interrupt-cells = <3>;
      };
      sgpio_out2: gpio@1 {
        compatible = "microchip,sparx5-sgpio-bank";
        reg = <1>;
        gpio-controller;
        #gpio-cells = <3>;
        ngpios = <96>;
      };
    };
```

## Documentation/devicetree/bindings/pinctrl/mobileye,eyeq5-pinctrl.yaml
```yaml
# SPDX-License-Identifier: (GPL-2.0-only OR BSD-2-Clause)
%YAML 1.2
---
$id: http://devicetree.org/schemas/pinctrl/mobileye,eyeq5-pinctrl.yaml#
$schema: http://devicetree.org/meta-schemas/core.yaml#

title: Mobileye EyeQ5 pin controller

description: >
  The EyeQ5 pin controller handles the two pin banks of the system. It belongs
  to a system-controller block called OLB.

  Pin control is about bias (pull-down, pull-up), drive strength and muxing. Pin
  muxing supports two functions for each pin: first is GPIO, second is
  pin-dependent.

  Pins and groups are bijective.

maintainers:
  - Grégory Clement <gregory.clement@bootlin.com>
  - Théo Lebrun <theo.lebrun@bootlin.com>
  - Vladimir Kondratiev <vladimir.kondratiev@mobileye.com>

$ref: pinctrl.yaml#

properties:
  compatible:
    enum:
      - mobileye,eyeq5-pinctrl

  reg:
    maxItems: 1

patternProperties:
  "-pins?$":
    type: object
    description: Pin muxing configuration.
    $ref: pinmux-node.yaml#
    additionalProperties: false
    properties:
      pins: true
      function:
        enum: [gpio,
               # Bank A
               timer0, timer1, timer2, timer5, uart0, uart1, can0, can1, spi0,
               spi1, refclk0,
               # Bank B
               timer3, timer4, timer6, uart2, can2, spi2, spi3, mclk0]
      bias-disable: true
      bias-pull-down: true
      bias-pull-up: true
      drive-strength: true
    required:
      - pins
      - function
    allOf:
      - if:
          properties:
            function:
              const: gpio
        then:
          properties:
            pins:
              items: # PA0 - PA28, PB0 - PB22
                pattern: '^(P(A|B)1?[0-9]|PA2[0-8]|PB2[0-2])$'
      - if:
          properties:
            function:
              const: timer0
        then:
          properties:
            pins:
              items:
                enum: [PA0, PA1]
      - if:
          properties:
            function:
              const: timer1
        then:
          properties:
            pins:
              items:
                enum: [PA2, PA3]
      - if:
          properties:
            function:
              const: timer2
        then:
          properties:
            pins:
              items:
                enum: [PA4, PA5]
      - if:
          properties:
            function:
              const: timer5
        then:
          properties:
            pins:
              items:
                enum: [PA6, PA7, PA8, PA9]
      - if:
          properties:
            function:
              const: uart0
        then:
          properties:
            pins:
              items:
                enum: [PA10, PA11]
      - if:
          properties:
            function:
              const: uart1
        then:
          properties:
            pins:
              items:
                enum: [PA12, PA13]
      - if:
          properties:
            function:
              const: can0
        then:
          properties:
            pins:
              items:
                enum: [PA14, PA15]
      - if:
          properties:
            function:
              const: can1
        then:
          properties:
            pins:
              items:
                enum: [PA16, PA17]
      - if:
          properties:
            function:
              const: spi0
        then:
          properties:
            pins:
              items:
                enum: [PA18, PA19, PA20, PA21, PA22]
      - if:
          properties:
            function:
              const: spi1
        then:
          properties:
            pins:
              items:
                enum: [PA23, PA24, PA25, PA26, PA27]
      - if:
          properties:
            function:
              const: refclk0
        then:
          properties:
            pins:
              items:
                enum: [PA28]
      - if:
          properties:
            function:
              const: timer3
        then:
          properties:
            pins:
              items:
                enum: [PB0, PB1]
      - if:
          properties:
            function:
              const: timer4
        then:
          properties:
            pins:
              items:
                enum: [PB2, PB3]
      - if:
          properties:
            function:
              const: timer6
        then:
          properties:
            pins:
              items:
                enum: [PB4, PB5, PB6, PB7]
      - if:
          properties:
            function:
              const: uart2
        then:
          properties:
            pins:
              items:
                enum: [PB8, PB9]
      - if:
          properties:
            function:
              const: can2
        then:
          properties:
            pins:
              items:
                enum: [PB10, PB11]
      - if:
          properties:
            function:
              const: spi2
        then:
          properties:
            pins:
              items:
                enum: [PB12, PB13, PB14, PB15, PB16]
      - if:
          properties:
            function:
              const: spi3
        then:
          properties:
            pins:
              items:
                enum: [PB17, PB18, PB19, PB20, PB21]
      - if:
          properties:
            function:
              const: mclk0
        then:
          properties:
            pins:
              items:
                enum: [PB22]

required:
  - compatible
  - reg

additionalProperties: false
```

## Documentation/devicetree/bindings/pinctrl/mscc,ocelot-pinctrl.txt
```
Microsemi Ocelot pin controller Device Tree Bindings
----------------------------------------------------

Required properties:
 - compatible		: Should be "mscc,ocelot-pinctrl"
 - reg			: Address and length of the register set for the device
 - gpio-controller	: Indicates this device is a GPIO controller
 - #gpio-cells		: Must be 2.
			  The first cell is the pin number and the
			  second cell specifies GPIO flags, as defined in
			  <dt-bindings/gpio/gpio.h>.
 - gpio-ranges		: Range of pins managed by the GPIO controller.


The ocelot-pinctrl driver uses the generic pin multiplexing and generic pin
configuration documented in pinctrl-bindings.txt.

The following generic properties are supported:
 - function
 - pins

Example:
	gpio: pinctrl@71070034 {
		compatible = "mscc,ocelot-pinctrl";
		reg = <0x71070034 0x28>;
		gpio-controller;
		#gpio-cells = <2>;
		gpio-ranges = <&gpio 0 0 22>;

		uart_pins: uart-pins {
				pins = "GPIO_6", "GPIO_7";
				function = "uart";
		};

		uart2_pins: uart2-pins {
				pins = "GPIO_12", "GPIO_13";
				function = "uart2";
		};
	};
```

## Documentation/devicetree/bindings/pinctrl/mscc,ocelot-pinctrl.yaml
```yaml
# SPDX-License-Identifier: GPL-2.0-only OR BSD-2-Clause
%YAML 1.2
---
$id: http://devicetree.org/schemas/pinctrl/mscc,ocelot-pinctrl.yaml#
$schema: http://devicetree.org/meta-schemas/core.yaml#

title: Microsemi Ocelot pin controller

maintainers:
  - Alexandre Belloni <alexandre.belloni@bootlin.com>
  - Lars Povlsen <lars.povlsen@microchip.com>

properties:
  compatible:
    enum:
      - microchip,lan966x-pinctrl
      - microchip,sparx5-pinctrl
      - mscc,jaguar2-pinctrl
      - mscc,luton-pinctrl
      - mscc,ocelot-pinctrl
      - mscc,serval-pinctrl
      - mscc,servalt-pinctrl

  reg:
    items:
      - description: Base address
      - description: Extended pin configuration registers
    minItems: 1

  gpio-controller: true

  '#gpio-cells':
    const: 2

  gpio-ranges: true

  interrupts:
    maxItems: 1

  interrupt-controller: true

  "#interrupt-cells":
    const: 2

  resets:
    maxItems: 1

  reset-names:
    description: Optional shared switch reset.
    items:
      - const: switch

patternProperties:
  '-pins$':
    type: object
    allOf:
      - $ref: pinmux-node.yaml
      - $ref: pincfg-node.yaml

    properties:
      function: true
      pins: true
      output-high: true
      output-low: true
      drive-strength: true

    required:
      - function
      - pins

    additionalProperties: false

required:
  - compatible
  - reg
  - gpio-controller
  - '#gpio-cells'
  - gpio-ranges

allOf:
  - $ref: pinctrl.yaml#
  - if:
      properties:
        compatible:
          contains:
            enum:
              - microchip,lan966x-pinctrl
              - microchip,sparx5-pinctrl
    then:
      properties:
        reg:
          minItems: 2

additionalProperties: false

examples:
  - |
    gpio: pinctrl@71070034 {
        compatible = "mscc,ocelot-pinctrl";
        reg = <0x71070034 0x28>;
        gpio-controller;
        #gpio-cells = <2>;
        gpio-ranges = <&gpio 0 0 22>;

        uart_pins: uart-pins {
            pins = "GPIO_6", "GPIO_7";
            function = "uart";
        };

        uart2_pins: uart2-pins {
            pins = "GPIO_12", "GPIO_13";
            function = "uart2";
        };
    };

...
```
