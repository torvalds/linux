## Documentation/devicetree/bindings/pinctrl/meson,pinctrl.txt
```
== Amlogic Meson pinmux controller ==

Required properties for the root node:
 - compatible: one of "amlogic,meson8-cbus-pinctrl"
		      "amlogic,meson8b-cbus-pinctrl"
		      "amlogic,meson8m2-cbus-pinctrl"
		      "amlogic,meson8-aobus-pinctrl"
		      "amlogic,meson8b-aobus-pinctrl"
		      "amlogic,meson8m2-aobus-pinctrl"
		      "amlogic,meson-gxbb-periphs-pinctrl"
		      "amlogic,meson-gxbb-aobus-pinctrl"
		      "amlogic,meson-gxl-periphs-pinctrl"
		      "amlogic,meson-gxl-aobus-pinctrl"
		      "amlogic,meson-axg-periphs-pinctrl"
		      "amlogic,meson-axg-aobus-pinctrl"
		      "amlogic,meson-g12a-periphs-pinctrl"
		      "amlogic,meson-g12a-aobus-pinctrl"
		      "amlogic,meson-a1-periphs-pinctrl"
 - reg: address and size of registers controlling irq functionality

=== GPIO sub-nodes ===

The GPIO bank for the controller is represented as a sub-node and it acts as a
GPIO controller.

Required properties for sub-nodes are:
 - reg: should contain a list of address and size, one tuple for each entry
   in reg-names.
 - reg-names: an array of strings describing the "reg" entries.
   Must contain "mux" and "gpio".
   May contain "pull", "pull-enable" and "ds" when appropriate.
 - gpio-controller: identifies the node as a gpio controller
 - #gpio-cells: must be 2

=== Other sub-nodes ===

Child nodes without the "gpio-controller" represent some desired
configuration for a pin or a group. Those nodes can be pinmux nodes or
configuration nodes.

Required properties for pinmux nodes are:
 - groups: a list of pinmux groups. The list of all available groups
   depends on the SoC and can be found in driver sources.
 - function: the name of a function to activate for the specified set
   of groups. The list of all available functions depends on the SoC
   and can be found in driver sources.

Required properties for configuration nodes:
 - pins: a list of pin names

Configuration nodes support the following generic properties, as
described in file pinctrl-bindings.txt:
 - "bias-disable"
 - "bias-pull-up"
 - "bias-pull-down"
 - "output-enable"
 - "output-disable"
 - "output-low"
 - "output-high"

Optional properties :
 - drive-strength-microamp: Drive strength for the specified pins in uA.
			    This property is only valid for G12A and newer.

=== Example ===

	pinctrl: pinctrl@c1109880 {
		compatible = "amlogic,meson8-cbus-pinctrl";
		reg = <0xc1109880 0x10>;
		#address-cells = <1>;
		#size-cells = <1>;
		ranges;

		gpio: banks@c11080b0 {
			reg = <0xc11080b0 0x28>,
			      <0xc11080e8 0x18>,
			      <0xc1108120 0x18>,
			      <0xc1108030 0x30>;
			reg-names = "mux", "pull", "pull-enable", "gpio";
			gpio-controller;
			#gpio-cells = <2>;
               };

		nand {
			mux {
				groups = "nand_io", "nand_io_ce0", "nand_io_ce1",
					 "nand_io_rb0", "nand_ale", "nand_cle",
					 "nand_wen_clk", "nand_ren_clk", "nand_dqs",
					 "nand_ce2", "nand_ce3";
				function = "nand";
			};
		};
	};
```

## Documentation/devicetree/bindings/pinctrl/microchip,mcp23s08.yaml
```yaml
# SPDX-License-Identifier: GPL-2.0-only
%YAML 1.2
---
$id: http://devicetree.org/schemas/pinctrl/microchip,mcp23s08.yaml#
$schema: http://devicetree.org/meta-schemas/core.yaml#

title: Microchip I/O expander with serial interface (I2C/SPI)

maintainers:
  - Himanshu Bhavani <himanshu.bhavani@siliconsignals.io>

description:
  Microchip MCP23008, MCP23017, MCP23S08, MCP23S17, MCP23S18 GPIO expander
  chips.These chips provide 8 or 16 GPIO pins with either I2C or SPI interface.

allOf:
  - $ref: /schemas/spi/spi-peripheral-props.yaml#

properties:
  compatible:
    enum:
      - microchip,mcp23s08
      - microchip,mcp23s17
      - microchip,mcp23s18
      - microchip,mcp23008
      - microchip,mcp23017
      - microchip,mcp23018

  reg:
    maxItems: 1

  gpio-controller: true

  '#gpio-cells':
    const: 2

  interrupt-controller: true

  '#interrupt-cells':
    const: 2

  interrupts:
    maxItems: 1

  reset-gpios:
    description: GPIO specifier for active-low reset pin.
    maxItems: 1

  microchip,spi-present-mask:
    description:
      Multiple SPI chips can share the same SPI chipselect. Set a bit in
      bit0-7 in this mask to 1 if there is a chip connected with the
      corresponding spi address set. For example if you have a chip with
      address 3 connected, you have to set bit3 to 1, which is 0x08. mcp23s08
      chip variant only supports bits 0-3. It is not possible to mix mcp23s08
      and mcp23s17 on the same chipselect. Set at least one bit to 1 for SPI
      chips.
    $ref: /schemas/types.yaml#/definitions/uint8

  microchip,irq-mirror:
    type: boolean
    description:
      Sets the mirror flag in the IOCON register. Devices with two interrupt
      outputs (these are the devices ending with 17 and those that have 16 IOs)
      have two IO banks IO 0-7 form bank 1 and IO 8-15 are bank 2. These chips
      have two different interrupt outputs One for bank 1 and another for
      bank 2. If irq-mirror is set, both interrupts are generated regardless of
      the bank that an input change occurred on. If it is not set,the interrupt
      are only generated for the bank they belong to.

  microchip,irq-active-high:
    type: boolean
    description:
      Sets the INTPOL flag in the IOCON register.This configures the IRQ output
      polarity as active high.

  drive-open-drain:
    type: boolean
    description:
      Sets the ODR flag in the IOCON register. This configures the IRQ output as
      open drain active low.

  pinmux:
    type: object
    properties:
      pins:
        description:
          The list of GPIO pins controlled by this node. Each pin name
          corresponds to a physical pin on the GPIO expander.
        items:
          pattern: '^gpio([0-9]|[1][0-5])$'
        maxItems: 16

      bias-pull-up:
        type: boolean
        description:
          Configures pull-up resistors for the GPIO pins. Absence of this
          property will leave the configuration in its default state.

    required:
      - pins

    additionalProperties: false

required:
  - compatible
  - reg
  - gpio-controller
  - '#gpio-cells'

unevaluatedProperties: false

examples:
  - |
    #include <dt-bindings/interrupt-controller/irq.h>
    #include <dt-bindings/gpio/gpio.h>

    i2c {
        #address-cells = <1>;
        #size-cells = <0>;

        gpio@21 {
            compatible = "microchip,mcp23017";
            reg = <0x21>;
            gpio-controller;
            #gpio-cells = <2>;

            interrupt-parent = <&gpio1>;
            interrupts = <17 IRQ_TYPE_LEVEL_LOW>;
            interrupt-controller;
            #interrupt-cells = <2>;

            microchip,irq-mirror;
            pinctrl-names = "default";
            pinctrl-0 = <&pinctrl_i2c_gpio0>, <&gpiopullups>;
            reset-gpios = <&gpio6 15 GPIO_ACTIVE_LOW>;

            gpiopullups: pinmux {
                pins = "gpio0", "gpio1", "gpio2", "gpio3",
                       "gpio4", "gpio5", "gpio6", "gpio7",
                       "gpio8", "gpio9", "gpio10", "gpio11",
                       "gpio12", "gpio13", "gpio14", "gpio15";
                bias-pull-up;
            };
        };
    };

  - |
    spi {
        #address-cells = <1>;
        #size-cells = <0>;

        gpio@0 {
            compatible = "microchip,mcp23s17";
            reg = <0>;
            gpio-controller;
            #gpio-cells = <2>;
            spi-max-frequency = <1000000>;
            microchip,spi-present-mask = /bits/ 8 <0x01>;
        };
    };
```

## Documentation/devicetree/bindings/pinctrl/microchip,mpfs-pinctrl-iomux0.yaml
```yaml
# SPDX-License-Identifier: GPL-2.0-only OR BSD-2-Clause
%YAML 1.2
---
$id: http://devicetree.org/schemas/pinctrl/microchip,mpfs-pinctrl-iomux0.yaml#
$schema: http://devicetree.org/meta-schemas/core.yaml#

title: Microchip PolarFire SoC iomux0

maintainers:
  - Conor Dooley <conor.dooley@microchip.com>

description:
  iomux0 is responsible for routing some functions to either the FPGA fabric,
  or to MSSIOs. It only performs muxing, and has no IO configuration role, as
  fabric IOs are configured separately and just routing a function to MSSIOs is
  not sufficient for it to actually get mapped to an MSSIO, just makes it
  possible.

properties:
  compatible:
    oneOf:
      - const: microchip,mpfs-pinctrl-iomux0
      - items:
          - const: microchip,pic64gx-pinctrl-iomux0
          - const: microchip,mpfs-pinctrl-iomux0

  reg:
    maxItems: 1

  pinctrl-use-default: true

patternProperties:
  '^mux-':
    type: object
    $ref: pinmux-node.yaml
    additionalProperties: false

    properties:
      function:
        description:
          A string containing the name of the function to mux to the group.
        enum: [ spi0, spi1, i2c0, i2c1, can0, can1, qspi, uart0, uart1, uart2,
                uart3, uart4, mdio0, mdio1 ]

      groups:
        description:
          An array of strings. Each string contains the name of a group.
        items:
          enum: [ spi0_fabric, spi0_mssio, spi1_fabric, spi1_mssio, i2c0_fabric,
                  i2c0_mssio, i2c1_fabric, i2c1_mssio, can0_fabric, can0_mssio,
                  can1_fabric, can1_mssio, qspi_fabric, qspi_mssio,
                  uart0_fabric, uart0_mssio, uart1_fabric, uart1_mssio,
                  uart2_fabric, uart2_mssio, uart3_fabric, uart3_mssio,
                  uart4_fabric, uart4_mssio, mdio0_fabric, mdio0_mssio,
                  mdio1_fabric, mdio1_mssio ]

    required:
      - function
      - groups

required:
  - compatible
  - reg

additionalProperties: false

examples:
  - |
    soc {
      #size-cells = <1>;
      #address-cells = <1>;

      pinctrl@200 {
        compatible = "microchip,mpfs-pinctrl-iomux0";
        reg = <0x200 0x4>;

        mux-spi0-fabric {
          function = "spi0";
          groups = "spi0_fabric";
        };

        mux-spi1-mssio {
          function = "spi1";
          groups = "spi1_mssio";
        };
      };
    };

...
```

## Documentation/devicetree/bindings/pinctrl/microchip,mpfs-pinctrl-mssio.yaml
```yaml
# SPDX-License-Identifier: GPL-2.0-only OR BSD-2-Clause
%YAML 1.2
---
$id: http://devicetree.org/schemas/pinctrl/microchip,mpfs-pinctrl-mssio.yaml#
$schema: http://devicetree.org/meta-schemas/core.yaml#

title: Microchip Polarfire SoC MSSIO pinctrl

maintainers:
  - Conor Dooley <conor.dooley@microchip.com>

properties:
  compatible:
    oneOf:
      - const: microchip,mpfs-pinctrl-mssio
      - items:
          - const: microchip,pic64gx-pinctrl-mssio
          - const: microchip,mpfs-pinctrl-mssio

  reg:
    maxItems: 1

  pinctrl-use-default: true

patternProperties:
  '-cfg$':
    type: object
    additionalProperties: false

    patternProperties:
      '-pins$':
        type: object
        additionalProperties: false

        allOf:
          - $ref: pincfg-node.yaml#
          - $ref: pinmux-node.yaml#

        properties:
          pins:
            description:
              The list of IOs that properties in the pincfg node apply to.

          function:
            description:
              A string containing the name of the function to mux for these
              pins. The "reserved" function tristates a pin.
            enum: [ sd, emmc, qspi, spi, usb, uart, i2c, can, mdio, misc
                    reserved, gpio, fabric-test, tied-low, tied-high, tristate ]

          bias-bus-hold: true
          bias-disable: true
          bias-pull-down: true
          bias-pull-up: true
          input-schmitt-enable: true
          low-power-enable: true

          drive-strength:
            enum: [ 2, 4, 6, 8, 10, 12, 16, 20 ]

          power-source:
            description:
              Which bank voltage to use. This cannot differ for pins in a
              given bank, the whole bank uses the same voltage.
            enum: [ 1200000, 1500000, 1800000, 2500000, 3300000 ]

          microchip,clamp-diode:
            $ref: /schemas/types.yaml#/definitions/flag
            description:
              Reflects the "Clamp Diode" setting in the MSS Configurator for
              this pin. This setting controls whether or not input voltage
              clamping should be enabled.

          microchip,ibufmd:
            $ref: /schemas/types.yaml#/definitions/uint32
            default: 0
            description:
              Reflects the "IBUFMD" bits in the MSS Configurator output files
              for this pin.

        required:
          - pins
          - function
          - power-source

required:
  - compatible
  - reg

additionalProperties: false

examples:
  - |
    pinctrl@204 {
      compatible = "microchip,mpfs-pinctrl-mssio";
      reg = <0x204 0x7c>;

      ikrd-spi1-cfg {
        spi1-pins {
          pins = <30>, <31>, <32>, <33>;
          function = "spi";
          bias-pull-up;
          drive-strength = <8>;
          power-source = <3300000>;
          microchip,ibufmd = <0x1>;
        };
      };
    };
...
```

## Documentation/devicetree/bindings/pinctrl/microchip,pic32-pinctrl.txt
```
* Microchip PIC32 Pin Controller

Please refer to pinctrl-bindings.txt, ../gpio/gpio.txt, and
../interrupt-controller/interrupts.txt for generic information regarding
pin controller, GPIO, and interrupt bindings.

PIC32 'pin configuration node' is a node of a group of pins which can be
used for a specific device or function. This node represents configuraions of
pins, optional function, and optional mux related configuration.

Required properties for pin controller node:
 - compatible: "microchip,pic32mada-pinctrl"
 - reg: Address range of the pinctrl registers.
 - clocks: Clock specifier (see clock bindings for details)

Required properties for pin configuration sub-nodes:
 - pins: List of pins to which the configuration applies.

Optional properties for pin configuration sub-nodes:
----------------------------------------------------
 - function: Mux function for the specified pins.
 - bias-pull-up: Enable weak pull-up.
 - bias-pull-down: Enable weak pull-down.
 - input-enable: Set the pin as an input.
 - output-low: Set the pin as an output level low.
 - output-high: Set the pin as an output level high.
 - microchip,digital: Enable digital I/O.
 - microchip,analog: Enable analog I/O.

Example:

pic32_pinctrl: pinctrl@1f801400{
	#address-cells = <1>;
	#size-cells = <1>;
	compatible = "microchip,pic32mzda-pinctrl";
	reg = <0x1f801400 0x400>;
	clocks = <&PBCLK1>;

	pinctrl_uart2: pinctrl_uart2 {
		uart2-tx {
			pins = "G9";
			function = "U2TX";
			microchip,digital;
			output-low;
		};
		uart2-rx {
			pins = "B0";
			function = "U2RX";
			microchip,digital;
			input-enable;
		};
	};
};

uart2: serial@1f822200 {
	compatible = "microchip,pic32mzda-uart";
	reg = <0x1f822200 0x50>;
	pinctrl-names = "default";
	pinctrl-0 = <&pinctrl_uart2>;
};
```
