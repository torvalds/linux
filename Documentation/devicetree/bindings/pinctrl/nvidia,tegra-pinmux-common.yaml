## Documentation/devicetree/bindings/pinctrl/nvidia,tegra234-pinmux.yaml
```yaml
# SPDX-License-Identifier: (GPL-2.0-only OR BSD-2-Clause)
%YAML 1.2
---
$id: http://devicetree.org/schemas/pinctrl/nvidia,tegra234-pinmux.yaml#
$schema: http://devicetree.org/meta-schemas/core.yaml#

title: NVIDIA Tegra234 Pinmux Controller

maintainers:
  - Thierry Reding <thierry.reding@gmail.com>
  - Jon Hunter <jonathanh@nvidia.com>

$ref: nvidia,tegra234-pinmux-common.yaml

properties:
  compatible:
    const: nvidia,tegra234-pinmux

patternProperties:
  "^pinmux(-[a-z0-9-]+)?$":
    type: object

    # pin groups
    additionalProperties:
      properties:
        nvidia,pins:
          items:
            enum: [ dap6_sclk_pa0, dap6_dout_pa1, dap6_din_pa2,
                    dap6_fs_pa3, dap4_sclk_pa4, dap4_dout_pa5,
                    dap4_din_pa6, dap4_fs_pa7, soc_gpio08_pb0,
                    qspi0_sck_pc0, qspi0_cs_n_pc1,
                    qspi0_io0_pc2, qspi0_io1_pc3, qspi0_io2_pc4,
                    qspi0_io3_pc5, qspi1_sck_pc6, qspi1_cs_n_pc7,
                    qspi1_io0_pd0, qspi1_io1_pd1, qspi1_io2_pd2,
                    qspi1_io3_pd3, eqos_txc_pe0, eqos_td0_pe1,
                    eqos_td1_pe2, eqos_td2_pe3, eqos_td3_pe4,
                    eqos_tx_ctl_pe5, eqos_rd0_pe6, eqos_rd1_pe7,
                    eqos_rd2_pf0, eqos_rd3_pf1, eqos_rx_ctl_pf2,
                    eqos_rxc_pf3, eqos_sma_mdio_pf4, eqos_sma_mdc_pf5,
                    soc_gpio13_pg0, soc_gpio14_pg1, soc_gpio15_pg2,
                    soc_gpio16_pg3, soc_gpio17_pg4, soc_gpio18_pg5,
                    soc_gpio19_pg6, soc_gpio20_pg7, soc_gpio21_ph0,
                    soc_gpio22_ph1, soc_gpio06_ph2, uart4_tx_ph3,
                    uart4_rx_ph4, uart4_rts_ph5, uart4_cts_ph6,
                    soc_gpio41_ph7, soc_gpio42_pi0, soc_gpio43_pi1,
                    soc_gpio44_pi2, gen1_i2c_scl_pi3, gen1_i2c_sda_pi4,
                    cpu_pwr_req_pi5, soc_gpio07_pi6,
                    sdmmc1_clk_pj0, sdmmc1_cmd_pj1, sdmmc1_dat0_pj2,
                    sdmmc1_dat1_pj3, sdmmc1_dat2_pj4, sdmmc1_dat3_pj5,
                    pex_l0_clkreq_n_pk0, pex_l0_rst_n_pk1,
                    pex_l1_clkreq_n_pk2, pex_l1_rst_n_pk3,
                    pex_l2_clkreq_n_pk4, pex_l2_rst_n_pk5,
                    pex_l3_clkreq_n_pk6, pex_l3_rst_n_pk7,
                    pex_l4_clkreq_n_pl0, pex_l4_rst_n_pl1,
                    pex_wake_n_pl2, soc_gpio34_pl3, dp_aux_ch0_hpd_pm0,
                    dp_aux_ch1_hpd_pm1, dp_aux_ch2_hpd_pm2,
                    dp_aux_ch3_hpd_pm3, soc_gpio55_pm4, soc_gpio36_pm5,
                    soc_gpio53_pm6, soc_gpio38_pm7, dp_aux_ch3_n_pn0,
                    soc_gpio39_pn1, soc_gpio40_pn2, dp_aux_ch1_p_pn3,
                    dp_aux_ch1_n_pn4, dp_aux_ch2_p_pn5, dp_aux_ch2_n_pn6,
                    dp_aux_ch3_p_pn7, extperiph1_clk_pp0,
                    extperiph2_clk_pp1, cam_i2c_scl_pp2, cam_i2c_sda_pp3,
                    soc_gpio23_pp4, soc_gpio24_pp5, soc_gpio25_pp6,
                    pwr_i2c_scl_pp7, pwr_i2c_sda_pq0, soc_gpio28_pq1,
                    soc_gpio29_pq2, soc_gpio30_pq3, soc_gpio31_pq4,
                    soc_gpio32_pq5, soc_gpio33_pq6, soc_gpio35_pq7,
                    soc_gpio37_pr0, soc_gpio56_pr1, uart1_tx_pr2,
                    uart1_rx_pr3, uart1_rts_pr4, uart1_cts_pr5,
                    soc_gpio61_pw0, soc_gpio62_pw1, gpu_pwr_req_px0,
                    cv_pwr_req_px1, gp_pwm2_px2, gp_pwm3_px3, uart2_tx_px4,
                    uart2_rx_px5, uart2_rts_px6, uart2_cts_px7, spi3_sck_py0,
                    spi3_miso_py1, spi3_mosi_py2, spi3_cs0_py3,
                    spi3_cs1_py4, uart5_tx_py5, uart5_rx_py6,
                    uart5_rts_py7, uart5_cts_pz0, usb_vbus_en0_pz1,
                    usb_vbus_en1_pz2, spi1_sck_pz3, spi1_miso_pz4,
                    spi1_mosi_pz5, spi1_cs0_pz6, spi1_cs1_pz7,
                    spi5_sck_pac0, spi5_miso_pac1, spi5_mosi_pac2,
                    spi5_cs0_pac3, soc_gpio57_pac4, soc_gpio58_pac5,
                    soc_gpio59_pac6, soc_gpio60_pac7, soc_gpio45_pad0,
                    soc_gpio46_pad1, soc_gpio47_pad2, soc_gpio48_pad3,
                    ufs0_ref_clk_pae0, ufs0_rst_n_pae1,
                    pex_l5_clkreq_n_paf0, pex_l5_rst_n_paf1,
                    pex_l6_clkreq_n_paf2, pex_l6_rst_n_paf3,
                    pex_l7_clkreq_n_pag0, pex_l7_rst_n_pag1,
                    pex_l8_clkreq_n_pag2, pex_l8_rst_n_pag3,
                    pex_l9_clkreq_n_pag4, pex_l9_rst_n_pag5,
                    pex_l10_clkreq_n_pag6, pex_l10_rst_n_pag7,
                    sdmmc1_comp, eqos_comp, qspi_comp,
                    # drive groups
                    drive_soc_gpio08_pb0, drive_soc_gpio36_pm5,
                    drive_soc_gpio53_pm6, drive_soc_gpio55_pm4,
                    drive_soc_gpio38_pm7, drive_soc_gpio39_pn1,
                    drive_soc_gpio40_pn2, drive_dp_aux_ch0_hpd_pm0,
                    drive_dp_aux_ch1_hpd_pm1, drive_dp_aux_ch2_hpd_pm2,
                    drive_dp_aux_ch3_hpd_pm3, drive_dp_aux_ch1_p_pn3,
                    drive_dp_aux_ch1_n_pn4, drive_dp_aux_ch2_p_pn5,
                    drive_dp_aux_ch2_n_pn6, drive_dp_aux_ch3_p_pn7,
                    drive_dp_aux_ch3_n_pn0, drive_pex_l2_clkreq_n_pk4,
                    drive_pex_wake_n_pl2, drive_pex_l1_clkreq_n_pk2,
                    drive_pex_l1_rst_n_pk3, drive_pex_l0_clkreq_n_pk0,
                    drive_pex_l0_rst_n_pk1, drive_pex_l2_rst_n_pk5,
                    drive_pex_l3_clkreq_n_pk6, drive_pex_l3_rst_n_pk7,
                    drive_pex_l4_clkreq_n_pl0, drive_pex_l4_rst_n_pl1,
                    drive_soc_gpio34_pl3, drive_pex_l5_clkreq_n_paf0,
                    drive_pex_l5_rst_n_paf1, drive_pex_l6_clkreq_n_paf2,
                    drive_pex_l6_rst_n_paf3, drive_pex_l10_clkreq_n_pag6,
                    drive_pex_l10_rst_n_pag7, drive_pex_l7_clkreq_n_pag0,
                    drive_pex_l7_rst_n_pag1, drive_pex_l8_clkreq_n_pag2,
                    drive_pex_l8_rst_n_pag3, drive_pex_l9_clkreq_n_pag4,
                    drive_pex_l9_rst_n_pag5, drive_sdmmc1_clk_pj0,
                    drive_sdmmc1_cmd_pj1, drive_sdmmc1_dat3_pj5,
                    drive_sdmmc1_dat2_pj4, drive_sdmmc1_dat1_pj3,
                    drive_sdmmc1_dat0_pj2 ]

unevaluatedProperties: false

examples:
  - |
    #include <dt-bindings/pinctrl/pinctrl-tegra.h>

    pinmux@2430000 {
        compatible = "nvidia,tegra234-pinmux";
        reg = <0x2430000 0x17000>;

        pinctrl-names = "pex_rst";
        pinctrl-0 = <&pex_rst_c5_out_state>;

        pex_rst_c5_out_state: pinmux-pex-rst-c5-out {
            pexrst {
                nvidia,pins = "pex_l5_rst_n_paf1";
                nvidia,schmitt = <TEGRA_PIN_DISABLE>;
                nvidia,enable-input = <TEGRA_PIN_DISABLE>;
                nvidia,io-hv = <TEGRA_PIN_ENABLE>;
                nvidia,tristate = <TEGRA_PIN_DISABLE>;
                nvidia,pull = <TEGRA_PIN_PULL_NONE>;
            };
        };
    };
...
```

## Documentation/devicetree/bindings/pinctrl/nvidia,tegra238-pinmux-aon.yaml
```yaml
# SPDX-License-Identifier: (GPL-2.0-only OR BSD-2-Clause)
%YAML 1.2
---
$id: http://devicetree.org/schemas/pinctrl/nvidia,tegra238-pinmux-aon.yaml#
$schema: http://devicetree.org/meta-schemas/core.yaml#

title: NVIDIA Tegra238 AON Pinmux Controller

maintainers:
  - Thierry Reding <thierry.reding@gmail.com>
  - Jon Hunter <jonathanh@nvidia.com>

properties:
  compatible:
    const: nvidia,tegra238-pinmux-aon

  reg:
    maxItems: 1

patternProperties:
  "^pinmux(-[a-z0-9-]+)?$":
    type: object

    # pin groups
    additionalProperties:
      $ref: nvidia,tegra238-pinmux-common.yaml

      properties:
        nvidia,pins:
          items:
            enum: [ bootv_ctl_n_paa0, soc_gpio00_paa1, vcomp_alert_paa2,
                    pwm1_paa3, batt_oc_paa4, soc_gpio04_paa5,
                    soc_gpio25_paa6, soc_gpio26_paa7,
                    hdmi_cec_pbb0,
                    spi2_sck_pcc0, spi2_miso_pcc1, spi2_mosi_pcc2,
                    spi2_cs0_pcc3, spi2_cs1_pcc4, uart3_tx_pcc5,
                    uart3_rx_pcc6, gen2_i2c_scl_pcc7,
                    gen2_i2c_sda_pdd0, gen8_i2c_scl_pdd1,
                    gen8_i2c_sda_pdd2, touch_clk_pdd3, dmic1_clk_pdd4,
                    dmic1_dat_pdd5, soc_gpio19_pdd6, pwm2_pdd7,
                    pwm3_pee0, pwm7_pee1, soc_gpio49_pee2,
                    soc_gpio82_pee3, soc_gpio50_pee4, soc_gpio83_pee5,
                    soc_gpio69_pff0, soc_gpio70_pff1, soc_gpio71_pff2,
                    soc_gpio72_pff3, soc_gpio73_pff4, soc_gpio74_pff5,
                    soc_gpio80_pff6, soc_gpio76_pff7, soc_gpio77_pgg0,
                    soc_gpio84_pgg1, uart2_tx_pgg2, uart2_rx_pgg3,
                    uart2_rts_pgg4, uart2_cts_pgg5, soc_gpio85_pgg6,
                    uart5_tx_pgg7, uart5_rx_phh0, uart5_rts_phh1,
                    uart5_cts_phh2, soc_gpio86_phh3,
                    # drive groups (ordered PAA, PBB, PCC, PDD, PEE, PFF, PGG, PHH)
                    drive_bootv_ctl_n_paa0, drive_soc_gpio00_paa1,
                    drive_vcomp_alert_paa2, drive_pwm1_paa3,
                    drive_batt_oc_paa4, drive_soc_gpio04_paa5,
                    drive_soc_gpio25_paa6, drive_soc_gpio26_paa7,
                    drive_hdmi_cec_pbb0,
                    drive_spi2_sck_pcc0, drive_spi2_miso_pcc1,
                    drive_spi2_mosi_pcc2, drive_spi2_cs0_pcc3,
                    drive_spi2_cs1_pcc4, drive_uart3_tx_pcc5,
                    drive_uart3_rx_pcc6, drive_gen2_i2c_scl_pcc7,
                    drive_gen2_i2c_sda_pdd0, drive_gen8_i2c_scl_pdd1,
                    drive_gen8_i2c_sda_pdd2, drive_touch_clk_pdd3,
                    drive_dmic1_clk_pdd4, drive_dmic1_dat_pdd5,
                    drive_soc_gpio19_pdd6, drive_pwm2_pdd7,
                    drive_pwm3_pee0, drive_pwm7_pee1,
                    drive_soc_gpio49_pee2, drive_soc_gpio50_pee4,
                    drive_soc_gpio82_pee3, drive_soc_gpio71_pff2,
                    drive_soc_gpio76_pff7, drive_soc_gpio74_pff5,
                    drive_soc_gpio86_phh3, drive_soc_gpio72_pff3,
                    drive_soc_gpio77_pgg0, drive_soc_gpio80_pff6,
                    drive_soc_gpio84_pgg1, drive_soc_gpio83_pee5,
                    drive_soc_gpio73_pff4, drive_soc_gpio70_pff1,
                    drive_soc_gpio85_pgg6, drive_soc_gpio69_pff0,
                    drive_uart5_tx_pgg7, drive_uart5_rx_phh0,
                    drive_uart2_tx_pgg2, drive_uart2_rx_pgg3,
                    drive_uart2_cts_pgg5, drive_uart2_rts_pgg4,
                    drive_uart5_cts_phh2, drive_uart5_rts_phh1 ]

required:
  - compatible
  - reg

additionalProperties: false

examples:
  - |
    #include <dt-bindings/pinctrl/pinctrl-tegra.h>

    pinmux@c300000 {
      compatible = "nvidia,tegra238-pinmux-aon";
      reg = <0x0c300000 0x4000>;

      pinctrl-names = "cec";
      pinctrl-0 = <&cec_state>;

      cec_state: pinmux-cec {
        cec {
          nvidia,pins = "hdmi_cec_pbb0";
          nvidia,function = "hdmi_cec";
        };
      };
    };
...
```

## Documentation/devicetree/bindings/pinctrl/nvidia,tegra238-pinmux-common.yaml
```yaml
# SPDX-License-Identifier: (GPL-2.0-only OR BSD-2-Clause)
%YAML 1.2
---
$id: http://devicetree.org/schemas/pinctrl/nvidia,tegra238-pinmux-common.yaml#
$schema: http://devicetree.org/meta-schemas/core.yaml#

title: NVIDIA Tegra238 Pinmux Controller

maintainers:
  - Thierry Reding <thierry.reding@gmail.com>
  - Jon Hunter <jonathanh@nvidia.com>

$ref: nvidia,tegra-pinmux-common.yaml

properties:
  nvidia,function:
    enum: [ dca_vsync, dca_hsync, displaya, rsvd0, i2c7_clk, i2c7_dat,
            i2c4_dat, i2c4_clk, i2c9_dat, i2c9_clk, usb_vbus_en0,
            usb_vbus_en1, spi3_din, spi1_cs0, spi3_cs0, spi1_din,
            spi3_cs1, spi1_sck, spi3_sck, spi1_cs1, spi1_dout, spi3_dout,
            gp_pwm5, gp_pwm6, extperiph2_clk, extperiph1_clk, i2c3_dat,
            i2c3_clk, extperiph4_clk, extperiph3_clk, dmic2_dat,
            dmic2_clk, uarta_cts, uarta_rts, uarta_rxd, uarta_txd,
            i2c5_clk, i2c5_dat, uartd_cts, uartd_rts, uartd_rxd,
            uartd_txd, i2c1_clk, i2c1_dat, sdmmc1_cd, i2s2_sclk,
            i2s2_sdata_out, i2s2_sdata_in, i2s2_lrck, i2s4_sclk,
            i2s4_sdata_out, i2s4_sdata_in, i2s4_lrck, i2s1_sclk,
            i2s1_sdata_out, i2s1_sdata_in, i2s1_lrck, aud_mclk,
            i2s3_lrck, i2s3_sclk, i2s3_sdata_in, i2s3_sdata_out,
            pe2_clkreq_l, pe1_clkreq_l, pe1_rst_l, pe0_clkreq_l,
            pe0_rst_l, pe2_rst_l, pe3_clkreq_l, pe3_rst_l,
            dp_aux_ch0_hpd, qspi0_io0, qspi0_io1, qspi0_sck, qspi0_cs_n,
            uartg_cts, uartg_rts, uartg_txd, uartg_rxd, sdmmc1_clk,
            sdmmc1_cmd, sdmmc1_comp, sdmmc1_dat3, sdmmc1_dat2,
            sdmmc1_dat1, sdmmc1_dat0, ufs0, soc_therm_oc1, hdmi_cec,
            gp_pwm4, uartc_rxd, uartc_txd, i2c8_dat, i2c8_clk,
            spi2_dout, i2c2_clk, spi2_cs0, i2c2_dat, spi2_sck, spi2_din,
            ppc_mode_1, ppc_ready, ppc_mode_2, ppc_cc, ppc_mode_0,
            ppc_int_n, uarte_txd, uarte_rxd, uartb_txd, uartb_rxd,
            uartb_cts, uartb_rts, uarte_cts, uarte_rts, gp_pwm7,
            gp_pwm2, gp_pwm3, gp_pwm1, spi2_cs1, dmic1_clk, dmic1_dat,
            rsvd1, dcb_hsync, dcb_vsync, soc_therm_oc4, gp_pwm8,
            nv_therm_fan_tach0, wdt_reset_outa, ccla_la_trigger_mux,
            dspk1_dat, dspk1_clk, nv_therm_fan_tach1, dspk0_dat,
            dspk0_clk, i2s5_sclk, i2s6_lrck, i2s6_sdata_in, i2s6_sclk,
            i2s6_sdata_out, i2s5_lrck, i2s5_sdata_out, i2s5_sdata_in,
            sdmmc1_pe3_rst_l, sdmmc1_pe3_clkreq_l, touch_clk,
            ppc_i2c_dat, wdt_reset_outb, spi5_cs1, ppc_rst_n,
            ppc_i2c_clk, spi4_cs1, soc_therm_oc3, spi5_sck, spi5_miso,
            spi4_sck, spi4_miso, spi4_cs0, spi4_mosi, spi5_cs0,
            spi5_mosi, led_blink, rsvd2, dmic3_clk, dmic3_dat,
            dmic4_clk, dmic4_dat, tsc_edge_out0, tsc_edge_out3,
            tsc_edge_out1, tsc_edge_out2, dmic5_clk, dmic5_dat, rsvd3,
            sdmmc1_wp, tsc_edge_out0a, tsc_edge_out0d, tsc_edge_out0b,
            tsc_edge_out0c, soc_therm_oc2 ]

  # out of the common properties, only these are allowed for Tegra238
  nvidia,pins: true
  nvidia,pull: true
  nvidia,tristate: true
  nvidia,schmitt: true
  nvidia,enable-input: true
  nvidia,open-drain: true
  nvidia,lock: true
  nvidia,drive-type: true
  nvidia,io-hv: true

required:
  - nvidia,pins

additionalProperties: false

...
```
