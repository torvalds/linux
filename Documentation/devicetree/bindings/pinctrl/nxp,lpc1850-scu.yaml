## Documentation/devicetree/bindings/pinctrl/nxp,lpc1850-scu.yaml
```yaml
# SPDX-License-Identifier: (GPL-2.0-only OR BSD-2-Clause)
%YAML 1.2
---
$id: http://devicetree.org/schemas/pinctrl/nxp,lpc1850-scu.yaml#
$schema: http://devicetree.org/meta-schemas/core.yaml#

title: NXP LPC18xx/43xx SCU pin controller

description:
  Not all pins support all pin generic node properties so either refer to
  the NXP 1850/4350 user manual or the pin table in the pinctrl-lpc18xx
  driver for supported pin properties.

maintainers:
  - Frank Li <Frank.Li@nxp.com>

properties:
  compatible:
    const: nxp,lpc1850-scu

  reg:
    maxItems: 1

  clocks:
    maxItems: 1

patternProperties:
  '-pins$':
    type: object
    additionalProperties: false

    patternProperties:
      '_cfg$':
        type: object

        allOf:
          - $ref: pincfg-node.yaml#
          - $ref: pinmux-node.yaml#

        unevaluatedProperties: false

        properties:
          nxp,gpio-pin-interrupt:
            $ref: /schemas/types.yaml#/definitions/uint32
            minimum: 0
            maximum: 7
            description:
              Assign pin to gpio pin interrupt controller
              irq number 0 to 7. See example below.

required:
  - compatible
  - reg
  - clocks

allOf:
  - $ref: pinctrl.yaml#

unevaluatedProperties: false

examples:
  - |
    #include <dt-bindings/clock/lpc18xx-ccu.h>

    pinctrl@40086000 {
        compatible = "nxp,lpc1850-scu";
        reg = <0x40086000 0x1000>;
        clocks = <&ccu1 CLK_CPU_SCU>;

        gpio-joystick-pins {
            gpio-joystick-1_cfg {
                pins = "p9_0";
                function = "gpio";
                nxp,gpio-pin-interrupt = <0>;
                input-enable;
                bias-disable;
            };
        };
    };
```

## Documentation/devicetree/bindings/pinctrl/nxp,s32g2-siul2-pinctrl.yaml
```yaml
# SPDX-License-Identifier: (GPL-2.0-only OR BSD-2-Clause)
# Copyright 2022, 2026 NXP
%YAML 1.2
---
$id: http://devicetree.org/schemas/pinctrl/nxp,s32g2-siul2-pinctrl.yaml#
$schema: http://devicetree.org/meta-schemas/core.yaml#

title: NXP S32G2 pin controller

maintainers:
  - Ghennadi Procopciuc <Ghennadi.Procopciuc@oss.nxp.com>
  - Chester Lin <chester62515@gmail.com>

description: |
  S32G2 pinmux is implemented in SIUL2 (System Integration Unit Lite2),
  whose memory map is split into two regions:
    SIUL2_0 @ 0x4009c000
    SIUL2_1 @ 0x44010000

  Every SIUL2 region has multiple register types. MSCR and IMCR registers
  need to be revealed for kernel to configure pinmux. PGPDO and PGPDI
  registers are used for GPIO output/input operations. EIRQ registers
  are used for external interrupt configuration.

  Please note that some register indexes are reserved in S32G2, such as
  MSCR102-MSCR111, MSCR123-MSCR143, IMCR84-IMCR118 and IMCR398-IMCR429.

properties:
  compatible:
    enum:
      - nxp,s32g2-siul2-pinctrl

  reg:
    minItems: 6
    description: |
      A list of MSCR/IMCR/PGPDO/PGPDI/EIRQ register regions to be reserved.
      - MSCR (Multiplexed Signal Configuration Register)
        An MSCR register can configure the associated pin as either a GPIO pin
        or a function output pin depends on the selected signal source.
      - IMCR (Input Multiplexed Signal Configuration Register)
        An IMCR register can configure the associated pin as function input
        pin depends on the selected signal source.
      - PGPDO (Parallel GPIO Pad Data Out Register)
        A PGPDO register is used to set the output value of a GPIO pin.
      - PGPDI (Parallel GPIO Pad Data In Register)
        A PGPDI register is used to read the input value of a GPIO pin.
      - EIRQ (External Interrupt Request)
        EIRQ registers are used to configure and manage external interrupts.

    items:
      - description: MSCR registers group 0 in SIUL2_0
      - description: MSCR registers group 1 in SIUL2_1
      - description: MSCR registers group 2 in SIUL2_1
      - description: IMCR registers group 0 in SIUL2_0
      - description: IMCR registers group 1 in SIUL2_1
      - description: IMCR registers group 2 in SIUL2_1
      - description: PGPDO registers in SIUL2_0
      - description: PGPDI registers in SIUL2_0
      - description: PGPDO registers in SIUL2_1
      - description: PGPDI registers in SIUL2_1
      - description: EIRQ registers in SIUL2_1

  gpio-controller: true

  "#gpio-cells":
    const: 2

  gpio-ranges:
    minItems: 1
    maxItems: 4

  interrupt-controller: true

  "#interrupt-cells":
    const: 2

  interrupts:
    maxItems: 1

patternProperties:
  '-pins$':
    type: object
    additionalProperties: false

    patternProperties:
      '-grp[0-9]$':
        type: object
        allOf:
          - $ref: pinmux-node.yaml#
          - $ref: pincfg-node.yaml#
        description: |
          Pinctrl node's client devices specify pin muxes using subnodes,
          which in turn use the standard properties below.

        properties:
          bias-disable: true
          bias-high-impedance: true
          bias-pull-up: true
          bias-pull-down: true
          drive-open-drain: true
          input-enable: true
          output-enable: true

          pinmux:
            description: |
              An integer array for representing pinmux configurations of
              a device. Each integer consists of a PIN_ID and a 4-bit
              selected signal source(SSS) as IOMUX setting, which is
              calculated as: pinmux = (PIN_ID << 4 | SSS)

          slew-rate:
            description: Supported slew rate based on Fmax values (MHz)
            enum: [83, 133, 150, 166, 208]

        additionalProperties: false

required:
  - compatible
  - reg

oneOf:
  - description: Legacy pinctrl-only node
    properties:
      reg:
        maxItems: 6

      gpio-controller: false
      "#gpio-cells": false
      gpio-ranges: false
      interrupt-controller: false
      "#interrupt-cells": false
      interrupts: false

  - description: Pinctrl node with GPIO and external interrupt support
    required:
      - gpio-controller
      - "#gpio-cells"
      - gpio-ranges
      - interrupt-controller
      - "#interrupt-cells"
      - interrupts
    properties:
      reg:
        minItems: 11

additionalProperties: false

examples:
  - |
    #include <dt-bindings/interrupt-controller/arm-gic.h>

    pinctrl: pinctrl@4009c240 {
        compatible = "nxp,s32g2-siul2-pinctrl";

              /* MSCR0-MSCR101 registers on siul2_0 */
        reg = <0x4009c240 0x198>,
              /* MSCR112-MSCR122 registers on siul2_1 */
              <0x44010400 0x2c>,
              /* MSCR144-MSCR190 registers on siul2_1 */
              <0x44010480 0xbc>,
              /* IMCR0-IMCR83 registers on siul2_0 */
              <0x4009ca40 0x150>,
              /* IMCR119-IMCR397 registers on siul2_1 */
              <0x44010c1c 0x45c>,
              /* IMCR430-IMCR495 registers on siul2_1 */
              <0x440110f8 0x108>,
              /* PGPDO registers on siul2_0 */
              <0x4009d700 0x10>,
              /* PGPDI registers on siul2_0 */
              <0x4009d740 0x10>,
              /* PGPDO registers on siul2_1 */
              <0x44011700 0x18>,
              /* PGPDI registers on siul2_1 */
              <0x44011740 0x18>,
              /* EIRQ registers on siul2_1 */
              <0x44010010 0x34>;

        gpio-controller;
        #gpio-cells = <2>;
        gpio-ranges = <&pinctrl 0 0 102>,
                      <&pinctrl 112 112 79>;

        interrupt-controller;
        #interrupt-cells = <2>;
        interrupts = <GIC_SPI 210 IRQ_TYPE_LEVEL_HIGH>;

        llce-can0-pins {
            llce-can0-grp0 {
                pinmux = <0x2b0>;
                input-enable;
                slew-rate = <208>;
            };

            llce-can0-grp1 {
                pinmux = <0x2c2>;
                output-enable;
                slew-rate = <208>;
            };
        };
    };
...
```

## Documentation/devicetree/bindings/pinctrl/oxnas,pinctrl.txt
```
* Oxford Semiconductor OXNAS SoC Family Pin Controller

Please refer to pinctrl-bindings.txt, ../gpio/gpio.txt, and
../interrupt-controller/interrupts.txt for generic information regarding
pin controller, GPIO, and interrupt bindings.

OXNAS 'pin configuration yesde' is a yesde of a group of pins which can be
used for a specific device or function. This yesde represents configurations of
pins, optional function, and optional mux related configuration.

Required properties for pin controller yesde:
 - compatible: "oxsemi,ox810se-pinctrl" or "oxsemi,ox820-pinctrl"
 - oxsemi,sys-ctrl: a phandle to the system controller syscon yesde

Required properties for pin configuration sub-yesdes:
 - pins: List of pins to which the configuration applies.

Optional properties for pin configuration sub-yesdes:
----------------------------------------------------
 - function: Mux function for the specified pins.
 - bias-pull-up: Enable weak pull-up.

Example:

pinctrl: pinctrl {
	compatible = "oxsemi,ox810se-pinctrl";

	/* Regmap for sys registers */
	oxsemi,sys-ctrl = <&sys>;

	pinctrl_uart2: pinctrl_uart2 {
		uart2a {
			pins = "gpio31";
			function = "fct3";
		};
		uart2b {
			pins = "gpio32";
			function = "fct3";
		};
	};
};

uart2: serial@900000 {
	compatible = "ns16550a";
	reg = <0x900000 0x100000>;
	clocks = <&sysclk>;
	interrupts = <29>;
	reg-shift = <0>;
	fifo-size = <16>;
	reg-io-width = <1>;
	current-speed = <115200>;
	yes-loopback-test;
	resets = <&reset 22>;
	pinctrl-names = "default";
	pinctrl-0 = <&pinctrl_uart2>;
};
```

## Documentation/devicetree/bindings/pinctrl/pincfg-node.yaml
```yaml
# SPDX-License-Identifier: GPL-2.0-only
%YAML 1.2
---
$id: http://devicetree.org/schemas/pinctrl/pincfg-node.yaml#
$schema: http://devicetree.org/meta-schemas/core.yaml#

title: Generic pin configuration node schema

maintainers:
  - Linus Walleij <linus.walleij@linaro.org>

description:
  Many data items that are represented in a pin configuration node are common
  and generic. Pin control bindings should use the properties defined below
  where they are applicable; not all of these properties are relevant or useful
  for all hardware or binding structures. Each individual binding document
  should state which of these generic properties, if any, are used, and the
  structure of the DT nodes that contain these properties.

properties:
  bias-disable:
    type: boolean
    description: disable any pin bias

  bias-high-impedance:
    type: boolean
    description: high impedance mode ("third-state", "floating")

  bias-bus-hold:
    type: boolean
    description: latch weakly

  bias-pull-up:
    oneOf:
      - type: boolean
      - $ref: /schemas/types.yaml#/definitions/uint32
    description: pull up the pin. Takes as optional argument on hardware
      supporting it the pull strength in Ohm.

  bias-pull-down:
    oneOf:
      - type: boolean
      - $ref: /schemas/types.yaml#/definitions/uint32
    description: pull down the pin. Takes as optional argument on hardware
      supporting it the pull strength in Ohm.

  bias-pull-pin-default:
    oneOf:
      - type: boolean
      - $ref: /schemas/types.yaml#/definitions/uint32
    description: use pin-default pull state. Takes as optional argument on
      hardware supporting it the pull strength in Ohm.

  drive-push-pull:
    oneOf:
      - type: boolean
      - $ref: /schemas/types.yaml#/definitions/uint32
        enum: [ 0, 1 ]
        deprecated: true
    description: drive actively high and low

  drive-open-drain:
    oneOf:
      - type: boolean
      - $ref: /schemas/types.yaml#/definitions/uint32
        const: 1    # No known cases of 0
        deprecated: true
    description: drive with open drain

  drive-open-source:
    type: boolean
    description: drive with open source

  drive-strength:
    $ref: /schemas/types.yaml#/definitions/uint32
    description: sink or source at most X mA

  drive-strength-microamp:
    description: sink or source at most X uA

  input-enable:
    type: boolean
    description: enable input on pin (no effect on output, such as
      enabling an input buffer)

  input-disable:
    type: boolean
    description: disable input on pin (no effect on output, such as
      disabling an input buffer)

  input-schmitt-enable:
    type: boolean
    description: enable schmitt-trigger mode

  input-schmitt-disable:
    type: boolean
    description: disable schmitt-trigger mode

  input-debounce:
    $ref: /schemas/types.yaml#/definitions/uint32
    description: Takes the debounce time in usec as argument or 0 to disable
      debouncing

  power-source:
    $ref: /schemas/types.yaml#/definitions/uint32
    description: select between different power supplies

  low-power-enable:
    type: boolean
    description: enable low power mode

  low-power-disable:
    type: boolean
    description: disable low power mode

  output-disable:
    type: boolean
    description: disable output on a pin (such as disable an output buffer)

  output-enable:
    type: boolean
    description: enable output on a pin without actively driving it
      (such as enabling an output buffer)

  output-impedance-ohms:
    description: set the output impedance of a pin to at most X ohms

  output-low:
    type: boolean
    description: set the pin to output mode with low level

  output-high:
    type: boolean
    description: set the pin to output mode with high level

  sleep-hardware-state:
    type: boolean
    description: indicate this is sleep related state which will be
      programmed into the registers for the sleep state.

  slew-rate:
    $ref: /schemas/types.yaml#/definitions/uint32
    description: set the slew rate

  skew-delay:
    $ref: /schemas/types.yaml#/definitions/uint32
    description:
      this affects the expected clock skew on input pins
      and the delay before latching a value to an output
      pin. Typically indicates how many double-inverters are
      used to delay the signal.

additionalProperties: true
```
