## Documentation/devicetree/bindings/pinctrl/atmel,at91-pinctrl.txt
```
* Atmel AT91 Pinmux Controller

The AT91 Pinmux Controler, enables the IC
to share one PAD to several functional blocks. The sharing is done by
multiplexing the PAD input/output signals. For each PAD there are up to
8 muxing options (called periph modes). Since different modules require
different PAD settings (like pull up, keeper, etc) the contoller controls
also the PAD settings parameters.

Please refer to pinctrl-bindings.txt in this directory for details of the
common pinctrl bindings used by client devices, including the meaning of the
phrase "pin configuration node".

Atmel AT91 pin configuration node is a node of a group of pins which can be
used for a specific device or function. This node represents both mux and config
of the pins in that group. The 'pins' selects the function mode(also named pin
mode) this pin can work on and the 'config' configures various pad settings
such as pull-up, multi drive, etc.

Required properties for iomux controller:
- compatible: "atmel,at91rm9200-pinctrl"
- atmel,mux-mask: array of mask (periph per bank) to describe if a pin can be
  configured in this periph mode. All the periph and bank need to be describe.

How to create such array:

Each column will represent the possible peripheral of the pinctrl
Each line will represent a pio bank

Take an example on the 9260
Peripheral: 2 ( A and B)
Bank: 3 (A, B and C)
=>

  /*    A         B     */
  0xffffffff 0xffc00c3b  /* pioA */
  0xffffffff 0x7fff3ccf  /* pioB */
  0xffffffff 0x007fffff  /* pioC */

For each peripheral/bank we will descibe in a u32 if a pin can can be
configured in it by putting 1 to the pin bit (1 << pin)

Let's take the pioA on peripheral B
From the datasheet Table 10-2.
Peripheral B
PA0	MCDB0
PA1	MCCDB
PA2
PA3	MCDB3
PA4	MCDB2
PA5	MCDB1
PA6
PA7
PA8
PA9
PA10	ETX2
PA11	ETX3
PA12
PA13
PA14
PA15
PA16
PA17
PA18
PA19
PA20
PA21
PA22	ETXER
PA23	ETX2
PA24	ETX3
PA25	ERX2
PA26	ERX3
PA27	ERXCK
PA28	ECRS
PA29	ECOL
PA30	RXD4
PA31	TXD4

=> 0xffc00c3b

Required properties for pin configuration node:
- atmel,pins: 4 integers array, represents a group of pins mux and config
  setting. The format is atmel,pins = <PIN_BANK PIN_BANK_NUM PERIPH CONFIG>.
  The PERIPH 0 means gpio.

Bits used for CONFIG:
PULL_UP(1 << 0): indicate this pin need a pull up.
MULTIDRIVE(1 << 1): indicate this pin need to be configured as multidrive.

NOTE:
Some requirements for using atmel,at91rm9200-pinctrl binding:
1. We have pin function node defined under at91 controller node to represent
   what pinmux functions this SoC supports.
2. The driver can use the function node's name and pin configuration node's
   name describe the pin function and group hierarchy.
   For example, Linux at91 pinctrl driver takes the function node's name
   as the function name and pin configuration node's name as group name to
   create the map table.
3. Each pin configuration node should have a phandle, devices can set pins
   configurations by referring to the phandle of that pin configuration node.
4. The gpio controller must be describe in the pinctrl simple-bus.

Examples:

pinctrl@fffff400 {
	#address-cells = <1>;
	#size-cells = <1>;
	ranges;
	compatible = "atmel,at91rm9200-pinctrl", "simple-bus";
	reg = <0xfffff400 0x600>;

	atmel,mux-mask = <
	      /*    A         B     */
	       0xffffffff 0xffc00c3b  /* pioA */
	       0xffffffff 0x7fff3ccf  /* pioB */
	       0xffffffff 0x007fffff  /* pioC */
	      >;

	/* shared pinctrl settings */
	dbgu {
		pinctrl_dbgu: dbgu-0 {
			atmel,pins =
				<1 14 0x1 0x0	/* PB14 periph A */
				 1 15 0x1 0x1>;	/* PB15 periph with pullup */
		};
	};
};

dbgu: serial@fffff200 {
	compatible = "atmel,at91sam9260-usart";
	reg = <0xfffff200 0x200>;
	interrupts = <1 4 7>;
	pinctrl-names = "default";
	pinctrl-0 = <&pinctrl_dbgu>;
	status = "disabled";
};
```

## Documentation/devicetree/bindings/pinctrl/atmel,at91-pio4-pinctrl.txt
```
* Atmel PIO4 Controller

The Atmel PIO4 controller is used to select the function of a pin and to
configure it.

Required properties:
- compatible:
	"atmel,sama5d2-pinctrl"
	"microchip,sama7d65-pinctrl", "microchip,sama7g5-pinctrl"
	"microchip,sama7g5-pinctrl"
- reg: base address and length of the PIO controller.
- interrupts: interrupt outputs from the controller, one for each bank.
- interrupt-controller: mark the device node as an interrupt controller.
- #interrupt-cells: should be two.
- gpio-controller: mark the device node as a gpio controller.
- #gpio-cells: should be two.

Please refer to ../gpio/gpio.txt and ../interrupt-controller/interrupts.txt for
a general description of GPIO and interrupt bindings.

Please refer to pinctrl-bindings.txt in this directory for details of the
common pinctrl bindings used by client devices.

Subnode format
Each node (or subnode) will list the pins it needs and how to configured these
pins.

	node {
		pinmux = <PIN_NUMBER_PINMUX>;
		GENERIC_PINCONFIG;
	};

Required properties:
- pinmux: integer array. Each integer represents a pin number plus mux and
ioset settings. Use the macros from boot/dts/<soc>-pinfunc.h file to get the
right representation of the pin.

Optional properties:
- GENERIC_PINCONFIG: generic pinconfig options to use:
	- bias-disable, bias-pull-down, bias-pull-up, drive-open-drain,
	 drive-push-pull input-schmitt-enable, input-debounce, output-low,
	 output-high.
	- for microchip,sama7g5-pinctrl only:
		- slew-rate: 0 - disabled, 1 - enabled (default)
- atmel,drive-strength: 0 or 1 for low drive, 2 for medium drive and 3 for
high drive. The default value is low drive.

Example:

#include <sama5d2-pinfunc.h>

...
{
	pioA: pinctrl@fc038000 {
		compatible = "atmel,sama5d2-pinctrl";
		reg = <0xfc038000 0x600>;
		interrupts = <18 IRQ_TYPE_LEVEL_HIGH 7>,
			     <68 IRQ_TYPE_LEVEL_HIGH 7>,
			     <69 IRQ_TYPE_LEVEL_HIGH 7>,
			     <70 IRQ_TYPE_LEVEL_HIGH 7>;
		interrupt-controller;
		#interrupt-cells = <2>;
		gpio-controller;
		#gpio-cells = <2>;
		clocks = <&pioA_clk>;

		pinctrl_i2c0_default: i2c0_default {
			pinmux = <PIN_PD21__TWD0>,
				 <PIN_PD22__TWCK0>;
			bias-disable;
		};

		pinctrl_led_gpio_default: led_gpio_default {
			pinmux = <PIN_PB0>,
				 <PIN_PB5>;
			bias-pull-up;
			atmel,drive-strength = <ATMEL_PIO_DRVSTR_ME>;
		};

		pinctrl_sdmmc1_default: sdmmc1_default {
			cmd_data {
				pinmux = <PIN_PA28__SDMMC1_CMD>,
					 <PIN_PA18__SDMMC1_DAT0>,
					 <PIN_PA19__SDMMC1_DAT1>,
					 <PIN_PA20__SDMMC1_DAT2>,
					 <PIN_PA21__SDMMC1_DAT3>;
				bias-pull-up;
			};

			ck_cd {
				pinmux = <PIN_PA22__SDMMC1_CK>,
					 <PIN_PA30__SDMMC1_CD>;
				bias-disable;
			};
		};
		...
	};
};
...
```

## Documentation/devicetree/bindings/pinctrl/atmel,at91rm9200-pinctrl.yaml
```yaml
# SPDX-License-Identifier: (GPL-2.0-only OR BSD-2-Clause)
%YAML 1.2
---
$id: http://devicetree.org/schemas/pinctrl/atmel,at91rm9200-pinctrl.yaml#
$schema: http://devicetree.org/meta-schemas/core.yaml#

title: Microchip PIO3 Pinmux Controller

maintainers:
  - Manikandan Muralidharan <manikandan.m@microchip.com>

description:
  The AT91 Pinmux Controller, enables the IC to share one PAD to several
  functional blocks. The sharing is done by multiplexing the PAD input/output
  signals. For each PAD there are up to 8 muxing options (called periph modes).
  Since different modules require different PAD settings (like pull up, keeper,
  etc) the controller controls also the PAD settings parameters.

properties:
  compatible:
    oneOf:
      - items:
          - enum:
              - atmel,at91rm9200-pinctrl
              - atmel,at91sam9x5-pinctrl
              - atmel,sama5d3-pinctrl
              - microchip,sam9x60-pinctrl
          - const: simple-mfd
      - items:
          - enum:
              - microchip,sam9x7-pinctrl
          - const: microchip,sam9x60-pinctrl
          - const: simple-mfd

  '#address-cells':
    const: 1

  '#size-cells':
    const: 1

  ranges: true

  atmel,mux-mask:
    $ref: /schemas/types.yaml#/definitions/uint32-matrix
    description: |
      Array of mask (periph per bank) to describe if a pin can be
      configured in this periph mode. All the periph and bank need to
      be described.

      #How to create such array:

      Each column will represent the possible peripheral of the pinctrl
      Each line will represent a pio bank

      #Example:

      In at91sam9260.dtsi,
      Peripheral: 2 ( A and B)
      Bank: 3 (A, B and C)

      #    A          B
      0xffffffff 0xffc00c3b  # pioA
      0xffffffff 0x7fff3ccf  # pioB
      0xffffffff 0x007fffff  # pioC

      For each peripheral/bank we will describe in a u32 if a pin can be
      configured in it by putting 1 to the pin bit (1 << pin)

      Let's take the pioA on peripheral B whose value is 0xffc00c3b
      From the datasheet Table 10-2.
      Peripheral B
      PA0     MCDB0
      PA1     MCCDB
      PA2
      PA3     MCDB3
      PA4     MCDB2
      PA5     MCDB1
      PA6
      PA7
      PA8
      PA9
      PA10    ETX2
      PA11    ETX3
      PA12
      PA13
      PA14
      PA15
      PA16
      PA17
      PA18
      PA19
      PA20
      PA21
      PA22    ETXER
      PA23    ETX2
      PA24    ETX3
      PA25    ERX2
      PA26    ERX3
      PA27    ERXCK
      PA28    ECRS
      PA29    ECOL
      PA30    RXD4
      PA31    TXD4

allOf:
  - $ref: pinctrl.yaml#

required:
  - compatible
  - ranges
  - "#address-cells"
  - "#size-cells"
  - atmel,mux-mask

patternProperties:
  'gpio@[0-9a-f]+$':
    $ref: /schemas/gpio/atmel,at91rm9200-gpio.yaml
    unevaluatedProperties: false

additionalProperties:
  type: object
  additionalProperties:
    type: object
    additionalProperties: false

    properties:
      atmel,pins:
        $ref: /schemas/types.yaml#/definitions/uint32-matrix
        description: |
          Each entry consists of 4 integers and represents the pins
          mux and config setting.The format is
          atmel,pins = <PIN_BANK PIN_BANK_NUM PERIPH CONFIG>.
          Supported pin number and mux varies for different SoCs, and
          are defined in <include/dt-bindings/pinctrl/at91.h>.
          items:
            items:
              - description:
                  Pin bank
              - description:
                  Pin bank index
              - description:
                  Peripheral function
              - description:
                  Pad configuration

examples:
  - |
    #include <dt-bindings/clock/at91.h>
    #include <dt-bindings/interrupt-controller/irq.h>
    #include <dt-bindings/pinctrl/at91.h>

    pinctrl@fffff400 {
        #address-cells = <1>;
        #size-cells = <1>;
        compatible = "atmel,at91rm9200-pinctrl", "simple-mfd";
        ranges = <0xfffff400 0xfffff400 0x600>;

        atmel,mux-mask = <
          /*    A         B     */
          0xffffffff 0xffc00c3b  /* pioA */
          0xffffffff 0x7fff3ccf  /* pioB */
          0xffffffff 0x007fffff  /* pioC */
          >;

        dbgu {
            dbgu-0 {
                atmel,pins =
                  <AT91_PIOB 14 AT91_PERIPH_A AT91_PINCTRL_PULL_UP
                   AT91_PIOB 15 AT91_PERIPH_A AT91_PINCTRL_NONE>;
            };
        };

        gpio@fffff400 {
            compatible = "atmel,at91rm9200-gpio";
            reg = <0xfffff400 0x200>;
            interrupts = <2 IRQ_TYPE_LEVEL_HIGH 1>;
            #gpio-cells = <2>;
            gpio-controller;
            interrupt-controller;
            #interrupt-cells = <2>;
            clocks = <&pmc PMC_TYPE_PERIPHERAL 2>;
        };
    };
...
```

## Documentation/devicetree/bindings/pinctrl/awinic,aw9523-pinctrl.yaml
```yaml
# SPDX-License-Identifier: (GPL-2.0-only OR BSD-2-Clause)
%YAML 1.2
---
$id: http://devicetree.org/schemas/pinctrl/awinic,aw9523-pinctrl.yaml#
$schema: http://devicetree.org/meta-schemas/core.yaml#

title: Awinic AW9523/AW9523B I2C GPIO Expander

maintainers:
  - AngeloGioacchino Del Regno <angelogioacchino.delregno@somainline.org>

description: |
  The Awinic AW9523/AW9523B I2C GPIO Expander featuring 16 multi-function
  I/O, 256 steps PWM mode and interrupt support.

properties:
  compatible:
    const: awinic,aw9523-pinctrl

  reg:
    maxItems: 1

  '#gpio-cells':
    description: |
      Specifying the pin number and flags, as defined in
      include/dt-bindings/gpio/gpio.h
    const: 2

  gpio-controller: true

  gpio-ranges:
    maxItems: 1

  interrupt-controller: true

  interrupts:
    maxItems: 1
    description: Specifies the INTN pin IRQ.

  '#interrupt-cells':
    description:
      Specifies the PIN numbers and Flags, as defined in defined in
      include/dt-bindings/interrupt-controller/irq.h
    const: 2

  reset-gpios:
    maxItems: 1

# PIN CONFIGURATION NODES
patternProperties:
  '-pins$':
    type: object
    description:
      Pinctrl node's client devices use subnodes for desired pin configuration.
      Client device subnodes use below standard properties.
    $ref: /schemas/pinctrl/pincfg-node.yaml

    properties:
      pins:
        description:
          List of gpio pins affected by the properties specified in
          this subnode.
        items:
          pattern: "^gpio([0-9]|1[0-5])$"
        minItems: 1
        maxItems: 16

      function:
        description:
          Specify the alternative function to be configured for the
          specified pins.

        enum: [ gpio, pwm ]

      bias-disable: true
      bias-pull-down: true
      bias-pull-up: true
      drive-open-drain: true
      drive-push-pull: true
      input-enable: true
      input-disable: true
      output-high: true
      output-low: true

    required:
      - pins
      - function

    additionalProperties: false

required:
  - compatible
  - reg
  - gpio-controller
  - '#gpio-cells'
  - gpio-ranges

additionalProperties: false

examples:
  # Example configuration to drive pins for a keyboard matrix
  - |
    #include <dt-bindings/gpio/gpio.h>
    #include <dt-bindings/interrupt-controller/irq.h>

    i2c {
        #address-cells = <1>;
        #size-cells = <0>;

        aw9523: gpio-expander@58 {
                compatible = "awinic,aw9523-pinctrl";
                reg = <0x58>;
                interrupt-parent = <&tlmm>;
                interrupts = <50 IRQ_TYPE_EDGE_FALLING>;
                gpio-controller;
                #gpio-cells = <2>;
                gpio-ranges = <&tlmm 0 0 16>;
                interrupt-controller;
                #interrupt-cells = <2>;
                reset-gpios = <&tlmm 51 GPIO_ACTIVE_HIGH>;

                keyboard-matrix-col-pins {
                        pins = "gpio8", "gpio9", "gpio10", "gpio11",
                               "gpio12", "gpio13", "gpio14", "gpio15";
                        function = "gpio";
                        input-disable;
                        output-low;
                };

                keyboard-matrix-row-pins {
                        pins = "gpio0", "gpio1", "gpio2", "gpio3",
                               "gpio4", "gpio5", "gpio6", "gpio7";
                        function = "gpio";
                        bias-pull-up;
                        drive-open-drain;
                        input-enable;
                };
        };
    };
```
