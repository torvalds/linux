## Documentation/devicetree/bindings/pinctrl/allwinner,sunxi-pinctrl.txt
```
* Allwinner A1X Pin Controller

The pins controlled by sunXi pin controller are organized in banks,
each bank has 32 pins.  Each pin has 7 multiplexing functions, with
the first two functions being GPIO in and out. The configuration on
the pins includes drive strength and pull-up.

Required properties:
- compatible: Should be one of the following (depending on your SoC):
  "allwinner,sun4i-a10-pinctrl"
  "allwinner,sun5i-a10s-pinctrl"
  "allwinner,sun5i-a13-pinctrl"
  "allwinner,sun6i-a31-pinctrl"
  "allwinner,sun6i-a31s-pinctrl"
  "allwinner,sun6i-a31-r-pinctrl"
  "allwinner,sun7i-a20-pinctrl"
  "allwinner,sun8i-a23-pinctrl"
  "allwinner,sun8i-a23-r-pinctrl"
  "allwinner,sun8i-a33-pinctrl"
  "allwinner,sun9i-a80-pinctrl"
  "allwinner,sun9i-a80-r-pinctrl"
  "allwinner,sun8i-a83t-pinctrl"
  "allwinner,sun8i-a83t-r-pinctrl"
  "allwinner,sun8i-h3-pinctrl"
  "allwinner,sun8i-h3-r-pinctrl"
  "allwinner,sun8i-r40-pinctrl"
  "allwinner,sun8i-v3-pinctrl"
  "allwinner,sun8i-v3s-pinctrl"
  "allwinner,sun50i-a64-pinctrl"
  "allwinner,sun50i-a64-r-pinctrl"
  "allwinner,sun50i-h5-pinctrl"
  "allwinner,sun50i-h6-pinctrl"
  "allwinner,sun50i-h6-r-pinctrl"
  "allwinner,suniv-f1c100s-pinctrl"
  "nextthing,gr8-pinctrl"

- reg: Should contain the register physical address and length for the
  pin controller.

- clocks: phandle to the clocks feeding the pin controller:
  - "apb": the gated APB parent clock
  - "hosc": the high frequency oscillator in the system
  - "losc": the low frequency oscillator in the system

Note: For backward compatibility reasons, the hosc and losc clocks are only
required if you need to use the optional input-debounce property. Any new
device tree should set them.

Each pin bank, depending on the SoC, can have an associated regulator:

- vcc-pa-supply: for the A10, A20, A31, A31s, A80 and R40 SoCs
- vcc-pb-supply: for the A31, A31s, A80 and V3s SoCs
- vcc-pc-supply: for the A10, A20, A31, A31s, A64, A80, H5, R40 and V3s SoCs
- vcc-pd-supply: for the A23, A31, A31s, A64, A80, A83t, H3, H5 and R40 SoCs
- vcc-pe-supply: for the A10, A20, A31, A31s, A64, A80, R40 and V3s SoCs
- vcc-pf-supply: for the A10, A20, A31, A31s, A80, R40 and V3s SoCs
- vcc-pg-supply: for the A10, A20, A31, A31s, A64, A80, H3, H5, R40 and V3s SoCs
- vcc-ph-supply: for the A31, A31s and A80 SoCs
- vcc-pl-supply: for the r-pinctrl of the A64, A80 and A83t SoCs
- vcc-pm-supply: for the r-pinctrl of the A31, A31s and A80 SoCs

Optional properties:
  - input-debounce: Array of debouncing periods in microseconds. One period per
    irq bank found in the controller. 0 if no setup required.


Please refer to pinctrl-bindings.txt in this directory for details of the
common pinctrl bindings used by client devices.

A pinctrl node should contain at least one subnodes representing the
pinctrl groups available on the machine. Each subnode will list the
pins it needs, and how they should be configured, with regard to muxer
configuration, drive strength and pullups. If one of these options is
not set, its actual value will be unspecified.

Allwinner A1X Pin Controller supports the generic pin multiplexing and
configuration bindings. For details on each properties, you can refer to
 ./pinctrl-bindings.txt.

Required sub-node properties:
  - pins
  - function

Optional sub-node properties:
  - bias-disable
  - bias-pull-up
  - bias-pull-down
  - drive-strength

*** Deprecated pin configuration and multiplexing binding

Required subnode-properties:

- allwinner,pins: List of strings containing the pin name.
- allwinner,function: Function to mux the pins listed above to.

Optional subnode-properties:
- allwinner,drive: Integer. Represents the current sent to the pin
    0: 10 mA
    1: 20 mA
    2: 30 mA
    3: 40 mA
- allwinner,pull: Integer.
    0: No resistor
    1: Pull-up resistor
    2: Pull-down resistor

Examples:

pio: pinctrl@1c20800 {
	compatible = "allwinner,sun5i-a13-pinctrl";
	reg = <0x01c20800 0x400>;
	#address-cells = <1>;
	#size-cells = <0>;

	uart1_pins_a: uart1@0 {
		allwinner,pins = "PE10", "PE11";
		allwinner,function = "uart1";
		allwinner,drive = <0>;
		allwinner,pull = <0>;
	};

	uart1_pins_b: uart1@1 {
		allwinner,pins = "PG3", "PG4";
		allwinner,function = "uart1";
		allwinner,drive = <0>;
		allwinner,pull = <0>;
	};
};


GPIO and interrupt controller
-----------------------------

This hardware also acts as a GPIO controller and an interrupt
controller.

Consumers that would want to refer to one or the other (or both)
should provide through the usual *-gpios and interrupts properties a
cell with 3 arguments, first the number of the bank, then the pin
inside that bank, and finally the flags for the GPIO/interrupts.

Example:

xio: gpio@38 {
	compatible = "nxp,pcf8574a";
	reg = <0x38>;

	gpio-controller;
	#gpio-cells = <2>;

	interrupt-parent = <&pio>;
	interrupts = <6 0 IRQ_TYPE_EDGE_FALLING>;
	interrupt-controller;
	#interrupt-cells = <2>;
};

reg_usb1_vbus: usb1-vbus {
	compatible = "regulator-fixed";
	regulator-name = "usb1-vbus";
	regulator-min-microvolt = <5000000>;
	regulator-max-microvolt = <5000000>;
	gpio = <&pio 7 6 GPIO_ACTIVE_HIGH>;
};
```

## Documentation/devicetree/bindings/pinctrl/amlogic,meson-pinctrl-a1.yaml
```yaml
# SPDX-License-Identifier: (GPL-2.0-only OR BSD-2-Clause)
%YAML 1.2
---
$id: http://devicetree.org/schemas/pinctrl/amlogic,meson-pinctrl-a1.yaml#
$schema: http://devicetree.org/meta-schemas/core.yaml#

title: Amlogic Meson A1 pinmux controller

maintainers:
  - Neil Armstrong <neil.armstrong@linaro.org>

allOf:
  - $ref: amlogic,meson-pinctrl-common.yaml#

properties:
  compatible:
    enum:
      - amlogic,c3-periphs-pinctrl
      - amlogic,t7-periphs-pinctrl
      - amlogic,meson-a1-periphs-pinctrl
      - amlogic,meson-s4-periphs-pinctrl

required:
  - compatible

patternProperties:
  "^bank@[0-9a-f]+$":
    $ref: amlogic,meson-pinctrl-common.yaml#/$defs/meson-gpio

    unevaluatedProperties: false

    properties:
      reg:
        maxItems: 2

      reg-names:
        items:
          - const: mux
          - const: gpio

      gpio-line-names:
        minItems: 62 # A1
        maxItems: 82 # S4

unevaluatedProperties:
  type: object
  $ref: amlogic,meson-pinctrl-common.yaml#/$defs/meson-pins

examples:
  - |
    periphs_pinctrl: pinctrl {
      compatible = "amlogic,meson-a1-periphs-pinctrl";
      #address-cells = <1>;
      #size-cells = <1>;
      ranges;

      bank@400 {
        reg = <0x0400 0x003c>,
              <0x0480 0x0118>;
        reg-names = "mux", "gpio";
        gpio-controller;
        #gpio-cells = <2>;
        gpio-ranges = <&periphs_pinctrl 0 0 62>;
      };

      cec_ao_a_h_pins: cec_ao_a_h {
        mux {
          groups = "cec_ao_a_h";
          function = "cec_ao_a_h";
          bias-disable;
        };
      };
    };
```

## Documentation/devicetree/bindings/pinctrl/amlogic,meson-pinctrl-common.yaml
```yaml
# SPDX-License-Identifier: (GPL-2.0-only OR BSD-2-Clause)
%YAML 1.2
---
$id: http://devicetree.org/schemas/pinctrl/amlogic,meson-pinctrl-common.yaml#
$schema: http://devicetree.org/meta-schemas/core.yaml#

title: Amlogic Meson pinmux controller

maintainers:
  - Neil Armstrong <neil.armstrong@linaro.org>

allOf:
  - $ref: pinctrl.yaml#

properties:
  ranges: true

  "#address-cells":
    enum: [1, 2]

  "#size-cells":
    enum: [1, 2]

required:
  - ranges
  - "#address-cells"
  - "#size-cells"

additionalProperties: true

$defs:
  meson-gpio:
    type: object

    properties:
      gpio-controller: true

      "#gpio-cells":
        const: 2

      gpio-ranges:
        maxItems: 1

    required:
      - reg
      - reg-names
      - gpio-controller
      - "#gpio-cells"
      - gpio-ranges

  meson-pins:
    type: object
    additionalProperties:
      type: object
      allOf:
        - $ref: pincfg-node.yaml#
        - $ref: pinmux-node.yaml#
```

## Documentation/devicetree/bindings/pinctrl/amlogic,meson-pinctrl-g12a-aobus.yaml
```yaml
# SPDX-License-Identifier: (GPL-2.0-only OR BSD-2-Clause)
%YAML 1.2
---
$id: http://devicetree.org/schemas/pinctrl/amlogic,meson-pinctrl-g12a-aobus.yaml#
$schema: http://devicetree.org/meta-schemas/core.yaml#

title: Amlogic Meson G12 AOBUS pinmux controller

maintainers:
  - Neil Armstrong <neil.armstrong@linaro.org>

allOf:
  - $ref: amlogic,meson-pinctrl-common.yaml#

properties:
  compatible:
    enum:
      - amlogic,meson-g12a-aobus-pinctrl

required:
  - compatible

patternProperties:
  "^bank@[0-9a-z]+$":
    $ref: amlogic,meson-pinctrl-common.yaml#/$defs/meson-gpio

    unevaluatedProperties: false

    properties:
      reg:
        maxItems: 3

      reg-names:
        items:
          - const: mux
          - const: ds
          - const: gpio

      gpio-line-names:
        maxItems: 15

unevaluatedProperties:
  type: object
  $ref: amlogic,meson-pinctrl-common.yaml#/$defs/meson-pins

examples:
  - |
    ao_pinctrl: pinctrl {
      compatible = "amlogic,meson-g12a-aobus-pinctrl";
      #address-cells = <1>;
      #size-cells = <1>;
      ranges;

      bank@14 {
        reg = <0x14 0x8>,
              <0x1c 0x8>,
              <0x24 0x14>;
        reg-names = "mux", "ds", "gpio";
        gpio-controller;
        #gpio-cells = <2>;
        gpio-ranges = <&ao_pinctrl 0 0 15>;
      };

      cec_ao_a_h_pins: cec_ao_a_h {
        mux {
          groups = "cec_ao_a_h";
          function = "cec_ao_a_h";
          bias-disable;
        };
      };
    };
```

## Documentation/devicetree/bindings/pinctrl/amlogic,meson-pinctrl-g12a-periphs.yaml
```yaml
# SPDX-License-Identifier: (GPL-2.0-only OR BSD-2-Clause)
%YAML 1.2
---
$id: http://devicetree.org/schemas/pinctrl/amlogic,meson-pinctrl-g12a-periphs.yaml#
$schema: http://devicetree.org/meta-schemas/core.yaml#

title: Amlogic Meson G12 PERIPHS pinmux controller

maintainers:
  - Neil Armstrong <neil.armstrong@linaro.org>

allOf:
  - $ref: amlogic,meson-pinctrl-common.yaml#

properties:
  compatible:
    enum:
      - amlogic,meson-g12a-periphs-pinctrl

required:
  - compatible

patternProperties:
  "^bank@[0-9a-z]+$":
    $ref: amlogic,meson-pinctrl-common.yaml#/$defs/meson-gpio

    unevaluatedProperties: false

    properties:
      reg:
        maxItems: 5

      reg-names:
        items:
          - const: gpio
          - const: pull
          - const: pull-enable
          - const: mux
          - const: ds

unevaluatedProperties:
  type: object
  $ref: amlogic,meson-pinctrl-common.yaml#/$defs/meson-pins

examples:
  - |
    periphs_pinctrl: pinctrl {
      compatible = "amlogic,meson-g12a-periphs-pinctrl";
      #address-cells = <1>;
      #size-cells = <1>;
      ranges;

      bank@40 {
        reg = <0x40  0x4c>,
              <0xe8  0x18>,
              <0x120 0x18>,
              <0x2c0 0x40>,
              <0x340 0x1c>;
        reg-names = "gpio", "pull", "pull-enable", "mux", "ds";
        gpio-controller;
        #gpio-cells = <2>;
        gpio-ranges = <&periphs_pinctrl 0 0 86>;
      };

      cec_ao_a_h_pins: cec_ao_a_h {
        mux {
          groups = "cec_ao_a_h";
          function = "cec_ao_a_h";
          bias-disable;
        };
      };
    };
```

## Documentation/devicetree/bindings/pinctrl/amlogic,meson8-pinctrl-aobus.yaml
```yaml
# SPDX-License-Identifier: (GPL-2.0-only OR BSD-2-Clause)
%YAML 1.2
---
$id: http://devicetree.org/schemas/pinctrl/amlogic,meson8-pinctrl-aobus.yaml#
$schema: http://devicetree.org/meta-schemas/core.yaml#

title: Amlogic Meson8 AOBUS pinmux controller

maintainers:
  - Neil Armstrong <neil.armstrong@linaro.org>

allOf:
  - $ref: amlogic,meson-pinctrl-common.yaml#

properties:
  compatible:
    oneOf:
      - enum:
          - amlogic,meson8-aobus-pinctrl
          - amlogic,meson8b-aobus-pinctrl
          - amlogic,meson-gxbb-aobus-pinctrl
          - amlogic,meson-gxl-aobus-pinctrl
          - amlogic,meson-axg-aobus-pinctrl
      - items:
          - const: amlogic,meson8m2-aobus-pinctrl
          - const: amlogic,meson8-aobus-pinctrl

required:
  - compatible

patternProperties:
  "^bank@[0-9a-f]+$":
    $ref: amlogic,meson-pinctrl-common.yaml#/$defs/meson-gpio

    unevaluatedProperties: false

    properties:
      reg:
        maxItems: 3

      reg-names:
        items:
          - const: mux
          - const: pull
          - const: gpio

      gpio-line-names:
        minItems: 11 # GXL
        maxItems: 16 # Meson8

unevaluatedProperties:
  type: object
  $ref: amlogic,meson-pinctrl-common.yaml#/$defs/meson-pins

examples:
  - |
    pinctrl_aobus: pinctrl {
      compatible = "amlogic,meson8-aobus-pinctrl";
      #address-cells = <1>;
      #size-cells = <1>;
      ranges;

      bank@14 {
        reg = <0x14 0x4>,
              <0x2c 0x4>,
              <0x24 0x8>;
        reg-names = "mux", "pull", "gpio";
        gpio-controller;
        #gpio-cells = <2>;
        gpio-ranges = <&pinctrl_aobus 0 0 16>;
      };

      cec_ao_a_h_pins: cec_ao_a_h {
        mux {
          groups = "cec_ao_a_h";
          function = "cec_ao_a_h";
          bias-disable;
        };
      };
    };
```

## Documentation/devicetree/bindings/pinctrl/amlogic,meson8-pinctrl-cbus.yaml
```yaml
# SPDX-License-Identifier: (GPL-2.0-only OR BSD-2-Clause)
%YAML 1.2
---
$id: http://devicetree.org/schemas/pinctrl/amlogic,meson8-pinctrl-cbus.yaml#
$schema: http://devicetree.org/meta-schemas/core.yaml#

title: Amlogic Meson8 CBUS pinmux controller

maintainers:
  - Neil Armstrong <neil.armstrong@linaro.org>

allOf:
  - $ref: amlogic,meson-pinctrl-common.yaml#

properties:
  compatible:
    oneOf:
      - enum:
          - amlogic,meson8-cbus-pinctrl
          - amlogic,meson8b-cbus-pinctrl
          - amlogic,meson-gxbb-periphs-pinctrl
          - amlogic,meson-gxl-periphs-pinctrl
          - amlogic,meson-axg-periphs-pinctrl
      - items:
          - const: amlogic,meson8m2-cbus-pinctrl
          - const: amlogic,meson8-cbus-pinctrl

required:
  - compatible

patternProperties:
  "^bank@[0-9a-f]+$":
    $ref: amlogic,meson-pinctrl-common.yaml#/$defs/meson-gpio

    unevaluatedProperties: false

    properties:
      reg:
        maxItems: 4

      reg-names:
        items:
          - const: mux
          - const: pull
          - const: pull-enable
          - const: gpio

      gpio-line-names:
        minItems: 83 # Meson8b
        maxItems: 120 # Meson8

unevaluatedProperties:
  type: object
  $ref: amlogic,meson-pinctrl-common.yaml#/$defs/meson-pins

examples:
  - |
    pinctrl_cbus: pinctrl {
      compatible = "amlogic,meson8-cbus-pinctrl";
      #address-cells = <1>;
      #size-cells = <1>;
      ranges;

      bank@80b0 {
        reg = <0x80b0 0x28>,
              <0x80e8 0x18>,
              <0x8120 0x18>,
              <0x8030 0x30>;
        reg-names = "mux", "pull", "pull-enable", "gpio";
        gpio-controller;
        #gpio-cells = <2>;
        gpio-ranges = <&pinctrl_cbus 0 0 120>;
      };

      cec_ao_a_h_pins: cec_ao_a_h {
        mux {
          groups = "cec_ao_a_h";
          function = "cec_ao_a_h";
          bias-disable;
        };
      };
    };
```
