## Documentation/devicetree/bindings/pinctrl/renesas,rzg2l-pinctrl.yaml
```yaml
# SPDX-License-Identifier: (GPL-2.0-only OR BSD-2-Clause)
%YAML 1.2
---
$id: http://devicetree.org/schemas/pinctrl/renesas,rzg2l-pinctrl.yaml#
$schema: http://devicetree.org/meta-schemas/core.yaml#

title: Renesas RZ/{G2L,V2L} combined Pin and GPIO controller

maintainers:
  - Geert Uytterhoeven <geert+renesas@glider.be>
  - Lad Prabhakar <prabhakar.mahadev-lad.rj@bp.renesas.com>

description:
  The Renesas SoCs of the RZ/{G2L,V2L} alike series feature a combined Pin and
  GPIO controller.
  Pin multiplexing and GPIO configuration is performed on a per-pin basis.
  Each port features up to 8 pins, each of them configurable for GPIO function
  (port mode) or in alternate function mode.
  Up to 8 different alternate function modes exist for each single pin.

properties:
  compatible:
    oneOf:
      - items:
          - enum:
              - renesas,r9a07g043-pinctrl # RZ/G2UL{Type-1,Type-2} and RZ/Five
              - renesas,r9a07g044-pinctrl # RZ/G2{L,LC}
              - renesas,r9a08g045-pinctrl # RZ/G3S

      - items:
          - enum:
              - renesas,r9a07g054-pinctrl     # RZ/V2L
          - const: renesas,r9a07g044-pinctrl  # RZ/G2{L,LC} fallback for RZ/V2L

  reg:
    maxItems: 1

  gpio-controller: true

  '#gpio-cells':
    const: 2
    description:
      The first cell contains the global GPIO port index, constructed using the
      RZG2L_GPIO() helper macro in <dt-bindings/pinctrl/rzg2l-pinctrl.h> and the
      second cell represents consumer flag as mentioned in ../gpio/gpio.txt
      E.g. "RZG2L_GPIO(39, 1)" for P39_1.

  gpio-ranges:
    maxItems: 1

  interrupt-controller: true

  '#interrupt-cells':
    const: 2
    description:
      The first cell contains the global GPIO port index, constructed using the
      RZG2L_GPIO() helper macro in <dt-bindings/pinctrl/rzg2l-pinctrl.h> and the
      second cell is used to specify the flag.
      E.g. "interrupts = <RZG2L_GPIO(43, 0) IRQ_TYPE_EDGE_FALLING>;" if P43_0 is
      being used as an interrupt.

  clocks:
    maxItems: 1

  power-domains:
    maxItems: 1

  resets:
    items:
      - description: GPIO_RSTN signal
      - description: GPIO_PORT_RESETN signal
      - description: GPIO_SPARE_RESETN signal

additionalProperties:
  anyOf:
    - type: object
      additionalProperties: false
      allOf:
        - $ref: pincfg-node.yaml#
        - $ref: pinmux-node.yaml#

        - if:
            properties:
              compatible:
                contains:
                  enum:
                    - renesas,r9a08g045-pinctrl
          then:
            properties:
              drive-strength: false
              output-impedance-ohms: false
              slew-rate: false
          else:
            properties:
              drive-strength-microamp: false

      description:
        Pin controller client devices use pin configuration subnodes (children
        and grandchildren) for desired pin configuration.
        Client device subnodes use below standard properties.

      properties:
        pinmux:
          description:
            Values are constructed from GPIO port number, pin number, and
            alternate function configuration number using the RZG2L_PORT_PINMUX()
            helper macro in <dt-bindings/pinctrl/rzg2l-pinctrl.h>.
        pins: true
        drive-strength:
          enum: [ 2, 4, 8, 12 ]
        drive-strength-microamp:
          enum: [ 1900, 2200, 4000, 4400, 4500, 4700, 5200, 5300, 5700,
                  5800, 6000, 6050, 6100, 6550, 6800, 7000, 8000, 9000,
                  10000 ]
        output-impedance-ohms:
          enum: [ 33, 50, 66, 100 ]
        power-source:
          description: I/O voltage in millivolt.
          enum: [ 1800, 2500, 3300 ]
        slew-rate: true
        gpio-hog: true
        gpios: true
        input-enable: true
        output-high: true
        output-low: true
        line-name: true

    - type: object
      additionalProperties:
        $ref: "#/additionalProperties/anyOf/0"

allOf:
  - $ref: pinctrl.yaml#

required:
  - compatible
  - reg
  - gpio-controller
  - '#gpio-cells'
  - gpio-ranges
  - interrupt-controller
  - '#interrupt-cells'
  - clocks
  - power-domains
  - resets

examples:
  - |
    #include <dt-bindings/pinctrl/rzg2l-pinctrl.h>
    #include <dt-bindings/clock/r9a07g044-cpg.h>

    pinctrl: pinctrl@11030000 {
            compatible = "renesas,r9a07g044-pinctrl";
            reg = <0x11030000 0x10000>;

            gpio-controller;
            #gpio-cells = <2>;
            gpio-ranges = <&pinctrl 0 0 392>;
            interrupt-controller;
            #interrupt-cells = <2>;
            clocks = <&cpg CPG_MOD R9A07G044_GPIO_HCLK>;
            resets = <&cpg R9A07G044_GPIO_RSTN>,
                     <&cpg R9A07G044_GPIO_PORT_RESETN>,
                     <&cpg R9A07G044_GPIO_SPARE_RESETN>;
            power-domains = <&cpg>;

            scif0_pins: serial0 {
                    pinmux = <RZG2L_PORT_PINMUX(38, 0, 1)>, /* Tx */
                             <RZG2L_PORT_PINMUX(38, 1, 1)>; /* Rx */
            };

            i2c1_pins: i2c1 {
                    pins = "RIIC1_SDA", "RIIC1_SCL";
                    input-enable;
            };

            sd1-pwr-en-hog {
                    gpio-hog;
                    gpios = <RZG2L_GPIO(39, 2) 0>;
                    output-high;
                    line-name = "sd1_pwr_en";
            };

            sdhi1_pins: sd1 {
                    sd1_mux {
                            pinmux = <RZG2L_PORT_PINMUX(19, 0, 1)>, /* CD */
                                     <RZG2L_PORT_PINMUX(19, 1, 1)>; /* WP */
                            power-source = <3300>;
                    };

                    sd1_data {
                            pins = "SD1_DATA0", "SD1_DATA1", "SD1_DATA2", "SD1_DATA3";
                            power-source = <3300>;
                    };

                    sd1_ctrl {
                            pins = "SD1_CLK", "SD1_CMD";
                            power-source = <3300>;
                    };
            };
    };
```

## Documentation/devicetree/bindings/pinctrl/renesas,rzg2l-poeg.yaml
```yaml
# SPDX-License-Identifier: (GPL-2.0-only OR BSD-2-Clause)
%YAML 1.2
---
$id: http://devicetree.org/schemas/pinctrl/renesas,rzg2l-poeg.yaml#
$schema: http://devicetree.org/meta-schemas/core.yaml#

title: Renesas RZ/G2L Port Output Enable for GPT (POEG)

maintainers:
  - Biju Das <biju.das.jz@bp.renesas.com>

description: |
  The output pins(GTIOCxA and GTIOCxB) of the general PWM timer (GPT) can be
  disabled by using the port output enabling function for the GPT (POEG).
  Specifically, either of the following ways can be used.
  * Input level detection of the GTETRGA to GTETRGD pins.
  * Output-disable request from the GPT.
  * SSF bit setting(ie, by setting POEGGn.SSF to 1)

  The state of the GTIOCxA and the GTIOCxB pins when the output is disabled,
  are controlled by the GPT module.

properties:
  compatible:
    items:
      - enum:
          - renesas,r9a07g044-poeg  # RZ/G2{L,LC}
          - renesas,r9a07g054-poeg  # RZ/V2L
      - const: renesas,rzg2l-poeg

  reg:
    maxItems: 1

  interrupts:
    maxItems: 1

  clocks:
    maxItems: 1

  power-domains:
    maxItems: 1

  resets:
    maxItems: 1

  renesas,gpt:
    $ref: /schemas/types.yaml#/definitions/phandle
    description: phandle to gpt instance that serves the pwm operation.

  renesas,poeg-id:
    $ref: /schemas/types.yaml#/definitions/uint32
    enum: [ 0, 1, 2, 3 ]
    description: |
      POEG group index. Valid values are:
        <0> : POEG group A
        <1> : POEG group B
        <2> : POEG group C
        <3> : POEG group D

required:
  - compatible
  - reg
  - interrupts
  - clocks
  - power-domains
  - resets
  - renesas,poeg-id
  - renesas,gpt

additionalProperties: false

examples:
  - |
    #include <dt-bindings/clock/r9a07g044-cpg.h>
    #include <dt-bindings/interrupt-controller/arm-gic.h>

    poeggd: poeg@10049400 {
        compatible = "renesas,r9a07g044-poeg", "renesas,rzg2l-poeg";
        reg = <0x10049400 0x400>;
        interrupts = <GIC_SPI 325 IRQ_TYPE_LEVEL_HIGH>;
        clocks = <&cpg CPG_MOD R9A07G044_POEG_D_CLKP>;
        power-domains = <&cpg>;
        resets = <&cpg R9A07G044_POEG_D_RST>;
        renesas,poeg-id = <3>;
        renesas,gpt = <&gpt>;
    };
```

## Documentation/devicetree/bindings/pinctrl/renesas,rzn1-pinctrl.txt
```
Renesas RZ/N1 SoC Pinctrl node description.

Pin controller node
-------------------
Required properties:
- compatible: SoC-specific compatible string "renesas,<soc-specific>-pinctrl"
  followed by "renesas,rzn1-pinctrl" as fallback. The SoC-specific compatible
  strings must be one of:
	"renesas,r9a06g032-pinctrl" for RZ/N1D
	"renesas,r9a06g033-pinctrl" for RZ/N1S
- reg: Address base and length of the memory area where the pin controller
  hardware is mapped to.
- clocks: phandle for the clock, see the description of clock-names below.
- clock-names: Contains the name of the clock:
    "bus", the bus clock, sometimes described as pclk, for register accesses.

Example:
	pinctrl: pin-controller@40067000 {
	    compatible = "renesas,r9a06g032-pinctrl", "renesas,rzn1-pinctrl";
	    reg = <0x40067000 0x1000>, <0x51000000 0x480>;
	    clocks = <&sysctrl R9A06G032_HCLK_PINCONFIG>;
	    clock-names = "bus";
	};

Sub-nodes
---------

The child nodes of the pin controller node describe a pin multiplexing
function.

- Pin multiplexing sub-nodes:
  A pin multiplexing sub-node describes how to configure a set of
  (or a single) pin in some desired alternate function mode.
  A single sub-node may define several pin configurations.
  Please refer to pinctrl-bindings.txt to get to know more on generic
  pin properties usage.

  The allowed generic formats for a pin multiplexing sub-node are the
  following ones:

  node-1 {
      pinmux = <PIN_ID_AND_MUX>, <PIN_ID_AND_MUX>, ... ;
      GENERIC_PINCONFIG;
  };

  node-2 {
      sub-node-1 {
          pinmux = <PIN_ID_AND_MUX>, <PIN_ID_AND_MUX>, ... ;
          GENERIC_PINCONFIG;
      };

      sub-node-2 {
          pinmux = <PIN_ID_AND_MUX>, <PIN_ID_AND_MUX>, ... ;
          GENERIC_PINCONFIG;
      };

      ...

      sub-node-n {
          pinmux = <PIN_ID_AND_MUX>, <PIN_ID_AND_MUX>, ... ;
          GENERIC_PINCONFIG;
      };
  };

  node-3 {
      pinmux = <PIN_ID_AND_MUX>, <PIN_ID_AND_MUX>, ... ;
      GENERIC_PINCONFIG;

      sub-node-1 {
          pinmux = <PIN_ID_AND_MUX>, <PIN_ID_AND_MUX>, ... ;
          GENERIC_PINCONFIG;
      };

      ...

      sub-node-n {
          pinmux = <PIN_ID_AND_MUX>, <PIN_ID_AND_MUX>, ... ;
          GENERIC_PINCONFIG;
      };
  };

  Use the latter two formats when pins part of the same logical group need to
  have different generic pin configuration flags applied. Note that the generic
  pinconfig in node-3 does not apply to the sub-nodes.

  Client sub-nodes shall refer to pin multiplexing sub-nodes using the phandle
  of the most external one.

  Eg.

  client-1 {
      ...
      pinctrl-0 = <&node-1>;
      ...
  };

  client-2 {
      ...
      pinctrl-0 = <&node-2>;
      ...
  };

  Required properties:
    - pinmux:
      integer array representing pin number and pin multiplexing configuration.
      When a pin has to be configured in alternate function mode, use this
      property to identify the pin by its global index, and provide its
      alternate function configuration number along with it.
      When multiple pins are required to be configured as part of the same
      alternate function they shall be specified as members of the same
      argument list of a single "pinmux" property.
      Integers values in the "pinmux" argument list are assembled as:
      (PIN | MUX_FUNC << 8)
      where PIN directly corresponds to the pl_gpio pin number and MUX_FUNC is
      one of the alternate function identifiers defined in:
      <include/dt-bindings/pinctrl/rzn1-pinctrl.h>
      These identifiers collapse the IO Multiplex Configuration Level 1 and
      Level 2 numbers that are detailed in the hardware reference manual into a
      single number. The identifiers for Level 2 are simply offset by 10.
      Additional identifiers are provided to specify the MDIO source peripheral.

  Optional generic pinconf properties:
    - bias-disable		- disable any pin bias
    - bias-pull-up		- pull up the pin with 50 KOhm
    - bias-pull-down		- pull down the pin with 50 KOhm
    - bias-high-impedance	- high impedance mode
    - drive-strength		- sink or source at most 4, 6, 8 or 12 mA

  Example:
  A serial communication interface with a TX output pin and an RX input pin.

  &pinctrl {
	pins_uart0: pins_uart0 {
		pinmux = <
			RZN1_PINMUX(103, RZN1_FUNC_UART0_I)	/* UART0_TXD */
			RZN1_PINMUX(104, RZN1_FUNC_UART0_I)	/* UART0_RXD */
		>;
	};
  };

  Example 2:
  Here we set the pull up on the RXD pin of the UART.

  &pinctrl {
	pins_uart0: pins_uart0 {
		pinmux = <RZN1_PINMUX(103, RZN1_FUNC_UART0_I)>;	/* TXD */

		pins_uart6_rx {
			pinmux = <RZN1_PINMUX(104, RZN1_FUNC_UART0_I)>; /* RXD */
			bias-pull-up;
		};
	};
  };
```
