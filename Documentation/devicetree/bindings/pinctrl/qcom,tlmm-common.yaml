## Documentation/devicetree/bindings/pinctrl/qcom,tlmm-common.yaml
```yaml
# SPDX-License-Identifier: (GPL-2.0-only OR BSD-2-Clause)
%YAML 1.2
---
$id: http://devicetree.org/schemas/pinctrl/qcom,tlmm-common.yaml#
$schema: http://devicetree.org/meta-schemas/core.yaml#

title: Qualcomm Technologies, Inc. Top Level Mode Multiplexer (TLMM) definitions

maintainers:
  - Bjorn Andersson <bjorn.andersson@linaro.org>

description:
  This defines the common properties used to describe all Qualcomm Top Level
  Mode Multiplexer bindings and pinconf/pinmux states for these.

properties:
  interrupts:
    description:
      TLMM summary IRQ and dirconn interrupts.
    minItems: 1
    maxItems: 9

  interrupt-controller: true

  '#interrupt-cells':
    description:
      Specifies the PIN numbers and Flags, as defined in defined in
      include/dt-bindings/interrupt-controller/irq.h
    const: 2

  gpio-controller: true

  '#gpio-cells':
    description:
      Specifying the pin number and flags, as defined in
      include/dt-bindings/gpio/gpio.h
    const: 2

  gpio-ranges:
    maxItems: 1

  wakeup-parent:
    description:
      Specifying the interrupt-controller used to wake up the system when the
      TLMM block has been powered down.

  gpio-reserved-ranges:
    description:
      Pins can be reserved for trusted applications and thereby unaccessible
      from the OS.  This property can be used to mark the pins which resources
      should not be accessed by the OS. Please see the ../gpio/gpio.txt for more
      information.

allOf:
  - $ref: pinctrl.yaml#

required:
  - interrupts
  - interrupt-controller
  - '#interrupt-cells'
  - gpio-controller
  - '#gpio-cells'
  - gpio-ranges

additionalProperties: true

$defs:
  qcom-tlmm-state:
    properties:
      drive-strength:
        enum: [2, 4, 6, 8, 10, 12, 14, 16]
        description:
          Selects the drive strength for the specified pins, in mA.

      bias-pull-down: true
      bias-pull-up: true
      bias-disable: true
      input-enable: false
      output-disable: true
      output-enable: true
      output-high: true
      output-low: true

    allOf:
      - $ref: pincfg-node.yaml#
      - $ref: pinmux-node.yaml#

      - if:
          properties:
            pins:
              items:
                pattern: "^gpio"
        then:
          required:
            - function
        else:
          properties:
            function: false

    additionalProperties: true
...
```

## Documentation/devicetree/bindings/pinctrl/qcom,x1e80100-tlmm.yaml
```yaml
# SPDX-License-Identifier: (GPL-2.0-only OR BSD-2-Clause)
%YAML 1.2
---
$id: http://devicetree.org/schemas/pinctrl/qcom,x1e80100-tlmm.yaml#
$schema: http://devicetree.org/meta-schemas/core.yaml#

title: Qualcomm Technologies, Inc. X1E80100 TLMM block

maintainers:
  - Rajendra Nayak <quic_rjendra@quicinc.com>

description:
  Top Level Mode Multiplexer pin controller in Qualcomm X1E80100 SoC.

allOf:
  - $ref: /schemas/pinctrl/qcom,tlmm-common.yaml#

properties:
  compatible:
    const: qcom,x1e80100-tlmm

  reg:
    maxItems: 1

  interrupts:
    maxItems: 1

  gpio-reserved-ranges:
    minItems: 1
    maxItems: 119

  gpio-line-names:
    maxItems: 238

patternProperties:
  "-state$":
    oneOf:
      - $ref: "#/$defs/qcom-x1e80100-tlmm-state"
      - patternProperties:
          "-pins$":
            $ref: "#/$defs/qcom-x1e80100-tlmm-state"
        additionalProperties: false

$defs:
  qcom-x1e80100-tlmm-state:
    type: object
    description:
      Pinctrl node's client devices use subnodes for desired pin configuration.
      Client device subnodes use below standard properties.
    $ref: qcom,tlmm-common.yaml#/$defs/qcom-tlmm-state
    unevaluatedProperties: false

    properties:
      pins:
        description:
          List of gpio pins affected by the properties specified in this
          subnode.
        items:
          oneOf:
            - pattern: "^gpio([0-9]|[1-9][0-9]|1[0-9][0-9]|2[0-2][0-9]|23[0-7])$"
            - enum: [ ufs_reset, sdc2_clk, sdc2_cmd, sdc2_data ]
        minItems: 1
        maxItems: 36

      function:
        description:
          Specify the alternative function to be configured for the specified
          pins.
        enum: [ aon_cci, aoss_cti, atest_char, atest_char0,
                atest_char1, atest_char2, atest_char3, atest_usb,
                audio_ext, audio_ref, cam_aon, cam_mclk, cci_async,
                cci_i2c, cci_timer0, cci_timer1, cci_timer2, cci_timer3,
                cci_timer4, cmu_rng0, cmu_rng1, cmu_rng2, cmu_rng3,
                cri_trng, dbg_out, ddr_bist, ddr_pxi0, ddr_pxi1,
                ddr_pxi2, ddr_pxi3, ddr_pxi4, ddr_pxi5, ddr_pxi6, ddr_pxi7,
                edp0_hot, edp0_lcd, edp1_hot, edp1_lcd, eusb0_ac, eusb1_ac,
                eusb2_ac, eusb3_ac, eusb5_ac, eusb6_ac, gcc_gp1, gcc_gp2,
                gcc_gp3, gpio, i2s0_data0, i2s0_data1, i2s0_sck, i2s0_ws, i2s1_data0,
                i2s1_data1, i2s1_sck, i2s1_ws, ibi_i3c, jitter_bist, mdp_vsync0,
                mdp_vsync1, mdp_vsync2, mdp_vsync3, mdp_vsync4, mdp_vsync5,
                mdp_vsync6, mdp_vsync7, mdp_vsync8, pcie3_clk, pcie4_clk,
                pcie5_clk, pcie6a_clk, pcie6b_clk, phase_flag, pll_bist, pll_clk,
                prng_rosc0, prng_rosc1, prng_rosc2, prng_rosc3, qdss_cti,
                qdss_gpio, qspi00, qspi01, qspi02, qspi03, qspi0_clk, qspi0_cs0,
                qspi0_cs1, qup0_se0, qup0_se1, qup0_se2, qup0_se3, qup0_se4,
                qup0_se5, qup0_se6, qup0_se7, qup1_se0, qup1_se1, qup1_se2, qup1_se3,
                qup1_se4, qup1_se5, qup1_se6, qup1_se7, qup2_se0, qup2_se1, qup2_se2,
                qup2_se3, qup2_se4, qup2_se5, qup2_se6, qup2_se7, sd_write, sdc4_clk,
                sdc4_cmd, sdc4_data0, sdc4_data1, sdc4_data2, sdc4_data3, sys_throttle,
                tb_trig, tgu_ch0, tgu_ch1, tgu_ch2, tgu_ch3, tgu_ch4, tgu_ch5,
                tgu_ch6, tgu_ch7, tmess_prng0, tmess_prng1, tmess_prng2, tmess_prng3,
                tsense_pwm1, tsense_pwm2, sense_pwm3, tsense_pwm4, usb0_dp, usb0_phy,
                usb0_sbrx, usb0_sbtx, usb1_dp, usb1_phy, usb1_sbrx, usb1_sbtx,
                usb2_dp, usb2_phy, usb2_sbrx, usb2_sbtx, vsense_trigger ]

    required:
      - pins

required:
  - compatible
  - reg

unevaluatedProperties: false

examples:
  - |
    #include <dt-bindings/interrupt-controller/arm-gic.h>
    tlmm: pinctrl@f100000 {
        compatible = "qcom,x1e80100-tlmm";
        reg = <0x0f100000 0xf00000>;
        gpio-controller;
        #gpio-cells = <2>;
        gpio-ranges = <&tlmm 0 0 239>;
        interrupt-controller;
        #interrupt-cells = <2>;
        interrupts = <GIC_SPI 208 IRQ_TYPE_LEVEL_HIGH>;

        gpio-wo-state {
            pins = "gpio1";
            function = "gpio";
        };

        uart-w-state {
            rx-pins {
                pins = "gpio26";
                function = "qup2_se7";
                bias-pull-up;
            };

            tx-pins {
                pins = "gpio27";
                function = "qup2_se7";
                bias-disable;
            };
        };
    };
...
```

## Documentation/devicetree/bindings/pinctrl/ralink,mt7620-pinctrl.yaml
```yaml
# SPDX-License-Identifier: GPL-2.0-only OR BSD-2-Clause
%YAML 1.2
---
$id: http://devicetree.org/schemas/pinctrl/ralink,mt7620-pinctrl.yaml#
$schema: http://devicetree.org/meta-schemas/core.yaml#

title: Ralink MT7620 Pin Controller

maintainers:
  - Arınç ÜNAL <arinc.unal@arinc9.com>
  - Sergio Paracuellos <sergio.paracuellos@gmail.com>

description:
  Ralink MT7620 pin controller for MT7620, MT7628 and MT7688 SoCs.
  The pin controller can only set the muxing of pin groups. Muxing individual
  pins is not supported. There is no pinconf support.

properties:
  compatible:
    const: ralink,mt7620-pinctrl

patternProperties:
  '-pins$':
    type: object
    patternProperties:
      '^(.*-)?pinmux$':
        type: object
        description: node for pinctrl.
        $ref: pinmux-node.yaml#

        properties:
          groups:
            description: The pin group to select.
            enum: [
              # common
              i2c, spi, wdt,

              # For MT7620 SoC
              ephy, mdio, nd_sd, pa, pcie, rgmii1, rgmii2, spi refclk,
              uartf, uartlite, wled,

              # For MT7628 and MT7688 SoCs
              gpio, i2s, p0led_an, p0led_kn, p1led_an, p1led_kn, p2led_an,
              p2led_kn, p3led_an, p3led_kn, p4led_an, p4led_kn, perst, pwm0,
              pwm1, refclk, sdmode, spi cs1, spis, uart0, uart1, uart2,
              wled_an, wled_kn,
            ]

          function:
            description: The mux function to select.
            enum: [
              # common
              gpio, i2c, refclk, spi,

              # For MT7620 SoC
              ephy, gpio i2s, gpio uartf, i2s uartf, mdio, nand, pa,
              pcie refclk, pcie rst, pcm gpio, pcm i2s, pcm uartf,
              rgmii1, rgmii2, sd, spi refclk, uartf, uartlite, wdt refclk,
              wdt rst, wled,

              # For MT7628 and MT7688 SoCs
              antenna, debug, i2s, jtag, p0led_an, p0led_kn,
              p1led_an, p1led_kn, p2led_an, p2led_kn, p3led_an, p3led_kn,
              p4led_an, p4led_kn, pcie, pcm, perst, pwm, pwm0, pwm1, pwm_uart2,
              rsvd, sdxc, sdxc d5 d4, sdxc d6, sdxc d7, spi cs1,
              spis, sw_r, uart0, uart1, uart2, utif, wdt, wled_an, wled_kn, -,
            ]

        required:
          - groups
          - function

        additionalProperties: false

    additionalProperties: false

allOf:
  - $ref: "pinctrl.yaml#"

required:
  - compatible

additionalProperties: false

examples:
  # Pinmux controller node
  - |
    pinctrl {
      compatible = "ralink,mt7620-pinctrl";

      i2c_pins: i2c0-pins {
        pinmux {
          groups = "i2c";
          function = "i2c";
        };
      };
    };
```

## Documentation/devicetree/bindings/pinctrl/ralink,mt7621-pinctrl.yaml
```yaml
# SPDX-License-Identifier: GPL-2.0-only OR BSD-2-Clause
%YAML 1.2
---
$id: http://devicetree.org/schemas/pinctrl/ralink,mt7621-pinctrl.yaml#
$schema: http://devicetree.org/meta-schemas/core.yaml#

title: Ralink MT7621 Pin Controller

maintainers:
  - Arınç ÜNAL <arinc.unal@arinc9.com>
  - Sergio Paracuellos <sergio.paracuellos@gmail.com>

description:
  Ralink MT7621 pin controller for MT7621 SoC.
  The pin controller can only set the muxing of pin groups. Muxing individual
  pins is not supported. There is no pinconf support.

properties:
  compatible:
    const: ralink,mt7621-pinctrl

patternProperties:
  '-pins$':
    type: object
    patternProperties:
      '^(.*-)?pinmux$':
        type: object
        description: node for pinctrl.
        $ref: pinmux-node.yaml#

        properties:
          groups:
            description: The pin group to select.
            enum: [i2c, jtag, mdio, pcie, rgmii1, rgmii2, sdhci, spi, uart1,
                   uart2, uart3, wdt]

          function:
            description: The mux function to select.
            enum: [gpio, i2c, i2s, jtag, mdio, nand1, nand2, pcie refclk,
                   pcie rst, pcm, rgmii1, rgmii2, sdhci, spdif2, spdif3, spi,
                   uart1, uart2, uart3, wdt refclk, wdt rst]

        required:
          - groups
          - function

        additionalProperties: false

    additionalProperties: false

allOf:
  - $ref: "pinctrl.yaml#"

required:
  - compatible

additionalProperties: false

examples:
  # Pinmux controller node
  - |
    pinctrl {
      compatible = "ralink,mt7621-pinctrl";

      i2c_pins: i2c0-pins {
        pinmux {
          groups = "i2c";
          function = "i2c";
        };
      };
    };
```

## Documentation/devicetree/bindings/pinctrl/ralink,rt2880-pinctrl.yaml
```yaml
# SPDX-License-Identifier: GPL-2.0-only OR BSD-2-Clause
%YAML 1.2
---
$id: http://devicetree.org/schemas/pinctrl/ralink,rt2880-pinctrl.yaml#
$schema: http://devicetree.org/meta-schemas/core.yaml#

title: Ralink RT2880 Pin Controller

maintainers:
  - Arınç ÜNAL <arinc.unal@arinc9.com>
  - Sergio Paracuellos <sergio.paracuellos@gmail.com>

description:
  Ralink RT2880 pin controller for RT2880 SoC.
  The pin controller can only set the muxing of pin groups. Muxing individual
  pins is not supported. There is no pinconf support.

properties:
  compatible:
    const: ralink,rt2880-pinctrl

patternProperties:
  '-pins$':
    type: object
    patternProperties:
      '^(.*-)?pinmux$':
        type: object
        description: node for pinctrl.
        $ref: pinmux-node.yaml#

        properties:
          groups:
            description: The pin group to select.
            enum: [i2c, spi, uartlite, jtag, mdio, sdram, pci]

          function:
            description: The mux function to select.
            enum: [gpio, i2c, spi, uartlite, jtag, mdio, sdram, pci]

        required:
          - groups
          - function

        additionalProperties: false

    additionalProperties: false

allOf:
  - $ref: "pinctrl.yaml#"

required:
  - compatible

additionalProperties: false

examples:
  # Pinmux controller node
  - |
    pinctrl {
      compatible = "ralink,rt2880-pinctrl";

      i2c_pins: i2c0-pins {
        pinmux {
          groups = "i2c";
          function = "i2c";
        };
      };
    };
```

## Documentation/devicetree/bindings/pinctrl/ralink,rt2880-pinmux.yaml
```yaml
# SPDX-License-Identifier: GPL-2.0-only OR BSD-2-Clause
%YAML 1.2
---
$id: http://devicetree.org/schemas/pinctrl/ralink,rt2880-pinmux.yaml#
$schema: http://devicetree.org/meta-schemas/core.yaml#

title: Ralink rt2880 pinmux controller

maintainers:
  - Sergio Paracuellos <sergio.paracuellos@gmail.com>

description:
  The rt2880 pinmux can only set the muxing of pin groups. Muxing indiviual pins
  is not supported. There is no pinconf support.

properties:
  compatible:
    const: ralink,rt2880-pinmux

patternProperties:
  '-pins$':
    type: object
    patternProperties:
      '^(.*-)?pinmux$':
        type: object
        description: node for pinctrl.
        $ref: pinmux-node.yaml#

        properties:
          groups:
            description: Name of the pin group to use for the functions.
            enum: [i2c, jtag, mdio, pcie, rgmii1, rgmii2, sdhci, spi,
                   uart1, uart2, uart3, wdt]
          function:
            description: The mux function to select
            enum: [gpio, i2c, i2s, jtag, mdio, nand1, nand2, pcie refclk,
                   pcie rst, pcm, rgmii1, rgmii2, sdhci, spdif2, spdif3,
                   spi, uart1, uart2, uart3, wdt refclk, wdt rst]

        required:
          - groups
          - function

        additionalProperties: false

    additionalProperties: false

allOf:
  - $ref: "pinctrl.yaml#"

required:
  - compatible

additionalProperties: false

examples:
  # Pinmux controller node
  - |
    pinctrl {
      compatible = "ralink,rt2880-pinmux";

      i2c_pins: i2c0-pins {
        pinmux {
          groups = "i2c";
          function = "i2c";
        };
      };
    };
```
