## Documentation/devicetree/bindings/pinctrl/raspberrypi,rp1-gpio.yaml
```yaml
# SPDX-License-Identifier: (GPL-2.0-only OR BSD-2-Clause)
%YAML 1.2
---
$id: http://devicetree.org/schemas/pinctrl/raspberrypi,rp1-gpio.yaml#
$schema: http://devicetree.org/meta-schemas/core.yaml#

title: RaspberryPi RP1 GPIO/Pinconf/Pinmux Controller submodule

maintainers:
  - A. della Porta <andrea.porta@suse.com>

description:
  The RP1 chipset is a Multi Function Device containing, among other
  sub-peripherals, a gpio/pinconf/mux controller whose 54 pins are grouped
  into 3 banks.
  It works also as an interrupt controller for those gpios.

properties:
  compatible:
    const: raspberrypi,rp1-gpio

  reg:
    maxItems: 3
    description: One reg specifier for each one of the 3 pin banks.

  '#gpio-cells':
    description: The first cell is the pin number and the second cell is used
      to specify the flags (see include/dt-bindings/gpio/gpio.h).
    const: 2

  gpio-controller: true

  gpio-ranges:
    maxItems: 1

  gpio-line-names:
    maxItems: 54

  interrupts:
    maxItems: 3
    description: One interrupt specifier for each one of the 3 pin banks.

  '#interrupt-cells':
    description:
      Specifies the Bank number [0, 1, 2] and Flags as defined in
      include/dt-bindings/interrupt-controller/irq.h.
    const: 2

  interrupt-controller: true

patternProperties:
  '-state$':
    oneOf:
      - $ref: '#/$defs/raspberrypi-rp1-state'
      - patternProperties:
          '-pins$':
            $ref: '#/$defs/raspberrypi-rp1-state'
        additionalProperties: false

$defs:
  raspberrypi-rp1-state:
    allOf:
      - $ref: pincfg-node.yaml#
      - $ref: pinmux-node.yaml#

    description:
      Pin controller client devices use pin configuration subnodes (children
      and grandchildren) for desired pin configuration.
      Client device subnodes use below standard properties.

    properties:
      pins:
        description:
          List of gpio pins affected by the properties specified in this
          subnode (either this or "groups" must be specified).
        items:
          pattern: '^gpio([0-9]|[1-4][0-9]|5[0-3])$'

      groups:
        description:
          List of groups affected by the properties specified in this
          subnode (either this or "pins" must be specified).
        items:
          anyOf:
            - pattern: '^gpio([0-9]|[1-4][0-9]|5[0-3])$'
            - enum: [ uart0, uart0_ctrl, uart1, uart1_ctrl, uart2, uart2_ctrl,
                      uart3, uart3_ctrl, uart4, uart4_ctrl, uart5_0,
                      uart5_0_ctrl, uart5_1, uart5_1_ctrl, uart5_2,
                      uart5_2_ctrl, uart5_3,
                      sd0, sd1,
                      i2s0, i2s0_dual, i2s0_quad, i2s1, i2s1_dual, i2s1_quad,
                      i2s2_0, i2s2_0_dual, i2s2_1, i2s2_1_dual,
                      i2c4_0, i2c4_1, i2c4_2, i2c4_3, i2c6_0, i2c6_1, i2c5_0,
                      i2c5_1, i2c5_2, i2c5_3, i2c0_0, i2c0_1, i2c1_0, i2c1_1,
                      i2c2_0, i2c2_1, i2c3_0, i2c3_1, i2c3_2,
                      dpi_16bit, dpi_16bit_cpadhi, dpi_16bit_pad666,
                      dpi_18bit, dpi_18bit_cpadhi, dpi_24bit,
                      spi0, spi0_quad, spi1, spi2, spi3, spi4, spi5, spi6_0,
                      spi6_1, spi7_0, spi7_1, spi8_0, spi8_1,
                      aaud_0, aaud_1, aaud_2, aaud_3, aaud_4,
                      vbus0_0, vbus0_1, vbus1, vbus2, vbus3,
                      mic_0, mic_1, mic_2, mic_3,
                      ir ]

      function:
        enum: [ alt0, alt1, alt2, alt3, alt4, gpio, alt6, alt7, alt8, none,
                aaud, dcd0, dpi, dsi0_te_ext, dsi1_te_ext, dsr0, dtr0, gpclk0,
                gpclk1, gpclk2, gpclk3, gpclk4, gpclk5, i2c0, i2c1, i2c2, i2c3,
                i2c4, i2c5, i2c6, i2s0, i2s1, i2s2, ir, mic, pcie_clkreq_n,
                pio, proc_rio, pwm0, pwm1, ri0, sd0, sd1, spi0, spi1, spi2,
                spi3, spi4, spi5, spi6, spi7, spi8, uart0, uart1, uart2, uart3,
                uart4, uart5, vbus0, vbus1, vbus2, vbus3 ]

        description:
          Specify the alternative function to be configured for the specified
          pins.

      bias-disable: true
      bias-pull-down: true
      bias-pull-up: true
      input-enable: true
      input-schmitt-enable: true
      output-enable: true
      output-high: true
      output-low: true
      slew-rate:
        description: 0 is slow slew rate, 1 is fast slew rate
        enum: [ 0, 1 ]
      drive-strength:
        enum: [ 2, 4, 8, 12 ]

    required:
      - function

    oneOf:
      - required: [ groups ]
      - required: [ pins ]

    additionalProperties: false

allOf:
  - $ref: pinctrl.yaml#

required:
  - reg
  - compatible
  - '#gpio-cells'
  - gpio-controller
  - interrupts
  - '#interrupt-cells'
  - interrupt-controller

unevaluatedProperties: false

examples:
  - |
    #include <dt-bindings/interrupt-controller/irq.h>

    rp1 {
        #address-cells = <2>;
        #size-cells = <2>;

        rp1_gpio: pinctrl@c0400d0000 {
            reg = <0xc0 0x400d0000  0x0 0xc000>,
                  <0xc0 0x400e0000  0x0 0xc000>,
                  <0xc0 0x400f0000  0x0 0xc000>;
            compatible = "raspberrypi,rp1-gpio";
            gpio-controller;
            #gpio-cells = <2>;
            interrupt-controller;
            #interrupt-cells = <2>;
            interrupts = <0 IRQ_TYPE_LEVEL_HIGH>,
                         <1 IRQ_TYPE_LEVEL_HIGH>,
                         <2 IRQ_TYPE_LEVEL_HIGH>;
            gpio-line-names =
                   "ID_SDA", // GPIO0
                   "ID_SCL", // GPIO1
                   "GPIO2", "GPIO3", "GPIO4", "GPIO5", "GPIO6",
                   "GPIO7", "GPIO8", "GPIO9", "GPIO10", "GPIO11",
                   "GPIO12", "GPIO13", "GPIO14", "GPIO15", "GPIO16",
                   "GPIO17", "GPIO18", "GPIO19", "GPIO20", "GPIO21",
                   "GPIO22", "GPIO23", "GPIO24", "GPIO25", "GPIO26",
                   "GPIO27",
                   "PCIE_RP1_WAKE", // GPIO28
                   "FAN_TACH", // GPIO29
                   "HOST_SDA", // GPIO30
                   "HOST_SCL", // GPIO31
                   "ETH_RST_N", // GPIO32
                   "", // GPIO33
                   "CD0_IO0_MICCLK", // GPIO34
                   "CD0_IO0_MICDAT0", // GPIO35
                   "RP1_PCIE_CLKREQ_N", // GPIO36
                   "", // GPIO37
                   "CD0_SDA", // GPIO38
                   "CD0_SCL", // GPIO39
                   "CD1_SDA", // GPIO40
                   "CD1_SCL", // GPIO41
                   "USB_VBUS_EN", // GPIO42
                   "USB_OC_N", // GPIO43
                   "RP1_STAT_LED", // GPIO44
                   "FAN_PWM", // GPIO45
                   "CD1_IO0_MICCLK", // GPIO46
                   "2712_WAKE", // GPIO47
                   "CD1_IO1_MICDAT1", // GPIO48
                   "EN_MAX_USB_CUR", // GPIO49
                   "", // GPIO50
                   "", // GPIO51
                   "", // GPIO52
                   ""; // GPIO53

            rp1-i2s0-default-state {
                function = "i2s0";
                pins = "gpio18", "gpio19", "gpio20", "gpio21";
                bias-disable;
            };

            rp1-uart0-default-state {
                txd-pins {
                    function = "uart0";
                    pins = "gpio14";
                    bias-disable;
                };

                rxd-pins {
                    function = "uart0";
                    pins = "gpio15";
                    bias-pull-up;
                };
            };
        };
    };
```

## Documentation/devicetree/bindings/pinctrl/realtek,rtd1315e-pinctrl.yaml
```yaml
# SPDX-License-Identifier: (GPL-2.0 OR BSD-2-Clause)
# Copyright 2023 Realtek Semiconductor Corporation
%YAML 1.2
---
$id: http://devicetree.org/schemas/pinctrl/realtek,rtd1315e-pinctrl.yaml#
$schema: http://devicetree.org/meta-schemas/core.yaml#

title: Realtek DHC RTD1315E Pin Controller

maintainers:
  - TY Chang <tychang@realtek.com>

description:
  The Realtek DHC RTD1315E is a high-definition media processor SoC. The
  RTD1315E pin controller is used to control pin function, pull up/down
  resistor, drive strength, schmitt trigger and power source.

properties:
  compatible:
    const: realtek,rtd1315e-pinctrl

  reg:
    maxItems: 1

patternProperties:
  '-pins$':
    type: object
    allOf:
      - $ref: pincfg-node.yaml#
      - $ref: pinmux-node.yaml#

    properties:
      pins:
        items:
          enum: [ gpio_0, gpio_1, emmc_rst_n, emmc_dd_sb, emmc_clk, emmc_cmd,
                  gpio_6, gpio_7, gpio_8, gpio_9, gpio_10, gpio_11, gpio_12,
                  gpio_13, gpio_14, gpio_15, gpio_16, gpio_17, gpio_18, gpio_19,
                  gpio_20, emmc_data_0, emmc_data_1, emmc_data_2, usb_cc2, gpio_25,
                  gpio_26, gpio_27, gpio_28, gpio_29, gpio_30, gpio_31, gpio_32,
                  gpio_33, gpio_34, gpio_35, hif_data, hif_en, hif_rdy, hif_clk,
                  gpio_dummy_40, gpio_dummy_41, gpio_dummy_42, gpio_dummy_43,
                  gpio_dummy_44, gpio_dummy_45, gpio_46, gpio_47, gpio_48, gpio_49,
                  gpio_50, usb_cc1, emmc_data_3, emmc_data_4, ir_rx, ur0_rx, ur0_tx,
                  gpio_57, gpio_58, gpio_59, gpio_60, gpio_61, gpio_62, gpio_dummy_63,
                  gpio_dummy_64, gpio_dummy_65, gpio_66, gpio_67, gpio_68, gpio_69,
                  gpio_70, gpio_71, gpio_72, gpio_dummy_73, emmc_data_5, emmc_data_6,
                  emmc_data_7, gpio_dummy_77, gpio_78, gpio_79, gpio_80, gpio_81,
                  ur2_loc, gspi_loc, hi_width, sf_en, arm_trace_dbg_en,
                  ejtag_aucpu_loc, ejtag_acpu_loc, ejtag_vcpu_loc, ejtag_scpu_loc,
                  dmic_loc, vtc_dmic_loc, vtc_tdm_loc, vtc_i2si_loc, tdm_ai_loc,
                  ai_loc, spdif_loc, hif_en_loc, scan_switch, wd_rset, boot_sel,
                  reset_n, testmode ]

      function:
        enum: [ gpio, nf, emmc, ao, gspi_loc0, gspi_loc1, uart0, uart1,
                uart2_loc0, uart2_loc1, i2c0, i2c1, i2c4, i2c5, pcie1,
                etn_led, etn_phy, spi, pwm0_loc0, pwm0_loc1, pwm1_loc0,
                pwm1_loc1, pwm2_loc0, pwm2_loc1, pwm3_loc0, pwm3_loc1,
                spdif_optical_loc0, spdif_optical_loc1, usb_cc1, usb_cc2,
                sd, dmic_loc0, dmic_loc1, ai_loc0, ai_loc1, tdm_ai_loc0,
                tdm_ai_loc1, hi_loc0, hi_m, vtc_i2so, vtc_i2si_loc0,
                vtc_i2si_loc1, vtc_dmic_loc0, vtc_dmic_loc1, vtc_tdm_loc0,
                vtc_tdm_loc1, dc_fan, pll_test_loc0, pll_test_loc1,
                ir_rx, uart2_disable, gspi_disable, hi_width_disable,
                hi_width_1bit, sf_disable, sf_enable, scpu_ejtag_loc0,
                scpu_ejtag_loc1, scpu_ejtag_loc2, scpu_ejtag_loc3,
                acpu_ejtag_loc0, acpu_ejtag_loc1, acpu_ejtag_loc2,
                vcpu_ejtag_loc0, vcpu_ejtag_loc1, vcpu_ejtag_loc2,
                aucpu_ejtag_loc0, aucpu_ejtag_loc1, aucpu_ejtag_loc2,
                gpu_ejtag, iso_tristate, dbg_out0, dbg_out1, standby_dbg,
                spdif, arm_trace_debug_disable, arm_trace_debug_enable,
                aucpu_ejtag_disable, acpu_ejtag_disable, vcpu_ejtag_disable,
                scpu_ejtag_disable, vtc_dmic_loc_disable, vtc_tdm_disable,
                vtc_i2si_disable, tdm_ai_disable, ai_disable, spdif_disable,
                hif_disable, hif_enable, test_loop, pmic_pwrup ]

      drive-strength:
        enum: [4, 8]

      bias-pull-down: true

      bias-pull-up: true

      bias-disable: true

      input-schmitt-enable: true

      input-schmitt-disable: true

      drive-push-pull: true

      power-source:
        description: |
          Valid arguments are described as below:
          0: power supply of 1.8V
          1: power supply of 3.3V
        enum: [0, 1]

      realtek,drive-strength-p:
        description: |
          Some of pins can be driven using the P-MOS and N-MOS transistor to
          achieve finer adjustments. The block-diagram representation is as
          follows:
                         VDD
                          |
                      ||--+
               +-----o||     P-MOS-FET
               |      ||--+
          IN --+          +----- out
               |      ||--+
               +------||     N-MOS-FET
                      ||--+
                          |
                         GND
          The driving strength of the P-MOS/N-MOS transistors impacts the
          waveform's rise/fall times. Greater driving strength results in
          shorter rise/fall times. Each P-MOS and N-MOS transistor offers
          8 configurable levels (0 to 7), with higher values indicating
          greater driving strength, contributing to achieving the desired
          speed.

          The realtek,drive-strength-p is used to control the driving strength
          of the P-MOS output.
        $ref: /schemas/types.yaml#/definitions/uint32
        minimum: 0
        maximum: 7

      realtek,drive-strength-n:
        description: |
          Similar to the realtek,drive-strength-p, the realtek,drive-strength-n
          is used to control the driving strength of the N-MOS output.
        $ref: /schemas/types.yaml#/definitions/uint32
        minimum: 0
        maximum: 7

      realtek,duty-cycle:
        description: |
          An integer describing the level to adjust output duty cycle, controlling
          the proportion of positive and negative waveforms in nanoseconds.
          Valid arguments are described as below:
          0: 0ns
          2: + 0.25ns
          3: + 0.5ns
          4: -0.25ns
          5: -0.5ns
        $ref: /schemas/types.yaml#/definitions/uint32
        enum: [ 0, 2, 3, 4, 5 ]

    required:
      - pins

    additionalProperties: false

required:
  - compatible
  - reg

additionalProperties: false

examples:
  - |
     pinctrl@4e000 {
         compatible = "realtek,rtd1315e-pinctrl";
         reg = <0x4e000 0x130>;

         emmc-hs200-pins {
             pins = "emmc_clk",
                    "emmc_cmd",
                    "emmc_data_0",
                    "emmc_data_1",
                    "emmc_data_2",
                    "emmc_data_3",
                    "emmc_data_4",
                    "emmc_data_5",
                    "emmc_data_6",
                    "emmc_data_7";
             function = "emmc";
             realtek,drive-strength-p = <0x2>;
             realtek,drive-strength-n = <0x2>;
         };

         i2c-0-pins {
             pins = "gpio_12",
                    "gpio_13";
             function = "i2c0";
             drive-strength = <4>;
         };
     };
```
