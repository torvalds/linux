## Documentation/devicetree/bindings/pinctrl/rockchip,pinctrl.txt
```
* Rockchip Pinmux Controller

The Rockchip Pinmux Controller, enables the IC
to share one PAD to several functional blocks. The sharing is done by
multiplexing the PAD input/output signals. For each PAD there are several
muxing options with option 0 being the use as a GPIO.

Please refer to pinctrl-bindings.txt in this directory for details of the
common pinctrl bindings used by client devices, including the meaning of the
phrase "pin configuration node".

The Rockchip pin configuration node is a node of a group of pins which can be
used for a specific device or function. This node represents both mux and
config of the pins in that group. The 'pins' selects the function mode(also
named pin mode) this pin can work on and the 'config' configures various pad
settings such as pull-up, etc.

The pins are grouped into up to 5 individual pin banks which need to be
defined as gpio sub-nodes of the pinmux controller.

Required properties for iomux controller:
  - compatible: should be
		"rockchip,px30-pinctrl":    for Rockchip PX30
		"rockchip,rv1108-pinctrl":  for Rockchip RV1108
		"rockchip,rk2928-pinctrl":  for Rockchip RK2928
		"rockchip,rk3066a-pinctrl": for Rockchip RK3066a
		"rockchip,rk3066b-pinctrl": for Rockchip RK3066b
		"rockchip,rk3128-pinctrl":  for Rockchip RK3128
		"rockchip,rk3188-pinctrl":  for Rockchip RK3188
		"rockchip,rk3228-pinctrl":  for Rockchip RK3228
		"rockchip,rk3288-pinctrl":  for Rockchip RK3288
		"rockchip,rk3308-pinctrl":  for Rockchip RK3308
		"rockchip,rk3328-pinctrl":  for Rockchip RK3328
		"rockchip,rk3368-pinctrl":  for Rockchip RK3368
		"rockchip,rk3399-pinctrl":  for Rockchip RK3399
		"rockchip,rk3568-pinctrl":  for Rockchip RK3568

  - rockchip,grf: phandle referencing a syscon providing the
	 "general register files"

Optional properties for iomux controller:
  - rockchip,pmu: phandle referencing a syscon providing the pmu registers
	 as some SoCs carry parts of the iomux controller registers there.
	 Required for at least rk3188 and rk3288. On the rk3368 this should
	 point to the PMUGRF syscon.

Deprecated properties for iomux controller:
  - reg: first element is the general register space of the iomux controller
	 It should be large enough to contain also separate pull registers.
	 second element is the separate pull register space of the rk3188.
	 Use rockchip,grf and rockchip,pmu described above instead.

Required properties for gpio sub nodes:
See rockchip,gpio-bank.yaml

Required properties for pin configuration node:
  - rockchip,pins: 3 integers array, represents a group of pins mux and config
    setting. The format is rockchip,pins = <PIN_BANK PIN_BANK_IDX MUX &phandle>.
    The MUX 0 means gpio and MUX 1 to N mean the specific device function.
    The phandle of a node containing the generic pinconfig options
    to use, as described in pinctrl-bindings.txt in this directory.

Examples:

#include <dt-bindings/pinctrl/rockchip.h>

...

pinctrl@20008000 {
	compatible = "rockchip,rk3066a-pinctrl";
	rockchip,grf = <&grf>;

	#address-cells = <1>;
	#size-cells = <1>;
	ranges;

	gpio0: gpio0@20034000 {
		compatible = "rockchip,gpio-bank";
		reg = <0x20034000 0x100>;
		interrupts = <GIC_SPI 54 IRQ_TYPE_LEVEL_HIGH>;
		clocks = <&clk_gates8 9>;

		gpio-controller;
		#gpio-cells = <2>;

		interrupt-controller;
		#interrupt-cells = <2>;
	};

	...

	pcfg_pull_default: pcfg_pull_default {
		bias-pull-pin-default
	};

	uart2 {
		uart2_xfer: uart2-xfer {
			rockchip,pins = <1 RK_PB0 1 &pcfg_pull_default>,
					<1 RK_PB1 1 &pcfg_pull_default>;
		};
	};
};

uart2: serial@20064000 {
	compatible = "snps,dw-apb-uart";
	reg = <0x20064000 0x400>;
	interrupts = <GIC_SPI 36 IRQ_TYPE_LEVEL_HIGH>;
	reg-shift = <2>;
	reg-io-width = <1>;
	clocks = <&mux_uart2>;

	pinctrl-names = "default";
	pinctrl-0 = <&uart2_xfer>;
};
```

## Documentation/devicetree/bindings/pinctrl/rockchip,pinctrl.yaml
```yaml
# SPDX-License-Identifier: GPL-2.0
%YAML 1.2
---
$id: http://devicetree.org/schemas/pinctrl/rockchip,pinctrl.yaml#
$schema: http://devicetree.org/meta-schemas/core.yaml#

title: Rockchip Pinmux Controller

maintainers:
  - Heiko Stuebner <heiko@sntech.de>

description: |
  The Rockchip Pinmux Controller enables the IC to share one PAD
  to several functional blocks. The sharing is done by multiplexing
  the PAD input/output signals. For each PAD there are several muxing
  options with option 0 being used as a GPIO.

  Please refer to pinctrl-bindings.txt in this directory for details of the
  common pinctrl bindings used by client devices, including the meaning of the
  phrase "pin configuration node".

  The Rockchip pin configuration node is a node of a group of pins which can be
  used for a specific device or function. This node represents both mux and
  config of the pins in that group. The 'pins' selects the function mode
  (also named pin mode) this pin can work on and the 'config' configures
  various pad settings such as pull-up, etc.

  The pins are grouped into up to 9 individual pin banks which need to be
  defined as gpio sub-nodes of the pinmux controller.

properties:
  compatible:
    enum:
      - rockchip,px30-pinctrl
      - rockchip,rk2928-pinctrl
      - rockchip,rk3036-pinctrl
      - rockchip,rk3066a-pinctrl
      - rockchip,rk3066b-pinctrl
      - rockchip,rk3128-pinctrl
      - rockchip,rk3188-pinctrl
      - rockchip,rk3228-pinctrl
      - rockchip,rk3288-pinctrl
      - rockchip,rk3308-pinctrl
      - rockchip,rk3328-pinctrl
      - rockchip,rk3368-pinctrl
      - rockchip,rk3399-pinctrl
      - rockchip,rk3568-pinctrl
      - rockchip,rk3588-pinctrl
      - rockchip,rv1108-pinctrl
      - rockchip,rv1126-pinctrl

  rockchip,grf:
    $ref: "/schemas/types.yaml#/definitions/phandle"
    description:
      The phandle of the syscon node for the GRF registers.

  rockchip,pmu:
    $ref: "/schemas/types.yaml#/definitions/phandle"
    description:
      The phandle of the syscon node for the PMU registers,
      as some SoCs carry parts of the iomux controller registers there.
      Required for at least rk3188 and rk3288. On the rk3368 this should
      point to the PMUGRF syscon.

  "#address-cells":
    enum: [1, 2]

  "#size-cells":
    enum: [1, 2]

  ranges: true

allOf:
  - $ref: "pinctrl.yaml#"

required:
  - compatible
  - rockchip,grf
  - "#address-cells"
  - "#size-cells"
  - ranges

patternProperties:
  "gpio@[0-9a-f]+$":
    type: object

    $ref: "/schemas/gpio/rockchip,gpio-bank.yaml#"

    unevaluatedProperties: false

  "pcfg-[a-z0-9-]+$":
    type: object
    properties:
      bias-disable: true

      bias-pull-down: true

      bias-pull-pin-default: true

      bias-pull-up: true

      drive-strength:
        minimum: 0
        maximum: 20

      input-enable: true

      input-schmitt-enable: true

      output-high: true

      output-low: true

    additionalProperties: false

additionalProperties:
  type: object
  additionalProperties:
    type: object
    properties:
      rockchip,pins:
        $ref: "/schemas/types.yaml#/definitions/uint32-matrix"
        minItems: 1
        items:
          items:
            - minimum: 0
              maximum: 8
              description:
                Pin bank.
            - minimum: 0
              maximum: 31
              description:
                Pin bank index.
            - minimum: 0
              maximum: 10
              description:
                Mux 0 means GPIO and mux 1 to N means
                the specific device function.
            - description:
                The phandle of a node contains the generic pinconfig options
                to use as described in pinctrl-bindings.txt.

examples:
  - |
    #include <dt-bindings/interrupt-controller/arm-gic.h>
    #include <dt-bindings/pinctrl/rockchip.h>

    pinctrl: pinctrl {
      compatible = "rockchip,rk3066a-pinctrl";
      rockchip,grf = <&grf>;

      #address-cells = <1>;
      #size-cells = <1>;
      ranges;

      gpio0: gpio@20034000 {
        compatible = "rockchip,gpio-bank";
        reg = <0x20034000 0x100>;
        interrupts = <GIC_SPI 54 IRQ_TYPE_LEVEL_HIGH>;
        clocks = <&clk_gates8 9>;

        gpio-controller;
        #gpio-cells = <2>;

        interrupt-controller;
        #interrupt-cells = <2>;
      };

      pcfg_pull_default: pcfg-pull-default {
        bias-pull-pin-default;
      };

      uart2 {
        uart2_xfer: uart2-xfer {
          rockchip,pins = <1 RK_PB0 1 &pcfg_pull_default>,
                          <1 RK_PB1 1 &pcfg_pull_default>;
        };
      };
    };

    uart2: serial@20064000 {
      compatible = "snps,dw-apb-uart";
      reg = <0x20064000 0x400>;
      interrupts = <GIC_SPI 36 IRQ_TYPE_LEVEL_HIGH>;
      clocks = <&mux_uart2>;
      pinctrl-0 = <&uart2_xfer>;
      pinctrl-names = "default";
      reg-io-width = <1>;
      reg-shift = <2>;
    };
```

## Documentation/devicetree/bindings/pinctrl/rockchip-pinctrl.txt
```
Rockchip GPIO and Pin Mux/Config controller

Rockchip's ARM based SoC's integrates a GPIO and Pin mux/config hardware
controller. It controls the input/output settings on the available pads/pins
and also provides ability to multiplex and configure the output of various
on-chip controllers onto these pads.

Required Properties:
- compatible: should be one of the following.
  - "rockchip,rk2928-pinctrl": for rk2928 compatible pin-controller,
  - "rockchip,rk3188-pinctrl": for rk3188 compatible pin-controller.
  - "rockchip,rk3288-pinctrl": for rk3288 compatible pin-controller.
  
- reg: Base address of the pin controller hardware module and length of
  the address space it occupies.

- Pin banks as child nodes: Pin banks of the controller are represented by child
  nodes of the controller node. Bank name is taken from name of the node. Each
  bank node must contain following properties:

  - gpio-controller: identifies the node as a gpio controller and pin bank.
  - #gpio-cells: number of cells in GPIO specifier. Since the generic GPIO
    binding is used, the amount of cells must be specified as 2. See generic
    GPIO binding documentation for description of particular cells.

- Pin mux/config groups as child nodes: The pin mux (selecting pin function
  mode) and pin config (pull up/down, driver strength) settings are represented
  as child nodes of the pin-controller node. There should be atleast one
  child node and there is no limit on the count of these child nodes.


  The following pin function and configuration properties are supported.
  
  -rockchip,pins: Gpio or function selection.
  -rockchip,pull: Pull up/down configuration.
  -rockchip,voltage: Voltage domain configuration.
  -rockchip,drive: Drive strength configuration.
  
  
  "rockchip,pins" could be assigned gpio name and function name.
  As an example, the pins in GPA0 bank of the pin controller can be represented
  as gpio name such as "GPIO0_A0", "GPIO0_A1", "GPIO0_A2" and so on. Not only that,
  the pins Could be represented as function name such as "UART0_TXD","UART0_RXD",
  "UART0_RTS","UART0_CTS" and so on.Because the use of encoding, this method 
  was able to achieve.The pin function name that could be applied on the pins listed 
  in the include/dt-bindings/pinctrl/rockchip-rkxx.h.

  "rockchip,pull" could be assigned the following values:
	#define VALUE_PULL_NORMAL		0
	#define VALUE_PULL_UP			1
	#define VALUE_PULL_DOWN			2
	#define VALUE_PULL_KEEP			3
	#define VALUE_PULL_DISABLE		4 //don't set and keep pull default
	
	
 "rockchip,voltage" could be assigned the following values:
	#define VALUE_VOL_DEFAULT		0
	#define VALUE_VOL_3V3			0
	#define VALUE_VOL_1V8			1
	
 "rockchip,drive" could be assigned the following values:
	#define VALUE_DRV_DEFAULT		0
	#define VALUE_DRV_2MA			0
	#define VALUE_DRV_4MA			1
	#define VALUE_DRV_8MA			2
	#define VALUE_DRV_12MA			3

 Note: A child should include atleast a pin function selection..


Example 1: A pin-controller node with pin banks:

 pinctrl: pinctrl@ff770000 {
		compatible = "rockchip,rk3288-pinctrl";
		reg = <0xff770000 0x140>,
		      <0xff770140 0x80>,
		      <0xff7701c0 0x80>;
		reg-names = "base", "pull", "drv";
		#address-cells = <1>;
		#size-cells = <1>;
		ranges;
		
		/* Pin bank without external interrupts */
		gpio0: gpio0@ff750000 {
			compatible = "rockchip,rk3288-gpio-bank0";
			reg =	<0xff750000 0x100>,
				<0xff730084 0x10>,
		      		<0xff730064 0x0c>,
				<0xff730070 0x0c>;
			reg-names = "base", "mux_bank0", "pull_bank0", "drv_bank0";
			interrupts = <GIC_SPI 81 IRQ_TYPE_LEVEL_HIGH>;
			clocks = <&clk_gates17 4>;

			gpio-controller;
			#gpio-cells = <2>;

			interrupt-controller;
			#interrupt-cells = <2>;
		};

	

Example 2: A pin-controller node with pin groups.

	gpio4_uart0 {
			uart0_xfer: uart0-xfer {
				rockchip,pins = <UART0BT_SIN>,
						<UART0BT_SOUT>;
				rockchip,pull = <VALUE_PULL_DISABLE>;
				rockchip,voltage = <VALUE_VOL_DEFAULT>;
				rockchip,drive = <VALUE_DRV_DEFAULT>;
				//rockchip,tristate = <VALUE_TRI_DEFAULT>;
			};

			uart0_cts: uart0-cts {
				rockchip,pins = <UART0BT_CTSN>;
				rockchip,pull = <VALUE_PULL_DISABLE>;
				//rockchip,voltage = <VALUE_VOL_DEFAULT>;
				rockchip,drive = <VALUE_DRV_DEFAULT>;
				//rockchip,tristate = <VALUE_TRI_DEFAULT>;
			};

			uart0_rts: uart0-rts {
				rockchip,pins = <UART0BT_RTSN>;
				rockchip,pull = <VALUE_PULL_DISABLE>;
				//rockchip,voltage = <VALUE_VOL_DEFAULT>;
				rockchip,drive = <VALUE_DRV_DEFAULT>;
				//rockchip,tristate = <VALUE_TRI_DEFAULT>;
			};

			uart0_rts_gpio: uart0-rts-gpio {
				rockchip,pins = <FUNC_TO_GPIO(UART0BT_RTSN)>;
				rockchip,drive = <VALUE_DRV_DEFAULT>;
			};
		};



Example 3: A i2c node that supports 'default' and 'gpio' states.

	i2c0: i2c@ff650000 {
		compatible = "rockchip,rk30-i2c";
		reg = <0xff650000 0x1000>;
		interrupts = <GIC_SPI 60 IRQ_TYPE_LEVEL_HIGH>;
		#address-cells = <1>;
		#size-cells = <0>;
		pinctrl-names = "default", "gpio";
		pinctrl-0 = <&i2c0_sda &i2c0_scl>;
		pinctrl-1 = <&i2c0_gpio>;
		gpios = <&gpio0 GPIO_B7 GPIO_ACTIVE_LOW>, <&gpio0 GPIO_C0 GPIO_ACTIVE_LOW>;
		clocks = <&clk_gates10 2>;
		rockchip,check-idle = <1>;
		status = "disabled";
	};
```

## Documentation/devicetree/bindings/pinctrl/samsung,pinctrl-gpio-bank.yaml
```yaml
# SPDX-License-Identifier: (GPL-2.0-only OR BSD-2-Clause)
%YAML 1.2
---
$id: http://devicetree.org/schemas/pinctrl/samsung,pinctrl-gpio-bank.yaml#
$schema: http://devicetree.org/meta-schemas/core.yaml#

title: Samsung S3C/S5P/Exynos SoC pin controller - gpio bank

maintainers:
  - Krzysztof Kozlowski <krzk@kernel.org>
  - Sylwester Nawrocki <s.nawrocki@samsung.com>
  - Tomasz Figa <tomasz.figa@gmail.com>

description: |
  This is a part of device tree bindings for Samsung S3C/S5P/Exynos SoC pin
  controller.

  GPIO bank description for Samsung S3C/S5P/Exynos SoC pin controller.

  See also Documentation/devicetree/bindings/pinctrl/samsung,pinctrl.yaml for
  additional information and example.

properties:
  '#gpio-cells':
    const: 2

  gpio-controller: true

  '#interrupt-cells':
    description:
      For GPIO banks supporting external GPIO interrupts or external wake-up
      interrupts.
    const: 2

  interrupt-controller:
    description:
      For GPIO banks supporting external GPIO interrupts or external wake-up
      interrupts.

  interrupts:
    description:
      For GPIO banks supporting direct external wake-up interrupts (without
      multiplexing).  Number of interrupts must match number of wake-up capable
      pins of this bank.
    minItems: 1
    maxItems: 8

required:
  - '#gpio-cells'
  - gpio-controller

additionalProperties: false
```
