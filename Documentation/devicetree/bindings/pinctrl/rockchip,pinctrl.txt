## Documentation/devicetree/bindings/pinctrl/socionext,uniphier-pinctrl.txt
```
UniPhier SoCs pin controller

Required properties:
- compatible: should be one of the following:
    "socionext,uniphier-ld4-pinctrl"  - for LD4 SoC
    "socionext,uniphier-pro4-pinctrl" - for Pro4 SoC
    "socionext,uniphier-sld8-pinctrl" - for sLD8 SoC
    "socionext,uniphier-pro5-pinctrl" - for Pro5 SoC
    "socionext,uniphier-pxs2-pinctrl" - for PXs2 SoC
    "socionext,uniphier-ld6b-pinctrl" - for LD6b SoC
    "socionext,uniphier-ld11-pinctrl" - for LD11 SoC
    "socionext,uniphier-ld20-pinctrl" - for LD20 SoC
    "socionext,uniphier-pxs3-pinctrl" - for PXs3 SoC

Note:
The UniPhier pinctrl should be a subnode of a "syscon" compatible node.

Example:
	soc-glue@5f800000 {
		compatible = "socionext,uniphier-pro4-soc-glue",
			     "simple-mfd", "syscon";
		reg = <0x5f800000 0x2000>;

		pinctrl: pinctrl {
			compatible = "socionext,uniphier-pro4-pinctrl";
		};
	};
```

## Documentation/devicetree/bindings/pinctrl/socionext,uniphier-pinctrl.yaml
```yaml
# SPDX-License-Identifier: GPL-2.0-only OR BSD-2-Clause

%YAML 1.2
---
$id: http://devicetree.org/schemas/pinctrl/socionext,uniphier-pinctrl.yaml#
$schema: http://devicetree.org/meta-schemas/core.yaml#

title: UniPhier SoCs pin controller

maintainers:
  - Masahiro Yamada <yamada.masahiro@socionext.com>

properties:
  compatible:
    enum:
      - socionext,uniphier-ld4-pinctrl
      - socionext,uniphier-pro4-pinctrl
      - socionext,uniphier-sld8-pinctrl
      - socionext,uniphier-pro5-pinctrl
      - socionext,uniphier-pxs2-pinctrl
      - socionext,uniphier-ld6b-pinctrl
      - socionext,uniphier-ld11-pinctrl
      - socionext,uniphier-ld20-pinctrl
      - socionext,uniphier-pxs3-pinctrl
      - socionext,uniphier-nx1-pinctrl

additionalProperties:
  type: object

  allOf:
    - $ref: pincfg-node.yaml#
    - $ref: pinmux-node.yaml#

  properties:
    function: true
    groups: true
    pins: true
    bias-pull-up: true
    bias-pull-down: true
    bias-pull-pin-default: true
    drive-strength: true

  additionalProperties:
    type: object

    allOf:
      - $ref: pincfg-node.yaml#
      - $ref: pinmux-node.yaml#

    properties:
      function: true
      groups: true
      pins: true
      bias-pull-up: true
      bias-pull-down: true
      bias-pull-pin-default: true
      drive-strength: true

    unevaluatedProperties: false

allOf:
  - $ref: pinctrl.yaml#

required:
  - compatible

examples:
  - |
    // The UniPhier pinctrl should be a subnode of a "syscon" compatible node.

    pinctrl {
        compatible = "socionext,uniphier-ld20-pinctrl";

        pinctrl_ether_rgmii: ether-rgmii {
            groups = "ether_rgmii";
            function = "ether_rgmii";

            tx {
                pins = "RGMII_TXCLK", "RGMII_TXD0", "RGMII_TXD1",
                       "RGMII_TXD2", "RGMII_TXD3", "RGMII_TXCTL";
                drive-strength = <9>;
            };
        };
    };
```

## Documentation/devicetree/bindings/pinctrl/sophgo,cv1800-pinctrl.yaml
```yaml
# SPDX-License-Identifier: GPL-2.0-only OR BSD-2-Clause
%YAML 1.2
---
$id: http://devicetree.org/schemas/pinctrl/sophgo,cv1800-pinctrl.yaml#
$schema: http://devicetree.org/meta-schemas/core.yaml#

title: Sophgo CV1800 Pin Controller

maintainers:
  - Inochi Amaoto <inochiama@outlook.com>

properties:
  compatible:
    enum:
      - sophgo,cv1800b-pinctrl
      - sophgo,cv1812h-pinctrl
      - sophgo,sg2000-pinctrl
      - sophgo,sg2002-pinctrl

  reg:
    items:
      - description: pinctrl for system domain
      - description: pinctrl for rtc domain

  reg-names:
    items:
      - const: sys
      - const: rtc

  resets:
    maxItems: 1

patternProperties:
  '-cfg$':
    type: object
    description:
      A pinctrl node should contain at least one subnode representing the
      pinctrl groups available on the machine.

    additionalProperties: false

    patternProperties:
      '-pins$':
        type: object
        description: |
          Each subnode will list the pins it needs, and how they should
          be configured, with regard to muxer configuration, bias, input
          enable/disable, input schmitt trigger, slew-rate, drive strength
          and bus hold state. In addition, all pins in the same subnode
          should have the same power domain. For configuration detail,
          refer to https://github.com/sophgo/sophgo-doc/.

        allOf:
          - $ref: pincfg-node.yaml#
          - $ref: pinmux-node.yaml#

        properties:
          pinmux:
            description: |
              The list of GPIOs and their mux settings that properties in the
              node apply to. This should be set using the GPIOMUX or GPIOMUX2
              macro.

          bias-pull-up:
            type: boolean

          bias-pull-down:
            type: boolean

          drive-strength-microamp:
            description: typical current when output high level.

          input-schmitt-microvolt:
            description: typical threshold for schmitt trigger.

          power-source:
            description: power supplies at X mV.
            enum: [ 1800, 3300 ]

          slew-rate:
            description: slew rate for output buffer (0 is fast, 1 is slow)
            enum: [ 0, 1 ]

          bias-bus-hold: true

        required:
          - pinmux
          - power-source

        additionalProperties: false

required:
  - compatible
  - reg
  - reg-names

additionalProperties: false

examples:
  - |
    #include <dt-bindings/pinctrl/pinctrl-cv1800b.h>

    pinctrl@3001000 {
        compatible = "sophgo,cv1800b-pinctrl";
        reg = <0x03001000 0x1000>,
              <0x05027000 0x1000>;
        reg-names = "sys", "rtc";

        uart0_cfg: uart0-cfg {
            uart0-pins {
                pinmux = <PINMUX(PIN_UART0_TX, 0)>,
                         <PINMUX(PIN_UART0_RX, 0)>;
                bias-pull-up;
                drive-strength-microamp = <10800>;
                input-schmitt-microvolt = <0>;
                power-source = <3300>;
                slew-rate = <0>;
            };
        };
    };

...
```

## Documentation/devicetree/bindings/pinctrl/sophgo,sg2042-pinctrl.yaml
```yaml
# SPDX-License-Identifier: GPL-2.0-only OR BSD-2-Clause
%YAML 1.2
---
$id: http://devicetree.org/schemas/pinctrl/sophgo,sg2042-pinctrl.yaml#
$schema: http://devicetree.org/meta-schemas/core.yaml#

title: Sophgo SG2042 Pin Controller

maintainers:
  - Inochi Amaoto <inochiama@outlook.com>

properties:
  compatible:
    enum:
      - sophgo,sg2042-pinctrl
      - sophgo,sg2044-pinctrl

  reg:
    maxItems: 1

patternProperties:
  '-cfg$':
    type: object
    description:
      A pinctrl node should contain at least one subnode representing the
      pinctrl groups available on the machine.

    additionalProperties: false

    patternProperties:
      '-pins$':
        type: object
        description: |
          Each subnode will list the pins it needs, and how they should
          be configured, with regard to muxer configuration, bias input
          enable/disable, input schmitt trigger enable, drive strength
          output enable/disable state. For configuration detail,
          refer to https://github.com/sophgo/sophgo-doc/.

        allOf:
          - $ref: pincfg-node.yaml#
          - $ref: pinmux-node.yaml#

        properties:
          pinmux:
            description: |
              The list of GPIOs and their mux settings that properties in the
              node apply to. This should be set using the PINMUX macro.

          bias-disable: true

          bias-pull-up:
            type: boolean

          bias-pull-down:
            type: boolean

          drive-strength-microamp:
            description: typical current when output low level.

          input-schmitt-enable: true

          input-schmitt-disable: true

        required:
          - pinmux

        additionalProperties: false

required:
  - compatible
  - reg

allOf:
  - if:
      properties:
        compatible:
          contains:
            const: sophgo,sg2042-pinctrl
    then:
      patternProperties:
        '-cfg$':
          patternProperties:
            '-pins$':
              properties:
                drive-strength-microamp:
                  enum: [ 5400, 8100, 10700, 13400,
                          16100, 18800, 21400, 24100,
                          26800, 29400, 32100, 34800,
                          37400, 40100, 42800, 45400 ]

  - if:
      properties:
        compatible:
          contains:
            const: sophgo,sg2044-pinctrl
    then:
      patternProperties:
        '-cfg$':
          patternProperties:
            '-pins$':
              properties:
                drive-strength-microamp:
                  enum: [ 3200, 6400, 9600, 12700,
                          15900, 19100, 22200, 25300,
                          29500, 32700, 35900, 39000,
                          42000, 45200, 48300, 51400]

additionalProperties: false

examples:
  - |
    #include <dt-bindings/pinctrl/pinctrl-sg2042.h>

    pinctrl@30011000 {
        compatible = "sophgo,sg2042-pinctrl";
        reg = <30011000 0x1000>;

        uart0_cfg: uart0-cfg {
            uart0-pins {
                pinmux = <PINMUX(PIN_UART0_TX, 0)>,
                         <PINMUX(PIN_UART0_RX, 0)>;
                bias-pull-up;
                drive-strength-microamp = <13400>;
            };
        };
    };

...
```

## Documentation/devicetree/bindings/pinctrl/spacemit,k1-pinctrl.yaml
```yaml
# SPDX-License-Identifier: GPL-2.0-only OR BSD-2-Clause
%YAML 1.2
---
$id: http://devicetree.org/schemas/pinctrl/spacemit,k1-pinctrl.yaml#
$schema: http://devicetree.org/meta-schemas/core.yaml#

title: SpacemiT K1 SoC Pin Controller

maintainers:
  - Yixun Lan <dlan@gentoo.org>

properties:
  compatible:
    enum:
      - spacemit,k1-pinctrl
      - spacemit,k3-pinctrl

  reg:
    items:
      - description: pinctrl io memory base

  clocks:
    items:
      - description: Functional Clock
      - description: Bus Clock

  clock-names:
    items:
      - const: func
      - const: bus

  resets:
    maxItems: 1

  spacemit,apbc:
    $ref: /schemas/types.yaml#/definitions/phandle
    description: Phandle to syscon that access the protected register

patternProperties:
  '-cfg$':
    type: object
    additionalProperties: false

    description:
      A pinctrl node should contain at least one subnode representing the
      pinctrl groups available on the machine.

    patternProperties:
      '-pins$':
        type: object
        additionalProperties: false

        description:
          Each subnode will list the pins it needs, and how they should
          be configured, with regard to muxer configuration, bias pull,
          drive strength, input schmitt trigger, slew rate, power source.

        allOf:
          - $ref: pincfg-node.yaml#
          - $ref: pinmux-node.yaml#

        properties:
          pinmux:
            description:
              The list of GPIOs and their mux settings that properties in the
              node apply to. This should be set using the K1_PADCONF macro to
              construct the value.

          bias-disable: true

          bias-pull-down: true

          bias-pull-up:
            description: |
              typical value for selecting bias pull up or strong pull up.
              0: normal bias pull up
              1: strong bias pull up
            enum: [ 0, 1 ]

          drive-strength:
            description:
              typical current (in mA) when the output at high level.
            anyOf:
              - enum: [ 11, 21, 32, 42 ]
                description: For K1 SoC, 1.8V voltage output

              - enum: [ 7, 10, 13, 16, 19, 23, 26, 29 ]
                description: For K1 SoC, 3.3V voltage output

              - enum: [ 2, 4, 6, 7, 9, 11, 13, 14, 21, 23, 25, 26, 28, 30, 31, 33 ]
                description: For K3 SoC, 1.8V voltage output

              - enum: [ 3, 5, 7, 9, 11, 13, 15, 17, 25, 27, 29, 31, 33, 35, 37, 38 ]
                description: For K3 SoC, 3.3V voltage output

          input-schmitt:
            description: |
              typical threshold for schmitt trigger.
              0: buffer mode
              1: trigger mode
              2, 3: trigger mode
            $ref: /schemas/types.yaml#/definitions/uint32
            enum: [ 0, 1, 2, 3 ]

          power-source:
            description: external power supplies at 1.8v or 3.3v.
            enum: [ 1800, 3300 ]

          slew-rate:
            description: |
              slew rate for output buffer.
              0: disable it
              1: enable it (via bundled value from drive strength)
              2: slow speed 0
              3: slow speed 1
              4: medium speed
              5: fast speed
            enum: [ 0, 1, 2, 3, 4, 5 ]

        required:
          - pinmux

required:
  - compatible
  - reg
  - clocks
  - clock-names

additionalProperties: false

examples:
  - |
    #define K1_PADCONF(pin, func) (((pin) << 16) | (func))

    soc {
        #address-cells = <2>;
        #size-cells = <2>;

        pinctrl@d401e000 {
            compatible = "spacemit,k1-pinctrl";
            reg = <0x0 0xd401e000 0x0 0x400>;
            clocks = <&syscon_apbc 42>,
                     <&syscon_apbc 94>;
            clock-names = "func", "bus";
            spacemit,apbc = <&syscon_apbc>;

            uart0_2_cfg: uart0-2-cfg {
                uart0-2-pins {
                    pinmux = <K1_PADCONF(68, 2)>,
                             <K1_PADCONF(69, 2)>;

                    bias-pull-up = <0>;
                    drive-strength = <32>;
                };
            };
        };
    };

...
```
