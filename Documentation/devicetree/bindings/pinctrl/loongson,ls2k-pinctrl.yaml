## Documentation/devicetree/bindings/pinctrl/marvell,armada-98dx3236-pinctrl.txt
```
* Marvell 98dx3236 pinctrl driver for mpp

Please refer to marvell,mvebu-pinctrl.txt in this directory for common binding
part and usage

Required properties:
- compatible: "marvell,98dx3236-pinctrl" or "marvell,98dx4251-pinctrl"
- reg: register specifier of MPP registers

This driver supports all 98dx3236, 98dx3336 and 98dx4251 variants

name          pins     functions
================================================================================
mpp0          0        gpo, spi0(mosi), dev(ad8)
mpp1          1        gpio, spi0(miso), dev(ad9)
mpp2          2        gpo, spi0(sck), dev(ad10)
mpp3          3        gpio, spi0(cs0), dev(ad11)
mpp4          4        gpio, spi0(cs1), smi(mdc), dev(cs0)
mpp5          5        gpio, pex(rsto), sd0(cmd), dev(bootcs)
mpp6          6        gpo, sd0(clk), dev(a2)
mpp7          7        gpio, sd0(d0), dev(ale0)
mpp8          8        gpio, sd0(d1), dev(ale1)
mpp9          9        gpio, sd0(d2), dev(ready0)
mpp10         10       gpio, sd0(d3), dev(ad12)
mpp11         11       gpio, uart1(rxd), uart0(cts), dev(ad13)
mpp12         12       gpo, uart1(txd), uart0(rts), dev(ad14)
mpp13         13       gpio, intr(out), dev(ad15)
mpp14         14       gpio, i2c0(sck)
mpp15         15       gpio, i2c0(sda)
mpp16         16       gpo, dev(oe)
mpp17         17       gpo, dev(clkout)
mpp18         18       gpio, uart1(txd)
mpp19         19       gpio, uart1(rxd), dev(rb)
mpp20         20       gpo, dev(we0)
mpp21         21       gpo, dev(ad0)
mpp22         22       gpo, dev(ad1)
mpp23         23       gpo, dev(ad2)
mpp24         24       gpo, dev(ad3)
mpp25         25       gpo, dev(ad4)
mpp26         26       gpo, dev(ad5)
mpp27         27       gpo, dev(ad6)
mpp28         28       gpo, dev(ad7)
mpp29         29       gpo, dev(a0)
mpp30         30       gpo, dev(a1)
mpp31         31       gpio, slv_smi(mdc), smi(mdc), dev(we1)
mpp32         32       gpio, slv_smi(mdio), smi(mdio), dev(cs1)
```

## Documentation/devicetree/bindings/pinctrl/marvell,armada-xp-pinctrl.txt
```
* Marvell Armada XP SoC pinctrl driver for mpp

Please refer to marvell,mvebu-pinctrl.txt in this directory for common binding
part and usage.

Required properties:
- compatible: "marvell,mv78230-pinctrl", "marvell,mv78260-pinctrl",
              "marvell,mv78460-pinctrl"

This driver supports all Armada XP variants, i.e. mv78230, mv78260, and mv78460.

Available mpp pins/groups and functions:
Note: brackets (x) are not part of the mpp name for marvell,function and given
only for more detailed description in this document.

* Marvell Armada XP (all variants)

name          pins     functions
================================================================================
mpp0          0        gpio, ge0(txclko), lcd(d0)
mpp1          1        gpio, ge0(txd0), lcd(d1)
mpp2          2        gpio, ge0(txd1), lcd(d2)
mpp3          3        gpio, ge0(txd2), lcd(d3)
mpp4          4        gpio, ge0(txd3), lcd(d4)
mpp5          5        gpio, ge0(txctl), lcd(d5)
mpp6          6        gpio, ge0(rxd0), lcd(d6)
mpp7          7        gpio, ge0(rxd1), lcd(d7)
mpp8          8        gpio, ge0(rxd2), lcd(d8)
mpp9          9        gpio, ge0(rxd3), lcd(d9)
mpp10         10       gpio, ge0(rxctl), lcd(d10)
mpp11         11       gpio, ge0(rxclk), lcd(d11)
mpp12         12       gpio, ge0(txd4), ge1(txd0), lcd(d12)
mpp13         13       gpio, ge0(txd5), ge1(txd1), lcd(d13)
mpp14         14       gpio, ge0(txd6), ge1(txd2), lcd(d15)
mpp15         15       gpio, ge0(txd7), ge1(txd3), lcd(d16)
mpp16         16       gpio, ge0(txd7), ge1(txd3), lcd(d16)
mpp17         17       gpio, ge0(col), ge1(txctl), lcd(d17)
mpp18         18       gpio, ge0(rxerr), ge1(rxd0), lcd(d18), ptp(trig)
mpp19         19       gpio, ge0(crs), ge1(rxd1), lcd(d19), ptp(evreq)
mpp20         20       gpio, ge0(rxd4), ge1(rxd2), lcd(d20), ptp(clk)
mpp21         21       gpio, ge0(rxd5), ge1(rxd3), lcd(d21), mem(bat)
mpp22         22       gpio, ge0(rxd6), ge1(rxctl), lcd(d22), sata0(prsnt)
mpp23         23       gpio, ge0(rxd7), ge1(rxclk), lcd(d23), sata1(prsnt)
mpp24         24       gpio, lcd(hsync), sata1(prsnt), tdm(rst)
mpp25         25       gpio, lcd(vsync), sata0(prsnt), tdm(pclk)
mpp26         26       gpio, lcd(clk), tdm(fsync), vdd(cpu1-pd)
mpp27         27       gpio, lcd(e), tdm(dtx), ptp(trig)
mpp28         28       gpio, lcd(pwm), tdm(drx), ptp(evreq)
mpp29         29       gpio, lcd(ref-clk), tdm(int0), ptp(clk), vdd(cpu0-pd)
mpp30         30       gpio, tdm(int1), sd0(clk)
mpp31         31       gpio, tdm(int2), sd0(cmd), vdd(cpu0-pd)
mpp32         32       gpio, tdm(int3), sd0(d0), vdd(cpu1-pd)
mpp33         33       gpio, tdm(int4), sd0(d1), mem(bat)
mpp34         34       gpio, tdm(int5), sd0(d2), sata0(prsnt)
mpp35         35       gpio, tdm(int6), sd0(d3), sata1(prsnt)
mpp36         36       gpio, spi(mosi)
mpp37         37       gpio, spi(miso)
mpp38         38       gpio, spi(sck)
mpp39         39       gpio, spi(cs0)
mpp40         40       gpio, spi(cs1), uart2(cts), lcd(vga-hsync), vdd(cpu1-pd),
                       pcie(clkreq0)
mpp41         41       gpio, spi(cs2), uart2(rts), lcd(vga-vsync), sata1(prsnt),
                       pcie(clkreq1)
mpp42         42       gpio, uart2(rxd), uart0(cts), tdm(int7), tdm-1(timer),
                       vdd(cpu0-pd)
mpp43         43       gpio, uart2(txd), uart0(rts), spi(cs3), pcie(rstout),
                       vdd(cpu2-3-pd){1}
mpp44         44       gpio, uart2(cts), uart3(rxd), spi(cs4), pcie(clkreq2),
                       mem(bat)
mpp45         45       gpio, uart2(rts), uart3(txd), spi(cs5), sata1(prsnt)
mpp46         46       gpio, uart3(rts), uart1(rts), spi(cs6), sata0(prsnt)
mpp47         47       gpio, uart3(cts), uart1(cts), spi(cs7), pcie(clkreq3),
                       ref(clkout)
mpp48         48       gpio, tclk, dev(burst/last)

* Marvell Armada XP (mv78260 and mv78460 only)

name          pins     functions
================================================================================
mpp49         49       gpio, dev(we3)
mpp50         50       gpio, dev(we2)
mpp51         51       gpio, dev(ad16)
mpp52         52       gpio, dev(ad17)
mpp53         53       gpio, dev(ad18)
mpp54         54       gpio, dev(ad19)
mpp55         55       gpio, dev(ad20), vdd(cpu0-pd)
mpp56         56       gpio, dev(ad21), vdd(cpu1-pd)
mpp57         57       gpio, dev(ad22), vdd(cpu2-3-pd){1}
mpp58         58       gpio, dev(ad23)
mpp59         59       gpio, dev(ad24)
mpp60         60       gpio, dev(ad25)
mpp61         61       gpio, dev(ad26)
mpp62         62       gpio, dev(ad27)
mpp63         63       gpio, dev(ad28)
mpp64         64       gpio, dev(ad29)
mpp65         65       gpio, dev(ad30)
mpp66         66       gpio, dev(ad31)

Notes:
* {1} vdd(cpu2-3-pd) only available on mv78460.
```

## Documentation/devicetree/bindings/pinctrl/marvell,armada3710-xb-pinctrl.yaml
```yaml
# SPDX-License-Identifier: (GPL-2.0-only OR BSD-2-Clause)
%YAML 1.2
---
$id: http://devicetree.org/schemas/pinctrl/marvell,armada3710-xb-pinctrl.yaml#
$schema: http://devicetree.org/meta-schemas/core.yaml#

title: Marvell Armada 37xx SoC pin and gpio controller

maintainers:
  - Gregory CLEMENT <gregory.clement@bootlin.com>
  - Marek Behún <kabel@kernel.org>
  - Miquel Raynal <miquel.raynal@bootlin.com>

description: >
  Each Armada 37xx SoC come with two pin and gpio controller one for the south
  bridge and the other for the north bridge.

  Inside this set of register the gpio latch allows exposing some configuration
  of the SoC and especially the clock frequency of the xtal. Hence, this node is
  a represent as syscon allowing sharing the register between multiple hardware
  block.

properties:
  compatible:
    items:
      - enum:
          - marvell,armada3710-sb-pinctrl
          - marvell,armada3710-nb-pinctrl
      - const: syscon
      - const: simple-mfd

  reg:
    items:
      - description: pinctrl and GPIO controller registers
      - description: interrupt controller registers

  gpio:
    description: GPIO controller subnode
    type: object
    additionalProperties: false

    properties:
      '#gpio-cells':
        const: 2

      gpio-controller: true

      gpio-ranges:
        description: Range of pins managed by the GPIO controller

      '#interrupt-cells':
        const: 2

      interrupt-controller: true

      interrupts:
        description: List of interrupt specifiers for the GPIO controller

    required:
      - '#gpio-cells'
      - gpio-ranges
      - gpio-controller
      - '#interrupt-cells'
      - interrupt-controller
      - interrupts

  xtal-clk:
    type: object
    additionalProperties: false

    properties:
      compatible:
        const: marvell,armada-3700-xtal-clock

      '#clock-cells':
        const: 0

      clock-output-names: true

patternProperties:
  '-pins$':
    $ref: pinmux-node.yaml#
    additionalProperties: false

    properties:
      groups:
        enum: [ emmc_nb, i2c1, i2c2, jtag, mii_col, onewire, pcie1,
                pcie1_clkreq, pcie1_wakeup, pmic0, pmic1, ptp, ptp_clk,
                ptp_trig, pwm0, pwm1, pwm2, pwm3, rgmii, sdio0, sdio_sb, smi,
                spi_cs1, spi_cs2, spi_cs3, spi_quad, uart1, uart2,
                usb2_drvvbus1, usb32_drvvbus ]

      function:
        enum: [ drvbus, emmc, gpio, i2c, jtag, led, mii, mii_err, onewire,
                pcie, pmic, ptp, pwm, sdio, smi, spi, uart ]

required:
  - compatible
  - reg

additionalProperties: false

examples:
  - |
    #include <dt-bindings/interrupt-controller/arm-gic.h>

    pinctrl_sb: pinctrl@18800 {
        compatible = "marvell,armada3710-sb-pinctrl", "syscon", "simple-mfd";
        reg = <0x18800 0x100>, <0x18C00 0x20>;

        gpio {
            #gpio-cells = <2>;
            gpio-ranges = <&pinctrl_sb 0 0 29>;
            gpio-controller;
            #interrupt-cells = <2>;
            interrupt-controller;
            interrupts =
                <GIC_SPI 160 IRQ_TYPE_LEVEL_HIGH>,
                <GIC_SPI 159 IRQ_TYPE_LEVEL_HIGH>,
                <GIC_SPI 158 IRQ_TYPE_LEVEL_HIGH>,
                <GIC_SPI 157 IRQ_TYPE_LEVEL_HIGH>,
                <GIC_SPI 156 IRQ_TYPE_LEVEL_HIGH>;
        };
    };
```

## Documentation/devicetree/bindings/pinctrl/marvell,berlin2-soc-pinctrl.yaml
```yaml
# SPDX-License-Identifier: (GPL-2.0-only OR BSD-2-Clause)
%YAML 1.2
---
$id: http://devicetree.org/schemas/pinctrl/marvell,berlin2-soc-pinctrl.yaml#
$schema: http://devicetree.org/meta-schemas/core.yaml#

title: Marvell Berlin pin-controller driver

maintainers:
  - Antoine Tenart <atenart@kernel.org>
  - Jisheng Zhang <jszhang@kernel.org>

description: >
  Pin control registers are part of both chip controller and system controller
  register sets. Pin controller nodes should be a sub-node of either the chip
  controller or system controller node. The pins controlled are organized in
  groups, so no actual pin information is needed.

  A pin-controller node should contain subnodes representing the pin group
  configurations, one per function. Each subnode has the group name and the
  muxing function used.

  Be aware the Marvell Berlin datasheets use the keyword 'mode' for what is
  called a 'function' in the pin-controller subsystem.

properties:
  compatible:
    items:
      - enum:
          - marvell,berlin2-soc-pinctrl
          - marvell,berlin2-system-pinctrl
          - marvell,berlin2cd-soc-pinctrl
          - marvell,berlin2cd-system-pinctrl
          - marvell,berlin2q-soc-pinctrl
          - marvell,berlin2q-system-pinctrl
          - marvell,berlin4ct-avio-pinctrl
          - marvell,berlin4ct-soc-pinctrl
          - marvell,berlin4ct-system-pinctrl
          - syna,as370-soc-pinctrl

  reg:
    maxItems: 1

additionalProperties:
  description: Pin group configuration subnodes.
  type: object
  $ref: /schemas/pinctrl/pinmux-node.yaml#
  additionalProperties: false

  properties:
    groups:
      description: List of pin group names.
      $ref: /schemas/types.yaml#/definitions/string-array

    function:
      description: Function used to mux the group.
      $ref: /schemas/types.yaml#/definitions/string

  required:
    - groups
    - function

allOf:
  - if:
      properties:
        compatible:
          contains:
            enum:
              - marvell,berlin4ct-avio-pinctrl
              - marvell,berlin4ct-soc-pinctrl
              - marvell,berlin4ct-system-pinctrl
              - syna,as370-soc-pinctrl
    then:
      required:
        - reg

examples:
  - |
    pinctrl {
        compatible = "marvell,berlin2q-system-pinctrl";

        uart0-pmux {
            groups = "GSM12";
            function = "uart0";
        };
    };
```
