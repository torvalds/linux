## Documentation/devicetree/bindings/pinctrl/marvell,mvebu-pinctrl.txt
```
* Marvell SoC pinctrl core driver for mpp

The pinctrl driver enables Marvell SoCs to configure the multi-purpose pins
(mpp) to a specific function. For each SoC family there is a SoC specific
driver using this core driver.

Please refer to pinctrl-bindings.txt in this directory for details of the
common pinctrl bindings used by client devices, including the meaning of the
phrase "pin configuration node".

A Marvell SoC pin configuration node is a node of a group of pins which can
be used for a specific device or function. Each node requires one or more
mpp pins or group of pins and a mpp function common to all pins.

Required properties for pinctrl driver:
- compatible: "marvell,<soc>-pinctrl"
  Please refer to each marvell,<soc>-pinctrl.txt binding doc for supported SoCs.

Required properties for pin configuration node:
- marvell,pins: string array of mpp pins or group of pins to be muxed.
- marvell,function: string representing a function to mux to for all
    marvell,pins given in this pin configuration node. The function has to be
    common for all marvell,pins. Please refer to marvell,<soc>-pinctrl.txt for
    valid pin/pin group names and available function names for each SoC.

Examples:

uart1: serial@12100 {
	compatible = "ns16550a";
	reg = <0x12100 0x100>;
	reg-shift = <2>;
	interrupts = <7>;

	pinctrl-0 = <&pmx_uart1_sw>;
	pinctrl-names = "default";
};

pinctrl: pinctrl@d0200 {
	compatible = "marvell,dove-pinctrl";
	reg = <0xd0200 0x14>, <0xd0440 0x04>, <0xd802c 0x08>;

	pmx_uart1_sw: pmx-uart1-sw {
		marvell,pins = "mpp_uart1";
		marvell,function = "uart1";
	};
};
```

## Documentation/devicetree/bindings/pinctrl/marvell,orion-pinctrl.txt
```
* Marvell Orion SoC pinctrl driver for mpp

Please refer to marvell,mvebu-pinctrl.txt in this directory for common binding
part and usage.

Required properties:
- compatible: "marvell,88f5181l-pinctrl", "marvell,88f5182-pinctrl",
              "marvell,88f5281-pinctrl"

- reg: two register areas, the first one describing the first two
  contiguous MPP registers, and the second one describing the single
  final MPP register, separated from the previous one.

Available mpp pins/groups and functions:
Note: brackets (x) are not part of the mpp name for marvell,function and given
only for more detailed description in this document.

* Marvell Orion 88f5181l

name          pins     functions
================================================================================
mpp0          0        pcie(rstout), pci(req2), gpio
mpp1          1        gpio, pci(gnt2)
mpp2          2        gpio, pci(req3), pci-1(pme)
mpp3          3        gpio, pci(gnt3)
mpp4          4        gpio, pci(req4)
mpp5          5        gpio, pci(gnt4)
mpp6          6        gpio, pci(req5), pci-1(clk)
mpp7          7        gpio, pci(gnt5), pci-1(clk)
mpp8          8        gpio, ge(col)
mpp9          9        gpio, ge(rxerr)
mpp10         10       gpio, ge(crs)
mpp11         11       gpio, ge(txerr)
mpp12         12       gpio, ge(txd4)
mpp13         13       gpio, ge(txd5)
mpp14         14       gpio, ge(txd6)
mpp15         15       gpio, ge(txd7)
mpp16         16       ge(rxd4)
mpp17         17       ge(rxd5)
mpp18         18       ge(rxd6)
mpp19         19       ge(rxd7)

* Marvell Orion 88f5182

name          pins     functions
================================================================================
mpp0          0        pcie(rstout), pci(req2), gpio
mpp1          1        gpio, pci(gnt2)
mpp2          2        gpio, pci(req3), pci-1(pme)
mpp3          3        gpio, pci(gnt3)
mpp4          4        gpio, pci(req4), bootnand(re), sata0(prsnt)
mpp5          5        gpio, pci(gnt4), bootnand(we), sata1(prsnt)
mpp6          6        gpio, pci(req5), nand(re0), sata0(act)
mpp7          7        gpio, pci(gnt5), nand(we0), sata1(act)
mpp8          8        gpio, ge(col)
mpp9          9        gpio, ge(rxerr)
mpp10         10       gpio, ge(crs)
mpp11         11       gpio, ge(txerr)
mpp12         12       gpio, ge(txd4), nand(re1), sata0(ledprsnt)
mpp13         13       gpio, ge(txd5), nand(we1), sata1(ledprsnt)
mpp14         14       gpio, ge(txd6), nand(re2), sata0(ledact)
mpp15         15       gpio, ge(txd7), nand(we2), sata1(ledact)
mpp16         16       uart1(rxd), ge(rxd4), gpio
mpp17         17       uart1(txd), ge(rxd5), gpio
mpp18         18       uart1(cts), ge(rxd6), gpio
mpp19         19       uart1(rts), ge(rxd7), gpio

* Marvell Orion 88f5281

name          pins     functions
================================================================================
mpp0          0        pcie(rstout), pci(req2), gpio
mpp1          1        gpio, pci(gnt2)
mpp2          2        gpio, pci(req3), pci(pme)
mpp3          3        gpio, pci(gnt3)
mpp4          4        gpio, pci(req4), bootnand(re)
mpp5          5        gpio, pci(gnt4), bootnand(we)
mpp6          6        gpio, pci(req5), nand(re0)
mpp7          7        gpio, pci(gnt5), nand(we0)
mpp8          8        gpio, ge(col)
mpp9          9        gpio, ge(rxerr)
mpp10         10       gpio, ge(crs)
mpp11         11       gpio, ge(txerr)
mpp12         12       gpio, ge(txd4), nand(re1)
mpp13         13       gpio, ge(txd5), nand(we1)
mpp14         14       gpio, ge(txd6), nand(re2)
mpp15         15       gpio, ge(txd7), nand(we2)
mpp16         16       uart1(rxd), ge(rxd4)
mpp17         17       uart1(txd), ge(rxd5)
mpp18         18       uart1(cts), ge(rxd6)
mpp19         19       uart1(rts), ge(rxd7)
```

## Documentation/devicetree/bindings/pinctrl/maxim,max77620-pinctrl.yaml
```yaml
# SPDX-License-Identifier: (GPL-2.0-only OR BSD-2-Clause)
%YAML 1.2
---
$id: http://devicetree.org/schemas/pinctrl/maxim,max77620-pinctrl.yaml#
$schema: http://devicetree.org/meta-schemas/core.yaml#

title: Pinmux controller function for Maxim MAX77620 Power management IC

maintainers:
  - Svyatoslav Ryhel <clamor95@gmail.com>

description:
  Device has 8 GPIO pins which can be configured as GPIO as well as the
  special IO functions.

allOf:
  - $ref: /schemas/pinctrl/pincfg-node.yaml
  - $ref: /schemas/pinctrl/pinmux-node.yaml

patternProperties:
  "^(pin|gpio).":
    type: object
    additionalProperties: false

    properties:
      pins:
        items:
          enum: [ gpio0, gpio1, gpio2, gpio3, gpio4, gpio5, gpio6, gpio7 ]

      function:
        items:
          enum: [ gpio, lpm-control-in, fps-out, 32k-out1, sd0-dvs-in, sd1-dvs-in,
                  reference-out ]

      drive-push-pull: true
      drive-open-drain: true
      bias-pull-up: true
      bias-pull-down: true

      maxim,active-fps-source:
        $ref: /schemas/types.yaml#/definitions/uint32
        description: |
          FPS source for the GPIOs to get enabled/disabled when system is in
          active state. Valid values are:
          - MAX77620_FPS_SRC_0: FPS source is FPS0.
          - MAX77620_FPS_SRC_1: FPS source is FPS1
          - MAX77620_FPS_SRC_2: FPS source is FPS2
          - MAX77620_FPS_SRC_NONE: GPIO is not controlled by FPS events and
                                   it gets enabled/disabled by register access.
          Absence of this property will leave the FPS configuration register
          for that GPIO to default configuration.

      maxim,active-fps-power-up-slot:
        $ref: /schemas/types.yaml#/definitions/uint32
        description:
          Sequencing event slot number on which the GPIO get enabled when
          master FPS input event set to HIGH. This is applicable if FPS source
          is selected as FPS0, FPS1 or FPS2.
        enum: [0, 1, 2, 3, 4, 5, 6, 7]

      maxim,active-fps-power-down-slot:
        $ref: /schemas/types.yaml#/definitions/uint32
        description:
          Sequencing event slot number on which the GPIO get disabled when
          master FPS input event set to LOW. This is applicable if FPS source
          is selected as FPS0, FPS1 or FPS2.
        enum: [0, 1, 2, 3, 4, 5, 6, 7]

      maxim,suspend-fps-source:
        $ref: /schemas/types.yaml#/definitions/uint32
        description:
          This is same as property "maxim,active-fps-source" but value get
          configured when system enters in to suspend state.

      maxim,suspend-fps-power-up-slot:
        $ref: /schemas/types.yaml#/definitions/uint32
        description:
          This is same as property "maxim,active-fps-power-up-slot" but this
          value get configured into FPS configuration register when system
          enters into suspend. This is applicable if suspend state FPS source
          is selected as FPS0, FPS1 or FPS2.
        enum: [0, 1, 2, 3, 4, 5, 6, 7]

      maxim,suspend-fps-power-down-slot:
        $ref: /schemas/types.yaml#/definitions/uint32
        description:
          This is same as property "maxim,active-fps-power-down-slot" but this
          value get configured into FPS configuration register when system
          enters into suspend. This is applicable if suspend state FPS source
          is selected as FPS0, FPS1 or FPS2.
        enum: [0, 1, 2, 3, 4, 5, 6, 7]

    required:
      - pins

additionalProperties: false

# see maxim,max77620.yaml for an example
```

## Documentation/devicetree/bindings/pinctrl/mediatek,mt65xx-pinctrl.yaml
```yaml
# SPDX-License-Identifier: (GPL-2.0-only OR BSD-2-Clause)
%YAML 1.2
---
$id: http://devicetree.org/schemas/pinctrl/mediatek,mt65xx-pinctrl.yaml#
$schema: http://devicetree.org/meta-schemas/core.yaml#

title: MediaTek MT65xx Pin Controller

maintainers:
  - Sean Wang <sean.wang@kernel.org>

description:
  The MediaTek's MT65xx Pin controller is used to control SoC pins.

properties:
  compatible:
    enum:
      - mediatek,mt2701-pinctrl
      - mediatek,mt2712-pinctrl
      - mediatek,mt6397-pinctrl
      - mediatek,mt7623-pinctrl
      - mediatek,mt8127-pinctrl
      - mediatek,mt8135-pinctrl
      - mediatek,mt8167-pinctrl
      - mediatek,mt8173-pinctrl
      - mediatek,mt8516-pinctrl

  reg:
    maxItems: 1

  pins-are-numbered:
    $ref: /schemas/types.yaml#/definitions/flag
    description:
      Specify the subnodes are using numbered pinmux to specify pins. (UNUSED)
    deprecated: true

  gpio-controller: true

  "#gpio-cells":
    const: 2
    description:
      Number of cells in GPIO specifier. Since the generic GPIO binding is used,
      the amount of cells must be specified as 2. See the below mentioned gpio
      binding representation for description of particular cells.

  gpio-line-names: true

  mediatek,pctl-regmap:
    $ref: /schemas/types.yaml#/definitions/phandle-array
    items:
      maxItems: 1
    minItems: 1
    maxItems: 2
    description:
      Should be phandles of the syscfg node.

  interrupt-controller: true

  interrupts:
    minItems: 1
    maxItems: 3

  "#interrupt-cells":
    const: 2

required:
  - compatible
  - gpio-controller
  - "#gpio-cells"

allOf:
  - $ref: pinctrl.yaml#

patternProperties:
  'pins$':
    type: object
    additionalProperties: false
    patternProperties:
      '(^pins|pins?$)':
        type: object
        additionalProperties: false
        description:
          A pinctrl node should contain at least one subnodes representing the
          pinctrl groups available on the machine. Each subnode will list the
          pins it needs, and how they should be configured, with regard to muxer
          configuration, pullups, drive strength, input enable/disable and input
          schmitt.
        $ref: /schemas/pinctrl/pincfg-node.yaml

        properties:
          pinmux:
            description:
              Integer array, represents gpio pin number and mux setting.
              Supported pin number and mux varies for different SoCs, and are
              defined as macros in dt-bindings/pinctrl/<soc>-pinfunc.h directly.

          bias-disable: true

          bias-pull-up:
            description:
              Besides generic pinconfig options, it can be used as the pull up
              settings for 2 pull resistors, R0 and R1. User can configure those
              special pins. Some macros have been defined for this usage, such
              as MTK_PUPD_SET_R1R0_00. See dt-bindings/pinctrl/mt65xx.h for
              valid arguments.

          bias-pull-down: true

          input-enable: true

          input-disable: true

          output-low: true

          output-high: true

          input-schmitt-enable: true

          input-schmitt-disable: true

          drive-strength:
            description:
              Can support some arguments, such as MTK_DRIVE_4mA, MTK_DRIVE_6mA,
              etc. See dt-bindings/pinctrl/mt65xx.h for valid arguments.

        required:
          - pinmux

additionalProperties: false

examples:
  - |
    #include <dt-bindings/interrupt-controller/irq.h>
    #include <dt-bindings/interrupt-controller/arm-gic.h>
    #include <dt-bindings/pinctrl/mt8135-pinfunc.h>

    soc {
        #address-cells = <2>;
        #size-cells = <2>;

        pinctrl@1c20800 {
            compatible = "mediatek,mt8135-pinctrl";
            reg = <0 0x1000B000 0 0x1000>;
            mediatek,pctl-regmap = <&syscfg_pctl_a>, <&syscfg_pctl_b>;
            gpio-controller;
            #gpio-cells = <2>;
            interrupt-controller;
            #interrupt-cells = <2>;
            interrupts = <GIC_SPI 116 IRQ_TYPE_LEVEL_HIGH>,
                         <GIC_SPI 117 IRQ_TYPE_LEVEL_HIGH>,
                         <GIC_SPI 118 IRQ_TYPE_LEVEL_HIGH>;

            i2c0_pins_a: i2c0-pins {
                pins1 {
                    pinmux = <MT8135_PIN_100_SDA0__FUNC_SDA0>,
                             <MT8135_PIN_101_SCL0__FUNC_SCL0>;
                    bias-disable;
                };
            };

            i2c1_pins_a: i2c1-pins {
                pins {
                    pinmux = <MT8135_PIN_195_SDA1__FUNC_SDA1>,
                             <MT8135_PIN_196_SCL1__FUNC_SCL1>;
                    bias-pull-up = <MTK_PUPD_SET_R1R0_01>;
                };
            };

            i2c2_pins_a: i2c2-pins {
                pins1 {
                    pinmux = <MT8135_PIN_193_SDA2__FUNC_SDA2>;
                    bias-pull-down;
                };

                pins2 {
                    pinmux = <MT8135_PIN_49_WATCHDOG__FUNC_GPIO49>;
                    bias-pull-up;
                };
            };
        };
    };
```
