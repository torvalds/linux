## Documentation/devicetree/bindings/pinctrl/eswin,eic7700-pinctrl.yaml
```yaml
# SPDX-License-Identifier: GPL-2.0-only OR BSD-2-Clause
%YAML 1.2
---
$id: http://devicetree.org/schemas/pinctrl/eswin,eic7700-pinctrl.yaml#
$schema: http://devicetree.org/meta-schemas/core.yaml#

title: Eswin Eic7700 Pinctrl

maintainers:
  - Yulin Lu <luyulin@eswincomputing.com>

allOf:
  - $ref: pinctrl.yaml#

description: |
  eic7700 pin configuration nodes act as a container for an arbitrary number of
  subnodes. Each of these subnodes represents some desired configuration for one or
  more pins. This configuration can include the mux function to select on those pin(s),
  and various pin configuration parameters, such as input-enable, pull-up, etc.

properties:
  compatible:
    const: eswin,eic7700-pinctrl

  reg:
    maxItems: 1

  vrgmii-supply:
    description:
      Regulator supply for the RGMII interface IO power domain.
      This property should reference a regulator that provides either 1.8V or 3.3V,
      depending on the board-level voltage configuration required by the RGMII interface.

patternProperties:
  '-grp$':
    type: object
    additionalProperties: false

    patternProperties:
      '-pins$':
        type: object

        properties:
          pins:
            description:
              For eic7700, specifies the name(s) of one or more pins to be configured by
              this node.
            items:
              enum: [ chip_mode, mode_set0, mode_set1, mode_set2, mode_set3, xin,
                      rst_out_n, key_reset_n, gpio0, por_sel, jtag0_tck, jtag0_tms,
                      jtag0_tdi, jtag0_tdo, gpio5, spi2_cs0_n, jtag1_tck, jtag1_tms,
                      jtag1_tdi, jtag1_tdo, gpio11, spi2_cs1_n, pcie_clkreq_n,
                      pcie_wake_n, pcie_perst_n, hdmi_scl, hdmi_sda, hdmi_cec,
                      jtag2_trst, rgmii0_clk_125, rgmii0_txen, rgmii0_txclk,
                      rgmii0_txd0, rgmii0_txd1, rgmii0_txd2, rgmii0_txd3, i2s0_bclk,
                      i2s0_wclk, i2s0_sdi, i2s0_sdo, i2s_mclk, rgmii0_rxclk,
                      rgmii0_rxdv, rgmii0_rxd0, rgmii0_rxd1, rgmii0_rxd2, rgmii0_rxd3,
                      i2s2_bclk, i2s2_wclk, i2s2_sdi, i2s2_sdo, gpio27, gpio28, gpio29,
                      rgmii0_mdc, rgmii0_mdio, rgmii0_intb, rgmii1_clk_125, rgmii1_txen,
                      rgmii1_txclk, rgmii1_txd0, rgmii1_txd1, rgmii1_txd2, rgmii1_txd3,
                      i2s1_bclk, i2s1_wclk, i2s1_sdi, i2s1_sdo, gpio34, rgmii1_rxclk,
                      rgmii1_rxdv, rgmii1_rxd0, rgmii1_rxd1, rgmii1_rxd2, rgmii1_rxd3,
                      spi1_cs0_n, spi1_clk, spi1_d0, spi1_d1, spi1_d2, spi1_d3, spi1_cs1_n,
                      rgmii1_mdc, rgmii1_mdio, rgmii1_intb, usb0_pwren, usb1_pwren,
                      i2c0_scl, i2c0_sda, i2c1_scl, i2c1_sda, i2c2_scl, i2c2_sda,
                      i2c3_scl, i2c3_sda, i2c4_scl, i2c4_sda, i2c5_scl, i2c5_sda,
                      uart0_tx, uart0_rx, uart1_tx, uart1_rx, uart1_cts, uart1_rts,
                      uart2_tx, uart2_rx, jtag2_tck, jtag2_tms, jtag2_tdi, jtag2_tdo,
                      fan_pwm, fan_tach, mipi_csi0_xvs, mipi_csi0_xhs, mipi_csi0_mclk,
                      mipi_csi1_xvs, mipi_csi1_xhs, mipi_csi1_mclk, mipi_csi2_xvs,
                      mipi_csi2_xhs, mipi_csi2_mclk, mipi_csi3_xvs, mipi_csi3_xhs,
                      mipi_csi3_mclk, mipi_csi4_xvs, mipi_csi4_xhs, mipi_csi4_mclk,
                      mipi_csi5_xvs, mipi_csi5_xhs, mipi_csi5_mclk, spi3_cs_n, spi3_clk,
                      spi3_di, spi3_do, gpio92, gpio93, s_mode, gpio95, spi0_cs_n,
                      spi0_clk, spi0_d0, spi0_d1, spi0_d2, spi0_d3, i2c10_scl,
                      i2c10_sda, i2c11_scl, i2c11_sda, gpio106, boot_sel0, boot_sel1,
                      boot_sel2, boot_sel3, gpio111, lpddr_ref_clk ]

          function:
            description:
              Specify the alternative function to be configured for the
              given pins.
            enum: [ disabled, boot_sel, chip_mode, emmc, fan_tach,
                    gpio, hdmi, i2c, i2s, jtag, ddr_ref_clk_sel,
                    lpddr_ref_clk, mipi_csi, osc, pcie, pwm,
                    rgmii, reset, sata, sdio, spi, s_mode, uart, usb ]

          input-schmitt-enable: true

          input-schmitt-disable: true

          bias-disable: true

          bias-pull-down: true

          bias-pull-up: true

          input-enable: true

          input-disable: true

          drive-strength-microamp: true

        required:
          - pins

        additionalProperties: false

        allOf:
          - $ref: pincfg-node.yaml#
          - $ref: pinmux-node.yaml#

          - if:
              properties:
                pins:
                  anyOf:
                    - pattern: '^rgmii'
                    - const: lpddr_ref_clk
            then:
              properties:
                drive-strength-microamp:
                  enum: [3000, 6000, 9000, 12000, 15000, 18000, 21000, 24000]
            else:
              properties:
                drive-strength-microamp:
                  enum: [6000, 9000, 12000, 15000, 18000, 21000, 24000, 27000]

required:
  - compatible
  - reg

unevaluatedProperties: false

examples:
  - |
    pinctrl@51600080 {
      compatible = "eswin,eic7700-pinctrl";
      reg = <0x51600080 0x1fff80>;
      vrgmii-supply = <&vcc_1v8>;

      dev-active-grp {
        /* group node defining 1 standard pin */
        gpio10-pins {
          pins = "jtag1_tdo";
          function = "gpio";
          input-enable;
          bias-pull-up;
        };

        /* group node defining 2 I2C pins */
        i2c6-pins {
          pins = "uart1_cts", "uart1_rts";
          function = "i2c";
        };
      };
    };
```

## Documentation/devicetree/bindings/pinctrl/fsl,imx-pinctrl.txt
```
* Freescale IOMUX Controller (IOMUXC) for i.MX

The IOMUX Controller (IOMUXC), together with the IOMUX, enables the IC
to share one PAD to several functional blocks. The sharing is done by
multiplexing the PAD input/output signals. For each PAD there are up to
8 muxing options (called ALT modes). Since different modules require
different PAD settings (like pull up, keeper, etc) the IOMUXC controls
also the PAD settings parameters.

Please refer to pinctrl-bindings.txt in this directory for details of the
common pinctrl bindings used by client devices, including the meaning of the
phrase "pin configuration node".

Freescale IMX pin configuration node is a node of a group of pins which can be
used for a specific device or function. This node represents both mux and config
of the pins in that group. The 'mux' selects the function mode(also named mux
mode) this pin can work on and the 'config' configures various pad settings
such as pull-up, open drain, drive strength, etc.

Required properties for iomux controller:
- compatible: "fsl,<soc>-iomuxc"
  Please refer to each fsl,<soc>-pinctrl.txt binding doc for supported SoCs.

Required properties for pin configuration node:
- fsl,pins: each entry consists of 6 integers and represents the mux and config
  setting for one pin. The first 5 integers <mux_reg conf_reg input_reg mux_val
  input_val> are specified using a PIN_FUNC_ID macro, which can be found in
  imx*-pinfunc.h under device tree source folder. The last integer CONFIG is
  the pad setting value like pull-up on this pin. And that's why fsl,pins entry
  looks like <PIN_FUNC_ID CONFIG> in the example below.

Bits used for CONFIG:
NO_PAD_CTL(1 << 31): indicate this pin does not need config.

SION(1 << 30): Software Input On Field.
Force the selected mux mode input path no matter of MUX_MODE functionality.
By default the input path is determined by functionality of the selected
mux mode (regular).

Other bits are used for PAD setting.
Please refer to each fsl,<soc>-pinctrl,txt binding doc for SoC specific part
of bits definitions.

NOTE:
Some requirements for using fsl,imx-pinctrl binding:
1. We have pin function node defined under iomux controller node to represent
   what pinmux functions this SoC supports.
2. The pin configuration node intends to work on a specific function should
   to be defined under that specific function node.
   The function node's name should represent well about what function
   this group of pins in this pin configuration node are working on.
3. The driver can use the function node's name and pin configuration node's
   name describe the pin function and group hierarchy.
   For example, Linux IMX pinctrl driver takes the function node's name
   as the function name and pin configuration node's name as group name to
   create the map table.
4. Each pin configuration node should have a phandle, devices can set pins
   configurations by referring to the phandle of that pin configuration node.

Examples:
usdhc@0219c000 { /* uSDHC4 */
	non-removable;
	vmmc-supply = <&reg_3p3v>;
	pinctrl-names = "default";
	pinctrl-0 = <&pinctrl_usdhc4_1>;
};

iomuxc@020e0000 {
	compatible = "fsl,imx6q-iomuxc";
	reg = <0x020e0000 0x4000>;

	/* shared pinctrl settings */
	usdhc4 {
		pinctrl_usdhc4_1: usdhc4grp-1 {
			fsl,pins = <
				MX6QDL_PAD_SD4_CMD__SD4_CMD    0x17059
				MX6QDL_PAD_SD4_CLK__SD4_CLK    0x10059
				MX6QDL_PAD_SD4_DAT0__SD4_DATA0 0x17059
				MX6QDL_PAD_SD4_DAT1__SD4_DATA1 0x17059
				MX6QDL_PAD_SD4_DAT2__SD4_DATA2 0x17059
				MX6QDL_PAD_SD4_DAT3__SD4_DATA3 0x17059
				MX6QDL_PAD_SD4_DAT4__SD4_DATA4 0x17059
				MX6QDL_PAD_SD4_DAT5__SD4_DATA5 0x17059
				MX6QDL_PAD_SD4_DAT6__SD4_DATA6 0x17059
				MX6QDL_PAD_SD4_DAT7__SD4_DATA7 0x17059
			>;
	};
	....
};
Refer to the IOMUXC controller chapter in imx6q datasheet,
0x17059 means enable hysteresis, 47KOhm Pull Up, 50Mhz speed,
80Ohm driver strength and Fast Slew Rate.
User should refer to each SoC spec to set the correct value.
```

## Documentation/devicetree/bindings/pinctrl/fsl,imx27-iomuxc.yaml
```yaml
# SPDX-License-Identifier: GPL-2.0-only OR BSD-2-Clause
%YAML 1.2
---
$id: http://devicetree.org/schemas/pinctrl/fsl,imx27-iomuxc.yaml#
$schema: http://devicetree.org/meta-schemas/core.yaml#

title: Freescale i.MX1/i.MX25/i.MX27 IOMUX Controller

maintainers:
  - Frank Li <Frank.Li@nxp.com>

description:
  Please refer to fsl,imx-pinctrl.txt and pinctrl-bindings.txt in this directory
  for common binding part and usage.

properties:
  compatible:
    enum:
      - fsl,imx1-iomuxc
      - fsl,imx27-iomuxc

  reg:
    maxItems: 1

  '#address-cells':
    const: 1

  '#size-cells':
    const: 1

  ranges: true

patternProperties:
  '^gpio@[0-9a-f]+$':
    type: object
    $ref: /schemas/gpio/fsl-imx-gpio.yaml
    unevaluatedProperties: false

  'grp$':
    type: object
    description:
      Pinctrl node's client devices use subnodes for desired pin configuration.
      Client device subnodes use below standard properties.

    properties:
      fsl,pins:
        description:
          three integers array, represents a group of pins mux and config
          setting. The format is fsl,pins = <PIN MUX_ID CONFIG>.
        $ref: /schemas/types.yaml#/definitions/uint32-matrix
        items:
          items:
            - description:
                PIN is an integer between 0 and 0xbf. imx27 has 6 ports with 32
                configurable pins each. PIN is PORT * 32 + PORT_PIN, PORT_PIN
                is the pin number on the specific port (between 0 and 31)
            - description: |
                MUX_ID is function + (direction << 2) + (gpio_oconf << 4)
                + (gpio_iconfa << 8) + (gpio_iconfb << 10)

                function value is used to select the pin function.
                Possible values:
                  0 - Primary function
                  1 - Alternate function
                  2 - GPIO
                Registers: GIUS (GPIO In Use), GPR (General Purpose Register)

                direction defines the data direction of the pin.
                Possible values:
                  0 - Input
                  1 - Output
                Register: DDIR

                gpio_oconf configures the gpio submodule output signal.
                This does not have any effect unless GPIO function is
                selected. A/B/C_IN are output signals of function blocks
                A,B and C. Specific function blocks are described in the
                reference manual.
                Possible values:
                  0 - A_IN
                  1 - B_IN
                  2 - C_IN
                  3 - Data Register
                Registers: OCR1, OCR2

                gpio_iconfa/b configures the gpio submodule input to
                functionblocks A and B. GPIO function should be selected if
                this is configured.
                Possible values:
                  0 - GPIO_IN
                  1 - Interrupt Status Register
                  2 - Pulldown
                  3 - Pullup
                Registers ICONFA1, ICONFA2, ICONFB1 and ICONFB2

            - description:
                CONFIG can be 0 or 1, meaning Pullup disable/enable.
    required:
      - fsl,pins

    additionalProperties: false

required:
  - compatible
  - reg

allOf:
  - $ref: pinctrl.yaml#

unevaluatedProperties: false

examples:
  - |
    pinmux@10015000 {
        compatible = "fsl,imx27-iomuxc";
        reg = <0x10015000 0x600>;

        uartgrp {
            fsl,pins = <
                0x8c 0x004 0x0 /* UART1_TXD__UART1_TXD */
                0x8d 0x000 0x0 /* UART1_RXD__UART1_RXD */
                0x8e 0x004 0x0 /* UART1_CTS__UART1_CTS */
                0x8f 0x000 0x0 /* UART1_RTS__UART1_RTS */
            >;
        };
    };
```
