## Documentation/devicetree/bindings/pinctrl/starfive,jhb100-sys2-pinctrl.yaml
```yaml
# SPDX-License-Identifier: GPL-2.0-only OR BSD-2-Clause
%YAML 1.2
---
$id: http://devicetree.org/schemas/pinctrl/starfive,jhb100-sys2-pinctrl.yaml#
$schema: http://devicetree.org/meta-schemas/core.yaml#

title: StarFive JHB100 System-2 Pin Controller

description: |
  Pinctrl bindings for JHB100 RISC-V SoC from StarFive Technology Ltd.

  The JHB100 SoC has 13 pinctrl domains - sys0, sys0h, sys1, sys2, per0, per1,
  per2, per2pok, per3, adc0, adc1, emmc, and vga.
  This document provides an overview of the "sys2" pinctrl domain.

  The "sys2" domain has a pin controller which provides
  - function selection for GPIO pads.
  - GPIO pad configuration.
  - GPIO interrupt handling.

  In the SYS2 Pin Controller, there are 37 multi-function GPIO_PADs. Each of
  them can be multiplexed to different hardware blocks through function
  selection. Each iopad has a maximum of up to 4 functions - 0, 1, 2, and 3.
  Function 0 is the default function which is the GPIO function.
  Function 1, 2, and 3 are the alternate functions or peripheral signals that
  can be routed to the iopad. The function selection can be carried out by
  writing the function number to the iopad function select register.

  Each iopad is configurable with parameters such as input-enable, internal
  pull-up/pull-down bias, drive strength, schmitt trigger, slew rate, input
  debounce nanoseconds, power source.

maintainers:
  - Changhuang Liang <changhuang.liang@starfivetech.com>

properties:
  compatible:
    items:
      - const: starfive,jhb100-sys2-pinctrl

  reg:
    maxItems: 1

  clocks:
    maxItems: 1

  resets:
    maxItems: 1

  interrupts:
    maxItems: 1

  interrupt-controller: true

  '#interrupt-cells':
    const: 2

  gpio-controller: true

  '#gpio-cells':
    const: 2

  gpio-ranges: true

  gpio-line-names: true

patternProperties:
  '-grp$':
    type: object
    additionalProperties: false
    patternProperties:
      '-pins$':
        type: object
        description: |
          A pinctrl node should contain at least one subnode representing the
          pinctrl groups available in the domain. Each subnode will list the
          pins it needs, and how they should be configured, with regard to
          function selection, bias, input enable/disable, input schmitt
          trigger enable/disable, slew-rate, input debounce nanoseconds,
          power-source and drive-strength.
        allOf:
          - $ref: /schemas/pinctrl/pincfg-node.yaml
          - $ref: /schemas/pinctrl/pinmux-node.yaml
        additionalProperties: false

        properties:
          pins:
            description:
              The list of IOs that properties in the pincfg node apply to.

          function:
            description:
              A string containing the name of the function to mux for these
              pins.
            enum: [ gpio, host0_port80, host1_port80, jtag, smbalert, uart ]

          bias-disable: true

          bias-pull-down:
            type: boolean

          bias-pull-up:
            type: boolean

          drive-strength:
            enum: [ 2, 4, 8, 12 ]

          drive-strength-microamp:
            enum: [ 2000, 4000, 8000, 12000 ]

          input-debounce-ns:
            minimum: 0
            maximum: 10485680
            description:
              Debounce time in nanoseconds. The hardware counts in 80 ns
              stages with a 17-bit counter, so the maximum is 10485680 ns.

          input-disable: true

          input-enable: true

          input-schmitt-enable: true

          input-schmitt-disable: true

          power-source:
            enum: [ 1800, 3300 ]
            description: I/O voltage in millivolt.

          slew-rate:
            enum: [ 0, 1 ]
            default: 0
            description: |
                0: slow
                1: fast

required:
  - compatible
  - reg
  - interrupts
  - interrupt-controller
  - '#interrupt-cells'
  - gpio-controller
  - '#gpio-cells'
  - gpio-ranges

additionalProperties: false

examples:
  - |
    soc {
        #address-cells = <2>;
        #size-cells = <2>;

        pinctrl_sys2: pinctrl@13082000 {
            compatible = "starfive,jhb100-sys2-pinctrl";
            reg = <0x0 0x13082000 0x0 0x1000>;
            interrupts = <59>;
            interrupt-controller;
            #interrupt-cells = <2>;
            gpio-controller;
            #gpio-cells = <2>;
            gpio-ranges = <&pinctrl_sys2 0 0 37>;
        };
    };
```

## Documentation/devicetree/bindings/pinctrl/ti,da850-pupd.yaml
```yaml
# SPDX-License-Identifier: (GPL-2.0-only OR BSD-2-Clause)
%YAML 1.2
---
$id: http://devicetree.org/schemas/pinctrl/ti,da850-pupd.yaml#
$schema: http://devicetree.org/meta-schemas/core.yaml#

title: Texas Instruments DA850/OMAP-L138/AM18x Pin Configuration

maintainers:
  - Eduard Bostina <egbostina@gmail.com>

description:
  These SoCs have a separate controller for setting bias (internal pullup/down).
  Bias can only be selected for groups rather than individual pins.
  The controller node also acts as a container for pin group configuration nodes.
  The names of these groups are ignored.

properties:
  compatible:
    const: ti,da850-pupd

  reg:
    maxItems: 1

  pinctrl-0: true
  pinctrl-names: true

patternProperties:
  "-groups$":
    type: object
    additionalProperties: false
    patternProperties:
      "^(disable|pull-(up|down))$":
        $ref: /schemas/pinctrl/pincfg-node.yaml#
        properties:
          groups:
            $ref: /schemas/types.yaml#/definitions/string-array
            description: An array of strings containing the name of a pin group.
            items:
              pattern: "^cp([0-9]|[1-2][0-9]|3[0-1])$"
          bias-disable: true
          bias-pull-up: true
          bias-pull-down: true
        additionalProperties: false

required:
  - compatible
  - reg

additionalProperties: false

examples:
  - |
    pinconf: pin-controller@22c00c {
        compatible = "ti,da850-pupd";
        reg = <0x22c00c 0x8>;
        pinctrl-0 = <&pinconf_bias_groups>;
        pinctrl-names = "default";

        pinconf_bias_groups: bias-groups {
            pull-up {
                groups = "cp30", "cp31";
                bias-pull-up;
            };
            pull-down {
                groups = "cp29", "cp28";
                bias-pull-down;
            };
            disable {
                groups = "cp27", "cp26";
                bias-disable;
            };
        };
    };
```

## Documentation/devicetree/bindings/pinctrl/ti,dra7-iodelay.yaml
```yaml
# SPDX-License-Identifier: (GPL-2.0-only OR BSD-2-Clause)
%YAML 1.2
---
$id: http://devicetree.org/schemas/pinctrl/ti,dra7-iodelay.yaml#
$schema: http://devicetree.org/meta-schemas/core.yaml#

title: Pin configuration for TI IODELAY controller

maintainers:
  - Nishanth Menon <nm@ti.com>
  - Bhargav Joshi <j.bhargav.u@gmail.com>

description:
  TI dra7 based SoCs such as am57xx have a controller for setting the IO delay
  for each pin. For most part the IO delay values are programmed by the
  bootloader, but some pins need to be configured dynamically by the kernel such
  as the MMC pins.

properties:
  compatible:
    const: ti,dra7-iodelay

  reg:
    maxItems: 1

  '#address-cells':
    const: 1

  '#size-cells':
    const: 0

  '#pinctrl-cells':
    const: 2

patternProperties:
  ^.*_conf$:
    type: object
    additionalProperties: false

    properties:
      pinctrl-pin-array:
        $ref: /schemas/types.yaml#/definitions/uint32-array
        description: |
          An array of 32-bit integers defining the pin delay configuration.

    required:
      - pinctrl-pin-array

required:
  - compatible
  - reg
  - '#address-cells'
  - '#size-cells'
  - '#pinctrl-cells'

additionalProperties: false

examples:
  - |
    #include <dt-bindings/pinctrl/dra.h>

    padconf@4844a000 {
        compatible = "ti,dra7-iodelay";
        reg = <0x4844a000 0x0d1c>;
        #address-cells = <1>;
        #size-cells = <0>;
        #pinctrl-cells = <2>;

        mmc2_iodelay_3v3_conf {
            pinctrl-pin-array = <
            0x18c A_DELAY_PS(0) G_DELAY_PS(120) /* CFG_GPMC_A19_IN */
            0x1a4 A_DELAY_PS(265) G_DELAY_PS(360) /* CFG_GPMC_A20_IN */
            0x1b0 A_DELAY_PS(0) G_DELAY_PS(120) /* CFG_GPMC_A21_IN */
            0x1bc A_DELAY_PS(0) G_DELAY_PS(120) /* CFG_GPMC_A22_IN */
            0x1c8 A_DELAY_PS(287) G_DELAY_PS(420) /* CFG_GPMC_A23_IN */
            0x1d4 A_DELAY_PS(144) G_DELAY_PS(240) /* CFG_GPMC_A24_IN */
            0x1e0 A_DELAY_PS(0) G_DELAY_PS(0) /* CFG_GPMC_A25_IN */
            0x1ec A_DELAY_PS(120) G_DELAY_PS(0) /* CFG_GPMC_A26_IN */
            0x1f8 A_DELAY_PS(120) G_DELAY_PS(180) /* CFG_GPMC_A27_IN */
            0x360 A_DELAY_PS(0) G_DELAY_PS(0) /* CFG_GPMC_CS1_IN */
            >;
        };
    };
```

## Documentation/devicetree/bindings/pinctrl/ti,palmas-pinctrl.yaml
```yaml
# SPDX-License-Identifier: (GPL-2.0-only OR BSD-2-Clause)
%YAML 1.2
---
$id: http://devicetree.org/schemas/pinctrl/ti,palmas-pinctrl.yaml#
$schema: http://devicetree.org/meta-schemas/core.yaml#

title: TI Palmas Pincontrol

maintainers:
  - Laxman Dewangan <ldewangan@nvidia.com>

description:
  The pins of Palmas device can be set on different option and provides
  the configuration for Pull UP/DOWN, open drain etc.

allOf:
  - $ref: pinctrl.yaml#

properties:
  compatible:
    enum:
      - ti,palmas-pinctrl
      - ti,tps65913-pinctrl
      - ti,tps80036-pinctrl

  ti,palmas-enable-dvfs1:
    type: boolean
    description:
      Enable DVFS1. Configure pins for DVFS1 mode.
      Selection primary or secondary function associated to I2C2_SCL_SCE,
      I2C2_SDA_SDO pin/pad for DVFS1 interface.

  ti,palmas-enable-dvfs2:
    type: boolean
    description:
      Enable DVFS2. Configure pins for DVFS2 mode.
      Selection primary or secondary function associated to GPADC_START
      and SYSEN2 pin/pad for DVFS2 interface.

  ti,palmas-override-powerhold:
    type: boolean
    description:
      This is applicable for PMICs for which GPIO7 is configured in POWERHOLD
      mode which has higher priority over DEV_ON bit and keeps the PMIC
      supplies on even after the DEV_ON bit is turned off. This property enables
      driver to over ride the POWERHOLD value to GPIO7 so as to turn off the PMIC
      in power off scenarios. So for GPIO7 if ti,palmas-override-powerhold is set
      then the GPIO_7 field should never be muxed to anything else.
      It should be set to POWERHOLD by default and only in case of
      power off scenarios the driver will over ride the mux value.

patternProperties:
  '^(pinmux|pins?-[a-z0-9-]+)$':
    type: object
    additionalProperties: false
    patternProperties:
      '^(pin.*|gpio[0-9]+|vac|powergood|nreswarm|pwrdown|gpadc_start|reset_in|nsleep|enable[12]|int)$':
        type: object
        allOf:
          - $ref: /schemas/pinctrl/pinmux-node.yaml
          - $ref: /schemas/pinctrl/pincfg-node.yaml
        unevaluatedProperties: false
        properties:
          pins:
            items:
              enum:
                - gpio0
                - gpio1
                - gpio2
                - gpio3
                - gpio4
                - gpio5
                - gpio6
                - gpio7
                - gpio8
                - gpio9
                - gpio10
                - gpio11
                - gpio12
                - gpio13
                - gpio14
                - gpio15
                - vac
                - powergood
                - nreswarm
                - pwrdown
                - gpadc_start
                - reset_in
                - nsleep
                - enable1
                - enable2
                - int

          function:
            description:
              Selects the mux function. There are 4 special functions opt0,
              opt1, opt2 and opt3. If any of these functions is selected then
              directly pins register will be written with 0, 1, 2 or 3
              respectively if it is valid for that pin or list of pins.
            enum:
              - gpio
              - led
              - pwm
              - regen
              - sysen
              - clk32kgaudio
              - id
              - vbus_det
              - chrg_det
              - vac
              - vacok
              - powergood
              - usb_psel
              - msecure
              - pwrhold
              - int
              - nreswarm
              - simrsto
              - simrsti
              - low_vbat
              - wireless_chrg1
              - rcm
              - pwrdown
              - gpadc_start
              - reset_in
              - nsleep
              - enable
              - opt0
              - opt1
              - opt2
              - opt3

        required:
          - pins

required:
  - compatible

unevaluatedProperties: false

examples:
  - |
    pmic {
        pinctrl {
            compatible = "ti,tps65913-pinctrl";
            ti,palmas-enable-dvfs1;
            pinctrl-names = "default";
            pinctrl-0 = <&palmas_pins_state>;

            pinmux {
                gpio0 {
                    pins = "gpio0";
                    function = "id";
                    bias-pull-up;
                };

                vac {
                    pins = "vac";
                    function = "vacok";
                    bias-pull-down;
                };

                gpio5 {
                    pins = "gpio5";
                    function = "opt0";
                    drive-open-drain = <1>;
                };
            };
        };
    };
```
