## Documentation/devicetree/bindings/power/supply/maxim,max8903.yaml
```yaml
# SPDX-License-Identifier: GPL-2.0
%YAML 1.2
---
$id: http://devicetree.org/schemas/power/supply/maxim,max8903.yaml#
$schema: http://devicetree.org/meta-schemas/core.yaml#

title: Maxim Semiconductor MAX8903 Battery Charger

maintainers:
  - Sebastian Reichel <sre@kernel.org>

allOf:
  - $ref: power-supply.yaml#

properties:
  compatible:
    const: maxim,max8903

  dok-gpios:
    maxItems: 1
    description: Valid DC power has been detected (active low, input)

  uok-gpios:
    maxItems: 1
    description: Valid USB power has been detected (active low, input)

  cen-gpios:
    maxItems: 1
    description: Charge enable pin (active low, output)

  chg-gpios:
    maxItems: 1
    description: Charger status pin (active low, input)

  flt-gpios:
    maxItems: 1
    description: Fault pin (active low, input)

  dcm-gpios:
    maxItems: 1
    description: Current limit mode setting (DC=1 or USB=0, output)

  usus-gpios:
    maxItems: 1
    description: USB suspend pin (active high, output)

  dc-current-limit-gpios:
    minItems: 1
    maxItems: 4
    description:
      GPIOs controlling DC input current limit via resistor mux.
      Used with dc-current-limit-mapping to select charging current.

  dc-current-limit-mapping:
    $ref: /schemas/types.yaml#/definitions/uint32-matrix
    minItems: 2
    maxItems: 16
    description: |
      Array of (current_microamps, gpio_bit_pattern) pairs defining available
      DC current limits. The gpio_bit_pattern is applied to dc-current-limit-gpios
      to select that current level.
    items:
      items:
        - description: Current limit in microamps
        - description: GPIO bit pattern value

  usb-current-limit-gpios:
    maxItems: 1
    description:
      GPIO driving the MAX8903 IUSB pin. IUSB is a silicon-fixed
      two-state input - low selects 100 mA, high selects 500 mA.
      Only the GPIO mapping is board-specific.

required:
  - compatible

dependentRequired:
  dc-current-limit-gpios: [dc-current-limit-mapping]
  dc-current-limit-mapping: [dc-current-limit-gpios]

anyOf:
  - required:
      - dok-gpios
  - required:
      - uok-gpios

additionalProperties: false

examples:
  - |
    #include <dt-bindings/gpio/gpio.h>
    charger {
      compatible = "maxim,max8903";
      dok-gpios = <&gpio2 3 GPIO_ACTIVE_LOW>;
      flt-gpios = <&gpio2 2 GPIO_ACTIVE_LOW>;
      chg-gpios = <&gpio3 15 GPIO_ACTIVE_LOW>;
      cen-gpios = <&gpio2 5 GPIO_ACTIVE_LOW>;
    };
  - |
    /* Example with DC and USB current limit control */
    #include <dt-bindings/gpio/gpio.h>
    charger {
      compatible = "maxim,max8903";
      dok-gpios = <&gpio2 3 GPIO_ACTIVE_LOW>;
      flt-gpios = <&gpio2 2 GPIO_ACTIVE_LOW>;
      chg-gpios = <&gpio3 15 GPIO_ACTIVE_LOW>;
      cen-gpios = <&gpio2 5 GPIO_ACTIVE_LOW>;
      dcm-gpios = <&gpio2 6 GPIO_ACTIVE_HIGH>;

      /* DC input current limit via IDC resistor mux */
      dc-current-limit-gpios = <&gpio1 0 GPIO_ACTIVE_HIGH>,
                               <&gpio1 1 GPIO_ACTIVE_HIGH>;
      dc-current-limit-mapping = <750000 0>,  /* GPIO[1:0]=0b00 */
                                 <900000 1>,  /* GPIO[1:0]=0b01 */
                                 <1400000 3>, /* GPIO[1:0]=0b11 */
                                 <2000000 2>; /* GPIO[1:0]=0b10 */

      /* USB current limit: IUSB pin, 100 mA (low) / 500 mA (high) */
      usb-current-limit-gpios = <&gpio1 2 GPIO_ACTIVE_HIGH>;
    };
```

## Documentation/devicetree/bindings/power/supply/sgmicro,sgm41542.yaml
```yaml
# SPDX-License-Identifier: (GPL-2.0-only OR BSD-2-Clause)
%YAML 1.2
---
$id: http://devicetree.org/schemas/power/supply/sgmicro,sgm41542.yaml#
$schema: http://devicetree.org/meta-schemas/core.yaml#

title: SGM41542 Battery Charger

description:
  The SGMicro SGM41542 is a single cell battery charger/boost controller.

maintainers:
  - Chris Morgan <macromorgan@hotmail.com>
  - Xu Shengfei <xsf@rock-chips.com>

allOf:
  - $ref: power-supply.yaml#

properties:
  compatible:
    const: sgmicro,sgm41542

  input-current-limit-microamp:
    default: 2400000
    minimum: 100000
    maximum: 3800000

  input-voltage-limit-microvolt:
    default: 4500000
    minimum: 3900000
    maximum: 12000000

  interrupts:
    maxItems: 1

  monitored-battery:
    description: |
        The charger uses the following battery properties
        constant-charge-current-max-microamp (default 2040000)
        constant-charge-voltage-max-microvolt (default 4208000)
        charge-term-current-microamp (default 180000)
        precharge-current-microamp (default 180000)

  reg:
    maxItems: 1

  regulators:
    type: object
    properties:
      otg-vbus:
        type: object
        description: OTG boost regulator
        $ref: /schemas/regulator/regulator.yaml
        unevaluatedProperties: false
    additionalProperties: false

required:
  - compatible
  - reg

unevaluatedProperties: false

examples:
  - |
    #include <dt-bindings/gpio/gpio.h>
    #include <dt-bindings/interrupt-controller/irq.h>

    battery: battery {
      compatible = "simple-battery";
      constant-charge-current-max-microamp = <10000000>;
      constant-charge-voltage-max-microvolt = <4350000>;
      precharge-current-microamp = <180000>;
      charge-term-current-microamp = <300000>;
    };

    i2c {
      #address-cells = <1>;
      #size-cells = <0>;

      charger@3b {
        compatible = "sgmicro,sgm41542";
        reg = <0x3b>;
        input-current-limit-microamp = <3000000>;
        input-voltage-limit-microvolt = <4500000>;
        interrupt-parent = <&gpio0>;
        interrupts = <26 IRQ_TYPE_EDGE_FALLING>;
        monitored-battery = <&battery>;

        regulators {
          otg-vbus {
            regulator-max-microvolt = <5000000>;
            regulator-min-microvolt = <5000000>;
          };
        };
      };
    };
```

## Documentation/devicetree/bindings/power/supply/ti,bq25630.yaml
```yaml
# SPDX-License-Identifier: (GPL-2.0-only OR BSD-2-Clause)
%YAML 1.2
---
$id: http://devicetree.org/schemas/power/supply/ti,bq25630.yaml#
$schema: http://devicetree.org/meta-schemas/core.yaml#

title: TI BQ25630 battery charger

maintainers:
  - Waqar Hameed <waqar.hameed@axis.com>

description: |
  I2C controlled single cell Li-ion and Li-polymer 5A buck charger.
  Datasheet: https://www.ti.com/lit/gpn/bq25630

allOf:
  - $ref: power-supply.yaml#

properties:
  compatible:
    const: ti,bq25630

  reg:
    const: 0x6b

  interrupts:
    maxItems: 1
    description:
      Device sends active low 256 µs pulse. Type should therefore be
      IRQ_TYPE_EDGE_FALLING.

required:
  - compatible
  - reg
  - interrupts
  - monitored-battery

unevaluatedProperties: false

examples:
  - |
    #include <dt-bindings/interrupt-controller/irq.h>

    i2c {
        #address-cells = <1>;
        #size-cells = <0>;

        charger@6b {
            compatible = "ti,bq25630";
            reg = <0x6b>;
            interrupts = <13 IRQ_TYPE_EDGE_FALLING>;
            monitored-battery = <&bat>;
        };
    };
...
```

## Documentation/devicetree/bindings/power/ti,smartreflex.yaml
```yaml
# SPDX-License-Identifier: (GPL-2.0-only OR BSD-2-Clause)
%YAML 1.2
---
$id: http://devicetree.org/schemas/power/ti,smartreflex.yaml#
$schema: http://devicetree.org/meta-schemas/core.yaml#

title: Texas Instruments SmartReflex

maintainers:
  - Eduard Bostina <egbostina@gmail.com>

description:
  SmartReflex is used to set and adjust the SoC operating points.

properties:
  compatible:
    enum:
      - ti,omap3-smartreflex-core
      - ti,omap3-smartreflex-mpu-iva
      - ti,omap4-smartreflex-core
      - ti,omap4-smartreflex-mpu
      - ti,omap4-smartreflex-iva

  reg:
    maxItems: 1

  interrupts:
    maxItems: 1

  ti,hwmods:
    description: Shall contain the TI interconnect module name if needed by the SoC
    $ref: /schemas/types.yaml#/definitions/string
    deprecated: true

required:
  - compatible
  - reg
  - interrupts

additionalProperties: false

examples:
  - |
    #include <dt-bindings/interrupt-controller/arm-gic.h>

    smartreflex@4a0db000 {
        compatible = "ti,omap4-smartreflex-iva";
        reg = <0x4a0db000 0x80>;
        interrupts = <GIC_SPI 102 IRQ_TYPE_LEVEL_HIGH>;
    };
```

## Documentation/devicetree/bindings/pwm/pwm-lp3943.yaml
```yaml
# SPDX-License-Identifier: (GPL-2.0-only OR BSD-2-Clause)
%YAML 1.2
---
$id: http://devicetree.org/schemas/pwm/pwm-lp3943.yaml#
$schema: http://devicetree.org/meta-schemas/core.yaml#

title: TI/National Semiconductor LP3943 PWM controller

maintainers:
  - Chaosheng Qu <quchaosheng000406@163.com>

description:
  LP3943 has two internal PWM channels. Each channel can be routed to one or
  more of the 16 outputs of the device.

  Note that the hardware limits the period length to the range 6250~1600000.

allOf:
  - $ref: pwm.yaml#

properties:
  compatible:
    const: ti,lp3943-pwm

  "#pwm-cells":
    const: 2

  ti,pwm0:
    description: Output pin number(s) for PWM channel 0.
    $ref: /schemas/types.yaml#/definitions/uint32-array
    minItems: 1
    maxItems: 16
    items:
      minimum: 0
      maximum: 15

  ti,pwm1:
    description: Output pin number(s) for PWM channel 1.
    $ref: /schemas/types.yaml#/definitions/uint32-array
    minItems: 1
    maxItems: 16
    items:
      minimum: 0
      maximum: 15

anyOf:
  - required:
      - ti,pwm0
  - required:
      - ti,pwm1

required:
  - compatible
  - "#pwm-cells"

unevaluatedProperties: false

examples:
  - |
    i2c {
        #address-cells = <1>;
        #size-cells = <0>;

        gpio@60 {
            compatible = "ti,lp3943";
            reg = <0x60>;

            /*
             * PWM 0 : output 8, 9 and 10
             * PWM 1 : output 15
             */
            pwm {
                compatible = "ti,lp3943-pwm";
                #pwm-cells = <2>;
                ti,pwm0 = <8 9 10>;
                ti,pwm1 = <15>;
            };
        };
    };
...
```

## Documentation/devicetree/bindings/pwm/raspberrypi,rp1-pwm.yaml
```yaml
# SPDX-License-Identifier: (GPL-2.0-only OR BSD-2-Clause)
%YAML 1.2
---
$id: http://devicetree.org/schemas/pwm/raspberrypi,rp1-pwm.yaml#
$schema: http://devicetree.org/meta-schemas/core.yaml#

title: Raspberry Pi RP1 PWM controller

maintainers:
  - Naushir Patuck <naush@raspberrypi.com>
  - Andrea della Porta <andrea.porta@suse.com>
  - Stanimir Varbanov <svarbanov@suse.de>

allOf:
  - $ref: pwm.yaml#

description: |
  The PWM peripheral is a flexible waveform generator with a
  variety of operational modes. It has the following features:
   - four independent output channels
   - 32-bit counter widths
   - Seven output generation modes
   - Optional per-channel output inversion
   - Optional duty-cycle data FIFO with DMA support
   - Optional sigma-delta noise shaping engine
  Serves as a fan speed provider to other nodes for a PWM-connected
  fan.

properties:
  compatible:
    const: raspberrypi,rp1-pwm

  reg:
    maxItems: 1

  clocks:
    maxItems: 1

  "#pwm-cells":
    const: 3

  dmas:
    maxItems: 1
    description: |
      Phandle to the DMA controller and the channel specifier for
      the duty-cycle FIFO.

  dma-names:
    items:
      - const: tx

required:
  - compatible
  - reg
  - clocks

unevaluatedProperties: false

examples:
  - |
    pwm@98000 {
      compatible = "raspberrypi,rp1-pwm";
      reg = <0x98000 0x100>;
      clocks = <&rp1_clocks 17>;
      #pwm-cells = <3>;
    };
```

## Documentation/devicetree/bindings/pwm/ti,am33xx-pwmss.yaml
```yaml
# SPDX-License-Identifier: (GPL-2.0-only OR BSD-2-Clause)
%YAML 1.2
---
$id: http://devicetree.org/schemas/pwm/ti,am33xx-pwmss.yaml#
$schema: http://devicetree.org/meta-schemas/core.yaml#

title: Texas Instruments SoC PWM Subsystem

maintainers:
  - Eduard Bostina <egbostina@gmail.com>

properties:
  compatible:
    oneOf:
      - const: ti,am33xx-pwmss
      - items:
          - enum:
              - ti,am4372-pwmss
              - ti,dra746-pwmss
          - const: ti,am33xx-pwmss

  reg:
    maxItems: 1

  "#address-cells":
    const: 1

  "#size-cells":
    const: 1

  ranges: true

patternProperties:
  "^(ecap|eqep|pwm|counter)@[0-9a-f]+$":
    type: object
    description: Child nodes for ECAP, EQEP (counter), and EHRPWM
    required:
      - compatible

required:
  - compatible
  - reg
  - "#address-cells"
  - "#size-cells"
  - ranges

additionalProperties: false

examples:
  - |
    pwm@48300000 {
        compatible = "ti,am33xx-pwmss";
        reg = <0x48300000 0x10>;
        #address-cells = <1>;
        #size-cells = <1>;
        ranges = <0x48300100 0x48300100 0x80>,   /* ECAP */
                 <0x48300180 0x48300180 0x80>,   /* EQEP */
                 <0x48300200 0x48300200 0x80>;   /* EHRPWM */

        pwm@48300100 {
            compatible = "ti,am3352-ecap";
            #pwm-cells = <3>;
            reg = <0x48300100 0x80>;
            clocks = <&l4ls_gclk>;
            clock-names = "fck";
        };

        counter@48300180 {
            compatible = "ti,am3352-eqep";
            reg = <0x48300180 0x80>;
            clocks = <&l4ls_gclk>;
            interrupts = <79>;
        };

        pwm@48300200 {
            compatible = "ti,am3352-ehrpwm";
            #pwm-cells = <3>;
            reg = <0x48300200 0x80>;
            clocks = <&ehrpwm0_tbclk>, <&l4ls_gclk>;
            clock-names = "tbclk", "fck";
        };
    };
```
