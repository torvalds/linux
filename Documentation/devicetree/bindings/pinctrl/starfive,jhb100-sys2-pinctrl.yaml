## Documentation/devicetree/bindings/power/mediatek,mt2701-scpsys.yaml
```yaml
# SPDX-License-Identifier: (GPL-2.0-only OR BSD-2-Clause)
%YAML 1.2
---
$id: http://devicetree.org/schemas/power/mediatek,mt2701-scpsys.yaml#
$schema: http://devicetree.org/meta-schemas/core.yaml#

title: MediaTek SCPSYS

maintainers:
  - Matthias Brugger <matthias.bgg@gmail.com>
  - AngeloGioacchino Del Regno <angelogioacchino.delregno@collabora.com>

description: >
  The System Control Processor System (SCPSYS) has several power management
  related tasks in the system. The tasks include thermal measurement, dynamic
  voltage frequency scaling (DVFS), interrupt filter and lowlevel sleep control.
  The System Power Manager (SPM) inside the SCPSYS is for the MTCMOS power
  domain control.

  It provides the power domains defined in:
    - include/dt-bindings/power/mt2701-power.h
    - include/dt-bindings/power/mt2712-power.h
    - include/dt-bindings/power/mt6797-power.h
    - include/dt-bindings/power/mt7622-power.h
    - include/dt-bindings/power/mt7623a-power.h

properties:
  compatible:
    oneOf:
      - enum:
          - mediatek,mt7623a-scpsys
          - mediatek,mt6797-scpsys
      - items:
          - enum:
              - mediatek,mt2701-scpsys
              - mediatek,mt2712-scpsys
              - mediatek,mt7622-scpsys
          - const: syscon
      - items:
          - const: mediatek,mt7623-scpsys
          - const: mediatek,mt2701-scpsys
          - const: syscon
      - items:
          - const: mediatek,mt7629-scpsys
          - const: mediatek,mt7622-scpsys

  '#power-domain-cells':
    description: Always 1
    const: 1

  reg:
    maxItems: 1

  interrupts:
    maxItems: 4

  clocks:
    minItems: 1
    maxItems: 20

  clock-names:
    minItems: 1
    maxItems: 6
    items:
      enum:
        - mm
        - mfg
        - ethif
        - venc
        - jpgdec
        - audio
        - vdec
        - hif_sel

  vdec-supply: true
  venc-supply: true
  isp-supply: true
  mm-supply: true
  audio-supply: true
  usb-supply: true
  mfg_async-supply: true
  mfg-supply: true

  infracfg:
    description: Infrastructure configuration controller phandle
    $ref: /schemas/types.yaml#/definitions/phandle

required:
  - compatible
  - '#power-domain-cells'
  - reg
  - infracfg
  - clocks
  - clock-names

additionalProperties: false

allOf:
  - if:
      properties:
        compatible:
          contains:
            const: mediatek,mt2701-scpsys
    then:
      properties:
        clocks:
          minItems: 3
          maxItems: 3
        clock-names:
          items:
            - const: mm
            - const: mfg
            - const: ethif
  - if:
      properties:
        compatible:
          contains:
            const: mediatek,mt7623a-scpsys
    then:
      properties:
        clocks:
          maxItems: 1
        clock-names:
          items:
            - const: ethif
  - if:
      properties:
        compatible:
          contains:
            const: mediatek,mt2712-scpsys
    then:
      properties:
        clocks:
          minItems: 6
        clock-names:
          items:
            - const: mm
            - const: mfg
            - const: venc
            - const: jpgdec
            - const: audio
            - const: vdec
  - if:
      properties:
        compatible:
          contains:
            const: mediatek,mt7622-scpsys
    then:
      properties:
        clocks:
          maxItems: 1
        clock-names:
          items:
            - const: hif_sel
  - if:
      properties:
        compatible:
          contains:
            const: mediatek,mt6797-scpsys
    then:
      properties:
        clocks:
          minItems: 3
          maxItems: 3
        clock-names:
          items:
            - const: mfg
            - const: mm
            - const: vdec

examples:
  - |
    #include <dt-bindings/clock/mt2701-clk.h>

    power-controller@10006000 {
        #power-domain-cells = <1>;
        compatible = "mediatek,mt2701-scpsys", "syscon";
        reg = <0x10006000 0x1000>;
        infracfg = <&infracfg>;
        clocks = <&topckgen CLK_TOP_MM_SEL>,
                  <&topckgen CLK_TOP_MFG_SEL>,
                  <&topckgen CLK_TOP_ETHIF_SEL>;
        clock-names = "mm", "mfg", "ethif";
    };
```

## Documentation/devicetree/bindings/power/renesas,r8a78000-mdlc.yaml
```yaml
# SPDX-License-Identifier: (GPL-2.0-only OR BSD-2-Clause)
%YAML 1.2
---
$id: http://devicetree.org/schemas/power/renesas,r8a78000-mdlc.yaml#
$schema: http://devicetree.org/meta-schemas/core.yaml#

title: Renesas R-Car X5H Module Controller

maintainers:
  - Geert Uytterhoeven <geert+renesas@glider.be>

description:
  Each instance of the R-Car X5H Module Controller (MODULE CONTROL) provides
  Power Gating for up to 64 Power Domains, and Module Standby and Reset for up
  to 256 modules in the Power Domain of each Module hierarchy.

properties:
  compatible:
    const: renesas,r8a78000-mdlc

  reg:
    maxItems: 1

  '#power-domain-cells':
    description: |
      - The first power domain specifier cell is the power domain part, and
        must be either the Module Power Domain Gating (MPDG) register index
        (0x00-0x3f) from the datasheet, for power domains which are backed by
        MPDG bits and which can be controlled in that manner,  or a Power
        Domain number, as defined in
        <dt-bindings/power/renesas,r8a78000-mdlc.h>, for power domains which
        are always on, and for which there are no MPDG bits to control them.

      - The second power domain specifier cell is the module standby part, and
        must be the module number (0x00-0xff), composed of the Module System
        Reset (MSRES) register index in the high nibble, and the Module Reset
        Destination bitfield index in the low nibble.
    const: 2

  '#reset-cells':
    description:
      The single reset specifier cell must be the module number (0x00-0xff),
      and thus identical to the second power domain specifier cell.
    const: 1

required:
  - compatible
  - reg
  - '#power-domain-cells'
  - '#reset-cells'

additionalProperties: false

examples:
  - |
    system-controller@c3060000 {
            compatible = "renesas,r8a78000-mdlc";
            reg = <0xc3060000 0x1000>;
            #power-domain-cells = <2>;
            #reset-cells = <1>;
    };
```

## Documentation/devicetree/bindings/power/reset/ti,keystone-reset.yaml
```yaml
# SPDX-License-Identifier: (GPL-2.0-only OR BSD-2-Clause)
%YAML 1.2
---
$id: http://devicetree.org/schemas/power/reset/ti,keystone-reset.yaml#
$schema: http://devicetree.org/meta-schemas/core.yaml#

title: TI Keystone SoC Reset Controller

maintainers:
  - Andrew Davis <afd@ti.com>

description:
  This is intended to allow SoC reset in case of software reset of selected
  watchdogs. The Keystone SoCs can contain up to 4 watchdog timers to reset
  SoC. Each watchdog timer event input is connected to the Reset Mux block. The
  Reset Mux block can be configured to cause reset or not. Additionally soft or
  hard reset can be configured.

properties:
  compatible:
    const: ti,keystone-reset

  reg:
    maxItems: 1

  ti,syscon-pll:
    $ref: /schemas/types.yaml#/definitions/phandle-array
    description:
      The phandle to syscon used to access pll controller registers and the
      offset to use reset control registers.
    items:
      - items:
          - description: phandle to pll controller syscon
          - description: offset within pll controller register space

  ti,syscon-dev:
    $ref: /schemas/types.yaml#/definitions/phandle-array
    description:
      The phandle to syscon used to access device state control registers and
      the offset in order to use mux block registers for all watchdogs.
    items:
      - items:
          - description: phandle to device state control syscon
          - description: offset within device state control register

  ti,soft-reset:
    type: boolean
    description:
      Boolean option indicating soft reset. By default hard reset is used.

  ti,wdt-list:
    $ref: /schemas/types.yaml#/definitions/uint32-array
    description:
      WDT list that can cause SoC reset. It's not related to WDT driver, it's
      just needed to enable a SoC related reset that's triggered by one of
      WDTs. The list is in format- <0>, <2>; It can be in random order and
      begins from 0 to 3, as keystone can contain up to 4 SoC reset watchdogs
      and can be in random order.
    minItems: 1
    maxItems: 4
    items:
      minimum: 0
      maximum: 3

required:
  - compatible
  - reg
  - ti,syscon-pll
  - ti,syscon-dev

additionalProperties: false

examples:
  - |
    reset-controller@328 {
        compatible = "ti,keystone-reset";
        reg = <0x328 0x10>;
        ti,syscon-pll = <&pllctrl 0xe4>;
        ti,syscon-dev = <&devctrl 0x328>;
        ti,wdt-list = <0>;
    };
```

## Documentation/devicetree/bindings/power/riscv,rpmi-device-power.yaml
```yaml
# SPDX-License-Identifier: (GPL-2.0-only OR BSD-2-Clause)
%YAML 1.2
---
$id: http://devicetree.org/schemas/power/riscv,rpmi-device-power.yaml#
$schema: http://devicetree.org/meta-schemas/core.yaml#

title: RISC-V RPMI device power service group based power domain controller

maintainers:
  - Joshua Yeong <joshua.yeong@starfivetech.com>

description: |
  The RISC-V Platform Management Interface (RPMI) [1] defines a
  messaging protocol which is modular and extensible. The supervisor
  software can send/receive RPMI messages via SBI MPXY extension [2]
  or some dedicated supervisor-mode RPMI transport.

  The RPMI specification [1] defines device power service group for
  accessing and controlling the power state of platform devices managed
  by a platform microcontroller. The supervisor software can access RPMI
  device power service group via SBI MPXY channel or some dedicated
  supervisor-mode RPMI transport.

  ===========================================
  References
  ===========================================

  [1] RISC-V Platform Management Interface (RPMI) v1.0 (or higher)
      https://github.com/riscv-non-isa/riscv-rpmi/releases

  [2] RISC-V Supervisor Binary Interface (SBI) v3.0 (or higher)
      https://github.com/riscv-non-isa/riscv-sbi-doc/releases

properties:
  compatible:
    description:
      Intended for use by the supervisor software.
    const: riscv,rpmi-device-power

  mboxes:
    maxItems: 1
    description:
      Mailbox channel of the underlying RPMI transport or SBI message proxy channel.

  "#power-domain-cells":
    const: 1
    description:
      Platform specific DOMAIN_ID as defined by the RISC-V Platform Management
      Interface (RPMI) specification.

required:
  - compatible
  - mboxes
  - "#power-domain-cells"

additionalProperties: false

examples:
  - |
    power-controller {
        compatible = "riscv,rpmi-device-power";
        mboxes = <&mpxy_mbox 0x1002 0x0>;
        #power-domain-cells = <1>;
    };
...
```

## Documentation/devicetree/bindings/power/riscv,rpmi-mpxy-device-power.yaml
```yaml
# SPDX-License-Identifier: (GPL-2.0-only OR BSD-2-Clause)
%YAML 1.2
---
$id: http://devicetree.org/schemas/power/riscv,rpmi-mpxy-device-power.yaml#
$schema: http://devicetree.org/meta-schemas/core.yaml#

title: RISC-V RPMI device power service group based message proxy

maintainers:
  - Joshua Yeong <joshua.yeong@starfivetech.com>

description: |
  The RISC-V Platform Management Interface (RPMI) [1] defines a
  messaging protocol which is modular and extensible. The supervisor
  software can send/receive RPMI messages via SBI MPXY extension [2]
  or some dedicated supervisor-mode RPMI transport.

  The RPMI specification [1] defines device power service group for
  accessing and controlling the power state of platform devices managed
  by a platform microcontroller. The SBI implementation (machine mode
  firmware or hypervisor) can implement an SBI MPXY channel to allow RPMI
  device power service group access to the supervisor software.

  ===========================================
  References
  ===========================================

  [1] RISC-V Platform Management Interface (RPMI) v1.0 (or higher)
      https://github.com/riscv-non-isa/riscv-rpmi/releases

  [2] RISC-V Supervisor Binary Interface (SBI) v3.0 (or higher)
      https://github.com/riscv-non-isa/riscv-sbi-doc/releases

properties:
  compatible:
    description:
      Intended for use by the SBI implementation.
    const: riscv,rpmi-mpxy-device-power

  mboxes:
    maxItems: 1
    description:
      Mailbox channel of the underlying RPMI transport.

  riscv,sbi-mpxy-channel-id:
    $ref: /schemas/types.yaml#/definitions/uint32
    description:
      The SBI MPXY channel id to be used for providing RPMI access to
      the supervisor software.

required:
  - compatible
  - mboxes
  - riscv,sbi-mpxy-channel-id

additionalProperties: false

examples:
  - |
    device-power-service {
        compatible = "riscv,rpmi-mpxy-device-power";
        mboxes = <&rpmi_shmem_mbox 0x9>;
        riscv,sbi-mpxy-channel-id = <0x1002>;
    };
...
```

## Documentation/devicetree/bindings/power/stericsson,ux500-pm-domains.yaml
```yaml
# SPDX-License-Identifier: (GPL-2.0-only OR BSD-2-Clause)
%YAML 1.2
---
$id: http://devicetree.org/schemas/power/stericsson,ux500-pm-domains.yaml#
$schema: http://devicetree.org/meta-schemas/core.yaml#

title: ST-Ericsson UX500 power domains

maintainers:
  - Linus Walleij <linusw@kernel.org>
  - Ulf Hansson <ulfh@kernel.org>

description:
  The UX500 power domain controller gates power to one or more peripherals on
  the SoC. Domain specifiers use one cell containing one of the DOMAIN_*
  indexes defined in include/dt-bindings/arm/ux500_pm_domains.h.

allOf:
  - $ref: power-domain.yaml#

properties:
  compatible:
    const: stericsson,ux500-pm-domains

  '#power-domain-cells':
    const: 1

required:
  - compatible
  - '#power-domain-cells'

unevaluatedProperties: false

examples:
  - |
    #include <dt-bindings/arm/ux500_pm_domains.h>

    pm_domains: power-controller {
        compatible = "stericsson,ux500-pm-domains";
        #power-domain-cells = <1>;
    };
```
