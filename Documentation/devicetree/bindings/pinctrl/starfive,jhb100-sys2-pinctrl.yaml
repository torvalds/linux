## Documentation/devicetree/bindings/regulator/lltc,ltc3589.yaml
```yaml
# SPDX-License-Identifier: (GPL-2.0-only OR BSD-2-Clause)
%YAML 1.2
---
$id: http://devicetree.org/schemas/regulator/lltc,ltc3589.yaml#
$schema: http://devicetree.org/meta-schemas/core.yaml#

title: Linear Technology LTC3589 PMIC

maintainers:
  - Frank Li <Frank.li@kernel.org>

description:
  Linear Technology LTC3589, LTC3589-1 and LTC3589-2 are PMICs
  containing three buck regulators, one boost regulator and four
  LDO regulators.

properties:
  compatible:
    enum:
      - lltc,ltc3589
      - lltc,ltc3589-1
      - lltc,ltc3589-2

  reg:
    maxItems: 1

  interrupts:
    maxItems: 1

  regulators:
    type: object
    additionalProperties: false

    patternProperties:
      "^(sw1|sw2|sw3|bb-out|ldo1|ldo2)$":
        type: object
        unevaluatedProperties: false
        $ref: regulator.yaml#

        properties:
          lltc,fb-voltage-divider:
            description:
              Feedback voltage divider resistor values (R1, R2) in ohms.
              Regulators sw1, sw2, sw3, and ldo2 can regulate the feedback
              reference from 0.3625 V to 0.75 V in 12.5 mV steps. The output
              voltage thus ranges between 0.3625 * (1 + R1/R2) V and
              0.75 * (1 + R1/R2) V. Regulators bb-out and ldo1 have a fixed
              0.8 V reference and thus output 0.8 * (1 + R1/R2) V. The ldo3
              regulator is fixed to 1.8 V on LTC3589 and to 2.8 V on
              LTC3589-1,2. The ldo4 regulator can output between 1.8 V and
              3.3 V on LTC3589 and between 1.2 V and 3.2 V on LTC3589-1,2 in
              four steps. The ldo1 standby regulator can not be disabled and
              thus should have the regulator-always-on property set.
            $ref: /schemas/types.yaml#/definitions/uint32-array
            items:
              - description: R1 in ohms
              - description: R2 in ohms.

        required:
          - lltc,fb-voltage-divider

      "^(ldo3|ldo4)$":
        type: object
        unevaluatedProperties: false
        $ref: regulator.yaml#

required:
  - compatible
  - reg
  - regulators

additionalProperties: false

examples:
  - |
    i2c {
        #address-cells = <1>;
        #size-cells = <0>;

        pmic@34 {
            compatible = "lltc,ltc3589-1";
            reg = <0x34>;

            regulators {
                sw1 {
                    regulator-min-microvolt = <591930>;
                    regulator-max-microvolt = <1224671>;
                    lltc,fb-voltage-divider = <100000 158000>;
                    regulator-ramp-delay = <7000>;
                    regulator-boot-on;
                    regulator-always-on;
                };

                sw2 {
                    regulator-min-microvolt = <704123>;
                    regulator-max-microvolt = <1456803>;
                    lltc,fb-voltage-divider = <180000 191000>;
                    regulator-ramp-delay = <7000>;
                    regulator-boot-on;
                    regulator-always-on;
                };

                sw3 {
                    regulator-min-microvolt = <1341250>;
                    regulator-max-microvolt = <2775000>;
                    lltc,fb-voltage-divider = <270000 100000>;
                    regulator-ramp-delay = <7000>;
                    regulator-boot-on;
                    regulator-always-on;
                };

                bb-out {
                    regulator-min-microvolt = <3387341>;
                    regulator-max-microvolt = <3387341>;
                    lltc,fb-voltage-divider = <511000 158000>;
                    regulator-boot-on;
                    regulator-always-on;
                };

                ldo1 {
                    regulator-min-microvolt = <1306329>;
                    regulator-max-microvolt = <1306329>;
                    lltc,fb-voltage-divider = <100000 158000>;
                    regulator-boot-on;
                    regulator-always-on;
                };

                ldo2 {
                    regulator-min-microvolt = <704123>;
                    regulator-max-microvolt = <1456806>;
                    lltc,fb-voltage-divider = <180000 191000>;
                    regulator-ramp-delay = <7000>;
                    regulator-boot-on;
                    regulator-always-on;
                };

                ldo3 {
                    regulator-min-microvolt = <2800000>;
                    regulator-max-microvolt = <2800000>;
                    regulator-boot-on;
                };

                ldo4 {
                    regulator-min-microvolt = <1200000>;
                    regulator-max-microvolt = <3200000>;
                };
            };
        };
    };
```

## Documentation/devicetree/bindings/regulator/mediatek,mt6380-regulator.yaml
```yaml
# SPDX-License-Identifier: (GPL-2.0-only OR BSD-2-Clause)
%YAML 1.2
---
$id: http://devicetree.org/schemas/regulator/mediatek,mt6380-regulator.yaml#
$schema: http://devicetree.org/meta-schemas/core.yaml#

title: MediaTek MT6380 Regulator

maintainers:
  - Sean Wang <sean.wang@mediatek.com>

properties:
  compatible:
    const: mediatek,mt6380-regulator

patternProperties:
  '^buck-(vcore1?|vrf)$':
    description: BUCK regulators
    $ref: regulator.yaml#
    unevaluatedProperties: false

    required:
      - regulator-min-microvolt
      - regulator-max-microvolt
      - regulator-ramp-delay

  '^ldo-v([mat]|phy|ddr)$':
    type: object
    description: LDO regulators
    $ref: regulator.yaml#
    unevaluatedProperties: false

    required:
      - regulator-min-microvolt
      - regulator-max-microvolt
      - regulator-ramp-delay

required:
  - compatible

additionalProperties: false

examples:
  - |
    regulators {
        compatible = "mediatek,mt6380-regulator";

        buck-vcore1 {
            regulator-name = "vcore1";
            regulator-min-microvolt = <600000>;
            regulator-max-microvolt = <1393750>;
            regulator-ramp-delay = <6250>;
            regulator-always-on;
            regulator-boot-on;
        };

        buck-vcore {
            regulator-name = "vcore";
            regulator-min-microvolt = <600000>;
            regulator-max-microvolt = <1393750>;
            regulator-ramp-delay = <6250>;
        };

        buck-vrf {
            regulator-name = "vrf";
            regulator-min-microvolt = <1200000>;
            regulator-max-microvolt = <1575000>;
            regulator-ramp-delay = <0>;
            regulator-always-on;
            regulator-boot-on;
        };

        ldo-vm {
            regulator-name = "vm";
            regulator-min-microvolt = <1050000>;
            regulator-max-microvolt = <1400000>;
            regulator-ramp-delay = <0>;
            regulator-always-on;
            regulator-boot-on;
        };

        ldo-va {
            regulator-name = "va";
            regulator-min-microvolt = <2200000>;
            regulator-max-microvolt = <3300000>;
            regulator-ramp-delay = <0>;
            regulator-always-on;
            regulator-boot-on;
        };

        ldo-vphy {
            regulator-name = "vphy";
            regulator-min-microvolt = <1800000>;
            regulator-max-microvolt = <1800000>;
            regulator-ramp-delay = <0>;
            regulator-always-on;
            regulator-boot-on;
        };

        ldo-vddr {
            regulator-name = "vddr";
            regulator-min-microvolt = <1240000>;
            regulator-max-microvolt = <1840000>;
            regulator-ramp-delay = <0>;
            regulator-always-on;
            regulator-boot-on;
        };

        ldo-vt {
            regulator-name = "vt";
            regulator-min-microvolt = <2200000>;
            regulator-max-microvolt = <3300000>;
            regulator-ramp-delay = <0>;
            regulator-always-on;
            regulator-boot-on;
        };
    };
```

## Documentation/devicetree/bindings/regulator/mps,mpq4210.yaml
```yaml
# SPDX-License-Identifier: (GPL-2.0-only OR BSD-2-Clause)
%YAML 1.2
---
$id: http://devicetree.org/schemas/regulator/mps,mpq4210.yaml#
$schema: http://devicetree.org/meta-schemas/core.yaml#

title: Monolithic Power Systems MPQ4210 buck-boost regulator

maintainers:
  - Tapio Reijonen <tapio.reijonen@vaisala.com>

description:
  The MPQ4210 is a synchronous four-switch buck-boost controller with an I2C
  interface. The output voltage is programmed through an 11-bit feedback
  reference DAC and scaled by an external feedback resistor divider.

  The controller ramps the feedback reference at 38, 50, 75 or 150 mV/ms.
  The divider scales the ramp rate along with the voltage, so the output
  ramp rates that regulator-ramp-delay can select are those values
  multiplied by (R1 + R2) / R2.

allOf:
  - $ref: regulator.yaml#

properties:
  compatible:
    const: mps,mpq4210

  reg:
    maxItems: 1

  enable-gpios:
    description: GPIO connected to the EN pin. If absent, EN is assumed to
      be permanently asserted.
    maxItems: 1

  mps,fb-voltage-divider-ohms:
    description: An array of two integers containing the resistor values R1
      and R2 of the output feedback voltage divider.
    maxItems: 2

required:
  - compatible
  - reg
  - mps,fb-voltage-divider-ohms

unevaluatedProperties: false

examples:
  - |
    #include <dt-bindings/gpio/gpio.h>
    i2c {
        #address-cells = <1>;
        #size-cells = <0>;

        regulator@64 {
            compatible = "mps,mpq4210";
            reg = <0x64>;
            regulator-name = "vout";
            regulator-min-microvolt = <4000000>;
            regulator-max-microvolt = <20000000>;
            enable-gpios = <&gpio0 2 GPIO_ACTIVE_LOW>;
            /* R1 = 82 kOhm, R2 = 9.1 kOhm */
            mps,fb-voltage-divider-ohms = <82000 9100>;
            /* 50 mV/ms reference ramp x (82000 + 9100) / 9100 */
            regulator-ramp-delay = <500>;
        };
    };
```

## Documentation/devicetree/bindings/regulator/nexperia,nex10000ub.yaml
```yaml
# SPDX-License-Identifier: GPL-2.0-only OR BSD-2-Clause
%YAML 1.2
---
$id: http://devicetree.org/schemas/regulator/nexperia,nex10000ub.yaml#
$schema: http://devicetree.org/meta-schemas/core.yaml#

title: Nexperia NEX10000UB dual output LCD bias power supply

maintainers:
  - Neil Armstrong <neil.armstrong@linaro.org>

description:
  The NEX10000UB is designed to supply positive/negative supplies for display Panels.

properties:
  compatible:
    enum:
      - nexperia,nex10000ub

  reg:
    maxItems: 1

  vin-supply: true

patternProperties:
  "^(vpos|vneg)$":
    type: object
    $ref: regulator.yaml#
    unevaluatedProperties: false

    properties:
      enable-gpios:
        maxItems: 1

    required:
      - enable-gpios

required:
  - compatible
  - reg

additionalProperties: false

examples:
  - |
    #include <dt-bindings/gpio/gpio.h>

    i2c {
        #address-cells = <1>;
        #size-cells = <0>;

        regulator@3e {
            compatible = "nexperia,nex10000ub";
            reg = <0x3e>;
            vin-supply = <&supply>;

            vpos {
                regulator-name = "outp";
                regulator-boot-on;
                enable-gpios = <&gpio 23 GPIO_ACTIVE_HIGH>;
            };

            vneg {
                regulator-name = "outn";
                regulator-boot-on;
                enable-gpios = <&gpio 40 GPIO_ACTIVE_HIGH>;
            };
        };
    };
```

## Documentation/devicetree/bindings/regulator/nvidia,tegra-regulators-coupling.yaml
```yaml
# SPDX-License-Identifier: GPL-2.0-only OR BSD-2-Clause
%YAML 1.2
---
$id: http://devicetree.org/schemas/regulator/nvidia,tegra-regulators-coupling.yaml#
$schema: http://devicetree.org/meta-schemas/core.yaml#

title: NVIDIA Tegra Regulators Coupling

description: >
  NVIDIA Tegra SoC's have a mandatory voltage-coupling between regulators. Thus
  on Tegra20 there are 3 coupled regulators and on NVIDIA Tegra30 there are 2.

  On Tegra20 SoC's - there are 3 coupled regulators:CORE, RTC and CPU. The CORE
  and RTC voltages shall be in a range of 170mV from each other and they both
  shall be higher than the CPU voltage by at least 120mV.

  On Tegra30 SoC's - there are 2 coupled regulators:CORE and CPU. The CORE and
  CPU voltages shall be in a range of 300mV from each other and CORE voltage
  shall be higher than the CPU by N mV, where N depends on the CPU voltage.

maintainers:
  - Dmitry Osipenko <digetx@gmail.com>
  - Thierry Reding <treding@nvidia.com>

properties:
  nvidia,tegra-core-regulator:
    description: designates regulator as the "Core domain" voltage regulator.
    type: boolean

  nvidia,tegra-rtc-regulator:
    description: designates regulator as the "RTC domain" voltage regulator.
    type: boolean

  nvidia,tegra-cpu-regulator:
    description: designates regulator as the "CPU domain" voltage regulator.
    type: boolean

additionalProperties: true
```

## Documentation/devicetree/bindings/regulator/rohm,bd73800-regulator.yaml
```yaml
# SPDX-License-Identifier: GPL-2.0-only OR BSD-2-Clause
%YAML 1.2
---
$id: http://devicetree.org/schemas/regulator/rohm,bd73800-regulator.yaml#
$schema: http://devicetree.org/meta-schemas/core.yaml#

title: ROHM BD73800 Power Management Integrated Circuit regulators

maintainers:
  - Matti Vaittinen <mazziesaccount@gmail.com>

description: |
  This module is part of the ROHM BD73800 MFD device. For more details
  see Documentation/devicetree/bindings/mfd/rohm,bd73800-pmic.yaml.

  The regulator controller is represented as a sub-node of the PMIC node
  on the device tree.

  Regulator nodes should be named to buck<number> and ldo<number>.
  The valid names for BD73800 regulator nodes are
  buck1, buck2, buck3, buck4, buck5, buck6, buck7, buck8
  ldo1, ldo2, ldo3, ldo4

patternProperties:
  "^buck[1-8]$":
    type: object
    description:
      Properties for a single BUCK regulator.
    allOf:
      - $ref: regulator.yaml#
      - $ref: rohm,pmic-states.yaml#

    properties:
      regulator-name:
        pattern: "^buck[1-8]$"
        description:
          should be "buck1", ..., "buck8"

      rohm,dvs-run-voltage:
        minimum: 0
        maximum: 3500000

      rohm,dvs-idle-voltage:
        minimum: 0
        maximum: 3500000

      rohm,dvs-suspend-voltage:
        minimum: 0
        maximum: 3500000

        # BUCKs 1,2,3,4 and 8 support voltages 0.5 - 1.3V
        # BUCK 5 supports voltages 0.3 - 1.3V
        # BUCKs 6 and 7 support voltages 1.5 - 3.5V

    required:
      - regulator-name

    unevaluatedProperties: false

  "^ldo[1-4]$":
    type: object
    description:
      Properties for single LDO regulator.
    allOf:
      - $ref: regulator.yaml#
      - $ref: rohm,pmic-states.yaml#

    properties:
      regulator-name:
        pattern: "^ldo[1-4]$"
        description:
          should be "ldo1", ..., "ldo4"

      rohm,dvs-run-voltage:
        minimum: 0
        maximum: 1

      rohm,dvs-idle-voltage:
        minimum: 0
        maximum: 1

      rohm,dvs-suspend-voltage:
        minimum: 0
        maximum: 1

      rohm,ldo-range-high:
        type: boolean
        description:
          LDO1 and LDO3 voltage ranges can be "high" or "low" depending on
          OTP. Indicate that the "high" range is used. See comment below
          for voltages.

        # LDOs 2 and 4 support voltages 0.75 - 3.3V
        # LDOs 1 and 3 may support different ranges depending on OTP.
        # either 0.6 - 1.8V or 0.75 - 3.3V.

    unevaluatedProperties: false

additionalProperties: false
```
