## Documentation/devicetree/bindings/power/amlogic,meson-ee-pwrc.yaml
```yaml
# SPDX-License-Identifier: (GPL-2.0 OR BSD-2-Clause)
# Copyright 2019 BayLibre, SAS
%YAML 1.2
---
$id: "http://devicetree.org/schemas/power/amlogic,meson-ee-pwrc.yaml#"
$schema: "http://devicetree.org/meta-schemas/core.yaml#"

title: Amlogic Meson Everything-Else Power Domains

maintainers:
  - Neil Armstrong <narmstrong@baylibre.com>

description: |+
  The Everything-Else Power Domains node should be the child of a syscon
  node with the required property:

  - compatible: Should be the following:
                "amlogic,meson-gx-hhi-sysctrl", "simple-mfd", "syscon"

  Refer to the the bindings described in
  Documentation/devicetree/bindings/mfd/syscon.yaml

properties:
  compatible:
    enum:
      - amlogic,meson8-pwrc
      - amlogic,meson8b-pwrc
      - amlogic,meson8m2-pwrc
      - amlogic,meson-g12a-pwrc
      - amlogic,meson-sm1-pwrc

  clocks:
    minItems: 1
    maxItems: 2

  clock-names:
    minItems: 1
    maxItems: 2
    items:
      - const: vpu
      - const: vapb

  resets:
    minItems: 11

  reset-names:
    minItems: 11

  "#power-domain-cells":
    const: 1

  amlogic,ao-sysctrl:
    description: phandle to the AO sysctrl node
    allOf:
      - $ref: /schemas/types.yaml#/definitions/phandle

allOf:
  - if:
      properties:
        compatible:
          enum:
            - amlogic,meson8b-pwrc
            - amlogic,meson8m2-pwrc
    then:
      properties:
        reset-names:
          items:
            - const: dblk
            - const: pic_dc
            - const: hdmi_apb
            - const: hdmi_system
            - const: venci
            - const: vencp
            - const: vdac
            - const: vencl
            - const: viu
            - const: venc
            - const: rdma
      required:
        - resets
        - reset-names

  - if:
      properties:
        compatible:
          enum:
            - amlogic,meson-g12a-pwrc
            - amlogic,meson-sm1-pwrc
    then:
      properties:
        reset-names:
          items:
            - const: viu
            - const: venc
            - const: vcbus
            - const: bt656
            - const: rdma
            - const: venci
            - const: vencp
            - const: vdac
            - const: vdi6
            - const: vencl
            - const: vid_lock
      required:
        - resets
        - reset-names

required:
  - compatible
  - clocks
  - clock-names
  - "#power-domain-cells"
  - amlogic,ao-sysctrl

additionalProperties: false

examples:
  - |
    pwrc: power-controller {
          compatible = "amlogic,meson-sm1-pwrc";
          #power-domain-cells = <1>;
          amlogic,ao-sysctrl = <&rti>;
          resets = <&reset_viu>,
                   <&reset_venc>,
                   <&reset_vcbus>,
                   <&reset_bt656>,
                   <&reset_rdma>,
                   <&reset_venci>,
                   <&reset_vencp>,
                   <&reset_vdac>,
                   <&reset_vdi6>,
                   <&reset_vencl>,
                   <&reset_vid_lock>;
          reset-names = "viu", "venc", "vcbus", "bt656",
                        "rdma", "venci", "vencp", "vdac",
                        "vdi6", "vencl", "vid_lock";
          clocks = <&clk_vpu>, <&clk_vapb>;
          clock-names = "vpu", "vapb";
    };
```

## Documentation/devicetree/bindings/power/amlogic,meson-gx-pwrc.txt
```
Amlogic Meson Power Controller (deprecated)
===========================================

The Amlogic Meson SoCs embeds an internal Power domain controller.

VPU Power Domain
----------------

The Video Processing Unit power domain is controlled by this power controller,
but the domain requires some external resources to meet the correct power
sequences.
The bindings must respect the power domain bindings as described in the file
power-domain.yaml

Device Tree Bindings:
---------------------

Required properties:
- compatible: should be one of the following :
	- "amlogic,meson-gx-pwrc-vpu" for the Meson GX SoCs
	- "amlogic,meson-g12a-pwrc-vpu" for the Meson G12A SoCs
- #power-domain-cells: should be 0
- amlogic,hhi-sysctrl: phandle to the HHI sysctrl node
- resets: phandles to the reset lines needed for this power demain sequence
	as described in ../reset/reset.txt
- clocks: from common clock binding: handle to VPU and VAPB clocks
- clock-names: from common clock binding: must contain "vpu", "vapb"
	corresponding to entry in the clocks property.

Parent node should have the following properties :
- compatible: "amlogic,meson-gx-ao-sysctrl", "syscon", "simple-mfd"
- reg: base address and size of the AO system control register space.

Example:
-------

ao_sysctrl: sys-ctrl@0 {
	compatible = "amlogic,meson-gx-ao-sysctrl", "syscon", "simple-mfd";
	reg =  <0x0 0x0 0x0 0x100>;

	pwrc_vpu: power-controller-vpu {
		compatible = "amlogic,meson-gx-pwrc-vpu";
		#power-domain-cells = <0>;
		amlogic,hhi-sysctrl = <&sysctrl>;
		resets = <&reset RESET_VIU>,
			 <&reset RESET_VENC>,
			 <&reset RESET_VCBUS>,
			 <&reset RESET_BT656>,
			 <&reset RESET_DVIN_RESET>,
			 <&reset RESET_RDMA>,
			 <&reset RESET_VENCI>,
			 <&reset RESET_VENCP>,
			 <&reset RESET_VDAC>,
			 <&reset RESET_VDI6>,
			 <&reset RESET_VENCL>,
			 <&reset RESET_VID_LOCK>;
		clocks = <&clkc CLKID_VPU>,
			 <&clkc CLKID_VAPB>;
		clock-names = "vpu", "vapb";
	};
};
```

## Documentation/devicetree/bindings/power/amlogic,meson-sec-pwrc.yaml
```yaml
# SPDX-License-Identifier: (GPL-2.0+ OR MIT)
# Copyright (c) 2019 Amlogic, Inc
# Author: Jianxin Pan <jianxin.pan@amlogic.com>
%YAML 1.2
---
$id: "http://devicetree.org/schemas/power/amlogic,meson-sec-pwrc.yaml#"
$schema: "http://devicetree.org/meta-schemas/core.yaml#"

title: Amlogic Meson Secure Power Domains

maintainers:
  - Jianxin Pan <jianxin.pan@amlogic.com>

description: |+
  Secure Power Domains used in Meson A1/C1/S4 SoCs, and should be the child node
  of secure-monitor.

properties:
  compatible:
    enum:
      - amlogic,meson-a1-pwrc
      - amlogic,meson-s4-pwrc

  "#power-domain-cells":
    const: 1

required:
  - compatible
  - "#power-domain-cells"

additionalProperties: false

examples:
  - |
    secure-monitor {
        compatible = "amlogic,meson-gxbb-sm";

        pwrc: power-controller {
            compatible = "amlogic,meson-a1-pwrc";
            #power-domain-cells = <1>;
        };
    };
```
