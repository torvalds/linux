## Documentation/devicetree/bindings/pinmux/pinmux_nvidia.txt
```
NVIDIA Tegra 2 pinmux controller

Required properties:
- compatible : "nvidia,tegra20-pinmux"
```

## Documentation/devicetree/bindings/platform/huawei,gaokun-ec.yaml
```yaml
# SPDX-License-Identifier: (GPL-2.0-only OR BSD-2-Clause)
%YAML 1.2
---
$id: http://devicetree.org/schemas/platform/huawei,gaokun-ec.yaml#
$schema: http://devicetree.org/meta-schemas/core.yaml#

title: Huawei Matebook E Go Embedded Controller

maintainers:
  - Pengyu Luo <mitltlatltl@gmail.com>

description:
  Different from other Qualcomm Snapdragon sc8180x and sc8280xp-based
  machines, the Huawei Matebook E Go tablets use embedded controllers
  while others use a system called PMIC GLink which handles battery,
  UCSI, USB Type-C DP Alt Mode. In addition, Huawei's implementation
  also handles additional features, such as charging thresholds, FN
  lock, smart charging, tablet lid status, thermal sensors, and more.

properties:
  compatible:
    enum:
      - huawei,gaokun3-ec

  reg:
    const: 0x38

  '#address-cells':
    const: 1

  '#size-cells':
    const: 0

  interrupts:
    maxItems: 1

patternProperties:
  '^connector@[01]$':
    $ref: /schemas/connector/usb-connector.yaml#

    properties:
      reg:
        maxItems: 1

required:
  - compatible
  - reg
  - interrupts

additionalProperties: false

examples:
  - |
    #include <dt-bindings/interrupt-controller/irq.h>
    i2c {
        #address-cells = <1>;
        #size-cells = <0>;

        embedded-controller@38 {
            compatible = "huawei,gaokun3-ec";
            reg = <0x38>;

            interrupts-extended = <&tlmm 107 IRQ_TYPE_LEVEL_LOW>;

            #address-cells = <1>;
            #size-cells = <0>;

            connector@0 {
                compatible = "usb-c-connector";
                reg = <0>;
                power-role = "dual";
                data-role = "dual";

                ports {
                    #address-cells = <1>;
                    #size-cells = <0>;

                    port@0 {
                        reg = <0>;

                        ucsi0_ss_in: endpoint {
                            remote-endpoint = <&usb_0_qmpphy_out>;
                        };
                    };

                    port@1 {
                        reg = <1>;

                        ucsi0_sbu: endpoint {
                            remote-endpoint = <&usb0_sbu_mux>;
                        };
                    };
                };
            };

            connector@1 {
                compatible = "usb-c-connector";
                reg = <1>;
                power-role = "dual";
                data-role = "dual";

                ports {
                    #address-cells = <1>;
                    #size-cells = <0>;

                    port@0 {
                        reg = <0>;

                        ucsi1_ss_in: endpoint {
                            remote-endpoint = <&usb_1_qmpphy_out>;
                        };
                    };

                    port@1 {
                        reg = <1>;

                        ucsi1_sbu: endpoint {
                            remote-endpoint = <&usb1_sbu_mux>;
                        };
                    };
                };
            };
        };
    };
```

## Documentation/devicetree/bindings/platform/microsoft,surface-sam.yaml
```yaml
# SPDX-License-Identifier: (GPL-2.0-only OR BSD-2-Clause)
%YAML 1.2
---
$id: http://devicetree.org/schemas/platform/microsoft,surface-sam.yaml#
$schema: http://devicetree.org/meta-schemas/core.yaml#

title: Surface System Aggregator Module (SAM, SSAM)

maintainers:
  - Konrad Dybcio <konradybcio@kernel.org>

description: |
  Surface devices use a standardized embedded controller to let the
  operating system interface with various hardware functions. The
  specific functionalities are modeled as subdevices and matched on
  five levels: domain, category, target, instance and function.

properties:
  compatible:
    const: microsoft,surface-sam

  interrupts:
    maxItems: 1

  current-speed: true

required:
  - compatible
  - interrupts

additionalProperties: false

examples:
  - |
    #include <dt-bindings/interrupt-controller/irq.h>
    uart {
        embedded-controller {
            compatible = "microsoft,surface-sam";

            interrupts-extended = <&tlmm 91 IRQ_TYPE_EDGE_RISING>;

            pinctrl-0 = <&ssam_state>;
            pinctrl-names = "default";

            current-speed = <4000000>;
        };
    };
```

## Documentation/devicetree/bindings/pmem/pmem-region.txt
```
Device-tree bindings for persistent memory regions
-----------------------------------------------------

Persistent memory refers to a class of memory devices that are:

	a) Usable as main system memory (i.e. cacheable), and
	b) Retain their contents across power failure.

Given b) it is best to think of persistent memory as a kind of memory mapped
storage device. To ensure data integrity the operating system needs to manage
persistent regions separately to the normal memory pool. To aid with that this
binding provides a standardised interface for discovering where persistent
memory regions exist inside the physical address space.

Bindings for the region nodes:
-----------------------------

Required properties:
	- compatible = "pmem-region"

	- reg = <base, size>;
		The reg property should specificy an address range that is
		translatable to a system physical address range. This address
		range should be mappable as normal system memory would be
		(i.e cacheable).

		If the reg property contains multiple address ranges
		each address range will be treated as though it was specified
		in a separate device node. Having multiple address ranges in a
		node implies no special relationship between the two ranges.

Optional properties:
	- Any relevant NUMA assocativity properties for the target platform.

	- volatile; This property indicates that this region is actually
	  backed by non-persistent memory. This lets the OS know that it
	  may skip the cache flushes required to ensure data is made
	  persistent after a write.

	  If this property is absent then the OS must assume that the region
	  is backed by non-volatile memory.

Examples:
--------------------

	/*
	 * This node specifies one 4KB region spanning from
	 * 0x5000 to 0x5fff that is backed by non-volatile memory.
	 */
	pmem@5000 {
		compatible = "pmem-region";
		reg = <0x00005000 0x00001000>;
	};

	/*
	 * This node specifies two 4KB regions that are backed by
	 * volatile (normal) memory.
	 */
	pmem@6000 {
		compatible = "pmem-region";
		reg = < 0x00006000 0x00001000
			0x00008000 0x00001000 >;
		volatile;
	};
```

## Documentation/devicetree/bindings/pmem/pmem-region.yaml
```yaml
# SPDX-License-Identifier: (GPL-2.0-only OR BSD-2-Clause)
%YAML 1.2
---
$id: http://devicetree.org/schemas/pmem-region.yaml#
$schema: http://devicetree.org/meta-schemas/core.yaml#

maintainers:
  - Oliver O'Halloran <oohall@gmail.com>

title: Persistent Memory Regions

description: |
  Persistent memory refers to a class of memory devices that are:

    a) Usable as main system memory (i.e. cacheable), and
    b) Retain their contents across power failure.

  Given b) it is best to think of persistent memory as a kind of memory mapped
  storage device. To ensure data integrity the operating system needs to manage
  persistent regions separately to the normal memory pool. To aid with that this
  binding provides a standardised interface for discovering where persistent
  memory regions exist inside the physical address space.

properties:
  compatible:
    const: pmem-region

  reg:
    maxItems: 1

  volatile:
    description:
      Indicates the region is volatile (non-persistent) and the OS can skip
      cache flushes for writes
    type: boolean

required:
  - compatible
  - reg

additionalProperties: false

examples:
  - |
    pmem@5000 {
        compatible = "pmem-region";
        reg = <0x00005000 0x00001000>;
    };
```

## Documentation/devicetree/bindings/power/act8945a-charger.txt
```
Device-Tree bindings for charger of Active-semi ACT8945A Multi-Function Device

Required properties:
 - compatible: "active-semi,act8945a", please refer to ../mfd/act8945a.txt.
 - active-semi,chglev-gpios: charge current level phandle with args
   as described in ../gpio/gpio.txt.

Optional properties:
 - active-semi,check-battery-temperature: boolean to check the battery
   temperature or not.
 - active-semi,input-voltage-threshold-microvolt: unit: mV;
   Specifies the charger's input over-voltage threshold value;
   The value can be: 6600, 7000, 7500, 8000; default: 6600
 - active-semi,precondition-timeout: unit: minutes;
   Specifies the charger's PRECONDITION safety timer setting value;
   The value can be: 40, 60, 80, 0; If 0, it means to disable this timer;
   default: 40.
 - active-semi,total-timeout: unit: hours;
   Specifies the charger's total safety timer setting value;
   The value can be: 3, 4, 5, 0; If 0, it means to disable this timer;
   default: 3.

Example:
	pmic@5b {
		compatible = "active-semi,act8945a";
		reg = <0x5b>;
		status = "okay";

		pinctrl-names = "default";
		pinctrl-0 = <&pinctrl_charger_chglev>;
		active-semi,chglev-gpios = <&pioA 12 GPIO_ACTIVE_HIGH>;
		active-semi,input-voltage-threshold-microvolt = <6600>;
		active-semi,precondition-timeout = <40>;
		active-semi,total-timeout = <3>;
	};
```

## Documentation/devicetree/bindings/power/actions,owl-sps.txt
```
Actions Semi Owl Smart Power System (SPS)

Required properties:
- compatible          :  "actions,s500-sps" for S500
                         "actions,s700-sps" for S700
                         "actions,s900-sps" for S900
- reg                 :  Offset and length of the register set for the device.
- #power-domain-cells :  Must be 1.
                         See macros in:
                          include/dt-bindings/power/owl-s500-powergate.h for S500
                          include/dt-bindings/power/owl-s700-powergate.h for S700
                          include/dt-bindings/power/owl-s900-powergate.h for S900


Example:

		sps: power-controller@b01b0100 {
			compatible = "actions,s500-sps";
			reg = <0xb01b0100 0x100>;
			#power-domain-cells = <1>;
		};
```

## Documentation/devicetree/bindings/power/actions,s500-sps.yaml
```yaml
# SPDX-License-Identifier: (GPL-2.0-only OR BSD-2-Clause)
%YAML 1.2
---
$id: http://devicetree.org/schemas/power/actions,s500-sps.yaml#
$schema: http://devicetree.org/meta-schemas/core.yaml#

title: Actions Semi Owl Smart Power System (SPS)

maintainers:
  - Andreas Färber <afaerber@suse.de>
  - Manivannan Sadhasivam <mani@kernel.org>

properties:
  compatible:
    enum:
      - actions,s500-sps
      - actions,s700-sps
      - actions,s900-sps

  reg:
    maxItems: 1

  '#power-domain-cells':
    const: 1

required:
  - compatible
  - reg
  - '#power-domain-cells'

additionalProperties: false

examples:
  - |
    power-controller@b01b0100 {
        compatible = "actions,s500-sps";
        reg = <0xb01b0100 0x100>;
        #power-domain-cells = <1>;
    };
```

## Documentation/devicetree/bindings/power/allwinner,sun20i-d1-ppu.yaml
```yaml
# SPDX-License-Identifier: (GPL-2.0-only OR BSD-2-Clause)
%YAML 1.2
---
$id: http://devicetree.org/schemas/power/allwinner,sun20i-d1-ppu.yaml#
$schema: http://devicetree.org/meta-schemas/core.yaml#

title: Allwinner SoCs PPU power domain controller

maintainers:
  - Samuel Holland <samuel@sholland.org>

description:
  D1 and related SoCs contain a power domain controller for the CPUs, GPU, and
  video-related hardware.

properties:
  compatible:
    enum:
      - allwinner,sun20i-d1-ppu
      - allwinner,sun8i-v853-ppu

  reg:
    maxItems: 1

  clocks:
    description: Bus Clock
    maxItems: 1

  resets:
    maxItems: 1

  '#power-domain-cells':
    const: 1

required:
  - compatible
  - reg
  - clocks
  - resets
  - '#power-domain-cells'

additionalProperties: false

examples:
  - |
    #include <dt-bindings/clock/sun20i-d1-r-ccu.h>
    #include <dt-bindings/reset/sun20i-d1-r-ccu.h>

    ppu: power-controller@7001000 {
        compatible = "allwinner,sun20i-d1-ppu";
        reg = <0x7001000 0x1000>;
        clocks = <&r_ccu CLK_BUS_R_PPU>;
        resets = <&r_ccu RST_BUS_R_PPU>;
        #power-domain-cells = <1>;
    };
```

## Documentation/devicetree/bindings/power/allwinner,sun50i-h6-prcm-ppu.yaml
```yaml
# SPDX-License-Identifier: (GPL-2.0-only OR BSD-2-Clause)
%YAML 1.2
---
$id: http://devicetree.org/schemas/power/allwinner,sun50i-h6-prcm-ppu.yaml#
$schema: http://devicetree.org/meta-schemas/core.yaml#

title: Allwinner SoCs PRCM power domain controller

maintainers:
  - Andre Przywara <andre.przywara@arm.com>

description:
  The Allwinner Power Reset Clock Management (PRCM) unit contains bits to
  control a few power domains.

properties:
  compatible:
    enum:
      - allwinner,sun50i-h6-prcm-ppu
      - allwinner,sun50i-h616-prcm-ppu
      - allwinner,sun55i-a523-prcm-ppu

  reg:
    maxItems: 1

  '#power-domain-cells':
    const: 1

required:
  - compatible
  - reg
  - '#power-domain-cells'

additionalProperties: false

examples:
  - |
    prcm_ppu: power-controller@7010210 {
        compatible = "allwinner,sun50i-h616-prcm-ppu";
        reg = <0x7010210 0x10>;
        #power-domain-cells = <1>;
    };
```
