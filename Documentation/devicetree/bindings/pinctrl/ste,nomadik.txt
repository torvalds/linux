## Documentation/devicetree/bindings/pinctrl/thead,th1520-pinctrl.yaml
```yaml
# SPDX-License-Identifier: (GPL-2.0-only OR BSD-2-Clause)
%YAML 1.2
---
$id: http://devicetree.org/schemas/pinctrl/thead,th1520-pinctrl.yaml#
$schema: http://devicetree.org/meta-schemas/core.yaml#

title: T-Head TH1520 SoC pin controller

maintainers:
  - Emil Renner Berthing <emil.renner.berthing@canonical.com>

description: |
  Pinmux and pinconf controller in the T-Head TH1520 RISC-V SoC.

  The TH1520 has 3 groups of pads each controlled from different memory ranges.
  Confusingly the memory ranges are named
    PADCTRL_AOSYS  -> PAD Group 1
    PADCTRL1_APSYS -> PAD Group 2
    PADCTRL0_APSYS -> PAD Group 3

  Each pad can be muxed individually to up to 6 different functions. For most
  pads only a few of those 6 configurations are valid though, and a few pads in
  group 1 does not support muxing at all.

  Pinconf is fairly regular except for a few pads in group 1 that either can't
  be configured or has some special functions. The rest have configurable drive
  strength, input enable, schmitt trigger, slew rate, pull-up and pull-down in
  addition to a special strong pull up.

  Certain pads in group 1 can be muxed to AUDIO_PA0 - AUDIO_PA30 functions and
  are then meant to be used by the audio co-processor. Each such pad can then
  be further muxed to either audio GPIO or one of 4 functions such as UART, I2C
  and I2S. If the audio pad is muxed to one of the 4 functions then pinconf is
  also configured in different registers. All of this is done from a different
  AUDIO_IOCTRL memory range and is left to the audio co-processor for now.

properties:
  compatible:
    enum:
      - thead,th1520-pinctrl
  reg:
    maxItems: 1

  clocks:
    maxItems: 1

  thead,pad-group:
    description: |
      Select the pad group that is associated with the pin controller instance.

        Base Address   Name           Group
        0xFF_FFF4_A000 PADCTRL_AOSYS  1
        0xFF_E7F3_C000 PADCTRL1_APSYS 2
        0xFF_EC00_7000 PADCTRL0_APSYS 3

    $ref: /schemas/types.yaml#/definitions/uint32
    enum: [1, 2, 3]

required:
  - compatible
  - reg
  - clocks

patternProperties:
  '-[0-9]+$':
    type: object
    additionalProperties: false

    patternProperties:
      '-pins$':
        type: object
        allOf:
          - $ref: /schemas/pinctrl/pincfg-node.yaml#
          - $ref: /schemas/pinctrl/pinmux-node.yaml#

        additionalProperties: false

        description:
          A pinctrl node should contain at least one subnode describing one
          or more pads and their associated pinmux and pinconf settings.

        properties:
          pins:
            description: List of pads that properties in the node apply to.

          function:
            enum: [ gpio, pwm, uart, ir, i2c, spi, qspi, sdio, audio, i2s,
                    gmac0, gmac1, dpu0, dpu1, isp, hdmi, bootsel, debug,
                    clock, jtag, iso7816, efuse, reset ]
            description: The mux function to select for the given pins.

          bias-disable: true

          bias-pull-up:
            oneOf:
              - type: boolean
                description: Enable the regular 48kOhm pull-up
              - enum: [ 2100, 48000 ]
                description: Enable the strong 2.1kOhm pull-up or regular 48kOhm pull-up

          bias-pull-down:
            oneOf:
              - type: boolean
              - const: 44000
            description: Enable the regular 44kOhm pull-down

          drive-strength:
            enum: [ 1, 2, 3, 5, 7, 8, 10, 12, 13, 15, 16, 18, 20, 21, 23, 25 ]
            description: Drive strength in mA

          input-enable: true

          input-disable: true

          input-schmitt-enable: true

          input-schmitt-disable: true

          slew-rate:
            maximum: 1

        required:
          - pins

additionalProperties: false

examples:
  - |
    padctrl0_apsys: pinctrl@ec007000 {
        compatible = "thead,th1520-pinctrl";
        reg = <0xec007000 0x1000>;
        clocks = <&apb_clk>;
        thead,pad-group = <3>;

        uart0_pins: uart0-0 {
            tx-pins {
                pins = "UART0_TXD";
                function = "uart";
                bias-disable;
                drive-strength = <3>;
                input-disable;
                input-schmitt-disable;
                slew-rate = <0>;
            };

            rx-pins {
                pins = "UART0_RXD";
                function = "uart";
                bias-disable;
                drive-strength = <1>;
                input-enable;
                input-schmitt-enable;
                slew-rate = <0>;
            };
        };
    };

    padctrl1_apsys: pinctrl@e7f3c000 {
        compatible = "thead,th1520-pinctrl";
        reg = <0xe7f3c000 0x1000>;
        clocks = <&apb_clk>;
        thead,pad-group = <2>;

        i2c5_pins: i2c5-0 {
            i2c-pins {
                pins = "QSPI1_CSN0",    /* I2C5_SCL */
                       "QSPI1_D0_MOSI"; /* I2C5_SDA */
                function = "i2c";
                bias-pull-up = <2100>;
                drive-strength = <7>;
                input-enable;
                input-schmitt-enable;
                slew-rate = <0>;
            };
        };
    };
```

## Documentation/devicetree/bindings/pinctrl/ti,da850-pupd.txt
```
* Pin configuration for TI DA850/OMAP-L138/AM18x

These SoCs have a separate controller for setting bias (internal pullup/down).
Bias can only be selected for groups rather than individual pins.

Required Properties:

  - compatible: Must be "ti,da850-pupd"
  - reg: Base address and length of the memory resource used by the pullup/down
    controller hardware module.

The controller node also acts as a container for pin group configuration nodes.
The names of these groups are ignored.

Pin Group Node Properties:

- groups: An array of strings, each string containing the name of a pin group.
          Valid names are "cp0".."cp31".

The pin configuration parameters use the generic pinconf bindings defined in
pinctrl-bindings.txt in this directory. The supported parameters are
bias-disable, bias-pull-up, bias-pull-down.


Example
-------

In common dtsi file:

	pinconf: pin-controller@22c00c {
		compatible = "ti,da850-pupd";
		reg = <0x22c00c 0x8>;
	};

In board-specific file:

	&pinconf {
		pinctrl-0 = <&pinconf_bias_groups>;
		pinctrl-names = "default";

		pinconf_bias_groups: bias-groups {
			pull-up {
				groups = "cp30", "cp31";
				bias-pull-up;
			};
			pull-down {
				groups = "cp29", "cp28";
				bias-pull-down;
			};
			disable {
				groups = "cp27", "cp26";
				bias-disable;
			};
		};
	};
```

## Documentation/devicetree/bindings/pinctrl/ti,iodelay.txt
```
* Pin configuration for TI IODELAY controller

TI dra7 based SoCs such as am57xx have a controller for setting the IO delay
for each pin. For most part the IO delay values are programmed by the bootloader,
but some pins need to be configured dynamically by the kernel such as the
MMC pins.

Required Properties:

  - compatible: Must be "ti,dra7-iodelay"
  - reg: Base address and length of the memory resource used
  - #address-cells: Number of address cells
  - #size-cells: Size of cells
  - #pinctrl-cells: Number of pinctrl cells, must be 2. See also
    Documentation/devicetree/bindings/pinctrl/pinctrl-bindings.txt

Example
-------

In the SoC specific dtsi file:

	dra7_iodelay_core: padconf@4844a000 {
		compatible = "ti,dra7-iodelay";
		reg = <0x4844a000 0x0d1c>;
		#address-cells = <1>;
		#size-cells = <0>;
		#pinctrl-cells = <2>;
	};

In board-specific file:

&dra7_iodelay_core {
	mmc2_iodelay_3v3_conf: mmc2_iodelay_3v3_conf {
		pinctrl-pin-array = <
		0x18c A_DELAY_PS(0) G_DELAY_PS(120)	/* CFG_GPMC_A19_IN */
		0x1a4 A_DELAY_PS(265) G_DELAY_PS(360)	/* CFG_GPMC_A20_IN */
		0x1b0 A_DELAY_PS(0) G_DELAY_PS(120)	/* CFG_GPMC_A21_IN */
		0x1bc A_DELAY_PS(0) G_DELAY_PS(120)	/* CFG_GPMC_A22_IN */
		0x1c8 A_DELAY_PS(287) G_DELAY_PS(420)	/* CFG_GPMC_A23_IN */
		0x1d4 A_DELAY_PS(144) G_DELAY_PS(240)	/* CFG_GPMC_A24_IN */
		0x1e0 A_DELAY_PS(0) G_DELAY_PS(0)	/* CFG_GPMC_A25_IN */
		0x1ec A_DELAY_PS(120) G_DELAY_PS(0)	/* CFG_GPMC_A26_IN */
		0x1f8 A_DELAY_PS(120) G_DELAY_PS(180)	/* CFG_GPMC_A27_IN */
		0x360 A_DELAY_PS(0) G_DELAY_PS(0)	/* CFG_GPMC_CS1_IN */
		>;
	};
};
```

## Documentation/devicetree/bindings/pinctrl/ti,omap-pinctrl.txt
```
OMAP Pinctrl definitions

Required properties:
- compatible : Should be one of:
  "ti,omap2420-padconf" - OMAP2420 compatible pinctrl
  "ti,omap2430-padconf" - OMAP2430 compatible pinctrl
  "ti,omap3-padconf" - OMAP3 compatible pinctrl
  "ti,omap4-padconf" - OMAP4 compatible pinctrl
  "ti,omap5-padconf" - OMAP5 compatible pinctrl

See Documentation/devicetree/bindings/pinctrl/pinctrl-single.txt for further details.
```

## Documentation/devicetree/bindings/pinctrl/toshiba,visconti-pinctrl.yaml
```yaml
# SPDX-License-Identifier: GPL-2.0-only OR BSD-2-Clause
%YAML 1.2
---
$id: http://devicetree.org/schemas/pinctrl/toshiba,visconti-pinctrl.yaml#
$schema: http://devicetree.org/meta-schemas/core.yaml#

title: Toshiba Visconti TMPV770x pin mux/config controller

maintainers:
  - Nobuhiro Iwamatsu <nobuhiro1.iwamatsu@toshiba.co.jp>

description:
  Toshiba's Visconti ARM SoC a pin mux/config controller.

properties:
  compatible:
    enum:
      - toshiba,tmpv7708-pinctrl

  reg:
    maxItems: 1

allOf:
  - $ref: pinctrl.yaml#

required:
  - compatible
  - reg

patternProperties:
  '-pins$':
    type: object
    description: |
      A pinctrl node should contain at least one subnodes representing the
      pinctrl groups available on the machine. Each subnode will list the
      pins it needs, and how they should be configured, with regard to muxer
      configuration, pullups, drive strength.
    $ref: pinmux-node.yaml
    additionalProperties: false

    properties:
      function:
        description:
          Function to mux.
        $ref: /schemas/types.yaml#/definitions/string
        enum: [i2c0, i2c1, i2c2, i2c3, i2c4, i2c5, i2c6, i2c7, i2c8,
               spi0, spi1, spi2, spi3, spi4, spi5, spi6,
               uart0, uart1, uart2, uart3, pwm, pcmif_out, pcmif_in]

      groups:
        description:
          Name of the pin group to use for the functions.
        items:
          enum: [i2c0_grp, i2c1_grp, i2c2_grp, i2c3_grp, i2c4_grp,
                 i2c5_grp, i2c6_grp, i2c7_grp, i2c8_grp,
                 spi0_grp, spi0_cs0_grp, spi0_cs1_grp, spi0_cs2_grp,
                 spi1_grp, spi2_grp, spi3_grp, spi4_grp, spi5_grp, spi6_grp,
                 uart0_grp, uart1_grp, uart2_grp, uart3_grp,
                 pwm0_gpio4_grp, pwm0_gpio8_grp, pwm0_gpio12_grp,
                 pwm0_gpio16_grp, pwm1_gpio5_grp, pwm1_gpio9_grp,
                 pwm1_gpio13_grp, pwm1_gpio17_grp, pwm2_gpio6_grp,
                 pwm2_gpio10_grp, pwm2_gpio14_grp, pwm2_gpio18_grp,
                 pwm3_gpio7_grp, pwm3_gpio11_grp, pwm3_gpio15_grp,
                 pwm3_gpio19_grp, pcmif_out_grp, pcmif_in_grp]
        minItems: 1
        maxItems: 8

      drive-strength:
        enum: [2, 4, 6, 8, 16, 24, 32]
        default: 2
        description:
          Selects the drive strength for the specified pins, in mA.

      bias-pull-up: true

      bias-pull-down: true

      bias-disable: true

additionalProperties: false

examples:
  # Pinmux controller node
  - |
    soc {
        #address-cells = <2>;
        #size-cells = <2>;

        pmux: pinmux@24190000 {
            compatible = "toshiba,tmpv7708-pinctrl";
            reg = <0 0x24190000 0 0x10000>;

            spi0_pins: spi0-pins {
                function = "spi0";
                groups = "spi0_grp";
            };
        };
    };
```

## Documentation/devicetree/bindings/pinctrl/ultrarisc,dp1000-pinctrl.yaml
```yaml
# SPDX-License-Identifier: (GPL-2.0-only OR BSD-2-Clause)
%YAML 1.2
---
$id: http://devicetree.org/schemas/pinctrl/ultrarisc,dp1000-pinctrl.yaml#
$schema: http://devicetree.org/meta-schemas/core.yaml#

title: UltraRISC DP1000 Pin Controller

maintainers:
  - Jia Wang <wangjia@ultrarisc.com>

description: |
  UltraRISC RISC-V SoC DP1000 pin controller.
  The controller manages ports A, B, C, D and LPC. Ports A-D default to
  GPIO and provide additional SPI, UART, I2C, and PWM mux functions.
  LPC pins default to the LPC interface and can be muxed to eSPI.
  All pins also support pin configuration, including drive strength,
  pull-up, and pull-down settings.

properties:
  compatible:
    const: ultrarisc,dp1000-pinctrl

  reg:
    items:
      - description: pin controller registers

required:
  - compatible
  - reg

patternProperties:
  '.*-pins$':
    type: object
    unevaluatedProperties: false
    allOf:
      - $ref: /schemas/pinctrl/pincfg-node.yaml#
      - $ref: /schemas/pinctrl/pinmux-node.yaml#
      - if:
          properties:
            pins:
              items:
                minimum: 40
                maximum: 52
        then:
          properties:
            function:
              enum:
                - lpc
                - espi
        else:
          properties:
            pins:
              items:
                maximum: 39
            function:
              enum:
                - gpio
                - i2c
                - pwm
                - spi
                - uart

    properties:
      pins:
        description: |
          List of pins affected by this state node, using numeric pin IDs.
          Pins 0-39 correspond to ports A-D, and pins 40-52 correspond
          to LPC0-LPC12.
        $ref: /schemas/types.yaml#/definitions/uint32-array
        minItems: 1
        uniqueItems: true
        items:
          minimum: 0
          maximum: 52

      function:
        description: |
          Mux function to select for the listed pins. Supported functions
          depend on the selected pins and match the DP1000 hardware mux
          table.
        enum:
          - gpio
          - i2c
          - pwm
          - spi
          - uart
          - lpc
          - espi

      bias-disable: true
      bias-high-impedance: true
      bias-pull-up: true
      bias-pull-down: true

      drive-strength:
        description: Output drive strength in mA.
        enum: [20, 27, 33, 40]

    required:
      - pins
      - function

unevaluatedProperties: false

examples:
  - |
    soc {
      #address-cells = <2>;
      #size-cells = <2>;

      pinctrl@11081000 {
        compatible = "ultrarisc,dp1000-pinctrl";
        reg = <0x0 0x11081000 0x0 0x1000>;

        i2c0-pins {
          pins = <12 13>;
          function = "i2c";
          bias-pull-up;
          drive-strength = <33>;
        };

        uart0-pins {
          pins = <8 9>;
          function = "uart";
          bias-pull-up;
          drive-strength = <33>;
        };
      };
    };
```
