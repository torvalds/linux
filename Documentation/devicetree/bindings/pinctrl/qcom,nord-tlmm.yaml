## Documentation/devicetree/bindings/pinctrl/qcom,qcs404-pinctrl.yaml
```yaml
# SPDX-License-Identifier: (GPL-2.0-only OR BSD-2-Clause)
%YAML 1.2
---
$id: http://devicetree.org/schemas/pinctrl/qcom,qcs404-pinctrl.yaml#
$schema: http://devicetree.org/meta-schemas/core.yaml#

title: Qualcomm QCS404 TLMM pin controller

maintainers:
  - Bjorn Andersson <andersson@kernel.org>
  - Krzysztof Kozlowski <krzysztof.kozlowski@linaro.org>

description:
  Top Level Mode Multiplexer pin controller in Qualcomm QCS404 SoC.

properties:
  compatible:
    const: qcom,qcs404-pinctrl

  reg:
    maxItems: 3

  reg-names:
    items:
      - const: south
      - const: north
      - const: east

  interrupts:
    maxItems: 1

  interrupt-controller: true
  "#interrupt-cells": true
  gpio-controller: true
  "#gpio-cells": true
  gpio-ranges: true
  wakeup-parent: true

  gpio-reserved-ranges:
    minItems: 1
    maxItems: 60

  gpio-line-names:
    maxItems: 120

patternProperties:
  "-state$":
    oneOf:
      - $ref: "#/$defs/qcom-qcs404-tlmm-state"
      - patternProperties:
          "-pins$":
            $ref: "#/$defs/qcom-qcs404-tlmm-state"
        additionalProperties: false

$defs:
  qcom-qcs404-tlmm-state:
    type: object
    description:
      Pinctrl node's client devices use subnodes for desired pin configuration.
      Client device subnodes use below standard properties.
    $ref: qcom,tlmm-common.yaml#/$defs/qcom-tlmm-state
    unevaluatedProperties: false

    properties:
      pins:
        description:
          List of gpio pins affected by the properties specified in this
          subnode.
        items:
          oneOf:
            - pattern: "^gpio([0-9]|[1-9][0-9]|1[0-1][0-9])$"
            - enum: [ sdc1_clk, sdc1_cmd, sdc1_data, sdc1_rclk, sdc2_clk,
                      sdc2_cmd, sdc2_data, ufs_reset ]
        minItems: 1
        maxItems: 36

      function:
        description:
          Specify the alternative function to be configured for the specified
          pins.

        enum: [ gpio, adsp_ext, atest_char, atest_char0, atest_char1,
                atest_char2, atest_char3, aud_cdc, audio_ts, bimc_dte0,
                bimc_dte1, blsp_i2c0, blsp_i2c1, blsp_i2c3, blsp_i2c4,
                blsp_i2c5, blsp_i2c_scl_a2, blsp_i2c_scl_b2, blsp_i2c_sda_a2,
                blsp_i2c_sda_b2, blsp_spi0, blsp_spi2, blsp_spi3, blsp_spi4,
                blsp_spi5, blsp_spi_clk_a1, blsp_spi_clk_b1, blsp_spi_cs_n_a1,
                blsp_spi_cs_n_b1, blsp_spi_miso_a1, blsp_spi_miso_b1,
                blsp_spi_mosi_a1, blsp_spi_mosi_b1, blsp_uart0, blsp_uart1,
                blsp_uart2, blsp_uart3, blsp_uart5, blsp_uart_rx_a2,
                blsp_uart_rx_b2, blsp_uart_tx_a2, blsp_uart_tx_b2, cri_trng,
                cri_trng0, cri_trng1, dbg_out, dsd_clk_a, dsd_clk_b, ebi2_a,
                ebi2_lcd, ebi_cdc, ebi_ch0, ext_lpass, ext_mclk0, ext_mclk1_a,
                ext_mclk1_b, gcc_gp1_clk_a, gcc_gp1_clk_b, gcc_gp2_clk_a,
                gcc_gp2_clk_b, gcc_gp3_clk_a, gcc_gp3_clk_b, gcc_plltest,
                gcc_tlmm, hdmi_ddc, hdmi_dtest, hdmi_lbk0, hdmi_lbk1,
                hdmi_lbk2, hdmi_lbk3, hdmi_lbk4, hdmi_lbk5, hdmi_lbk6,
                hdmi_lbk7, hdmi_lbk8, hdmi_lbk9, hdmi_pixel, hdmi_rcv, hdmi_tx,
                i2s_1, i2s_2, i2s_3_data0_a, i2s_3_data0_b, i2s_3_data1_a,
                i2s_3_data1_b, i2s_3_data2_a, i2s_3_data2_b, i2s_3_data3_a,
                i2s_3_data3_b, i2s_3_sck_a, i2s_3_sck_b, i2s_3_ws_a,
                i2s_3_ws_b, i2s_4, ir_in, ldo_en, ldo_update, mclk_in1,
                mclk_in2, m_voc, nfc_dwl, nfc_irq, pcie_clk, pll_bist,
                prng_rosc, pwm_led1, pwm_led10, pwm_led11, pwm_led12,
                pwm_led13, pwm_led14, pwm_led15, pwm_led16, pwm_led17,
                pwm_led18, pwm_led19, pwm_led2, pwm_led20, pwm_led21,
                pwm_led22, pwm_led23, pwm_led24, pwm_led3, pwm_led4, pwm_led5,
                pwm_led6, pwm_led7, pwm_led8, pwm_led9, qdss_cti_trig_in_a0,
                qdss_cti_trig_in_a1, qdss_cti_trig_in_b0, qdss_cti_trig_in_b1,
                qdss_cti_trig_out_a0, qdss_cti_trig_out_a1,
                qdss_cti_trig_out_b0, qdss_cti_trig_out_b1, qdss_traceclk_a,
                qdss_traceclk_b, qdss_tracectl_a, qdss_tracectl_b,
                qdss_tracedata_a, qdss_tracedata_b, rgb_clk, rgb_data0,
                rgb_data1, rgb_data2, rgb_data3, rgb_data4, rgb_data5,
                rgb_data6, rgb_data7, rgb_data_b0, rgb_data_b1, rgb_data_b2,
                rgb_data_b3, rgb_data_b4, rgb_data_b5, rgb_data_b6,
                rgb_data_b7, rgb_de, rgb_hsync, rgb_mdp, rgb_vsync, rgmi_dll1,
                rgmi_dll2, rgmii_ck, rgmii_ctl, rgmii_int, rgmii_mdc,
                rgmii_mdio, rgmii_rx, rgmii_tx, rgmii_wol, sd_write,
                spdifrx_opt, spi_lcd, spkr_dac0, wlan1_adc0, wlan1_adc1,
                wlan2_adc0, wlan2_adc1, wsa_en ]

    required:
      - pins

allOf:
  - $ref: /schemas/pinctrl/qcom,tlmm-common.yaml#

required:
  - compatible
  - reg

additionalProperties: false

examples:
  - |
    #include <dt-bindings/interrupt-controller/arm-gic.h>

    tlmm: pinctrl@1000000 {
        compatible = "qcom,qcs404-pinctrl";
        reg = <0x01000000 0x200000>,
              <0x01300000 0x200000>,
              <0x07b00000 0x200000>;
        reg-names = "south", "north", "east";
        interrupts = <GIC_SPI 208 IRQ_TYPE_LEVEL_HIGH>;
        gpio-ranges = <&tlmm 0 0 120>;
        gpio-controller;
        #gpio-cells = <2>;
        interrupt-controller;
        #interrupt-cells = <2>;


        blsp1-i2c1-default-state {
            pins = "gpio24", "gpio25";
            function = "blsp_i2c1";
        };

        blsp1-i2c2-default-state {
            sda-pins {
                pins = "gpio19";
                function = "blsp_i2c_sda_a2";
            };

            scl-pins {
                pins = "gpio20";
                function = "blsp_i2c_scl_a2";
            };
        };
    };
```

## Documentation/devicetree/bindings/pinctrl/qcom,qcs615-tlmm.yaml
```yaml
# SPDX-License-Identifier: (GPL-2.0-only OR BSD-2-Clause)
%YAML 1.2
---
$id: http://devicetree.org/schemas/pinctrl/qcom,qcs615-tlmm.yaml#
$schema: http://devicetree.org/meta-schemas/core.yaml#

title: Qualcomm Technologies, Inc. QCS615 TLMM block

maintainers:
  - Lijuan Gao <quic_lijuang@quicinc.com>

description:
  Top Level Mode Multiplexer pin controller in Qualcomm QCS615 SoC.

allOf:
  - $ref: /schemas/pinctrl/qcom,tlmm-common.yaml#

properties:
  compatible:
    const: qcom,qcs615-tlmm

  reg:
    maxItems: 3

  reg-names:
    items:
      - const: east
      - const: west
      - const: south

  interrupts:
    maxItems: 1

  gpio-reserved-ranges:
    minItems: 1
    maxItems: 62

  gpio-line-names:
    maxItems: 123

patternProperties:
  "-state$":
    oneOf:
      - $ref: "#/$defs/qcom-qcs615-tlmm-state"
      - type: object
        patternProperties:
          "-pins$":
            $ref: "#/$defs/qcom-qcs615-tlmm-state"
        additionalProperties: false

$defs:
  qcom-qcs615-tlmm-state:
    type: object
    description:
      Pinctrl node's client devices use subnodes for desired pin configuration.
      Client device subnodes use below standard properties.
    $ref: qcom,tlmm-common.yaml#/$defs/qcom-tlmm-state
    unevaluatedProperties: false

    properties:
      pins:
        description:
          List of gpio pins affected by the properties specified in this
          subnode.
        items:
          oneOf:
            - pattern: "^gpio([0-9]|[1-9][0-9]|1[0-1][0-9]|12[0-2])$"
            - enum: [ sdc1_clk, sdc1_cmd, sdc1_data, sdc1_rclk,
                      sdc2_clk, sdc2_cmd, sdc2_data, ufs_reset ]
        minItems: 1
        maxItems: 36

      function:
        description:
          Specify the alternative function to be configured for the specified
          pins.
        enum: [ gpio, adsp_ext, agera_pll, aoss_cti, atest_char, atest_tsens,
                atest_usb, cam_mclk, cci_async, cci_i2c, cci_timer, copy_gp,
                copy_phase, cri_trng, dbg_out_clk, ddr_bist, ddr_pxi, dp_hot,
                edp_hot, edp_lcd, emac_gcc, emac_phy_intr, forced_usb, gcc_gp,
                gp_pdm, gps_tx, hs0_mi2s, hs1_mi2s, jitter_bist, ldo_en,
                ldo_update, m_voc, mclk1, mclk2, mdp_vsync, mdp_vsync0_out,
                mdp_vsync1_out, mdp_vsync2_out, mdp_vsync3_out, mdp_vsync4_out,
                mdp_vsync5_out, mi2s_1, mss_lte, nav_pps_in, nav_pps_out,
                pa_indicator_or, pcie_clk_req, pcie_ep_rst, phase_flag, pll_bist,
                pll_bypassnl, pll_reset_n, prng_rosc, qdss_cti, qdss_gpio,
                qlink_enable, qlink_request, qspi, qup0, qup1, rgmii,
                sd_write_protect, sp_cmu, ter_mi2s, tgu_ch, uim1, uim2, usb0_hs,
                usb1_hs, usb_phy_ps, vfr_1, vsense_trigger_mirnat, wlan, wsa_clk,
                wsa_data ]

    required:
      - pins

required:
  - compatible
  - reg
  - reg-names

unevaluatedProperties: false

examples:
  - |
    #include <dt-bindings/interrupt-controller/arm-gic.h>

    tlmm: pinctrl@3000000 {
        compatible = "qcom,qcs615-tlmm";
        reg = <0x03100000 0x300000>,
              <0x03500000 0x300000>,
              <0x03c00000 0x300000>;
        reg-names = "east", "west", "south";
        interrupts = <GIC_SPI 208 IRQ_TYPE_LEVEL_HIGH>;
        gpio-ranges = <&tlmm 0 0 123>;
        gpio-controller;
        #gpio-cells = <2>;
        interrupt-controller;
        #interrupt-cells = <2>;

        qup3-uart2-state {
            pins ="gpio16", "gpio17";
            function = "qup0";
        };
    };
...
```

## Documentation/devicetree/bindings/pinctrl/qcom,qcs8300-tlmm.yaml
```yaml
# SPDX-License-Identifier: (GPL-2.0-only OR BSD-2-Clause)
%YAML 1.2
---
$id: http://devicetree.org/schemas/pinctrl/qcom,qcs8300-tlmm.yaml#
$schema: http://devicetree.org/meta-schemas/core.yaml#

title: Qualcomm Technologies, Inc. QCS8300 TLMM block

maintainers:
  - Jingyi Wang <quic_jingyw@quicinc.com>

description: |
  Top Level Mode Multiplexer pin controller in Qualcomm QCS8300 SoC.

allOf:
  - $ref: /schemas/pinctrl/qcom,tlmm-common.yaml#

properties:
  compatible:
    const: qcom,qcs8300-tlmm

  reg:
    maxItems: 1

  interrupts:
    maxItems: 1

  gpio-reserved-ranges:
    minItems: 1
    maxItems: 67

  gpio-line-names:
    maxItems: 133

patternProperties:
  "-state$":
    oneOf:
      - $ref: "#/$defs/qcom-qcs8300-tlmm-state"
      - patternProperties:
          "-pins$":
            $ref: "#/$defs/qcom-qcs8300-tlmm-state"
        additionalProperties: false

$defs:
  qcom-qcs8300-tlmm-state:
    type: object
    description:
      Pinctrl node's client devices use subnodes for desired pin configuration.
      Client device subnodes use below standard properties.
    $ref: qcom,tlmm-common.yaml#/$defs/qcom-tlmm-state
    unevaluatedProperties: false

    properties:
      pins:
        description:
          List of gpio pins affected by the properties specified in this
          subnode.
        items:
          oneOf:
            - pattern: "^gpio([0-9]|[1-9][0-9]|1[0-2][0-9]|13[0-2])$"
            - enum: [ ufs_reset, sdc1_rclk, sdc1_clk, sdc1_cmd, sdc1_data ]
        minItems: 1
        maxItems: 36

      function:
        description:
          Specify the alternative function to be configured for the specified
          pins.

        enum: [ aoss_cti, atest_char, atest_usb2, audio_ref, cam_mclk,
                cci_async, cci_i2c_scl, cci_i2c_sda, cci_timer, cri_trng,
                dbg_out, ddr_bist, ddr_pxi0, ddr_pxi1, ddr_pxi2, ddr_pxi3,
                edp0_hot, edp0_lcd, edp1_lcd, egpio, emac0_mcg0, emac0_mcg1,
                emac0_mcg2, emac0_mcg3, emac0_mdc, emac0_mdio, emac0_ptp_aux,
                emac0_ptp_pps, gcc_gp1, gcc_gp2, gcc_gp3, gcc_gp4, gcc_gp5,
                gpio, hs0_mi2s, hs1_mi2s, hs2_mi2s, ibi_i3c, jitter_bist,
                mdp0_vsync0, mdp0_vsync1, mdp0_vsync3, mdp0_vsync6, mdp0_vsync7,
                mdp_vsync, mi2s1_data0, mi2s1_data1, mi2s1_sck, mi2s1_ws,
                mi2s2_data0, mi2s2_data1, mi2s2_sck, mi2s2_ws, mi2s_mclk0,
                mi2s_mclk1, pcie0_clkreq, pcie1_clkreq, phase_flag, pll_bist,
                pll_clk, prng_rosc0, prng_rosc1, prng_rosc2, prng_rosc3,
                qdss_cti, qdss_gpio, qup0_se0, qup0_se1, qup0_se2, qup0_se3,
                qup0_se4, qup0_se5, qup0_se6, qup0_se7, qup1_se0, qup1_se1,
                qup1_se2, qup1_se3, qup1_se4, qup1_se5, qup1_se6, qup1_se7,
                qup2_se0, sailss_emac0, sailss_ospi, sail_top, sgmii_phy,
                tb_trig, tgu_ch0, tgu_ch1, tgu_ch2, tgu_ch3, tsense_pwm1,
                tsense_pwm2, tsense_pwm3, tsense_pwm4, usb2phy_ac,
                vsense_trigger ]

    required:
      - pins

required:
  - compatible
  - reg

unevaluatedProperties: false

examples:
  - |
    #include <dt-bindings/interrupt-controller/arm-gic.h>

    tlmm: pinctrl@f100000 {
        compatible = "qcom,qcs8300-tlmm";
        reg = <0x0f100000 0x300000>;
        interrupts = <GIC_SPI 208 IRQ_TYPE_LEVEL_HIGH>;
        gpio-controller;
        #gpio-cells = <2>;
        gpio-ranges = <&tlmm 0 0 134>;
        interrupt-controller;
        #interrupt-cells = <2>;

        qup-uart7-state {
            pins = "gpio43", "gpio44";
            function = "qup0_se7";
        };
    };
...
```
