## Documentation/devicetree/bindings/pinctrl/qcom,glymur-tlmm.yaml
```yaml
# SPDX-License-Identifier: (GPL-2.0-only OR BSD-2-Clause)
%YAML 1.2
---
$id: http://devicetree.org/schemas/pinctrl/qcom,glymur-tlmm.yaml#
$schema: http://devicetree.org/meta-schemas/core.yaml#

title: Qualcomm Technologies, Inc. Glymur TLMM block

maintainers:
  - Bjorn Andersson <bjorn.andersson@oss.qualcomm.com>

description:
  Top Level Mode Multiplexer pin controller in Qualcomm Glymur SoC.

allOf:
  - $ref: /schemas/pinctrl/qcom,tlmm-common.yaml#

properties:
  compatible:
    const: qcom,glymur-tlmm

  reg:
    maxItems: 1

  interrupts:
    maxItems: 1

  gpio-reserved-ranges:
    minItems: 1
    maxItems: 125

  gpio-line-names:
    maxItems: 250

patternProperties:
  "-state$":
    oneOf:
      - $ref: "#/$defs/qcom-glymur-tlmm-state"
      - patternProperties:
          "-pins$":
            $ref: "#/$defs/qcom-glymur-tlmm-state"
        additionalProperties: false

$defs:
  qcom-glymur-tlmm-state:
    type: object
    description:
      Pinctrl node's client devices use subnodes for desired pin configuration.
      Client device subnodes use below standard properties.
    $ref: qcom,tlmm-common.yaml#/$defs/qcom-tlmm-state
    unevaluatedProperties: false

    properties:
      pins:
        description:
          List of gpio pins affected by the properties specified in this
          subnode.
        items:
          oneOf:
            - pattern: "^gpio([0-9]|[1-9][0-9]|1[0-9][0-9]|2[0-4][0-9])$"
            - enum: [ ufs_reset, sdc2_clk, sdc2_cmd, sdc2_data ]
        minItems: 1
        maxItems: 36

      function:
        description:
          Specify the alternative function to be configured for the specified
          pins.
        enum: [ gpio, resout_gpio_n, aoss_cti, asc_cci, atest_char, atest_usb,
                audio_ext_mclk0, audio_ext_mclk1, audio_ref_clk, cam_asc_mclk4,
                cam_mclk, cci_async_in, cci_i2c_scl, cci_i2c_sda, cci_timer,
                cmu_rng, cri_trng, dbg_out_clk, ddr_bist_complete,
                ddr_bist_fail, ddr_bist_start, ddr_bist_stop, ddr_pxi,
                edp0_hot, edp0_lcd, edp1_lcd, egpio, eusb0_ac_en, eusb1_ac_en,
                eusb2_ac_en, eusb3_ac_en, eusb5_ac_en, eusb6_ac_en, gcc_gp1,
                gcc_gp2, gcc_gp3, host2wlan_sol, i2c0_s_scl, i2c0_s_sda,
                i2s0_data, i2s0_sck, i2s0_ws, i2s1_data, i2s1_sck, i2s1_ws,
                ibi_i3c, jitter_bist, mdp_vsync_out, mdp_vsync_e, mdp_vsync_p,
                mdp_vsync_s, pcie3a_clk, pcie3a_rst_n, pcie3b_clk,
                pcie4_clk_req_n, pcie5_clk_req_n, pcie6_clk_req_n, phase_flag,
                pll_bist_sync, pll_clk_aux, pmc_oca_n, pmc_uva_n, prng_rosc,
                qdss_cti, qdss_gpio, qspi, qup0_se0, qup0_se1, qup0_se2,
                qup0_se3_l0, qup0_se3, qup0_se4, qup0_se5, qup0_se6, qup0_se7,
                qup1_se0, qup1_se1, qup1_se2, qup1_se3, qup1_se4, qup1_se5,
                qup1_se6, qup1_se7, qup2_se0, qup2_se1, qup2_se2, qup2_se3,
                qup2_se4, qup2_se5, qup2_se6, qup2_se7, qup3_se0, qup3_se1,
                sd_write_protect, sdc4_clk, sdc4_cmd, sdc4_data, smb_acok_n,
                sys_throttle, tb_trig_sdc2, tb_trig_sdc4, tmess_prng,
                tsense_pwm, tsense_therm, usb0_dp, usb0_phy_ps, usb0_sbrx,
                usb0_sbtx, usb0_tmu, usb1_dbg, usb1_dp, usb1_phy_ps, usb1_sbrx,
                usb1_sbtx, usb1_tmu, usb2_dp, usb2_phy_ps, usb2_sbrx, usb2_sbtx,
                usb2_tmu, vsense_trigger_mirnat, wcn_sw, wcn_sw_ctrl ]

    required:
      - pins

required:
  - compatible
  - reg

unevaluatedProperties: false

examples:
  - |
    #include <dt-bindings/interrupt-controller/arm-gic.h>
    tlmm: pinctrl@f100000 {
        compatible = "qcom,glymur-tlmm";
        reg = <0x0f100000 0xf00000>;
        interrupts = <GIC_SPI 208 IRQ_TYPE_LEVEL_HIGH>;
        gpio-controller;
        #gpio-cells = <2>;
        interrupt-controller;
        #interrupt-cells = <2>;
        gpio-ranges = <&tlmm 0 0 249>;
        wakeup-parent = <&pdc>;
        gpio-reserved-ranges = <4 4>, <10 2>, <33 3>, <44 4>;
        qup_uart21_default: qup-uart21-default-state {
            tx-pins {
                pins = "gpio86";
                function = "qup2_se5";
                drive-strength = <2>;
                bias-disable;
            };

            rx-pins {
                pins = "gpio87";
                function = "qup2_se5";
                drive-strength = <2>;
                bias-disable;
            };
        };
    };
...
```

## Documentation/devicetree/bindings/pinctrl/qcom,hawi-tlmm.yaml
```yaml
# SPDX-License-Identifier: (GPL-2.0-only OR BSD-2-Clause)
%YAML 1.2
---
$id: http://devicetree.org/schemas/pinctrl/qcom,hawi-tlmm.yaml#
$schema: http://devicetree.org/meta-schemas/core.yaml#

title: Qualcomm Technologies, Inc. Hawi TLMM block

maintainers:
  - Mukesh Ojha <mukesh.ojha@oss.qualcomm.com>

description:
  Top Level Mode Multiplexer pin controller in Qualcomm Hawi SoC.

allOf:
  - $ref: /schemas/pinctrl/qcom,tlmm-common.yaml#

properties:
  compatible:
    const: qcom,hawi-tlmm

  reg:
    maxItems: 1

  interrupts:
    maxItems: 1

  gpio-reserved-ranges:
    minItems: 1
    maxItems: 113

  gpio-line-names:
    maxItems: 226

patternProperties:
  "-state$":
    oneOf:
      - $ref: "#/$defs/qcom-hawi-tlmm-state"
      - patternProperties:
          "-pins$":
            $ref: "#/$defs/qcom-hawi-tlmm-state"
        additionalProperties: false

$defs:
  qcom-hawi-tlmm-state:
    type: object
    description:
      Pinctrl node's client devices use subnodes for desired pin configuration.
      Client device subnodes use below standard properties.
    $ref: qcom,tlmm-common.yaml#/$defs/qcom-tlmm-state
    unevaluatedProperties: false

    properties:
      pins:
        description:
          List of gpio pins affected by the properties specified in this
          subnode.
        items:
          oneOf:
            - pattern: "^gpio([0-9]|[1-9][0-9]|1[0-9][0-9]|20[0-9]|21[0-9]|22[0-5])$"
            - enum: [ ufs_reset, sdc2_clk, sdc2_cmd, sdc2_data ]
        minItems: 1
        maxItems: 36

      function:
        description:
          Specify the alternative function to be configured for the specified
          pins.
        enum: [ gpio, aoss_cti, atest_char, atest_usb, audio_ext_mclk,
                audio_ref_clk, cam_mclk, cci_async_in, cci_i2c0, cci_i2c1,
                cci_i2c2, cci_i2c3, cci_i2c4, cci_i2c5, cci_timer, coex_espmi,
                coex_uart1_rx, coex_uart1_tx, dbg_out_clk, ddr_bist, ddr_pxi,
                dp_hot, egpio, gcc_gp, gnss_adc, host_rst, i2chub0_se0,
                i2chub0_se1, i2chub0_se2, i2chub0_se3, i2chub0_se4, i2s0, i2s1,
                ibi_i3c, jitter_bist, mdp_esync0, mdp_esync1, mdp_esync2,
                mdp_vsync, mdp_vsync_e, mdp_vsync_p, mdp_vsync0_out,
                mdp_vsync1_out, mdp_vsync2_out, mdp_vsync3_out, mdp_vsync5_out,
                modem_pps_in, modem_pps_out, nav_gpio, nav_gpio0, nav_gpio3,
                nav_rffe, pcie0_clk_req_n, pcie0_rst_n, pcie1_clk_req_n,
                phase_flag, pll_bist_sync, pll_clk_aux, qdss_cti, qlink,
                qspi, qspi_clk, qspi_cs, qup1_se0, qup1_se1, qup1_se2,
                qup1_se3, qup1_se4, qup1_se5, qup1_se6, qup1_se7, qup2_se0,
                qup2_se1, qup2_se2, qup2_se3, qup2_se4_01, qup2_se4_23,
                qup3_se0_01, qup3_se0_23, qup3_se1, qup3_se2, qup3_se3,
                qup3_se4, qup3_se5, qup4_se0, qup4_se1, qup4_se2, qup4_se3_01,
                qup4_se3_23, qup4_se3_l3, qup4_se4_01, qup4_se4_23, qup4_se4_l3,
                rng_rosc, sd_write_protect, sdc4_clk, sdc4_cmd, sdc4_data,
                sys_throttle, tb_trig_sdc, tmess_rng, tsense_clm, tsense_pwm,
                uim0, uim1, usb0_hs, usb_phy, vfr, vsense_trigger_mirnat,
                wcn_sw_ctrl ]

    required:
      - pins

required:
  - compatible
  - reg

unevaluatedProperties: false

examples:
  - |
    #include <dt-bindings/interrupt-controller/arm-gic.h>

    tlmm: pinctrl@f100000 {
        compatible = "qcom,hawi-tlmm";
        reg = <0x0f100000 0x300000>;
        interrupts = <GIC_ESPI 272 IRQ_TYPE_LEVEL_HIGH>;
        gpio-controller;
        #gpio-cells = <2>;
        gpio-ranges = <&tlmm 0 0 227>;
        interrupt-controller;
        #interrupt-cells = <2>;

        qup-uart7-state {
          pins = "gpio62", "gpio63";
          function = "qup1_se7";
        };
    };
...
```

## Documentation/devicetree/bindings/pinctrl/qcom,ipq4019-pinctrl.txt
```
Qualcomm Atheros IPQ4019 TLMM block

This is the Top Level Mode Multiplexor block found on the Qualcomm IPQ8019
platform, it provides pinctrl, pinmux, pinconf, and gpiolib facilities.

Required properties:
- compatible: "qcom,ipq4019-pinctrl"
- reg: Should be the base address and length of the TLMM block.
- interrupts: Should be the parent IRQ of the TLMM block.
- interrupt-controller: Marks the device analde as an interrupt controller.
- #interrupt-cells: Should be two.
- gpio-controller: Marks the device analde as a GPIO controller.
- #gpio-cells : Should be two.
                The first cell is the gpio pin number and the
                second cell is used for optional parameters.
- gpio-ranges: see ../gpio/gpio.txt

Optional properties:

- gpio-reserved-ranges: see ../gpio/gpio.txt

Please refer to ../gpio/gpio.txt and ../interrupt-controller/interrupts.txt for
a general description of GPIO and interrupt bindings.

Please refer to pinctrl-bindings.txt in this directory for details of the
common pinctrl bindings used by client devices, including the meaning of the
phrase "pin configuration analde".

The pin configuration analdes act as a container for an arbitrary number of
subanaldes. Each of these subanaldes represents some desired configuration for a
pin, a group, or a list of pins or groups. This configuration can include the
mux function to select on those pin(s)/group(s), and various pin configuration
parameters, such as pull-up, drive strength, etc.

The name of each subanalde is analt important; all subanaldes should be enumerated
and processed purely based on their content.

Each subanalde only affects those parameters that are explicitly listed. In
other words, a subanalde that lists a mux function but anal pin configuration
parameters implies anal information about any pin configuration parameters.
Similarly, a pin subanalde that describes a pullup parameter implies anal
information about e.g. the mux function.


The following generic properties as defined in pinctrl-bindings.txt are valid
to specify in a pin configuration subanalde:
 pins, function, bias-disable, bias-pull-down, bias-pull-up, drive-open-drain,
 drive-strength.

Analn-empty subanaldes must specify the 'pins' property.
Analte that analt all properties are valid for all pins.


Valid values for qcom,pins are:
  gpio0-gpio99
    Supports mux, bias and drive-strength

Valid values for qcom,function are:
aud_pin, audio_pwm, blsp_i2c0, blsp_i2c1, blsp_spi0, blsp_spi1, blsp_uart0,
blsp_uart1, chip_rst, gpio, i2s_rx, i2s_spdif_in, i2s_spdif_out, i2s_td, i2s_tx,
jtag, led0, led1, led2, led3, led4, led5, led6, led7, led8, led9, led10, led11,
mdc, mdio, pcie, pmu, prng_rosc, qpic, rgmii, rmii, sdio, smart0, smart1,
smart2, smart3, tm, wifi0, wifi1

Example:

	tlmm: pinctrl@1000000 {
		compatible = "qcom,ipq4019-pinctrl";
		reg = <0x1000000 0x300000>;

		gpio-controller;
		#gpio-cells = <2>;
		gpio-ranges = <&tlmm 0 0 100>;
		interrupt-controller;
		#interrupt-cells = <2>;
		interrupts = <0 208 0>;

		serial_pins: serial_pinmux {
			mux {
				pins = "gpio60", "gpio61";
				function = "blsp_uart0";
				bias-disable;
			};
		};
	};
```

## Documentation/devicetree/bindings/pinctrl/qcom,ipq4019-pinctrl.yaml
```yaml
# SPDX-License-Identifier: (GPL-2.0-only OR BSD-2-Clause)
%YAML 1.2
---
$id: http://devicetree.org/schemas/pinctrl/qcom,ipq4019-pinctrl.yaml#
$schema: http://devicetree.org/meta-schemas/core.yaml#

title: Qualcomm Technologies, Inc. IPQ4019 TLMM block

maintainers:
  - Bjorn Andersson <bjorn.andersson@linaro.org>

description: |
  Top Level Mode Multiplexer pin controller in Qualcomm IPQ4019 SoC.

allOf:
  - $ref: /schemas/pinctrl/qcom,tlmm-common.yaml#

properties:
  compatible:
    const: qcom,ipq4019-pinctrl

  reg:
    maxItems: 1

  interrupts:
    maxItems: 1

  gpio-reserved-ranges: true

patternProperties:
  "-state$":
    oneOf:
      - $ref: "#/$defs/qcom-ipq4019-tlmm-state"
      - patternProperties:
          "-pins$":
            $ref: "#/$defs/qcom-ipq4019-tlmm-state"
        additionalProperties: false

  "-hog(-[0-9]+)?$":
    type: object
    required:
      - gpio-hog

$defs:
  qcom-ipq4019-tlmm-state:
    type: object
    description:
      Pinctrl node's client devices use subnodes for desired pin configuration.
      Client device subnodes use below standard properties.
    $ref: qcom,tlmm-common.yaml#/$defs/qcom-tlmm-state
    unevaluatedProperties: false

    properties:
      pins:
        description:
          List of gpio pins affected by the properties specified in this
          subnode.
        items:
          pattern: "^gpio([0-9]|[1-9][0-9])$"
        minItems: 1
        maxItems: 36

      function:
        description:
          Specify the alternative function to be configured for the specified
          pins.
        enum: [ aud_pin, audio_pwm, blsp_i2c0, blsp_i2c1, blsp_spi0,
                blsp_spi1, blsp_uart0, blsp_uart1, chip_rst, gpio,
                i2s_rx, i2s_spdif_in, i2s_spdif_out, i2s_td, i2s_tx,
                jtag, led0, led1, led2, led3, led4, led5, led6, led7,
                led8, led9, led10, led11, mdc, mdio, pcie, pmu,
                prng_rosc, qpic, rgmii, rmii, sdio, smart0, smart1,
                smart2, smart3, tm, wifi0, wifi1 ]

    required:
      - pins

required:
  - compatible
  - reg

unevaluatedProperties: false

examples:
  - |
    #include <dt-bindings/interrupt-controller/arm-gic.h>
    tlmm: pinctrl@1000000 {
        compatible = "qcom,ipq4019-pinctrl";
        reg = <0x01000000 0x300000>;

        gpio-controller;
        #gpio-cells = <2>;
        gpio-ranges = <&tlmm 0 0 100>;
        interrupt-controller;
        #interrupt-cells = <2>;
        interrupts = <GIC_SPI 208 IRQ_TYPE_LEVEL_HIGH>;

        uart-state {
            pins = "gpio16", "gpio17";
            function = "blsp_uart0";
            bias-disable;
        };
    };
```
