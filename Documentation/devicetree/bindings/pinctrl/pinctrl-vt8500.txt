## Documentation/devicetree/bindings/pinctrl/qcom,ipq5018-tlmm.yaml
```yaml
# SPDX-License-Identifier: (GPL-2.0-only OR BSD-2-Clause)
%YAML 1.2
---
$id: http://devicetree.org/schemas/pinctrl/qcom,ipq5018-tlmm.yaml#
$schema: http://devicetree.org/meta-schemas/core.yaml#

title: Qualcomm IPQ5018 TLMM pin controller

maintainers:
  - Bjorn Andersson <andersson@kernel.org>
  - Krzysztof Kozlowski <krzysztof.kozlowski@linaro.org>

description:
  Top Level Mode Multiplexer pin controller in Qualcomm IPQ5018 SoC.

properties:
  compatible:
    const: qcom,ipq5018-tlmm

  reg:
    maxItems: 1

  interrupts:
    maxItems: 1

  interrupt-controller: true
  "#interrupt-cells": true
  gpio-controller: true
  "#gpio-cells": true
  gpio-ranges: true
  wakeup-parent: true

  gpio-reserved-ranges:
    minItems: 1
    maxItems: 24

  gpio-line-names:
    maxItems: 47

patternProperties:
  "-state$":
    oneOf:
      - $ref: "#/$defs/qcom-ipq5018-tlmm-state"
      - patternProperties:
          "-pins$":
            $ref: "#/$defs/qcom-ipq5018-tlmm-state"
        additionalProperties: false

$defs:
  qcom-ipq5018-tlmm-state:
    type: object
    description:
      Pinctrl node's client devices use subnodes for desired pin configuration.
      Client device subnodes use below standard properties.
    $ref: qcom,tlmm-common.yaml#/$defs/qcom-tlmm-state
    unevaluatedProperties: false

    properties:
      pins:
        description:
          List of gpio pins affected by the properties specified in this
          subnode.
        items:
          pattern: "^gpio([0-9]|[1-3][0-9]|4[0-6])$"
        minItems: 1
        maxItems: 8

      function:
        description:
          Specify the alternative function to be configured for the specified
          pins.

        enum: [ atest_char, audio_pdm0, audio_pdm1, audio_rxbclk, audio_rxd,
                audio_rxfsync, audio_rxmclk, audio_txbclk, audio_txd,
                audio_txfsync, audio_txmclk, blsp0_i2c, blsp0_spi, blsp0_uart0,
                blsp0_uart1, blsp1_i2c0, blsp1_i2c1, blsp1_spi0, blsp1_spi1,
                blsp1_uart0, blsp1_uart1, blsp1_uart2, blsp2_i2c0, blsp2_i2c1,
                blsp2_spi, blsp2_spi0, blsp2_spi1, btss, burn0, burn1, cri_trng,
                cri_trng0, cri_trng1, cxc_clk, cxc_data, dbg_out, eud_gpio,
                gcc_plltest, gcc_tlmm, gpio, led0, led2, mac0, mac1, mdc, mdio,
                pcie0_clk, pcie0_wake, pcie1_clk, pcie1_wake, pll_test,
                prng_rosc, pwm0, pwm1, pwm2, pwm3, qdss_cti_trig_in_a0,
                qdss_cti_trig_in_a1, qdss_cti_trig_in_b0, qdss_cti_trig_in_b1,
                qdss_cti_trig_out_a0, qdss_cti_trig_out_a1,
                qdss_cti_trig_out_b0, qdss_cti_trig_out_b1, qdss_traceclk_a,
                qdss_traceclk_b, qdss_tracectl_a, qdss_tracectl_b,
                qdss_tracedata_a, qdss_tracedata_b, qspi_clk, qspi_cs,
                qspi_data, reset_out, sdc1_clk, sdc1_cmd, sdc1_data, wci_txd,
                wci_rxd, wsa_swrm, wsi_clk3, wsi_data3, wsis_reset, xfem ]

    required:
      - pins

required:
  - compatible
  - reg

additionalProperties: false

examples:
  - |
    #include <dt-bindings/interrupt-controller/arm-gic.h>
    tlmm: pinctrl@1000000 {
        compatible = "qcom,ipq5018-tlmm";
        reg = <0x01000000 0x300000>;
        gpio-controller;
        #gpio-cells = <2>;
        gpio-ranges = <&tlmm 0 0 47>;
        interrupt-controller;
        #interrupt-cells = <2>;
        interrupts = <GIC_SPI 208 IRQ_TYPE_LEVEL_HIGH>;

        uart-w-state {
            rx-pins {
                pins = "gpio33";
                function = "blsp1_uart1";
                bias-pull-down;
            };

            tx-pins {
                pins = "gpio34";
                function = "blsp1_uart1";
                bias-pull-down;
            };
        };
    };
...
```

## Documentation/devicetree/bindings/pinctrl/qcom,ipq5210-tlmm.yaml
```yaml
# SPDX-License-Identifier: (GPL-2.0-only OR BSD-2-Clause)
%YAML 1.2
---
$id: http://devicetree.org/schemas/pinctrl/qcom,ipq5210-tlmm.yaml#
$schema: http://devicetree.org/meta-schemas/core.yaml#

title: Qualcomm IPQ5210 TLMM pin controller

maintainers:
  - Bjorn Andersson <andersson@kernel.org>
  - Kathiravan Thirumoorthy <kathiravan.thirumoorthy@oss.qualcomm.com>

description:
  Top Level Mode Multiplexer pin controller in Qualcomm IPQ5210 SoC.

allOf:
  - $ref: /schemas/pinctrl/qcom,tlmm-common.yaml#

properties:
  compatible:
    const: qcom,ipq5210-tlmm

  reg:
    maxItems: 1

  interrupts:
    maxItems: 1

  gpio-reserved-ranges:
    minItems: 1
    maxItems: 27

  gpio-line-names:
    maxItems: 54

patternProperties:
  "-state$":
    oneOf:
      - $ref: "#/$defs/qcom-ipq5210-tlmm-state"
      - patternProperties:
          "-pins$":
            $ref: "#/$defs/qcom-ipq5210-tlmm-state"
        additionalProperties: false

$defs:
  qcom-ipq5210-tlmm-state:
    type: object
    description:
      Pinctrl node's client devices use subnodes for desired pin configuration.
      Client device subnodes use below standard properties.
    $ref: qcom,tlmm-common.yaml#/$defs/qcom-tlmm-state
    unevaluatedProperties: false

    properties:
      pins:
        description:
          List of gpio pins affected by the properties specified in this
          subnode.
        items:
          pattern: "^gpio([0-9]|[1-4][0-9]|5[0-3])$"
        minItems: 1
        maxItems: 36

      function:
        description:
          Specify the alternative function to be configured for the specified
          pins.

        enum: [ atest_char_start, atest_char_status0, atest_char_status1,
                atest_char_status2, atest_char_status3, atest_tic_en, audio_pri,
                audio_pri_mclk_out0, audio_pri_mclk_in0, audio_pri_mclk_out1,
                audio_pri_mclk_in1, audio_pri_mclk_out2, audio_pri_mclk_in2,
                audio_pri_mclk_out3, audio_pri_mclk_in3, audio_sec,
                audio_sec_mclk_out0, audio_sec_mclk_in0, audio_sec_mclk_out1,
                audio_sec_mclk_in1, audio_sec_mclk_out2, audio_sec_mclk_in2,
                audio_sec_mclk_out3, audio_sec_mclk_in3, core_voltage_0,
                cri_trng0, cri_trng1, cri_trng2, cri_trng3, dbg_out_clk, dg_out,
                gcc_plltest_bypassnl, gcc_plltest_resetn, gcc_tlmm, gpio, led0,
                led1, led2, mdc_mst, mdc_slv0, mdc_slv1, mdc_slv2, mdio_mst,
                mdio_slv0, mdio_slv1, mdio_slv2, mux_tod_out, pcie0_clk_req_n,
                pcie0_wake, pcie1_clk_req_n, pcie1_wake, pll_test,
                pon_active_led, pon_mux_sel, pon_rx, pon_rx_los, pon_tx,
                pon_tx_burst, pon_tx_dis, pon_tx_fault, pon_tx_sd, gpn_rx_los,
                gpn_tx_burst, gpn_tx_dis, gpn_tx_fault, gpn_tx_sd, pps, pwm0,
                pwm1, pwm2, pwm3, qdss_cti_trig_in_a0, qdss_cti_trig_in_a1,
                qdss_cti_trig_in_b0, qdss_cti_trig_in_b1, qdss_cti_trig_out_a0,
                qdss_cti_trig_out_a1, qdss_cti_trig_out_b0,
                qdss_cti_trig_out_b1, qdss_traceclk_a, qdss_tracectl_a,
                qdss_tracedata_a, qrng_rosc0, qrng_rosc1, qrng_rosc2,
                qspi_data, qspi_clk, qspi_cs_n, qup_se0, qup_se1, qup_se2,
                qup_se3, qup_se4, qup_se5, qup_se5_l1, resout, rx_los0, rx_los1,
                rx_los2, sdc_clk, sdc_cmd, sdc_data, tsens_max ]

    required:
      - pins

required:
  - compatible
  - reg

unevaluatedProperties: false

examples:
  - |
    #include <dt-bindings/interrupt-controller/arm-gic.h>

    tlmm: pinctrl@1000000 {
        compatible = "qcom,ipq5210-tlmm";
        reg = <0x01000000 0x300000>;
        gpio-controller;
        #gpio-cells = <0x2>;
        gpio-ranges = <&tlmm 0 0 54>;
        interrupts = <GIC_SPI 31 IRQ_TYPE_LEVEL_HIGH>;
        interrupt-controller;
        #interrupt-cells = <0x2>;

        qup-uart1-default-state {
            pins = "gpio38", "gpio39";
            function = "qup_se1";
            drive-strength = <6>;
            bias-pull-down;
        };
    };
```

## Documentation/devicetree/bindings/pinctrl/qcom,ipq5332-tlmm.yaml
```yaml
# SPDX-License-Identifier: (GPL-2.0-only OR BSD-2-Clause)
%YAML 1.2
---
$id: http://devicetree.org/schemas/pinctrl/qcom,ipq5332-tlmm.yaml#
$schema: http://devicetree.org/meta-schemas/core.yaml#

title: Qualcomm IPQ5332 TLMM pin controller

maintainers:
  - Bjorn Andersson <andersson@kernel.org>
  - Krzysztof Kozlowski <krzysztof.kozlowski@linaro.org>

description: |
  Top Level Mode Multiplexer pin controller in Qualcomm IPQ5332 SoC.

allOf:
  - $ref: /schemas/pinctrl/qcom,tlmm-common.yaml#

properties:
  compatible:
    const: qcom,ipq5332-tlmm

  reg:
    maxItems: 1

  interrupts:
    maxItems: 1

  gpio-reserved-ranges:
    minItems: 1
    maxItems: 27

  gpio-line-names:
    maxItems: 53

patternProperties:
  "-state$":
    oneOf:
      - $ref: "#/$defs/qcom-ipq5332-tlmm-state"
      - patternProperties:
          "-pins$":
            $ref: "#/$defs/qcom-ipq5332-tlmm-state"
        additionalProperties: false

$defs:
  qcom-ipq5332-tlmm-state:
    type: object
    description:
      Pinctrl node's client devices use subnodes for desired pin configuration.
      Client device subnodes use below standard properties.
    $ref: qcom,tlmm-common.yaml#/$defs/qcom-tlmm-state
    unevaluatedProperties: false

    properties:
      pins:
        description:
          List of gpio pins affected by the properties specified in this
          subnode.
        items:
          pattern: "^gpio([0-9]|[1-4][0-9]|5[0-2])$"
        minItems: 1
        maxItems: 36

      function:
        description:
          Specify the alternative function to be configured for the specified
          pins.

        enum: [ atest_char, atest_char0, atest_char1, atest_char2, atest_char3,
                atest_tic, audio_pri, audio_pri0, audio_pri1, audio_sec,
                audio_sec0, audio_sec1, blsp0_i2c, blsp0_spi, blsp0_uart0,
                blsp0_uart1, blsp1_i2c0, blsp1_i2c1, blsp1_spi0, blsp1_spi1,
                blsp1_uart0, blsp1_uart1, blsp1_uart2, blsp2_i2c0, blsp2_i2c1,
                blsp2_spi, blsp2_spi0, blsp2_spi1, core_voltage, cri_trng0,
                cri_trng1, cri_trng2, cri_trng3, cxc_clk, cxc_data, dbg_out,
                gcc_plltest, gcc_tlmm, gpio, lock_det, mac0, mac1, mdc0, mdc1,
                mdio0, mdio1, pc, pcie0_clk, pcie0_wake, pcie1_clk, pcie1_wake,
                pcie2_clk, pcie2_wake, pll_test, prng_rosc0, prng_rosc1,
                prng_rosc2, prng_rosc3, pta, pwm0, pwm1, pwm2, pwm3,
                qdss_cti_trig_in_a0, qdss_cti_trig_in_a1, qdss_cti_trig_in_b0,
                qdss_cti_trig_in_b1, qdss_cti_trig_out_a0,
                qdss_cti_trig_out_a1, qdss_cti_trig_out_b0,
                qdss_cti_trig_out_b1, qdss_traceclk_a, qdss_traceclk_b,
                qdss_tracectl_a, qdss_tracectl_b, qdss_tracedata_a,
                qdss_tracedata_b, qspi_data, qspi_clk, qspi_cs, resout, rx0,
                rx1, sdc_data, sdc_clk, sdc_cmd, tsens_max, wci_txd, wci_rxd,
                wsi_clk, wsi_clk3, wsi_data, wsi_data3, wsis_reset, xfem ]

    required:
      - pins

required:
  - compatible
  - reg

unevaluatedProperties: false

examples:
  - |
    #include <dt-bindings/interrupt-controller/arm-gic.h>

    tlmm: pinctrl@1000000 {
        compatible = "qcom,ipq5332-tlmm";
        reg = <0x01000000 0x300000>;
        gpio-controller;
        #gpio-cells = <0x2>;
        gpio-ranges = <&tlmm 0 0 53>;
        interrupts = <GIC_SPI 249 IRQ_TYPE_LEVEL_HIGH>;
        interrupt-controller;
        #interrupt-cells = <0x2>;

        serial0-state {
            pins = "gpio18", "gpio19";
            function = "blsp0_uart0";
            drive-strength = <8>;
            bias-pull-up;
        };
    };
```

## Documentation/devicetree/bindings/pinctrl/qcom,ipq5424-tlmm.yaml
```yaml
# SPDX-License-Identifier: (GPL-2.0-only OR BSD-2-Clause)
%YAML 1.2
---
$id: http://devicetree.org/schemas/pinctrl/qcom,ipq5424-tlmm.yaml#
$schema: http://devicetree.org/meta-schemas/core.yaml#

title: Qualcomm IPQ5424 TLMM pin controller

maintainers:
  - Bjorn Andersson <andersson@kernel.org>

description:
  Top Level Mode Multiplexer pin controller in Qualcomm IPQ5424 SoC.

allOf:
  - $ref: /schemas/pinctrl/qcom,tlmm-common.yaml#

properties:
  compatible:
    const: qcom,ipq5424-tlmm

  reg:
    maxItems: 1

  interrupts:
    maxItems: 1

  gpio-reserved-ranges:
    minItems: 1
    maxItems: 25

  gpio-line-names:
    maxItems: 50

patternProperties:
  "-state$":
    oneOf:
      - $ref: "#/$defs/qcom-ipq5424-tlmm-state"
      - patternProperties:
          "-pins$":
            $ref: "#/$defs/qcom-ipq5424-tlmm-state"
        additionalProperties: false

$defs:
  qcom-ipq5424-tlmm-state:
    type: object
    description:
      Pinctrl node's client devices use subnodes for desired pin configuration.
      Client device subnodes use below standard properties.
    $ref: qcom,tlmm-common.yaml#/$defs/qcom-tlmm-state
    unevaluatedProperties: false

    properties:
      pins:
        description:
          List of gpio pins affected by the properties specified in this
          subnode.
        items:
          pattern: "^gpio([0-9]|[1-4][0-9])$"
        minItems: 1
        maxItems: 50

      function:
        description:
          Specify the alternative function to be configured for the specified
          pins.

        enum: [ atest_char, atest_char0, atest_char1, atest_char2, atest_char3,
                atest_tic, audio_pri, audio_pri0, audio_pri1, audio_sec,
                audio_sec0, audio_sec1, core_voltage, cri_trng0, cri_trng1,
                cri_trng2, cri_trng3, cxc_clk, cxc_data, dbg_out, gcc_plltest,
                gcc_tlmm, gpio, i2c0_scl, i2c0_sda, i2c1_scl, i2c1_sda, i2c11,
                mac0, mac1, mdc_mst, mdc_slv, mdio_mst, mdio_slv, pcie0_clk,
                pcie0_wake, pcie1_clk, pcie1_wake, pcie2_clk, pcie2_wake,
                pcie3_clk, pcie3_wake, pll_test, prng_rosc0, prng_rosc1,
                prng_rosc2, prng_rosc3, PTA0_0, PTA0_1, PTA0_2, PTA10, PTA11,
                pwm0, pwm1, pwm2, qdss_cti_trig_in_a0, qdss_cti_trig_out_a0,
                qdss_cti_trig_in_a1, qdss_cti_trig_out_a1, qdss_cti_trig_in_b0,
                qdss_cti_trig_out_b0, qdss_cti_trig_in_b1, qdss_cti_trig_out_b1,
                qdss_traceclk_a, qdss_tracectl_a, qdss_tracedata_a, qspi_clk,
                qspi_cs, qspi_data, resout, rx0, rx1, rx2, sdc_clk, sdc_cmd,
                sdc_data, spi0_cs, spi0_clk, spi0_miso, spi0_mosi, spi1, spi10,
                spi11, tsens_max, uart0, uart1, wci_txd, wci_rxd, wsi_clk, wsi_data ]

    required:
      - pins

required:
  - compatible
  - reg

unevaluatedProperties: false

examples:
  - |
    #include <dt-bindings/interrupt-controller/arm-gic.h>

    tlmm: pinctrl@1000000 {
        compatible = "qcom,ipq5424-tlmm";
        reg = <0x01000000 0x300000>;
        gpio-controller;
        #gpio-cells = <0x2>;
        gpio-ranges = <&tlmm 0 0 50>;
        interrupts = <GIC_SPI 84 IRQ_TYPE_LEVEL_HIGH>;
        interrupt-controller;
        #interrupt-cells = <0x2>;

        uart1_pins: uart1-state {
            pins = "gpio43", "gpio44";
            function = "uart1";
            drive-strength = <8>;
            bias-pull-up;
        };
    };
```
