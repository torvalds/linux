## Documentation/devicetree/bindings/pinctrl/qcom,sdx75-tlmm.yaml
```yaml
# SPDX-License-Identifier: (GPL-2.0-only OR BSD-2-Clause)
%YAML 1.2
---
$id: http://devicetree.org/schemas/pinctrl/qcom,sdx75-tlmm.yaml#
$schema: http://devicetree.org/meta-schemas/core.yaml#

title: Qualcomm Technologies, Inc. SDX75 TLMM block

maintainers:
  - Rohit Agarwal <quic_rohiagar@quicinc.com>

description:
  Top Level Mode Multiplexer pin controller in Qualcomm SDX75 SoC.

allOf:
  - $ref: /schemas/pinctrl/qcom,tlmm-common.yaml#

properties:
  compatible:
    const: qcom,sdx75-tlmm

  reg:
    maxItems: 1

  interrupts: true
  interrupt-controller: true
  "#interrupt-cells": true
  gpio-controller: true

  gpio-reserved-ranges:
    minItems: 1
    maxItems: 67

  gpio-line-names:
    maxItems: 133

  "#gpio-cells": true
  gpio-ranges: true
  wakeup-parent: true

patternProperties:
  "-state$":
    oneOf:
      - $ref: "#/$defs/qcom-sdx75-tlmm-state"
      - patternProperties:
          "-pins$":
            $ref: "#/$defs/qcom-sdx75-tlmm-state"
        additionalProperties: false

$defs:
  qcom-sdx75-tlmm-state:
    type: object
    description:
      Pinctrl node's client devices use subnodes for desired pin configuration.
      Client device subnodes use below standard properties.
    $ref: qcom,tlmm-common.yaml#/$defs/qcom-tlmm-state
    unevaluatedProperties: false

    properties:
      pins:
        description:
          List of gpio pins affected by the properties specified in this
          subnode.
        items:
          oneOf:
            - pattern: "^gpio([0-9]|[1-9][0-9]|1[0-2][0-9]|13[0-2])$"
            - enum: [ sdc1_clk, sdc1_cmd, sdc1_data, sdc1_rclk, sdc2_clk, sdc2_cmd, sdc2_data ]
        minItems: 1
        maxItems: 36

      function:
        description:
          Specify the alternative function to be configured for the specified
          pins.
        enum: [ adsp_ext, atest_char, audio_ref_clk, bimc_dte, char_exec, coex_uart2,
                coex_uart, cri_trng, cri_trng0, cri_trng1, dbg_out_clk, ddr_bist,
                ddr_pxi0, ebi0_wrcdc, ebi2_a, ebi2_lcd, ebi2_lcd_te, emac0_mcg,
                emac0_ptp, emac1_mcg, emac1_ptp, emac_cdc, emac_pps_in, eth0_mdc,
                eth0_mdio, eth1_mdc, eth1_mdio, ext_dbg, gcc_125_clk, gcc_gp1_clk,
                gcc_gp2_clk, gcc_gp3_clk, gcc_plltest, gpio, i2s_mclk, jitter_bist,
                ldo_en, ldo_update, m_voc, mgpi_clk, native_char, native_tsens,
                native_tsense, nav_dr_sync, nav_gpio, pa_indicator, pci_e,
                pcie0_clkreq_n, pcie1_clkreq_n, pcie2_clkreq_n, pll_bist_sync,
                pll_clk_aux, pll_ref_clk, pri_mi2s, prng_rosc, qdss_cti, qdss_gpio,
                qlink0_b_en, qlink0_b_req, qlink0_l_en, qlink0_l_req, qlink0_wmss,
                qlink1_l_en, qlink1_l_req, qlink1_wmss, qup_se0, qup_se1_l2_mira,
                qup_se1_l2_mirb, qup_se1_l3_mira, qup_se1_l3_mirb, qup_se2, qup_se3,
                qup_se4, qup_se5, qup_se6, qup_se7, qup_se8, rgmii_rx_ctl, rgmii_rxc,
                rgmii_rxd, rgmii_tx_ctl, rgmii_txc, rgmii_txd, sd_card, sdc1_tb,
                sdc2_tb_trig, sec_mi2s, sgmii_phy_intr0_n, sgmii_phy_intr1_n,
                spmi_coex, spmi_vgi, tgu_ch0_trigout, tmess_prng0, tmess_prng1,
                tmess_prng2, tmess_prng3, tri_mi2s, uim1_clk, uim1_data, uim1_present,
                uim1_reset, uim2_clk, uim2_data, uim2_present, uim2_reset,
                usb2phy_ac_en, vsense_trigger_mirnat]

    required:
      - pins

required:
  - compatible
  - reg

additionalProperties: false

examples:
  - |
    #include <dt-bindings/interrupt-controller/arm-gic.h>
    tlmm: pinctrl@f100000 {
        compatible = "qcom,sdx75-tlmm";
        reg = <0x0f100000 0x300000>;
        gpio-controller;
        #gpio-cells = <2>;
        gpio-ranges = <&tlmm 0 0 133>;
        interrupt-controller;
        #interrupt-cells = <2>;
        interrupts = <GIC_SPI 208 IRQ_TYPE_LEVEL_HIGH>;

        gpio-wo-state {
            pins = "gpio1";
            function = "gpio";
        };

        uart-w-state {
            rx-pins {
                pins = "gpio12";
                function = "qup_se1_l2_mira";
                bias-disable;
            };

            tx-pins {
                pins = "gpio13";
                function = "qup_se1_l3_mira";
                bias-disable;
            };
        };
    };
...
```

## Documentation/devicetree/bindings/pinctrl/qcom,shikra-tlmm.yaml
```yaml
# SPDX-License-Identifier: (GPL-2.0-only OR BSD-2-Clause)
%YAML 1.2
---
$id: http://devicetree.org/schemas/pinctrl/qcom,shikra-tlmm.yaml#
$schema: http://devicetree.org/meta-schemas/core.yaml#

title: Qualcomm Technologies, Inc. Shikra TLMM block

maintainers:
  - Komal Bajaj <komal.bajaj@oss.qualcomm.com>

description: |
  Top Level Mode Multiplexer pin controller in Qualcomm Shikra SoC.

allOf:
  - $ref: /schemas/pinctrl/qcom,tlmm-common.yaml#

properties:
  compatible:
    const: qcom,shikra-tlmm

  reg:
    maxItems: 1

  interrupts:
    maxItems: 1

  gpio-reserved-ranges:
    minItems: 1
    maxItems: 83

  gpio-line-names:
    maxItems: 166

patternProperties:
  "-state$":
    oneOf:
      - $ref: "#/$defs/qcom-shikra-tlmm-state"
      - patternProperties:
          "-pins$":
            $ref: "#/$defs/qcom-shikra-tlmm-state"
        additionalProperties: false

$defs:
  qcom-shikra-tlmm-state:
    type: object
    description:
      Pinctrl node's client devices use subnodes for desired pin configuration.
      Client device subnodes use below standard properties.
    $ref: qcom,tlmm-common.yaml#/$defs/qcom-tlmm-state
    unevaluatedProperties: false

    properties:
      pins:
        description:
          List of gpio pins affected by the properties specified in this
          subnode.
        items:
          oneOf:
            - pattern: "^gpio([0-9]|[1-9][0-9]|1[0-5][0-9]|16[0-5])$"
            - enum: [ sdc1_rclk, sdc1_clk, sdc1_cmd, sdc1_data,
                      sdc2_clk, sdc2_cmd, sdc2_data ]
        minItems: 1
        maxItems: 36

      function:
        description:
          Specify the alternative function to be configured for the specified
          pins.

        enum: [ gpio, agera_pll, atest_bbrx, atest_char, atest_gpsadc,
                atest_tsens, atest_usb, cam_mclk, cci_async, cci_i2c0,
                cci_i2c1, cci_timer, char_exec, cri_trng, dac_calib,
                dbg_out_clk, ddr_bist, ddr_pxi, dmic, emac_dll, emac_mcg,
                emac_phy, emac0_ptp_aux, emac0_ptp_pps, emac1_ptp_aux,
                emac1_ptp_pps, ext_mclk, gcc_gp, gsm0_tx, i2s0, i2s1,
                i2s2, i2s3, jitter_bist, m_voc, mdp_vsync_e, mdp_vsync_out0,
                mdp_vsync_out1, mdp_vsync_p, mdp_vsync_s, mpm_pwr, mss_lte,
                nav_gpio, pa_indicator_or, pbs_in, pbs_out, pcie0_clk_req_n,
                phase_flag, pll, prng_rosc, pwm, qdss_cti, qup0_se0,
                qup0_se1, qup0_se1_01, qup0_se1_23, qup0_se2, qup0_se3_01,
                qup0_se3_23, qup0_se4_01, qup0_se4_23, qup0_se5, qup0_se6,
                qup0_se7_01, qup0_se7_23, qup0_se8, qup0_se9, qup0_se9_01,
                qup0_se9_23, rgmii, sd_write_protect, sdc_cdc, sdc_tb_trig,
                ssbi_wtr, swr0_rx, swr0_tx, tgu_ch_trigout, tsc_async,
                tsense_pwm, uim1, uim2, unused_adsp, unused_gsm1, usb0_phy_ps,
                vfr, vsense_trigger_mirnat, wlan ]

    required:
      - pins

required:
  - compatible
  - reg

unevaluatedProperties: false

examples:
  - |
    #include <dt-bindings/interrupt-controller/arm-gic.h>

    tlmm: pinctrl@500000 {
        compatible = "qcom,shikra-tlmm";
        reg = <0x00500000 0x800000>;

        interrupts = <GIC_SPI 227 IRQ_TYPE_LEVEL_HIGH>;

        gpio-controller;
        #gpio-cells = <2>;

        interrupt-controller;
        #interrupt-cells = <2>;

        gpio-ranges = <&tlmm 0 0 166>;

        qup-uart0-default-state {
            pins = "gpio0", "gpio1";
            function = "qup0_se1";
            drive-strength = <2>;
            bias-disable;
        };
    };
...
```

## Documentation/devicetree/bindings/pinctrl/qcom,sm4250-lpass-lpi-pinctrl.yaml
```yaml
# SPDX-License-Identifier: (GPL-2.0-only OR BSD-2-Clause)
%YAML 1.2
---
$id: http://devicetree.org/schemas/pinctrl/qcom,sm4250-lpass-lpi-pinctrl.yaml#
$schema: http://devicetree.org/meta-schemas/core.yaml#

title: Qualcomm SM4250 SoC LPASS LPI TLMM

maintainers:
  - Srinivas Kandagatla <srinivas.kandagatla@linaro.org>

description:
  Top Level Mode Multiplexer pin controller in the Low Power Audio SubSystem
  (LPASS) Low Power Island (LPI) of Qualcomm SM4250 SoC.

properties:
  compatible:
    const: qcom,sm4250-lpass-lpi-pinctrl

  reg:
    items:
      - description: LPASS LPI TLMM Control and Status registers
      - description: LPASS LPI MCC registers

  clocks:
    items:
      - description: LPASS Audio voting clock

  clock-names:
    items:
      - const: audio

patternProperties:
  "-state$":
    oneOf:
      - $ref: "#/$defs/qcom-sm4250-lpass-state"
      - patternProperties:
          "-pins$":
            $ref: "#/$defs/qcom-sm4250-lpass-state"
        additionalProperties: false

$defs:
  qcom-sm4250-lpass-state:
    type: object
    description:
      Pinctrl node's client devices use subnodes for desired pin configuration.
      Client device subnodes use below standard properties.
    $ref: qcom,lpass-lpi-common.yaml#/$defs/qcom-tlmm-state
    unevaluatedProperties: false

    properties:
      pins:
        description:
          List of gpio pins affected by the properties specified in this
          subnode.
        items:
          pattern: "^gpio([0-9]|1[0-9]|2[0-6])$"

      function:
        enum: [ gpio, dmic01_clk, dmic01_data, dmic23_clk, dmic23_data,
                dmic4_clk, dmic4_data, ext_mclk0_a, ext_mclk0_b, ext_mclk1_a,
                ext_mclk1_b, ext_mclk1_c, i2s1_clk, i2s1_data, i2s1_ws,
                i2s2_clk, i2s2_data, i2s2_ws, i2s3_clk, i2s3_data, i2s3_ws,
                qua_mi2s_data, qua_mi2s_sclk, qua_mi2s_ws, slim_clk, slim_data,
                swr_rx_clk, swr_rx_data, swr_tx_clk, swr_tx_data, swr_wsa_clk,
                swr_wsa_data ]
        description:
          Specify the alternative function to be configured for the specified
          pins.

allOf:
  - $ref: qcom,lpass-lpi-common.yaml#

required:
  - compatible
  - reg
  - clocks
  - clock-names

unevaluatedProperties: false

examples:
  - |
    #include <dt-bindings/sound/qcom,q6afe.h>
    lpi_tlmm: pinctrl@a7c0000 {
        compatible = "qcom,sm4250-lpass-lpi-pinctrl";
        reg = <0xa7c0000 0x20000>,
              <0xa950000 0x10000>;
        clocks = <&q6afecc LPASS_HW_DCODEC_VOTE LPASS_CLK_ATTRIBUTE_COUPLE_NO>;
        clock-names = "audio";
        gpio-controller;
        #gpio-cells = <2>;
        gpio-ranges = <&lpi_tlmm 0 0 19>;

        i2s2-active-state {
            clk-pins {
                pins = "gpio10";
                function = "i2s2_clk";
                drive-strength = <2>;
                slew-rate = <1>;
                bias-disable;
            };

            data-pins {
                pins = "gpio12";
                function = "i2s2_data";
                drive-strength = <2>;
                slew-rate = <1>;
            };
        };

        i2s2-sleep-clk-state {
            pins = "gpio10";
            function = "i2s2_clk";
            drive-strength = <2>;
            bias-pull-down;
        };
    };
```

## Documentation/devicetree/bindings/pinctrl/qcom,sm4450-tlmm.yaml
```yaml
# SPDX-License-Identifier: (GPL-2.0-only OR BSD-2-Clause)
%YAML 1.2
---
$id: http://devicetree.org/schemas/pinctrl/qcom,sm4450-tlmm.yaml#
$schema: http://devicetree.org/meta-schemas/core.yaml#

title: Qualcomm Technologies, Inc. SM4450 TLMM block

maintainers:
  - Tengfei Fan <quic_tengfan@quicinc.com>

description:
  Top Level Mode Multiplexer pin controller in Qualcomm SM4450 SoC.

allOf:
  - $ref: /schemas/pinctrl/qcom,tlmm-common.yaml#

properties:
  compatible:
    const: qcom,sm4450-tlmm

  reg:
    maxItems: 1

  interrupts: true
  interrupt-controller: true
  "#interrupt-cells": true
  gpio-controller: true

  gpio-reserved-ranges:
    minItems: 1
    maxItems: 68

  gpio-line-names:
    maxItems: 136

  "#gpio-cells": true
  gpio-ranges: true
  wakeup-parent: true

patternProperties:
  "-state$":
    oneOf:
      - $ref: "#/$defs/qcom-sm4450-tlmm-state"
      - patternProperties:
          "-pins$":
            $ref: "#/$defs/qcom-sm4450-tlmm-state"
        additionalProperties: false

$defs:
  qcom-sm4450-tlmm-state:
    type: object
    description:
      Pinctrl node's client devices use subnodes for desired pin configuration.
      Client device subnodes use below standard properties.
    $ref: qcom,tlmm-common.yaml#/$defs/qcom-tlmm-state
    unevaluatedProperties: false

    properties:
      pins:
        description:
          List of gpio pins affected by the properties specified in this
          subnode.
        items:
          oneOf:
            - pattern: "^gpio([0-9]|[1-9][0-9]|1[0-2][0-9]|13[0-5])$"
            - enum: [ sdc2_clk, sdc2_cmd, sdc2_data, ufs_reset ]
          minItems: 1
          maxItems: 36

      function:
        description:
          Specify the alternative function to be configured for the specified
          pins.
        enum: [ gpio, atest_char, atest_usb0, audio_ref_clk, cam_mclk,
                cci_async_in0, cci_i2c, cci, cmu_rng, coex_uart1_rx,
                coex_uart1_tx, cri_trng, dbg_out_clk, ddr_bist,
                ddr_pxi0_test, ddr_pxi1_test, gcc_gp1_clk, gcc_gp2_clk,
                gcc_gp3_clk, host2wlan_sol, ibi_i3c_qup0, ibi_i3c_qup1,
                jitter_bist_ref, mdp_vsync0_out, mdp_vsync1_out,
                mdp_vsync2_out, mdp_vsync3_out, mdp_vsync, nav,
                pcie0_clk_req, phase_flag, pll_bist_sync, pll_clk_aux,
                prng_rosc, qdss_cti_trig0, qdss_cti_trig1, qdss_gpio,
                qlink0_enable, qlink0_request, qlink0_wmss_reset,
                qup0_se0, qup0_se1, qup0_se2, qup0_se3, qup0_se4,
                qup1_se0, qup1_se1, qup1_se2, qup1_se2_l2, qup1_se3,
                qup1_se4, sd_write_protect, tb_trig_sdc1, tb_trig_sdc2,
                tgu_ch0_trigout, tgu_ch1_trigout, tgu_ch2_trigout,
                tgu_ch3_trigout, tmess_prng, tsense_pwm1_out,
                tsense_pwm2_out, uim0, uim1, usb0_hs_ac, usb0_phy_ps,
                vfr_0_mira, vfr_0_mirb, vfr_1, vsense_trigger_mirnat,
                wlan1_adc_dtest0, wlan1_adc_dtest1 ]

        required:
          - pins

required:
  - compatible
  - reg

additionalProperties: false

examples:
  - |
    #include <dt-bindings/interrupt-controller/arm-gic.h>
    tlmm: pinctrl@f100000 {
        compatible = "qcom,sm4450-tlmm";
        reg = <0x0f100000 0x300000>;
        gpio-controller;
        #gpio-cells = <2>;
        gpio-ranges = <&tlmm 0 0 137>;
        interrupt-controller;
        #interrupt-cells = <2>;
        interrupts = <GIC_SPI 208 IRQ_TYPE_LEVEL_HIGH>;

        gpio-wo-state {
            pins = "gpio1";
            function = "gpio";
        };

        uart-w-state {
            rx-pins {
                pins = "gpio23";
                function = "qup1_se2";
                bias-pull-up;
            };

            tx-pins {
                pins = "gpio22";
                function = "qup1_se2";
                bias-disable;
            };
        };
    };
...
```
