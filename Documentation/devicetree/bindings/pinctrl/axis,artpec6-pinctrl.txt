## Documentation/devicetree/bindings/pinctrl/brcm,bcm21664-pinctrl.yaml
```yaml
# SPDX-License-Identifier: GPL-2.0-only OR BSD-2-Clause
%YAML 1.2
---
$id: http://devicetree.org/schemas/pinctrl/brcm,bcm21664-pinctrl.yaml#
$schema: http://devicetree.org/meta-schemas/core.yaml#

title: Broadcom BCM21664 pin controller

maintainers:
  - Florian Fainelli <florian.fainelli@broadcom.com>
  - Ray Jui <rjui@broadcom.com>
  - Scott Branden <sbranden@broadcom.com>

allOf:
  - $ref: pinctrl.yaml#

properties:
  compatible:
    const: brcm,bcm21664-pinctrl

  reg:
    maxItems: 1

patternProperties:
  '-pins$':
    type: object
    additionalProperties: false

    patternProperties:
      '-grp[0-9]$':
        type: object

        properties:
          pins:
            description:
              Specifies the name(s) of one or more pins to be configured by
              this node.
            items:
              enum: [ adcsyn, batrm, bsc1clk, bsc1dat, camcs0, camcs1, clk32k,
                      clk_cx8, dclk1, dclk4, dclkreq1, dclkreq4, dmic0clk,
                      dmic0dq, dsi0te, gpio00, gpio01, gpio02, gpio03, gpio04,
                      gpio05, gpio06, gpio07, gpio08, gpio09, gpio10, gpio11,
                      gpio12, gpio13, gpio14, gpio15, gpio16, gpio17, gpio18,
                      gpio19, gpio20, gpio21, gpio22, gpio23, gpio24, gpio25,
                      gpio26, gpio27, gpio28, gpio32, gpio33, gpio34, gpio93,
                      gpio94, gps_calreq, gps_hostreq, gps_pablank, gps_tmark,
                      icusbdm, icusbdp, lcdcs0, lcdres, lcdscl, lcdsda, lcdte,
                      mdmgpio00, mdmgpio01, mdmgpio02, mdmgpio03, mdmgpio04,
                      mdmgpio05, mdmgpio06, mdmgpio07, mdmgpio08, mmc0ck,
                      mmc0cmd, mmc0dat0, mmc0dat1, mmc0dat2, mmc0dat3, mmc0dat4,
                      mmc0dat5, mmc0dat6, mmc0dat7, mmc0rst, mmc1ck, mmc1cmd,
                      mmc1dat0, mmc1dat1, mmc1dat2, mmc1dat3, mmc1dat4,
                      mmc1dat5, mmc1dat6, mmc1dat7, mmc1rst, pc1, pc2, pmbscclk,
                      pmbscdat, pmuint, resetn, rfst2g_mtsloten3g,
                      rtxdata2g_txdata3g1, rtxen2g_txdata3g2, rxdata3g0,
                      rxdata3g1, rxdata3g2, sdck, sdcmd, sddat0, sddat1, sddat2,
                      sddat3, simclk, simdat, simdet, simrst, spi0clk, spi0fss,
                      spi0rxd, spi0txd, sri_c, sri_d, sri_e, sspck, sspdi,
                      sspdo, sspsyn, stat1, stat2, swclktck, swdiotms, sysclken,
                      tdi, tdo, testmode, traceclk, tracedt00, tracedt01,
                      tracedt02, tracedt03, tracedt04, tracedt05, tracedt06,
                      tracedt07, tracedt08, tracedt09, tracedt10, tracedt11,
                      tracedt12, tracedt13, tracedt14, tracedt15, trstb,
                      txdata3g0, ubctsn, ubrtsn, ubrx, ubtx ]

          function:
            description:
              Specifies the pin mux selection.
            enum: [ alt1, alt2, alt3, alt4, alt5, alt6 ]

          bias-disable: true

          bias-pull-up:
            type: boolean

          bias-pull-down:
            type: boolean

          slew-rate:
            description: |
              Meaning depends on configured pin mux:
                bsc*clk/pmbscclk or bsc*dat/pmbscdat or gpio16/gpio17:
                  0: Standard (100 kbps) & Fast (400 kbps) mode
                  1: Highspeed (3.4 Mbps) mode
                Otherwise:
                  0: fast slew rate
                  1: normal slew rate

          drive-strength:
            enum: [ 2, 4, 6, 8, 10, 12, 14, 16 ]

          input-enable: true
          input-disable: true

          input-schmitt-enable: true
          input-schmitt-disable: true

        required:
          - pins

        additionalProperties: false

        allOf:
          - $ref: pincfg-node.yaml#
          # Limitations for I2C pins
          - if:
              properties:
                pins:
                  contains:
                    enum: [ bsc1clk, bsc1dat, gpio16, gpio17, pmbscclk,
                            pmbscdat ]
            then:
              properties:
                drive-strength: false
                bias-pull-down: false
                input-schmitt-enable: false
                input-schmitt-disable: false


required:
  - compatible
  - reg

unevaluatedProperties: false

examples:
  - |
    pinctrl@35004800 {
      compatible = "brcm,bcm21664-pinctrl";
      reg = <0x35004800 0x7f0>;

      dev-a-active-pins {
        /* group node defining 1 standard pin */
        std-grp0 {
          pins = "gpio00";
          function = "alt1";
          input-schmitt-enable;
          bias-disable;
          slew-rate = <1>;
          drive-strength = <4>;
        };

        /* group node defining 2 I2C pins */
        i2c-grp0 {
          pins = "bsc1clk", "bsc1dat";
          function = "alt2";
          bias-pull-up;
          input-enable;
        };
      };
    };
...
```

## Documentation/devicetree/bindings/pinctrl/brcm,bcm2712c0-pinctrl.yaml
```yaml
# SPDX-License-Identifier: GPL-2.0-only OR BSD-2-Clause
%YAML 1.2
---
$id: http://devicetree.org/schemas/pinctrl/brcm,bcm2712c0-pinctrl.yaml#
$schema: http://devicetree.org/meta-schemas/core.yaml#

title: Broadcom STB family pin controller

maintainers:
  - Ivan T. Ivanov <iivanov@suse.de>
  - A. della Porta <andrea.porta@suse.com>

description: >
  Broadcom's STB family of memory-mapped pin controllers.

  This includes the pin controllers inside the BCM2712 SoC which
  are instances of the STB family and has two silicon variants,
  C0 and D0, which differs slightly in terms of registers layout.

  The -aon- (Always On) variant is the same IP block but differs
  in the number of pins that are associated and the pinmux functions
  for each of those pins.

allOf:
  - $ref: pinctrl.yaml#

properties:
  compatible:
    enum:
      - brcm,bcm2712c0-pinctrl
      - brcm,bcm2712c0-aon-pinctrl
      - brcm,bcm2712d0-pinctrl
      - brcm,bcm2712d0-aon-pinctrl

  reg:
    maxItems: 1

patternProperties:
  '-state$':
    oneOf:
      - $ref: '#/$defs/brcmstb-pinctrl-state'
      - patternProperties:
          '-pins$':
            $ref: '#/$defs/brcmstb-pinctrl-state'
        additionalProperties: false

$defs:
  brcmstb-pinctrl-state:
    allOf:
      - $ref: pincfg-node.yaml#
      - $ref: pinmux-node.yaml#

    description: >
      Pin controller client devices use pin configuration subnodes (children
      and grandchildren) for desired pin configuration.

      Client device subnodes use below standard properties.

    properties:
      pins:
        description:
          List of gpio pins affected by the properties specified in this
          subnode (either this or "groups" must be specified).
        items:
          pattern: '^((aon_)?s?gpio[0-6]?[0-9])|(emmc_(clk|cmd|dat[0-7]|ds))$'

      function:
        description:
          Specify the alternative function to be configured for the specified
          pins.
        enum: [ gpio, alt1, alt2, alt3, alt4, alt5, alt6, alt7, alt8,
                aon_cpu_standbyb, aon_fp_4sec_resetb, aon_gpclk, aon_pwm,
                arm_jtag, aud_fs_clk0, avs_pmu_bsc, bsc_m0, bsc_m1, bsc_m2,
                bsc_m3, clk_observe, ctl_hdmi_5v, enet0, enet0_mii, enet0_rgmii,
                ext_sc_clk, fl0, fl1, gpclk0, gpclk1, gpclk2, hdmi_tx0_auto_i2c,
                hdmi_tx0_bsc, hdmi_tx1_auto_i2c, hdmi_tx1_bsc, i2s_in, i2s_out,
                ir_in, mtsif, mtsif_alt, mtsif_alt1, pdm, pkt, pm_led_out, sc0,
                sd0, sd2, sd_card_a, sd_card_b, sd_card_c, sd_card_d, sd_card_e,
                sd_card_f, sd_card_g, spdif_out, spi_m, spi_s, sr_edm_sense, te0,
                te1, tsio, uart0, uart1, uart2, usb_pwr, usb_vbus, uui, vc_i2c0,
                vc_i2c3, vc_i2c4, vc_i2c5, vc_i2csl, vc_pcm, vc_pwm0, vc_pwm1,
                vc_spi0, vc_spi3, vc_spi4, vc_spi5, vc_uart0, vc_uart2, vc_uart3,
                vc_uart4 ]

      bias-disable: true
      bias-pull-down: true
      bias-pull-up: true

    required:
      - pins

    if:
      properties:
        pins:
          not:
            contains:
              pattern: "^emmc_(clk|cmd|dat[0-7]|ds)$"
    then:
      required:
        - function
    else:
      properties:
        function: false

    additionalProperties: false

required:
  - compatible
  - reg

unevaluatedProperties: false

examples:
  - |
    pinctrl@7d504100 {
        compatible = "brcm,bcm2712c0-pinctrl";
        reg = <0x7d504100 0x30>;

        bt-shutdown-default-state {
            function = "gpio";
            pins = "gpio29";
        };

        uarta-default-state {
            rts-tx-pins {
                function = "uart0";
                pins = "gpio24", "gpio26";
                bias-disable;
            };

            cts-rx-pins {
                function = "uart0";
                pins = "gpio25", "gpio27";
                bias-pull-up;
            };
        };
    };
```

## Documentation/devicetree/bindings/pinctrl/brcm,bcm2835-gpio.txt
```
Broadcom BCM2835 GPIO (and pinmux) controller

The BCM2835 GPIO module is a combined GPIO controller, (GPIO) interrupt
controller, and pinmux/control device.

Required properties:
- compatible: "brcm,bcm2835-gpio"
- reg: Should contain the physical address of the GPIO module's registers.
- gpio-controller: Marks the device node as a GPIO controller.
- #gpio-cells : Should be two. The first cell is the pin number and the
  second cell is used to specify optional parameters:
  - bit 0 specifies polarity (0 for normal, 1 for inverted)
- interrupts : The interrupt outputs from the controller. One interrupt per
  individual bank followed by the "all banks" interrupt.
- interrupt-controller: Marks the device node as an interrupt controller.
- #interrupt-cells : Should be 2.
  The first cell is the GPIO number.
  The second cell is used to specify flags:
    bits[3:0] trigger type and level flags:
      1 = low-to-high edge triggered.
      2 = high-to-low edge triggered.
      4 = active high level-sensitive.
      8 = active low level-sensitive.
    Valid combinations are 1, 2, 3, 4, 8.

Please refer to ../gpio/gpio.txt for a general description of GPIO bindings.

Please refer to pinctrl-bindings.txt in this directory for details of the
common pinctrl bindings used by client devices, including the meaning of the
phrase "pin configuration node".

Each pin configuration node lists the pin(s) to which it applies, and one or
more of the mux function to select on those pin(s), and pull-up/down
configuration. Each subnode only affects those parameters that are explicitly
listed. In other words, a subnode that lists only a mux function implies no
information about any pull configuration. Similarly, a subnode that lists only
a pul parameter implies no information about the mux function.

Required subnode-properties:
- brcm,pins: An array of cells. Each cell contains the ID of a pin. Valid IDs
  are the integer GPIO IDs; 0==GPIO0, 1==GPIO1, ... 53==GPIO53.

Optional subnode-properties:
- brcm,function: Integer, containing the function to mux to the pin(s):
  0: GPIO in
  1: GPIO out
  2: alt5
  3: alt4
  4: alt0
  5: alt1
  6: alt2
  7: alt3
- brcm,pull: Integer, representing the pull-down/up to apply to the pin(s):
  0: none
  1: down
  2: up

Each of brcm,function and brcm,pull may contain either a single value which
will be applied to all pins in brcm,pins, or 1 value for each entry in
brcm,pins.

Example:

	gpio: gpio {
		compatible = "brcm,bcm2835-gpio";
		reg = <0x2200000 0xb4>;
		interrupts = <2 17>, <2 19>, <2 18>, <2 20>;

		gpio-controller;
		#gpio-cells = <2>;

		interrupt-controller;
		#interrupt-cells = <2>;
	};
```

## Documentation/devicetree/bindings/pinctrl/brcm,bcm2835-gpio.yaml
```yaml
# SPDX-License-Identifier: (GPL-2.0-only OR BSD-2-Clause)
%YAML 1.2
---
$id: http://devicetree.org/schemas/pinctrl/brcm,bcm2835-gpio.yaml#
$schema: http://devicetree.org/meta-schemas/core.yaml#

title: Broadcom BCM2835 GPIO (and pinmux) controller

maintainers:
  - Florian Fainelli <f.fainelli@gmail.com>

description: >
  The BCM2835 GPIO module is a combined GPIO controller, (GPIO) interrupt
  controller, and pinmux/control device.

properties:
  compatible:
    enum:
      - brcm,bcm2835-gpio
      - brcm,bcm2711-gpio
      - brcm,bcm7211-gpio

  reg:
    maxItems: 1

  '#gpio-cells':
    const: 2

  gpio-controller: true
  gpio-ranges: true
  gpio-line-names: true

  interrupts:
    description: >
      Interrupt outputs: one per bank, then the combined “all banks” line.
      BCM7211 may specify up to four per-bank wake-up lines and one combined
      wake-up interrupt.
    minItems: 4
    maxItems: 10

  '#interrupt-cells':
    const: 2

  interrupt-controller: true

additionalProperties:
  oneOf:
    - type: object
      additionalProperties: false

      patternProperties:
        '^pins?-':
          type: object
          allOf:
            - $ref: /schemas/pinctrl/pincfg-node.yaml#
            - $ref: /schemas/pinctrl/pinmux-node.yaml#
          additionalProperties: false

          properties:
            pins: true
            function: true
            bias-disable: true
            bias-pull-up: true
            bias-pull-down: true
            output-high: true
            output-low: true

          required:
            - pins
            - function

    - type: object
      additionalProperties: false
      deprecated: true

      properties:
        brcm,pins:
          description:
            GPIO pin numbers for legacy configuration.
          $ref: /schemas/types.yaml#/definitions/uint32-array

        brcm,function:
          description:
            Legacy mux function for the pins (0=input, 1=output, 2–7=alt functions).
          $ref: /schemas/types.yaml#/definitions/uint32-array
          maximum: 7

        brcm,pull:
          description: >
            Legacy pull setting for the pins (0=none, 1=pull-down, 2=pull-up).
          $ref: /schemas/types.yaml#/definitions/uint32-array
          maximum: 2

      required:
        - brcm,pins

allOf:
  - if:
      properties:
        compatible:
          contains:
            enum:
              - brcm,bcm2835-gpio
              - brcm,bcm2711-gpio
    then:
      properties:
        interrupts:
          maxItems: 5

examples:
  - |
    gpio@2200000 {
        compatible = "brcm,bcm2835-gpio";
        reg = <0x2200000 0xb4>;
        interrupts = <2 17>, <2 19>, <2 18>, <2 20>, <2 21>;
        #gpio-cells = <2>;
        gpio-controller;
        #interrupt-cells = <2>;
        interrupt-controller;
    };
```
