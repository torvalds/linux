## Documentation/devicetree/bindings/pinctrl/brcm,bcm4708-pinmux.txt
```
Broadcom Northstar pins mux controller

Some of Northstar SoCs's pins can be used for various purposes thanks to the mux
controller. This binding allows describing mux controller and listing available
functions. They can be referenced later by other bindings to let system
configure controller correctly.

A list of pins varies across chipsets so few bindings are available.

Node of the pinmux must be nested in the CRU (Central Resource Unit) "syscon"
noce.

Required properties:
- compatible: must be one of:
	"brcm,bcm4708-pinmux"
	"brcm,bcm4709-pinmux"
	"brcm,bcm53012-pinmux"
- offset: offset of pin registers in the CRU block

Functions and their groups available for all chipsets:
- "spi": "spi_grp"
- "i2c": "i2c_grp"
- "pwm": "pwm0_grp", "pwm1_grp", "pwm2_grp", "pwm3_grp"
- "uart1": "uart1_grp"

Additionally available on BCM4709 and BCM53012:
- "mdio": "mdio_grp"
- "uart2": "uart2_grp"
- "sdio": "sdio_pwr_grp", "sdio_1p8v_grp"

For documentation of subnodes see:
Documentation/devicetree/bindings/pinctrl/pinctrl-bindings.txt

Example:
	dmu@1800c000 {
		compatible = "simple-bus";
		ranges = <0 0x1800c000 0x1000>;
		#address-cells = <1>;
		#size-cells = <1>;

		cru@100 {
			compatible = "syscon", "simple-mfd";
			reg = <0x100 0x1a4>;

			pinctrl {
				compatible = "brcm,bcm4708-pinmux";
				offset = <0xc0>;

				spi-pins {
					function = "spi";
					groups = "spi_grp";
				};
			};
		};
	};
```

## Documentation/devicetree/bindings/pinctrl/brcm,bcm4908-pinctrl.yaml
```yaml
# SPDX-License-Identifier: GPL-2.0-only OR BSD-2-Clause
%YAML 1.2
---
$id: http://devicetree.org/schemas/pinctrl/brcm,bcm4908-pinctrl.yaml#
$schema: http://devicetree.org/meta-schemas/core.yaml#

title: Broadcom BCM4908 pin controller

maintainers:
  - Rafał Miłecki <rafal@milecki.pl>

description:
  Binding for pin controller present on BCM4908 family SoCs.

properties:
  compatible:
    const: brcm,bcm4908-pinctrl

  reg:
    maxItems: 1

patternProperties:
  '-pins$':
    type: object
    $ref: pinmux-node.yaml#
    additionalProperties: false

    properties:
      function:
        enum: [ led_0, led_1, led_2, led_3, led_4, led_5, led_6, led_7, led_8,
                led_9, led_10, led_11, led_12, led_13, led_14, led_15, led_16,
                led_17, led_18, led_19, led_20, led_21, led_22, led_23, led_24,
                led_25, led_26, led_27, led_28, led_29, led_30, led_31,
                hs_uart, i2c, i2s, nand_ctrl, nand_data, emmc_ctrl, usb0_pwr,
                usb1_pwr ]

      groups:
        minItems: 1
        maxItems: 2
        items:
          enum: [ led_0_grp_a, led_1_grp_a, led_2_grp_a, led_3_grp_a,
                  led_4_grp_a, led_5_grp_a, led_6_grp_a, led_7_grp_a,
                  led_8_grp_a, led_9_grp_a, led_10_grp_a, led_10_grp_b,
                  led_11_grp_a, led_11_grp_b, led_12_grp_a, led_12_grp_b,
                  led_13_grp_a, led_13_grp_b, led_14_grp_a, led_15_grp_a,
                  led_16_grp_a, led_17_grp_a, led_18_grp_a, led_19_grp_a,
                  led_20_grp_a, led_21_grp_a, led_22_grp_a, led_23_grp_a,
                  led_24_grp_a, led_25_grp_a, led_26_grp_a, led_27_grp_a,
                  led_28_grp_a, led_29_grp_a, led_30_grp_a, led_31_grp_a,
                  led_31_grp_b, hs_uart_grp, i2c_grp_a, i2c_grp_b, i2s_grp,
                  nand_ctrl_grp, nand_data_grp, emmc_ctrl_grp, usb0_pwr_grp,
                  usb1_pwr_grp ]

allOf:
  - $ref: pinctrl.yaml#

required:
  - compatible
  - reg

unevaluatedProperties: false

examples:
  - |
    pinctrl@ff800560 {
        compatible = "brcm,bcm4908-pinctrl";
        reg = <0xff800560 0x10>;

        led_0-a-pins {
            function = "led_0";
            groups = "led_0_grp_a";
        };
    };
```

## Documentation/devicetree/bindings/pinctrl/brcm,bcm6318-pinctrl.yaml
```yaml
# SPDX-License-Identifier: GPL-2.0-only OR BSD-2-Clause
%YAML 1.2
---
$id: http://devicetree.org/schemas/pinctrl/brcm,bcm6318-pinctrl.yaml#
$schema: http://devicetree.org/meta-schemas/core.yaml#

title: Broadcom BCM6318 pin controller

maintainers:
  - Álvaro Fernández Rojas <noltari@gmail.com>
  - Jonas Gorski <jonas.gorski@gmail.com>

description:
  Bindings for Broadcom's BCM6318 memory-mapped pin controller.

properties:
  compatible:
    const: brcm,bcm6318-pinctrl

  reg:
    maxItems: 2

patternProperties:
  '-pins$':
    type: object
    $ref: pinmux-node.yaml#

    properties:
      function:
        enum: [ ephy0_spd_led, ephy1_spd_led, ephy2_spd_led, ephy3_spd_led,
                ephy0_act_led, ephy1_act_led, ephy2_act_led, ephy3_act_led,
                serial_led_data, serial_led_clk, inet_act_led, inet_fail_led,
                dsl_led, post_fail_led, wlan_wps_led, usb_pwron,
                usb_device_led, usb_active ]

      pins:
        enum: [ gpio0, gpio1, gpio2, gpio3, gpio4, gpio5, gpio6, gpio7,
                gpio8, gpio9, gpio10, gpio11, gpio12, gpio13, gpio40 ]

required:
  - compatible
  - reg

additionalProperties: false

examples:
  - |
    pinctrl@18 {
      compatible = "brcm,bcm6318-pinctrl";
      reg = <0x18 0x10>, <0x54 0x18>;

      pinctrl_ephy0_spd_led: ephy0_spd_led-pins {
        function = "ephy0_spd_led";
        pins = "gpio0";
      };

      pinctrl_ephy1_spd_led: ephy1_spd_led-pins {
        function = "ephy1_spd_led";
        pins = "gpio1";
      };

      pinctrl_ephy2_spd_led: ephy2_spd_led-pins {
        function = "ephy2_spd_led";
        pins = "gpio2";
      };

      pinctrl_ephy3_spd_led: ephy3_spd_led-pins {
        function = "ephy3_spd_led";
        pins = "gpio3";
      };

      pinctrl_ephy0_act_led: ephy0_act_led-pins {
        function = "ephy0_act_led";
        pins = "gpio4";
      };

      pinctrl_ephy1_act_led: ephy1_act_led-pins {
        function = "ephy1_act_led";
        pins = "gpio5";
      };

      pinctrl_ephy2_act_led: ephy2_act_led-pins {
        function = "ephy2_act_led";
        pins = "gpio6";
      };

      pinctrl_ephy3_act_led: ephy3_act_led-pins {
        function = "ephy3_act_led";
        pins = "gpio7";
      };

      pinctrl_serial_led: serial_led-pins {
        pinctrl_serial_led_data: serial_led_data-pins {
          function = "serial_led_data";
          pins = "gpio6";
        };

        pinctrl_serial_led_clk: serial_led_clk-pins {
          function = "serial_led_clk";
          pins = "gpio7";
        };
      };

      pinctrl_inet_act_led: inet_act_led-pins {
        function = "inet_act_led";
        pins = "gpio8";
      };

      pinctrl_inet_fail_led: inet_fail_led-pins {
        function = "inet_fail_led";
        pins = "gpio9";
      };

      pinctrl_dsl_led: dsl_led-pins {
        function = "dsl_led";
        pins = "gpio10";
      };

      pinctrl_post_fail_led: post_fail_led-pins {
        function = "post_fail_led";
        pins = "gpio11";
      };

      pinctrl_wlan_wps_led: wlan_wps_led-pins {
        function = "wlan_wps_led";
        pins = "gpio12";
      };

      pinctrl_usb_pwron: usb_pwron-pins {
        function = "usb_pwron";
        pins = "gpio13";
      };

      pinctrl_usb_device_led: usb_device_led-pins {
        function = "usb_device_led";
        pins = "gpio13";
      };

      pinctrl_usb_active: usb_active-pins {
        function = "usb_active";
        pins = "gpio40";
      };
    };
```

## Documentation/devicetree/bindings/pinctrl/brcm,bcm63268-pinctrl.yaml
```yaml
# SPDX-License-Identifier: GPL-2.0-only OR BSD-2-Clause
%YAML 1.2
---
$id: http://devicetree.org/schemas/pinctrl/brcm,bcm63268-pinctrl.yaml#
$schema: http://devicetree.org/meta-schemas/core.yaml#

title: Broadcom BCM63268 pin controller

maintainers:
  - Álvaro Fernández Rojas <noltari@gmail.com>
  - Jonas Gorski <jonas.gorski@gmail.com>

description:
  Bindings for Broadcom's BCM63268 memory-mapped pin controller.

properties:
  compatible:
    const: brcm,bcm63268-pinctrl

  reg:
    maxItems: 3

patternProperties:
  '-pins$':
    type: object
    $ref: pinmux-node.yaml#

    properties:
      function:
        enum: [ serial_led_clk, serial_led_data, hsspi_cs4, hsspi_cs5,
                hsspi_cs6, hsspi_cs7, adsl_spi_miso, adsl_spi_mosi,
                vreq_clk, pcie_clkreq_b, robosw_led_clk, robosw_led_data,
                nand, gpio35_alt, dectpd, vdsl_phy_override_0,
                vdsl_phy_override_1, vdsl_phy_override_2,
                vdsl_phy_override_3, dsl_gpio8, dsl_gpio9 ]

      pins:
        enum: [ gpio0, gpio1, gpio16, gpio17, gpio8, gpio9, gpio18, gpio19,
                gpio22, gpio23, gpio30, gpio31, nand_grp, gpio35
                dectpd_grp, vdsl_phy_override_0_grp,
                vdsl_phy_override_1_grp, vdsl_phy_override_2_grp,
                vdsl_phy_override_3_grp, dsl_gpio8, dsl_gpio9 ]

required:
  - compatible
  - reg

additionalProperties: false

examples:
  - |
    pinctrl@10 {
      compatible = "brcm,bcm63268-pinctrl";
      reg = <0x10 0x4>, <0x18 0x8>, <0x38 0x4>;

      pinctrl_serial_led: serial_led-pins {
        pinctrl_serial_led_clk: serial_led_clk-pins {
          function = "serial_led_clk";
          pins = "gpio0";
        };

        pinctrl_serial_led_data: serial_led_data-pins {
          function = "serial_led_data";
          pins = "gpio1";
        };
      };

      pinctrl_hsspi_cs4: hsspi_cs4-pins {
        function = "hsspi_cs4";
        pins = "gpio16";
      };

      pinctrl_hsspi_cs5: hsspi_cs5-pins {
        function = "hsspi_cs5";
        pins = "gpio17";
      };

      pinctrl_hsspi_cs6: hsspi_cs6-pins {
        function = "hsspi_cs6";
        pins = "gpio8";
      };

      pinctrl_hsspi_cs7: hsspi_cs7-pins {
        function = "hsspi_cs7";
        pins = "gpio9";
      };

      pinctrl_adsl_spi: adsl_spi-pins {
        pinctrl_adsl_spi_miso: adsl_spi_miso-pins {
          function = "adsl_spi_miso";
          pins = "gpio18";
        };

        pinctrl_adsl_spi_mosi: adsl_spi_mosi-pins {
          function = "adsl_spi_mosi";
          pins = "gpio19";
        };
      };

      pinctrl_vreq_clk: vreq_clk-pins {
        function = "vreq_clk";
        pins = "gpio22";
      };

      pinctrl_pcie_clkreq_b: pcie_clkreq_b-pins {
        function = "pcie_clkreq_b";
        pins = "gpio23";
      };

      pinctrl_robosw_led_clk: robosw_led_clk-pins {
        function = "robosw_led_clk";
        pins = "gpio30";
      };

      pinctrl_robosw_led_data: robosw_led_data-pins {
        function = "robosw_led_data";
        pins = "gpio31";
      };

      pinctrl_nand: nand-pins {
        function = "nand";
        group = "nand_grp";
      };

      pinctrl_gpio35_alt: gpio35_alt-pins {
        function = "gpio35_alt";
        pin = "gpio35";
      };

      pinctrl_dectpd: dectpd-pins {
        function = "dectpd";
        group = "dectpd_grp";
      };

      pinctrl_vdsl_phy_override_0: vdsl_phy_override_0-pins {
        function = "vdsl_phy_override_0";
        group = "vdsl_phy_override_0_grp";
      };

      pinctrl_vdsl_phy_override_1: vdsl_phy_override_1-pins {
        function = "vdsl_phy_override_1";
        group = "vdsl_phy_override_1_grp";
      };

      pinctrl_vdsl_phy_override_2: vdsl_phy_override_2-pins {
        function = "vdsl_phy_override_2";
        group = "vdsl_phy_override_2_grp";
      };

      pinctrl_vdsl_phy_override_3: vdsl_phy_override_3-pins {
        function = "vdsl_phy_override_3";
        group = "vdsl_phy_override_3_grp";
      };

      pinctrl_dsl_gpio8: dsl_gpio8-pins {
        function = "dsl_gpio8";
        group = "dsl_gpio8";
      };

      pinctrl_dsl_gpio9: dsl_gpio9-pins {
        function = "dsl_gpio9";
        group = "dsl_gpio9";
      };
    };
```

## Documentation/devicetree/bindings/pinctrl/brcm,bcm6328-pinctrl.yaml
```yaml
# SPDX-License-Identifier: GPL-2.0-only OR BSD-2-Clause
%YAML 1.2
---
$id: http://devicetree.org/schemas/pinctrl/brcm,bcm6328-pinctrl.yaml#
$schema: http://devicetree.org/meta-schemas/core.yaml#

title: Broadcom BCM6328 pin controller

maintainers:
  - Álvaro Fernández Rojas <noltari@gmail.com>
  - Jonas Gorski <jonas.gorski@gmail.com>

description:
  Bindings for Broadcom's BCM6328 memory-mapped pin controller.

properties:
  compatible:
    const: brcm,bcm6328-pinctrl

  reg:
    maxItems: 1

patternProperties:
  '-pins$':
    type: object
    $ref: pinmux-node.yaml#

    properties:
      function:
        enum: [ serial_led_data, serial_led_clk, inet_act_led, pcie_clkreq,
                led, ephy0_act_led, ephy1_act_led, ephy2_act_led,
                ephy3_act_led, hsspi_cs1, usb_device_port, usb_host_port ]

      pins:
        enum: [ gpio6, gpio7, gpio11, gpio16, gpio17, gpio18, gpio19,
                gpio20, gpio25, gpio26, gpio27, gpio28, hsspi_cs1,
                usb_port1 ]

allOf:
  - $ref: pinctrl.yaml#

required:
  - compatible
  - reg

additionalProperties: false

examples:
  - |
    pinctrl@18 {
      compatible = "brcm,bcm6328-pinctrl";
      reg = <0x18 0x10>;

      pinctrl_serial_led: serial_led-pins {
        pinctrl_serial_led_data: serial_led_data-pins {
          function = "serial_led_data";
          pins = "gpio6";
        };

        pinctrl_serial_led_clk: serial_led_clk-pins {
          function = "serial_led_clk";
          pins = "gpio7";
        };
      };

      pinctrl_inet_act_led: inet_act_led-pins {
        function = "inet_act_led";
        pins = "gpio11";
      };

      pinctrl_pcie_clkreq: pcie_clkreq-pins {
        function = "pcie_clkreq";
        pins = "gpio16";
      };

      pinctrl_ephy0_spd_led: ephy0_spd_led-pins {
        function = "led";
        pins = "gpio17";
      };

      pinctrl_ephy1_spd_led: ephy1_spd_led-pins {
        function = "led";
        pins = "gpio18";
      };

      pinctrl_ephy2_spd_led: ephy2_spd_led-pins {
        function = "led";
        pins = "gpio19";
      };

      pinctrl_ephy3_spd_led: ephy3_spd_led-pins {
        function = "led";
        pins = "gpio20";
      };

      pinctrl_ephy0_act_led: ephy0_act_led-pins {
        function = "ephy0_act_led";
        pins = "gpio25";
      };

      pinctrl_ephy1_act_led: ephy1_act_led-pins {
        function = "ephy1_act_led";
        pins = "gpio26";
      };

      pinctrl_ephy2_act_led: ephy2_act_led-pins {
        function = "ephy2_act_led";
        pins = "gpio27";
      };

      pinctrl_ephy3_act_led: ephy3_act_led-pins {
        function = "ephy3_act_led";
        pins = "gpio28";
      };

      pinctrl_hsspi_cs1: hsspi_cs1-pins {
        function = "hsspi_cs1";
        pins = "hsspi_cs1";
      };

      pinctrl_usb_port1_device: usb_port1_device-pins {
        function = "usb_device_port";
        pins = "usb_port1";
      };

      pinctrl_usb_port1_host: usb_port1_host-pins {
        function = "usb_host_port";
        pins = "usb_port1";
      };
    };
```
