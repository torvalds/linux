## Documentation/devicetree/bindings/pinctrl/brcm,bcm6358-pinctrl.yaml
```yaml
# SPDX-License-Identifier: GPL-2.0-only OR BSD-2-Clause
%YAML 1.2
---
$id: http://devicetree.org/schemas/pinctrl/brcm,bcm6358-pinctrl.yaml#
$schema: http://devicetree.org/meta-schemas/core.yaml#

title: Broadcom BCM6358 pin controller

maintainers:
  - Álvaro Fernández Rojas <noltari@gmail.com>
  - Jonas Gorski <jonas.gorski@gmail.com>

description:
  Bindings for Broadcom's BCM6358 memory-mapped pin controller.

properties:
  compatible:
    const: brcm,bcm6358-pinctrl

  reg:
    maxItems: 1

patternProperties:
  '-pins$':
    type: object
    $ref: pinmux-node.yaml#

    properties:
      function:
        enum: [ ebi_cs, uart1, serial_led, legacy_led, led, spi_cs, utopia,
                pwm_syn_clk, sys_irq ]

      pins:
        enum: [ ebi_cs_grp, uart1_grp, serial_led_grp, legacy_led_grp,
                led_grp, spi_cs_grp, utopia_grp, pwm_syn_clk, sys_irq_grp ]

allOf:
  - $ref: pinctrl.yaml#

required:
  - compatible
  - reg

additionalProperties: false

examples:
  - |
    pinctrl@18 {
      compatible = "brcm,bcm6358-pinctrl";
      reg = <0x18 0x4>;

      pinctrl_ebi_cs: ebi_cs-pins {
        function = "ebi_cs";
        groups = "ebi_cs_grp";
      };

      pinctrl_uart1: uart1-pins {
        function = "uart1";
        groups = "uart1_grp";
      };

      pinctrl_serial_led: serial_led-pins {
        function = "serial_led";
        groups = "serial_led_grp";
      };

      pinctrl_legacy_led: legacy_led-pins {
        function = "legacy_led";
        groups = "legacy_led_grp";
      };

      pinctrl_led: led-pins {
        function = "led";
        groups = "led_grp";
      };

      pinctrl_spi_cs_23: spi_cs-pins {
        function = "spi_cs";
        groups = "spi_cs_grp";
      };

      pinctrl_utopia: utopia-pins {
        function = "utopia";
        groups = "utopia_grp";
      };

      pinctrl_pwm_syn_clk: pwm_syn_clk-pins {
        function = "pwm_syn_clk";
        groups = "pwm_syn_clk_grp";
      };

      pinctrl_sys_irq: sys_irq-pins {
        function = "sys_irq";
        groups = "sys_irq_grp";
      };
    };
```

## Documentation/devicetree/bindings/pinctrl/brcm,bcm6362-pinctrl.yaml
```yaml
# SPDX-License-Identifier: GPL-2.0-only OR BSD-2-Clause
%YAML 1.2
---
$id: http://devicetree.org/schemas/pinctrl/brcm,bcm6362-pinctrl.yaml#
$schema: http://devicetree.org/meta-schemas/core.yaml#

title: Broadcom BCM6362 pin controller

maintainers:
  - Álvaro Fernández Rojas <noltari@gmail.com>
  - Jonas Gorski <jonas.gorski@gmail.com>

description:
  Bindings for Broadcom's BCM6362 memory-mapped pin controller.

properties:
  compatible:
    const: brcm,bcm6362-pinctrl

  reg:
    maxItems: 2

patternProperties:
  '-pins$':
    type: object
    $ref: pinmux-node.yaml#
    unevaluatedProperties: false

    properties:
      function:
        enum: [ usb_device_led, sys_irq, serial_led_clk, serial_led_data,
                robosw_led_data, robosw_led_clk, robosw_led0, robosw_led1,
                inet_led, spi_cs2, spi_cs3, ntr_pulse, uart1_scts,
                uart1_srts, uart1_sdin, uart1_sdout, adsl_spi_miso,
                adsl_spi_mosi, adsl_spi_clk, adsl_spi_cs, ephy0_led,
                ephy1_led, ephy2_led, ephy3_led, ext_irq0, ext_irq1,
                ext_irq2, ext_irq3, nand ]

      pins:
        enum: [ gpio0, gpio1, gpio2, gpio3, gpio4, gpio5, gpio6, gpio7,
                gpio8, gpio9, gpio10, gpio11, gpio12, gpio13, gpio14,
                gpio15, gpio16, gpio17, gpio18, gpio19, gpio20, gpio21,
                gpio22, gpio23, gpio24, gpio25, gpio26, gpio27, nand_grp ]

    patternProperties:
      '-pins$':
        $ref: '#/patternProperties/-pins$'

allOf:
  - $ref: pinctrl.yaml#

required:
  - compatible
  - reg

additionalProperties: false

examples:
  - |
    pinctrl@18 {
      compatible = "brcm,bcm6362-pinctrl";
      reg = <0x18 0x10>, <0x38 0x4>;

      pinctrl_usb_device_led: usb_device_led-pins {
        function = "usb_device_led";
        pins = "gpio0";
      };

      pinctrl_sys_irq: sys_irq-pins {
        function = "sys_irq";
        pins = "gpio1";
      };

      pinctrl_serial_led: serial_led-pins {
        pinctrl_serial_led_clk: serial_led_clk-pins {
          function = "serial_led_clk";
          pins = "gpio2";
        };

        pinctrl_serial_led_data: serial_led_data-pins {
          function = "serial_led_data";
          pins = "gpio3";
        };
      };

      pinctrl_robosw_led_data: robosw_led_data-pins {
        function = "robosw_led_data";
        pins = "gpio4";
      };

      pinctrl_robosw_led_clk: robosw_led_clk-pins {
        function = "robosw_led_clk";
        pins = "gpio5";
      };

      pinctrl_robosw_led0: robosw_led0-pins {
        function = "robosw_led0";
        pins = "gpio6";
      };

      pinctrl_robosw_led1: robosw_led1-pins {
        function = "robosw_led1";
        pins = "gpio7";
      };

      pinctrl_inet_led: inet_led-pins {
        function = "inet_led";
        pins = "gpio8";
      };

      pinctrl_spi_cs2: spi_cs2-pins {
        function = "spi_cs2";
        pins = "gpio9";
      };

      pinctrl_spi_cs3: spi_cs3-pins {
        function = "spi_cs3";
        pins = "gpio10";
      };

      pinctrl_ntr_pulse: ntr_pulse-pins {
        function = "ntr_pulse";
        pins = "gpio11";
      };

      pinctrl_uart1_scts: uart1_scts-pins {
        function = "uart1_scts";
        pins = "gpio12";
      };

      pinctrl_uart1_srts: uart1_srts-pins {
        function = "uart1_srts";
        pins = "gpio13";
      };

      pinctrl_uart1: uart1-pins {
        pinctrl_uart1_sdin: uart1_sdin-pins {
          function = "uart1_sdin";
          pins = "gpio14";
        };

        pinctrl_uart1_sdout: uart1_sdout-pins {
          function = "uart1_sdout";
          pins = "gpio15";
        };
      };

      pinctrl_adsl_spi: adsl_spi-pins {
        pinctrl_adsl_spi_miso: adsl_spi_miso-pins {
          function = "adsl_spi_miso";
          pins = "gpio16";
        };

        pinctrl_adsl_spi_mosi: adsl_spi_mosi-pins {
          function = "adsl_spi_mosi";
          pins = "gpio17";
        };

        pinctrl_adsl_spi_clk: adsl_spi_clk-pins {
          function = "adsl_spi_clk";
          pins = "gpio18";
        };

        pinctrl_adsl_spi_cs: adsl_spi_cs-pins {
          function = "adsl_spi_cs";
          pins = "gpio19";
        };
      };

      pinctrl_ephy0_led: ephy0_led-pins {
        function = "ephy0_led";
        pins = "gpio20";
      };

      pinctrl_ephy1_led: ephy1_led-pins {
        function = "ephy1_led";
        pins = "gpio21";
      };

      pinctrl_ephy2_led: ephy2_led-pins {
        function = "ephy2_led";
        pins = "gpio22";
      };

      pinctrl_ephy3_led: ephy3_led-pins {
        function = "ephy3_led";
        pins = "gpio23";
      };

      pinctrl_ext_irq0: ext_irq0-pins {
        function = "ext_irq0";
        pins = "gpio24";
      };

      pinctrl_ext_irq1: ext_irq1-pins {
        function = "ext_irq1";
        pins = "gpio25";
      };

      pinctrl_ext_irq2: ext_irq2-pins {
        function = "ext_irq2";
        pins = "gpio26";
      };

      pinctrl_ext_irq3: ext_irq3-pins {
        function = "ext_irq3";
        pins = "gpio27";
      };

      pinctrl_nand: nand-pins {
        function = "nand";
        pins = "nand_grp";
      };
    };
```

## Documentation/devicetree/bindings/pinctrl/brcm,bcm6368-pinctrl.yaml
```yaml
# SPDX-License-Identifier: GPL-2.0-only OR BSD-2-Clause
%YAML 1.2
---
$id: http://devicetree.org/schemas/pinctrl/brcm,bcm6368-pinctrl.yaml#
$schema: http://devicetree.org/meta-schemas/core.yaml#

title: Broadcom BCM6368 pin controller

maintainers:
  - Álvaro Fernández Rojas <noltari@gmail.com>
  - Jonas Gorski <jonas.gorski@gmail.com>

description:
  Bindings for Broadcom's BCM6368 memory-mapped pin controller.

properties:
  compatible:
    const: brcm,bcm6368-pinctrl

  reg:
    maxItems: 2

patternProperties:
  '-pins$':
    type: object
    $ref: pinmux-node.yaml#

    properties:
      function:
        enum: [ analog_afe_0, analog_afe_1, sys_irq, serial_led_data,
                serial_led_clk, inet_led, ephy0_led, ephy1_led, ephy2_led,
                ephy3_led, robosw_led_data, robosw_led_clk, robosw_led0,
                robosw_led1, usb_device_led, pci_req1, pci_gnt1, pci_intb,
                pci_req0, pci_gnt0, pcmcia_cd1, pcmcia_cd2, pcmcia_vs1,
                pcmcia_vs2, ebi_cs2, ebi_cs3, spi_cs2, spi_cs3, spi_cs4,
                spi_cs5, uart1 ]

      pins:
        enum: [ gpio0, gpio1, gpio2, gpio3, gpio4, gpio5, gpio6, gpio7,
                gpio8, gpio9, gpio10, gpio11, gpio12, gpio13, gpio14,
                gpio16, gpio17, gpio18, gpio19, gpio20, gpio22, gpio23,
                gpio24, gpio25, gpio26, gpio27, gpio28, gpio29, gpio30,
                gpio31, uart1_grp ]

allOf:
  - $ref: pinctrl.yaml#

required:
  - compatible
  - reg

additionalProperties: false

examples:
  - |
    pinctrl@18 {
      compatible = "brcm,bcm6368-pinctrl";
      reg = <0x18 0x4>, <0x38 0x4>;

      pinctrl_analog_afe_0: analog_afe_0-pins {
        function = "analog_afe_0";
        pins = "gpio0";
      };

      pinctrl_analog_afe_1: analog_afe_1-pins {
        function = "analog_afe_1";
        pins = "gpio1";
      };

      pinctrl_sys_irq: sys_irq-pins {
        function = "sys_irq";
        pins = "gpio2";
      };

      pinctrl_serial_led: serial_led-pins {
        pinctrl_serial_led_data: serial_led_data-pins {
          function = "serial_led_data";
          pins = "gpio3";
        };

        pinctrl_serial_led_clk: serial_led_clk-pins {
          function = "serial_led_clk";
          pins = "gpio4";
        };
      };

      pinctrl_inet_led: inet_led-pins {
        function = "inet_led";
        pins = "gpio5";
      };

      pinctrl_ephy0_led: ephy0_led-pins {
        function = "ephy0_led";
        pins = "gpio6";
      };

      pinctrl_ephy1_led: ephy1_led-pins {
        function = "ephy1_led";
        pins = "gpio7";
      };

      pinctrl_ephy2_led: ephy2_led-pins {
        function = "ephy2_led";
        pins = "gpio8";
      };

      pinctrl_ephy3_led: ephy3_led-pins {
        function = "ephy3_led";
        pins = "gpio9";
      };

      pinctrl_robosw_led_data: robosw_led_data-pins {
        function = "robosw_led_data";
        pins = "gpio10";
      };

      pinctrl_robosw_led_clk: robosw_led_clk-pins {
        function = "robosw_led_clk";
        pins = "gpio11";
      };

      pinctrl_robosw_led0: robosw_led0-pins {
        function = "robosw_led0";
        pins = "gpio12";
      };

      pinctrl_robosw_led1: robosw_led1-pins {
        function = "robosw_led1";
        pins = "gpio13";
      };

      pinctrl_usb_device_led: usb_device_led-pins {
        function = "usb_device_led";
        pins = "gpio14";
      };

      pinctrl_pci: pci-pins {
        pinctrl_pci_req1: pci_req1-pins {
          function = "pci_req1";
          pins = "gpio16";
        };

        pinctrl_pci_gnt1: pci_gnt1-pins {
          function = "pci_gnt1";
          pins = "gpio17";
        };

        pinctrl_pci_intb: pci_intb-pins {
          function = "pci_intb";
          pins = "gpio18";
        };

        pinctrl_pci_req0: pci_req0-pins {
          function = "pci_req0";
          pins = "gpio19";
        };

        pinctrl_pci_gnt0: pci_gnt0-pins {
          function = "pci_gnt0";
          pins = "gpio20";
        };
      };

      pinctrl_pcmcia: pcmcia-pins {
        pinctrl_pcmcia_cd1: pcmcia_cd1-pins {
          function = "pcmcia_cd1";
          pins = "gpio22";
        };

        pinctrl_pcmcia_cd2: pcmcia_cd2-pins {
          function = "pcmcia_cd2";
          pins = "gpio23";
        };

        pinctrl_pcmcia_vs1: pcmcia_vs1-pins {
          function = "pcmcia_vs1";
          pins = "gpio24";
        };

        pinctrl_pcmcia_vs2: pcmcia_vs2-pins {
          function = "pcmcia_vs2";
          pins = "gpio25";
        };
      };

      pinctrl_ebi_cs2: ebi_cs2-pins {
        function = "ebi_cs2";
        pins = "gpio26";
      };

      pinctrl_ebi_cs3: ebi_cs3-pins {
        function = "ebi_cs3";
        pins = "gpio27";
      };

      pinctrl_spi_cs2: spi_cs2-pins {
        function = "spi_cs2";
        pins = "gpio28";
      };

      pinctrl_spi_cs3: spi_cs3-pins {
        function = "spi_cs3";
        pins = "gpio29";
      };

      pinctrl_spi_cs4: spi_cs4-pins {
        function = "spi_cs4";
        pins = "gpio30";
      };

      pinctrl_spi_cs5: spi_cs5-pins {
        function = "spi_cs5";
        pins = "gpio31";
      };

      pinctrl_uart1: uart1-pins {
        function = "uart1";
        group = "uart1_grp";
      };
    };
```

## Documentation/devicetree/bindings/pinctrl/brcm,cygnus-pinmux.txt
```
Broadcom Cygnus IOMUX Controller

The Cygnus IOMUX controller supports group based mux configuration. In
addition, certain pins can be muxed to GPIO function individually.

Required properties:

- compatible:
    Must be "brcm,cygnus-pinmux"

- reg:
    Define the base and range of the I/O address space that contains the Cygnus
IOMUX registers

Properties in subnodes:

- function:
    The mux function to select

- groups:
    The list of groups to select with a given function

For more details, refer to
Documentation/devicetree/bindings/pinctrl/pinctrl-bindings.txt

For example:

	pinmux: pinmux@0x0301d0c8 {
		compatible = "brcm,cygnus-pinmux";
		reg = <0x0301d0c8 0x1b0>;

		pinctrl-names = "default";
		pinctrl-0 = <&i2s0_default>;

		i2s0_default: i2s0_default {
			mux {
				function = "i2s0";
				groups = "i2s0_0_grp", "i2s0_1_grp";
			};
		};
	};

List of supported functions and groups in Cygnus:

"i2s0": "i2s0_0_grp", "i2s0_1_grp"

"i2s1": "i2s1_0_grp", "i2s1_1_grp"

"i2s2": "i2s2_0_grp", "i2s2_1_grp", "i2s2_2_grp", "i2s2_3_grp", "i2s2_4_grp"

"spdif": "spdif_grp"

"pwm0": "pwm0_grp"

"pwm1": "pwm1_grp"

"pwm2": "pwm2_grp"

"pwm3": "pwm3_grp"

"pwm4": "pwm4_grp"

"pwm5": "pwm5_grp"

"key": "key0_grp", "key1_grp", "key2_grp", "key3_grp", "key4_grp", "key5_grp",
"key6_grp", "key7_grp", "key8_grp", "key9_grp", "key10_grp", "key11_grp",
"key12_grp", "key13_grp", "key14_grp", "key15_grp"

"audio_dte": "audio_dte0_grp", "audio_dte1_grp", "audio_dte2_grp", "audio_dte3_grp"

"smart_card0": "smart_card0_grp", "smart_card0_fcb_grp"

"smart_card1": "smart_card1_grp", "smart_card1_fcb_grp"

"spi0": "spi0_grp"

"spi1": "spi1_grp"

"spi2": "spi2_grp"

"spi3": "spi3_grp"

"spi4": "spi4_0_grp", "spi4_1_grp"

"spi5": "spi5_grp"

"sw_led0": "sw_led0_0_grp", "sw_led0_1_grp"

"sw_led1": "sw_led1_grp"

"sw_led2": "sw_led2_0_grp", "sw_led2_1_grp"

"d1w": "d1w_grp"

"lcd": "lcd_grp"

"sram": "sram_0_grp", "sram_1_grp"

"uart0": "uart0_grp"

"uart1": "uart1_grp", "uart1_dte_grp"

"uart2": "uart2_grp"

"uart3": "uart3_grp"

"uart4": "uart4_grp"

"qspi": "qspi_0_grp", "qspi_1_grp"

"nand": "nand_grp"

"sdio0": "sdio0_grp", "sdio0_cd_grp", "sdio0_mmc_grp"

"sdio1": "sdio1_data_0_grp", "sdio1_data_1_grp", "sdio1_cd_grp",
"sdio1_led_grp", "sdio1_mmc_grp"

"can0": "can0_grp"

"can1": "can1_grp"

"cam": "cam_led_grp", "cam_0_grp", "cam_1_grp"

"bsc1": "bsc1_grp"

"pcie_clkreq": "pcie_clkreq_grp"

"usb0_oc": "usb0_oc_grp"

"usb1_oc": "usb1_oc_grp"

"usb2_oc": "usb2_oc_grp"
```
