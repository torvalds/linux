## Documentation/devicetree/bindings/pinctrl/brcm,nsp-gpio.txt
```
Broadcom Northstar plus (NSP) GPIO/PINCONF Controller

Required properties:
- compatible:
    Must be "brcm,nsp-gpio-a"

- reg:
    Should contain the register physical address and length for each of
    GPIO base, IO control registers

- #gpio-cells:
    Must be two. The first cell is the GPIO pin number (within the
    controller's pin space) and the second cell is used for the following:
    bit[0]: polarity (0 for active high and 1 for active low)

- gpio-controller:
    Specifies that the node is a GPIO controller

- ngpios:
    Number of gpios supported (58x25 supports 32 and 58x23 supports 24)

Optional properties:
- interrupts:
    Interrupt ID

- interrupt-controller:
    Specifies that the node is an interrupt controller

- gpio-ranges:
    Specifies the mapping between gpio controller and pin-controllers pins.
    This requires 4 fields in cells defined as -
    1. Phandle of pin-controller.
    2. GPIO base pin offset.
    3  Pin-control base pin offset.
    4. number of gpio pins which are linearly mapped from pin base.

Supported generic PINCONF properties in child nodes:
- pins:
    The list of pins (within the controller's own pin space) that properties
    in the node apply to. Pin names are "gpio-<pin>"

- bias-disable:
    Disable pin bias

- bias-pull-up:
    Enable internal pull up resistor

- bias-pull-down:
    Enable internal pull down resistor

- drive-strength:
    Valid drive strength values include 2, 4, 6, 8, 10, 12, 14, 16 (mA)

Example:

	gpioa: gpio@18000020 {
		compatible = "brcm,nsp-gpio-a";
		reg = <0x18000020 0x100>,
		      <0x1803f1c4 0x1c>;
		#gpio-cells = <2>;
		gpio-controller;
		ngpios = <32>;
		gpio-ranges = <&pinctrl 0 0 31>;
		interrupt-controller;
		interrupts = <GIC_SPI 85 IRQ_TYPE_LEVEL_HIGH>;

		/* Hog a few default settings */
		pinctrl-names = "default";
		pinctrl-0 = <&led>;
		led: led {
			pins = "gpio-1";
			bias-pull-up;
		};

		pwr: pwr {
			gpio-hog;
			gpios = <3 1>;
			output-high;
		};
	};
```

## Documentation/devicetree/bindings/pinctrl/brcm,nsp-pinmux.txt
```
Broadcom NSP (Northstar plus) IOMUX Controller

The NSP IOMUX controller supports group based mux configuration. In
addition, certain pins can be muxed to GPIO function individually.

Required properties:
- compatible:
    Must be "brcm,nsp-pinmux"

- reg:
    Should contain the register physical address and length for each of
    GPIO_CONTROL0, GP_AUX_SEL and IPROC_CONFIG IOMUX registers

Properties in subnodes:
- function:
    The mux function to select

- groups:
    The list of groups to select with a given function

For more details, refer to
Documentation/devicetree/bindings/pinctrl/pinctrl-bindings.txt

For example:

	pinmux: pinmux@1803f1c0 {
		compatible = "brcm,nsp-pinmux";
		reg = <0x1803f1c0 0x04>,
		      <0x18030028 0x04>,
		      <0x1803f408 0x04>;

		pinctrl-names = "default";
		pinctrl-0 = <&pwm &gpio_b &nand_sel>;

		pwm: pwm {
			function = "pwm";
			groups = "pwm0_grp", "pwm1_grp";
		};

		gpio_b: gpio_b {
			function = "gpio_b";
			groups = "gpio_b_0_grp", "gpio_b_1_grp";
		};

		nand_sel: nand_sel {
			function = "nand";
			groups = "nand_grp";
		};
	};

List of supported functions and groups in Northstar Plus:

"spi": "spi_grp"

"i2c": "i2c_grp"

"mdio": "mdio_grp"

"pwm": "pwm0_grp", "pwm1_grp", "pwm2_grp", "pwm3_grp"

"gpio_b": "gpio_b_0_grp", "gpio_b_1_grp", "gpio_b_2_grp", "gpio_b_3_grp"

"uart1": "uart1_grp"

"uart2": "uart2_grp"

"synce": "synce_grp"

"sata_led_grps": "sata0_led_grp", "sata1_led_grp"

"xtal_out": "xtal_out_grp"

"sdio": "sdio_pwr_grp", "sdio_1p8v_grp"

"switch_led": "switch_p05_led0_grp", "switch_p05_led1_grp"

"nand": "nand_grp"

"emmc": "emmc_grp"
```
