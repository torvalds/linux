## Documentation/devicetree/bindings/pinctrl/fsl,imxrt1050.yaml
```yaml
# SPDX-License-Identifier: (GPL-2.0-only OR BSD-2-Clause)
%YAML 1.2
---
$id: http://devicetree.org/schemas/pinctrl/fsl,imxrt1050.yaml#
$schema: http://devicetree.org/meta-schemas/core.yaml#

title: Freescale IMXRT1050 IOMUX Controller

maintainers:
  - Giulio Benetti <giulio.benetti@benettiengineering.com>
  - Jesse Taube <Mr.Bossman075@gmail.com>

description:
  Please refer to fsl,imx-pinctrl.txt and pinctrl-bindings.txt in this directory
  for common binding part and usage.

properties:
  compatible:
    const: fsl,imxrt1050-iomuxc

  reg:
    maxItems: 1

# Client device subnode's properties
patternProperties:
  'grp$':
    type: object
    description:
      Pinctrl node's client devices use subnodes for desired pin configuration.
      Client device subnodes use below standard properties.

    properties:
      fsl,pins:
        description:
          each entry consists of 6 integers and represents the mux and config
          setting for one pin. The first 5 integers <mux_reg conf_reg input_reg
          mux_val input_val> are specified using a PIN_FUNC_ID macro, which can
          be found in <arch/arm/boot/dts/imxrt1050-pinfunc.h>. The last
          integer CONFIG is the pad setting value like pull-up on this pin. Please
          refer to i.MXRT1050 Reference Manual for detailed CONFIG settings.
        $ref: /schemas/types.yaml#/definitions/uint32-matrix
        items:
          items:
            - description: |
                "mux_reg" indicates the offset of mux register.
            - description: |
                "conf_reg" indicates the offset of pad configuration register.
            - description: |
                "input_reg" indicates the offset of select input register.
            - description: |
                "mux_val" indicates the mux value to be applied.
            - description: |
                "input_val" indicates the select input value to be applied.
            - description: |
                "pad_setting" indicates the pad configuration value to be applied.

    required:
      - fsl,pins

    additionalProperties: false

required:
  - compatible
  - reg

additionalProperties: false

examples:
  - |
    iomuxc: iomuxc@401f8000 {
        compatible = "fsl,imxrt1050-iomuxc";
        reg = <0x401f8000 0x4000>;

        pinctrl_lpuart1: lpuart1grp {
            fsl,pins =
              <0x0EC 0x2DC 0x000 0x2 0x0	0xf1>,
              <0x0F0 0x2E0 0x000 0x2 0x0	0xf1>;
        };
    };
```

## Documentation/devicetree/bindings/pinctrl/fsl,imxrt1170.yaml
```yaml
# SPDX-License-Identifier: (GPL-2.0-only OR BSD-2-Clause)
%YAML 1.2
---
$id: http://devicetree.org/schemas/pinctrl/fsl,imxrt1170.yaml#
$schema: http://devicetree.org/meta-schemas/core.yaml#

title: Freescale i.MXRT1170 IOMUX Controller

maintainers:
  - Giulio Benetti <giulio.benetti@benettiengineering.com>
  - Jesse Taube <Mr.Bossman075@gmail.com>

description:
  Please refer to fsl,imx-pinctrl.txt and pinctrl-bindings.txt in this directory
  for common binding part and usage.

properties:
  compatible:
    const: fsl,imxrt1170-iomuxc

  reg:
    maxItems: 1

# Client device subnode's properties
patternProperties:
  'grp$':
    type: object
    description:
      Pinctrl node's client devices use subnodes for desired pin configuration.
      Client device subnodes use below standard properties.

    properties:
      fsl,pins:
        description:
          each entry consists of 6 integers and represents the mux and config
          setting for one pin. The first 5 integers <mux_reg conf_reg input_reg
          mux_val input_val> are specified using a PIN_FUNC_ID macro, which can
          be found in <arch/arm/boot/dts/imxrt1170-pinfunc.h>. The last
          integer CONFIG is the pad setting value like pull-up on this pin. Please
          refer to i.MXRT1170 Reference Manual for detailed CONFIG settings.
        $ref: /schemas/types.yaml#/definitions/uint32-matrix
        items:
          items:
            - description: |
                "mux_reg" indicates the offset of mux register.
            - description: |
                "conf_reg" indicates the offset of pad configuration register.
            - description: |
                "input_reg" indicates the offset of select input register.
            - description: |
                "mux_val" indicates the mux value to be applied.
            - description: |
                "input_val" indicates the select input value to be applied.
            - description: |
                "pad_setting" indicates the pad configuration value to be applied.
    required:
      - fsl,pins

    additionalProperties: false

required:
  - compatible
  - reg

additionalProperties: false

examples:
  - |
    iomuxc: iomuxc@400e8000 {
        compatible = "fsl,imxrt1170-iomuxc";
        reg = <0x400e8000 0x4000>;
        pinctrl_lpuart1: lpuart1grp {
            fsl,pins =
              <0x16C 0x3B0 0x620 0x0 0x0  0xf1>,
              <0x170 0x3B4 0x61C 0x0 0x0	0xf1>;
        };
    };
```

## Documentation/devicetree/bindings/pinctrl/fsl,mxs-pinctrl.txt
```
* Freescale MXS Pin Controller

The pins controlled by mxs pin controller are organized in banks, each bank
has 32 pins.  Each pin has 4 multiplexing functions, and generally, the 4th
function is GPIO.  The configuration on the pins includes drive strength,
voltage and pull-up.

Required properties:
- compatible: "fsl,imx23-pinctrl" or "fsl,imx28-pinctrl"
- reg: Should contain the register physical address and length for the
  pin controller.

Please refer to pinctrl-bindings.txt in this directory for details of the
common pinctrl bindings used by client devices.

The yesde of mxs pin controller acts as a container for an arbitrary number of
subyesdes.  Each of these subyesdes represents some desired configuration for
a group of pins, and only affects those parameters that are explicitly listed.
In other words, a subyesde that describes a drive strength parameter implies yes
information about pull-up. For this reason, even seemingly boolean values are
actually tristates in this binding: unspecified, off, or on. Unspecified is
represented as an absent property, and off/on are represented as integer
values 0 and 1.

Those subyesdes under mxs pin controller yesde will fall into two categories.
One is to set up a group of pins for a function, both mux selection and pin
configurations, and it's called group yesde in the binding document.   The other
one is to adjust the pin configuration for some particular pins that need a
different configuration than what is defined in group yesde.  The binding
document calls this type of yesde config yesde.

On mxs, there is yes hardware pin group. The pin group in this binding only
means a group of pins put together for particular peripheral to work in
particular function, like SSP0 functioning as mmc0-8bit.  That said, the
group yesde should include all the pins needed for one function rather than
having these pins defined in several group yesdes.  It also means each of
"pinctrl-*" phandle in client device yesde should only have one group yesde
pointed in there, while the phandle can have multiple config yesde referenced
there to adjust configurations for some pins in the group.

Required subyesde-properties:
- fsl,pinmux-ids: An integer array.  Each integer in the array specify a pin
  with given mux function, with bank, pin and mux packed as below.

    [15..12] : bank number
    [11..4]  : pin number
    [3..0]   : mux selection

  This integer with mux selection packed is used as an entity by both group
  and config yesdes to identify a pin.  The mux selection in the integer takes
  effects only on group yesde, and will get igyesred by driver with config yesde,
  since config yesde is only meant to set up pin configurations.

  Valid values for these integers are listed below.

- reg: Should be the index of the group yesdes for same function.  This property
  is required only for group yesdes, and should yest be present in any config
  yesdes.

Optional subyesde-properties:
- fsl,drive-strength: Integer.
    0: MXS_DRIVE_4mA
    1: MXS_DRIVE_8mA
    2: MXS_DRIVE_12mA
    3: MXS_DRIVE_16mA
- fsl,voltage: Integer.
    0: MXS_VOLTAGE_LOW  - 1.8 V
    1: MXS_VOLTAGE_HIGH - 3.3 V
- fsl,pull-up: Integer.
    0: MXS_PULL_DISABLE - Disable the internal pull-up
    1: MXS_PULL_ENABLE  - Enable the internal pull-up

Note that when enabling the pull-up, the internal pad keeper gets disabled.
Also, some pins doesn't have a pull up, in that case, setting the fsl,pull-up
will only disable the internal pad keeper.

Examples:

pinctrl@80018000 {
	#address-cells = <1>;
	#size-cells = <0>;
	compatible = "fsl,imx28-pinctrl";
	reg = <0x80018000 2000>;

	mmc0_8bit_pins_a: mmc0-8bit@0 {
		reg = <0>;
		fsl,pinmux-ids = <
			MX28_PAD_SSP0_DATA0__SSP0_D0
			MX28_PAD_SSP0_DATA1__SSP0_D1
			MX28_PAD_SSP0_DATA2__SSP0_D2
			MX28_PAD_SSP0_DATA3__SSP0_D3
			MX28_PAD_SSP0_DATA4__SSP0_D4
			MX28_PAD_SSP0_DATA5__SSP0_D5
			MX28_PAD_SSP0_DATA6__SSP0_D6
			MX28_PAD_SSP0_DATA7__SSP0_D7
			MX28_PAD_SSP0_CMD__SSP0_CMD
			MX28_PAD_SSP0_DETECT__SSP0_CARD_DETECT
			MX28_PAD_SSP0_SCK__SSP0_SCK
		>;
		fsl,drive-strength = <MXS_DRIVE_4mA>;
		fsl,voltage = <MXS_VOLTAGE_HIGH>;
		fsl,pull-up = <MXS_PULL_ENABLE>;
	};

	mmc_cd_cfg: mmc-cd-cfg {
		fsl,pinmux-ids = <MX28_PAD_SSP0_DETECT__SSP0_CARD_DETECT>;
		fsl,pull-up = <MXS_PULL_DISABLE>;
	};

	mmc_sck_cfg: mmc-sck-cfg {
		fsl,pinmux-ids = <MX28_PAD_SSP0_SCK__SSP0_SCK>;
		fsl,drive-strength = <MXS_DRIVE_12mA>;
		fsl,pull-up = <MXS_PULL_DISABLE>;
	};
};

In this example, group yesde mmc0-8bit defines a group of pins for mxs SSP0
to function as a 8-bit mmc device, with 8mA, 3.3V and pull-up configurations
applied on all these pins.  And config yesdes mmc-cd-cfg and mmc-sck-cfg are
adjusting the configuration for pins card-detection and clock from what group
yesde mmc0-8bit defines.  Only the configuration properties to be adjusted need
to be listed in the config yesdes.

Valid values for i.MX28/i.MX23 pinmux-id are defined in
arch/arm/boot/dts/imx28-pinfunc.h and arch/arm/boot/dts/imx23-pinfunc.h.
The definitions for the padconfig properties can be found in
arch/arm/boot/dts/mxs-pinfunc.h.
```

## Documentation/devicetree/bindings/pinctrl/fsl,scu-pinctrl.yaml
```yaml
# SPDX-License-Identifier: (GPL-2.0-only OR BSD-2-Clause)
%YAML 1.2
---
$id: http://devicetree.org/schemas/pinctrl/fsl,scu-pinctrl.yaml#
$schema: http://devicetree.org/meta-schemas/core.yaml#

title: i.MX SCU Client Device Node - Pinctrl bindings based on SCU Message Protocol

maintainers:
  - Dong Aisheng <aisheng.dong@nxp.com>

description: i.MX SCU Client Device Node
  Client nodes are maintained as children of the relevant IMX-SCU device node.
  This binding uses the i.MX common pinctrl binding.
  (Documentation/devicetree/bindings/pinctrl/fsl,imx-pinctrl.txt)

allOf:
  - $ref: pinctrl.yaml#

properties:
  compatible:
    enum:
      - fsl,imx8qm-iomuxc
      - fsl,imx8qxp-iomuxc
      - fsl,imx8dxl-iomuxc

patternProperties:
  'grp$':
    type: object
    description:
      Pinctrl node's client devices use subnodes for desired pin configuration.
      Client device subnodes use below standard properties.

    properties:
      fsl,pins:
        description:
          each entry consists of 3 integers and represents the pin ID, the mux value
          and pad setting for the pin. The first 2 integers - pin_id and mux_val - are
          specified using a PIN_FUNC_ID macro, which can be found in
          <include/dt-bindings/pinctrl/pads-imx8qxp.h>. The last integer is
          the pad setting value like pull-up on this pin. Please refer to the
          appropriate i.MX8 Reference Manual for detailed pad CONFIG settings.
        $ref: /schemas/types.yaml#/definitions/uint32-matrix
        items:
          items:
            - description: |
                "pin_id" indicates the pin ID
            - description: |
                "mux_val" indicates the mux value to be applied.
            - description: |
                "pad_setting" indicates the pad configuration value to be applied.

    required:
      - fsl,pins

    additionalProperties: false

required:
  - compatible

additionalProperties: false

examples:
  - |
    pinctrl {
        compatible = "fsl,imx8qxp-iomuxc";

        pinctrl_lpuart0: lpuart0grp {
            fsl,pins = <
                111 0 0x06000020
                112 0 0x06000020
            >;
        };
    };
```

## Documentation/devicetree/bindings/pinctrl/fsl,vf610-iomuxc.yaml
```yaml
# SPDX-License-Identifier: (GPL-2.0-only OR BSD-2-Clause)
%YAML 1.2
---
$id: http://devicetree.org/schemas/pinctrl/fsl,vf610-iomuxc.yaml#
$schema: http://devicetree.org/meta-schemas/core.yaml#

title: Freescale Vybrid VF610 IOMUX Controller

description:
  Please refer to fsl,imx-pinctrl.txt in this directory for common binding part
  and usage.

maintainers:
  - Frank Li <Frank.Li@nxp.com>

properties:
  compatible:
    const: fsl,vf610-iomuxc

  reg:
    maxItems: 1

patternProperties:
  'grp$':
    type: object
    description:
      Pinctrl node's client devices use subnodes for desired pin configuration.
      Client device subnodes use below standard properties.

    properties:
      fsl,pins:
        description:
          two integers array, represents a group of pins mux and config setting.
          The format is fsl,pins = <PIN_FUNC_ID CONFIG>, PIN_FUNC_ID is a pin
          working on a specific function, CONFIG is the pad setting value such
          as pull-up, speed, ode for this pin. Please refer to Vybrid VF610
          datasheet for the valid pad config settings.
        $ref: /schemas/types.yaml#/definitions/uint32-matrix
        items:
          items:
            - description:
                PIN_FUN_ID refer to vf610-pinfunc.h in device tree source folder
                for all available PIN_FUNC_ID for Vybrid VF610.
            - description: |
                CONFIG bits definition is
                PAD_CTL_SPEED_LOW               (1 << 12)
                PAD_CTL_SPEED_MED               (2 << 12)
                PAD_CTL_SPEED_HIGH              (3 << 12)
                PAD_CTL_SRE_FAST                (1 << 11)
                PAD_CTL_SRE_SLOW                (0 << 11)
                PAD_CTL_ODE                     (1 << 10)
                PAD_CTL_HYS                     (1 << 9)
                PAD_CTL_DSE_DISABLE             (0 << 6)
                PAD_CTL_DSE_150ohm              (1 << 6)
                PAD_CTL_DSE_75ohm               (2 << 6)
                PAD_CTL_DSE_50ohm               (3 << 6)
                PAD_CTL_DSE_37ohm               (4 << 6)
                PAD_CTL_DSE_30ohm               (5 << 6)
                PAD_CTL_DSE_25ohm               (6 << 6)
                PAD_CTL_DSE_20ohm               (7 << 6)
                PAD_CTL_PUS_100K_DOWN           (0 << 4)
                PAD_CTL_PUS_47K_UP              (1 << 4)
                PAD_CTL_PUS_100K_UP             (2 << 4)
                PAD_CTL_PUS_22K_UP              (3 << 4)
                PAD_CTL_PKE                     (1 << 3)
                PAD_CTL_PUE                     (1 << 2)
                PAD_CTL_OBE_ENABLE              (1 << 1)
                PAD_CTL_IBE_ENABLE              (1 << 0)
                PAD_CTL_OBE_IBE_ENABLE          (3 << 0)

    required:
      - fsl,pins

    additionalProperties: false

required:
  - compatible
  - reg

allOf:
  - $ref: pinctrl.yaml#

unevaluatedProperties: false
```
