## Documentation/devicetree/bindings/cpufreq/cpufreq-st.txt
```
Binding for ST's CPUFreq driver
===============================

ST's CPUFreq driver attempts to read 'process' and 'version' attributes
from the SoC, then supplies the OPP framework with 'prop' and 'supported
hardware' information respectively.  The framework is then able to read
the DT and operate in the usual way.

For more information about the expected DT format [See: ../opp/opp.txt].

Frequency Scaling only
----------------------

No vendor specific driver required for this.

Located in CPU's node:

- operating-points		: [See: ../power/opp.txt]

Example [safe]
--------------

cpus {
	cpu@0 {
				 /* kHz     uV   */
		operating-points = <1500000 0
				    1200000 0
				    800000  0
				    500000  0>;
	};
};

Dynamic Voltage and Frequency Scaling (DVFS)
--------------------------------------------

This requires the ST CPUFreq driver to supply 'process' and 'version' info.

Located in CPU's node:

- operating-points-v2		: [See ../power/opp.txt]

Example [unsafe]
----------------

cpus {
	cpu@0 {
		operating-points-v2	= <&cpu0_opp_table>;
	};
};

cpu0_opp_table: opp_table {
	compatible = "operating-points-v2";

	/* ############################################################### */
	/* # WARNING: Do not attempt to copy/replicate these nodes,      # */
	/* #          they are only to be supplied by the bootloader !!! # */
	/* ############################################################### */
	opp0 {
		/*			   Major       Minor       Substrate */
		/*			   2           all         all       */
		opp-supported-hw	= <0x00000004  0xffffffff  0xffffffff>;
		opp-hz			= /bits/ 64 <1500000000>;
		clock-latency-ns	= <10000000>;

		opp-microvolt-pcode0	= <1200000>;
		opp-microvolt-pcode1	= <1200000>;
		opp-microvolt-pcode2	= <1200000>;
		opp-microvolt-pcode3	= <1200000>;
		opp-microvolt-pcode4	= <1170000>;
		opp-microvolt-pcode5	= <1140000>;
		opp-microvolt-pcode6	= <1100000>;
		opp-microvolt-pcode7	= <1070000>;
	};

	opp1 {
		/*			   Major       Minor       Substrate */
		/*			   all         all         all       */
		opp-supported-hw	= <0xffffffff  0xffffffff  0xffffffff>;
		opp-hz			= /bits/ 64 <1200000000>;
		clock-latency-ns	= <10000000>;

		opp-microvolt-pcode0	= <1110000>;
		opp-microvolt-pcode1	= <1150000>;
		opp-microvolt-pcode2	= <1100000>;
		opp-microvolt-pcode3	= <1080000>;
		opp-microvolt-pcode4	= <1040000>;
		opp-microvolt-pcode5	= <1020000>;
		opp-microvolt-pcode6	= <980000>;
		opp-microvolt-pcode7	= <930000>;
	};
};
```

## Documentation/devicetree/bindings/cpufreq/imx-cpufreq-dt.txt
```
i.MX CPUFreq-DT OPP bindings
================================

Certain i.MX SoCs support different OPPs depending on the "market segment" and
"speed grading" value which are written in fuses. These bits are combined with
the opp-supported-hw values for each OPP to check if the OPP is allowed.

Required properties:
--------------------

For each opp entry in 'operating-points-v2' table:
- opp-supported-hw: Two bitmaps indicating:
  - Supported speed grade mask
  - Supported market segment mask
    0: Consumer
    1: Extended Consumer
    2: Industrial
    3: Automotive

Example:
--------

opp_table {
	compatible = "operating-points-v2";
	opp-1000000000 {
		opp-hz = /bits/ 64 <1000000000>;
		/* grade >= 0, consumer only */
		opp-supported-hw = <0xf>, <0x3>;
	};

	opp-1300000000 {
		opp-hz = /bits/ 64 <1300000000>;
		opp-microvolt = <1000000>;
		/* grade >= 1, all segments */
		opp-supported-hw = <0xe>, <0x7>;
	};
}
```

## Documentation/devicetree/bindings/cpufreq/mediatek,mt8196-cpufreq-hw.yaml
```yaml
# SPDX-License-Identifier: (GPL-2.0-only OR BSD-2-Clause)
%YAML 1.2
---
$id: http://devicetree.org/schemas/cpufreq/mediatek,mt8196-cpufreq-hw.yaml#
$schema: http://devicetree.org/meta-schemas/core.yaml#

title: MediaTek Hybrid CPUFreq for MT8196/MT6991 series SoCs

maintainers:
  - Nicolas Frattaroli <nicolas.frattaroli@collabora.com>

description:
  MT8196 uses CPUFreq management hardware that supports dynamic voltage
  frequency scaling (dvfs), and can support several performance domains.

properties:
  compatible:
    const: mediatek,mt8196-cpufreq-hw

  reg:
    items:
      - description: FDVFS control register region
      - description: OPP tables and control for performance domain 0
      - description: OPP tables and control for performance domain 1
      - description: OPP tables and control for performance domain 2

  "#performance-domain-cells":
    const: 1

required:
  - compatible
  - reg
  - "#performance-domain-cells"

additionalProperties: false

examples:
  - |
    cpus {
            #address-cells = <1>;
            #size-cells = <0>;

            cpu0: cpu@0 {
                device_type = "cpu";
                compatible = "arm,cortex-a720";
                enable-method = "psci";
                performance-domains = <&performance 0>;
                reg = <0x000>;
            };

            /* ... */

            cpu6: cpu@600 {
                device_type = "cpu";
                compatible = "arm,cortex-x4";
                enable-method = "psci";
                performance-domains = <&performance 1>;
                reg = <0x600>;
            };

            cpu7: cpu@700 {
                device_type = "cpu";
                compatible = "arm,cortex-x925";
                enable-method = "psci";
                performance-domains = <&performance 2>;
                reg = <0x700>;
            };
    };

    /* ... */

    soc {
        #address-cells = <2>;
        #size-cells = <2>;

        performance: performance-controller@c2c2034 {
            compatible = "mediatek,mt8196-cpufreq-hw";
            reg = <0 0xc220400 0 0x20>, <0 0xc2c0f20 0 0x120>,
                  <0 0xc2c1040 0 0x120>, <0 0xc2c1160 0 0x120>;
            #performance-domain-cells = <1>;
        };
    };
```

## Documentation/devicetree/bindings/cpufreq/nvidia,tegra124-cpufreq.txt
```
Tegra124 CPU frequency scaling driver bindings
----------------------------------------------

Both required and optional properties listed below must be defined
under node /cpus/cpu@0.

Required properties:
- clocks: Must contain an entry for each entry in clock-names.
  See ../clocks/clock-bindings.txt for details.
- clock-names: Must include the following entries:
  - cpu_g: Clock mux for the fast CPU cluster.
  - pll_x: Fast PLL clocksource.
  - pll_p: Auxiliary PLL used during fast PLL rate changes.
  - dfll: Fast DFLL clocksource that also automatically scales CPU voltage.

Optional properties:
- clock-latency: Specify the possible maximum transition latency for clock,
  in unit of nanoseconds.

Example:
--------
cpus {
	#address-cells = <1>;
	#size-cells = <0>;

	cpu@0 {
		device_type = "cpu";
		compatible = "arm,cortex-a15";
		reg = <0>;

		clocks = <&tegra_car TEGRA124_CLK_CCLK_G>,
			 <&tegra_car TEGRA124_CLK_PLL_X>,
			 <&tegra_car TEGRA124_CLK_PLL_P>,
			 <&dfll>;
		clock-names = "cpu_g", "pll_x", "pll_p", "dfll";
		clock-latency = <300000>;
	};

	<...>
};
```

## Documentation/devicetree/bindings/cpufreq/nvidia,tegra20-cpufreq.txt
```
Binding for NVIDIA Tegra20 CPUFreq
==================================

Required properties:
- clocks: Must contain an entry for the CPU clock.
  See ../clocks/clock-bindings.txt for details.
- operating-points-v2: See ../bindings/opp/opp.txt for details.
- #cooling-cells: Should be 2. See ../thermal/thermal-cooling-devices.yaml for details.

For each opp entry in 'operating-points-v2' table:
- opp-supported-hw: Two bitfields indicating:
	On Tegra20:
	1. CPU process ID mask
	2. SoC speedo ID mask

	On Tegra30:
	1. CPU process ID mask
	2. CPU speedo ID mask

	A bitwise AND is performed against these values and if any bit
	matches, the OPP gets enabled.

- opp-microvolt: CPU voltage triplet.

Optional properties:
- cpu-supply: Phandle to the CPU power supply.

Example:
	regulators {
		cpu_reg: regulator0 {
			regulator-name = "vdd_cpu";
		};
	};

	cpu0_opp_table: opp_table0 {
		compatible = "operating-points-v2";

		opp@456000000 {
			clock-latency-ns = <125000>;
			opp-microvolt = <825000 825000 1125000>;
			opp-supported-hw = <0x03 0x0001>;
			opp-hz = /bits/ 64 <456000000>;
		};

		...
	};

	cpus {
		cpu@0 {
			compatible = "arm,cortex-a9";
			clocks = <&tegra_car TEGRA20_CLK_CCLK>;
			operating-points-v2 = <&cpu0_opp_table>;
			cpu-supply = <&cpu_reg>;
			#cooling-cells = <2>;
		};
	};
```

## Documentation/devicetree/bindings/cpufreq/qcom,shikra-epss.yaml
```yaml
# SPDX-License-Identifier: GPL-2.0-only OR BSD-2-Clause
%YAML 1.2
---
$id: http://devicetree.org/schemas/cpufreq/qcom,shikra-epss.yaml#
$schema: http://devicetree.org/meta-schemas/core.yaml#

title: Qualcomm Shikra SoC EPSS

maintainers:
  - Imran Shaik <imran.shaik@oss.qualcomm.com>
  - Taniya Das <taniya.das@oss.qualcomm.com>

description: |
  EPSS is a hardware engine used by some Qualcomm SoCs to manage
  frequency in hardware. It is capable of controlling frequency for
  multiple clusters.

  The Qualcomm Shikra SoC EPSS supports up to 12 frequency lookup table
  (LUT) entries.

properties:
  compatible:
    enum:
      - qcom,shikra-epss

  reg:
    items:
      - description: Frequency domain 0 register region
      - description: Frequency domain 1 register region

  reg-names:
    items:
      - const: freq-domain0
      - const: freq-domain1

  clocks:
    items:
      - description: XO Clock
      - description: GPLL0 Clock

  clock-names:
    items:
      - const: xo
      - const: alternate

  interrupts:
    items:
      - description: IRQ line for DCVSH 0
      - description: IRQ line for DCVSH 1

  interrupt-names:
    items:
      - const: dcvsh-irq-0
      - const: dcvsh-irq-1

  '#freq-domain-cells':
    const: 1

  '#clock-cells':
    const: 1

required:
  - compatible
  - reg
  - clocks
  - clock-names
  - interrupts
  - interrupt-names
  - '#freq-domain-cells'
  - '#clock-cells'

additionalProperties: false

examples:
  - |
    #include <dt-bindings/clock/qcom,rpmcc.h>
    #include <dt-bindings/interrupt-controller/arm-gic.h>

    soc {
      #address-cells = <1>;
      #size-cells = <1>;

      cpufreq@fd91000 {
        compatible = "qcom,shikra-epss";
        reg = <0x0fd91000 0x1000>, <0x0fd92000 0x1000>;
        reg-names = "freq-domain0", "freq-domain1";
        clocks = <&rpmcc RPM_SMD_XO_CLK_SRC>, <&gpll0>;
        clock-names = "xo", "alternate";
        interrupts = <GIC_SPI 30 IRQ_TYPE_LEVEL_HIGH>,
                     <GIC_SPI 31 IRQ_TYPE_LEVEL_HIGH>;
        interrupt-names = "dcvsh-irq-0", "dcvsh-irq-1";
        #freq-domain-cells = <1>;
        #clock-cells = <1>;
      };
    };
...
```

## Documentation/devicetree/bindings/cpufreq/qcom-cpufreq-nvmem.yaml
```yaml
# SPDX-License-Identifier: (GPL-2.0-only OR BSD-2-Clause)
%YAML 1.2
---
$id: http://devicetree.org/schemas/cpufreq/qcom-cpufreq-nvmem.yaml#
$schema: http://devicetree.org/meta-schemas/core.yaml#

title: Qualcomm Technologies, Inc. NVMEM CPUFreq

maintainers:
  - Ilia Lin <ilia.lin@kernel.org>

description: |
  In certain Qualcomm Technologies, Inc. SoCs such as QCS404, The CPU supply
  voltage is dynamically configured by Core Power Reduction (CPR) depending on
  current CPU frequency and efuse values.
  CPR provides a power domain with multiple levels that are selected depending
  on the CPU OPP in use. The CPUFreq driver sets the CPR power domain level
  according to the required OPPs defined in the CPU OPP tables.

select:
  properties:
    compatible:
      contains:
        enum:
          - qcom,apq8064
          - qcom,apq8096
          - qcom,ipq8064
          - qcom,msm8939
          - qcom,msm8960
          - qcom,msm8974
          - qcom,msm8996
          - qcom,qcs404
  required:
    - compatible

properties:
  cpus:
    type: object

    patternProperties:
      '^cpu@[0-9a-f]+$':
        type: object

        properties:
          power-domains:
            maxItems: 1

          power-domain-names:
            items:
              - const: cpr

        required:
          - power-domains
          - power-domain-names

patternProperties:
  '^opp-table(-[a-z0-9]+)?$':
    if:
      properties:
        compatible:
          const: operating-points-v2-kryo-cpu
    then:
      patternProperties:
        '^opp-?[0-9]+$':
          required:
            - required-opps

additionalProperties: true

examples:
  - |
    / {
        model = "Qualcomm Technologies, Inc. QCS404 EVB 1000";
        compatible = "qcom,qcs404-evb-1000", "qcom,qcs404-evb", "qcom,qcs404";
        #address-cells = <2>;
        #size-cells = <2>;

        cpus {
            #address-cells = <1>;
            #size-cells = <0>;

            CPU0: cpu@100 {
                device_type = "cpu";
                compatible = "arm,cortex-a53";
                reg = <0x100>;
                enable-method = "psci";
                cpu-idle-states = <&CPU_SLEEP_0>;
                next-level-cache = <&L2_0>;
                #cooling-cells = <2>;
                clocks = <&apcs_glb>;
                operating-points-v2 = <&cpu_opp_table>;
                power-domains = <&cpr>;
                power-domain-names = "cpr";
            };

            CPU1: cpu@101 {
                device_type = "cpu";
                compatible = "arm,cortex-a53";
                reg = <0x101>;
                enable-method = "psci";
                cpu-idle-states = <&CPU_SLEEP_0>;
                next-level-cache = <&L2_0>;
                #cooling-cells = <2>;
                clocks = <&apcs_glb>;
                operating-points-v2 = <&cpu_opp_table>;
                power-domains = <&cpr>;
                power-domain-names = "cpr";
            };

            CPU2: cpu@102 {
                device_type = "cpu";
                compatible = "arm,cortex-a53";
                reg = <0x102>;
                enable-method = "psci";
                cpu-idle-states = <&CPU_SLEEP_0>;
                next-level-cache = <&L2_0>;
                #cooling-cells = <2>;
                clocks = <&apcs_glb>;
                operating-points-v2 = <&cpu_opp_table>;
                power-domains = <&cpr>;
                power-domain-names = "cpr";
            };

            CPU3: cpu@103 {
                device_type = "cpu";
                compatible = "arm,cortex-a53";
                reg = <0x103>;
                enable-method = "psci";
                cpu-idle-states = <&CPU_SLEEP_0>;
                next-level-cache = <&L2_0>;
                #cooling-cells = <2>;
                clocks = <&apcs_glb>;
                operating-points-v2 = <&cpu_opp_table>;
                power-domains = <&cpr>;
                power-domain-names = "cpr";
            };
        };

        cpu_opp_table: opp-table-cpu {
            compatible = "operating-points-v2-kryo-cpu";
            opp-shared;

            opp-1094400000 {
                opp-hz = /bits/ 64 <1094400000>;
                required-opps = <&cpr_opp1>;
            };
            opp-1248000000 {
                opp-hz = /bits/ 64 <1248000000>;
                required-opps = <&cpr_opp2>;
            };
            opp-1401600000 {
                opp-hz = /bits/ 64 <1401600000>;
                required-opps = <&cpr_opp3>;
            };
        };

        cpr_opp_table: opp-table-cpr {
            compatible = "operating-points-v2-qcom-level";

            cpr_opp1: opp1 {
                opp-level = <1>;
                qcom,opp-fuse-level = <1>;
            };
            cpr_opp2: opp2 {
                opp-level = <2>;
                qcom,opp-fuse-level = <2>;
            };
            cpr_opp3: opp3 {
                opp-level = <3>;
                qcom,opp-fuse-level = <3>;
            };
        };
    };
```
