## Documentation/devicetree/bindings/cpufreq/qemu,virtual-cpufreq.yaml
```yaml
# SPDX-License-Identifier: GPL-2.0-only OR BSD-2-Clause
%YAML 1.2
---
$id: http://devicetree.org/schemas/cpufreq/qemu,virtual-cpufreq.yaml#
$schema: http://devicetree.org/meta-schemas/core.yaml#

title: Virtual CPUFreq

maintainers:
  - David Dai <davidai@google.com>
  - Saravana Kannan <saravanak@google.com>

description:
  Virtual CPUFreq is a virtualized driver in guest kernels that sends performance
  selection of its vCPUs as a hint to the host through MMIO regions. Each vCPU
  is associated with a performance domain which can be shared with other vCPUs.
  Each performance domain has its own set of registers for performance controls.

properties:
  compatible:
    const: qemu,virtual-cpufreq

  reg:
    maxItems: 1
    description:
      Address and size of region containing performance controls for each of the
      performance domains. Regions for each performance domain is placed
      contiguously and contain registers for controlling DVFS(Dynamic Frequency
      and Voltage) characteristics. The size of the region is proportional to
      total number of performance domains.

required:
  - compatible
  - reg

additionalProperties: false

examples:
  - |
    soc {
      #address-cells = <1>;
      #size-cells = <1>;

      cpufreq@1040000 {
        compatible = "qemu,virtual-cpufreq";
        reg = <0x1040000 0x2000>;
      };
    };
```

## Documentation/devicetree/bindings/cpufreq/ti-cpufreq.txt
```
TI CPUFreq and OPP bindings
================================

Certain TI SoCs, like those in the am335x, am437x, am57xx, and dra7xx
families support different OPPs depending on the silicon variant in use.
The ti-cpufreq driver can use revision and an efuse value from the SoC to
provide the OPP framework with supported hardware information. This is
used to determine which OPPs from the operating-points-v2 table get enabled
when it is parsed by the OPP framework.

Required properties:
--------------------
In 'cpus' nodes:
- operating-points-v2: Phandle to the operating-points-v2 table to use.

In 'operating-points-v2' table:
- compatible: Should be
	- 'operating-points-v2-ti-cpu' for am335x, am43xx, and dra7xx/am57xx,
	  omap34xx, omap36xx and am3517 SoCs
- syscon: A phandle pointing to a syscon node representing the control module
	  register space of the SoC.

Optional properties:
--------------------
- "vdd-supply", "vbb-supply": to define two regulators for dra7xx
- "cpu0-supply", "vbb-supply": to define two regulators for omap36xx

For each opp entry in 'operating-points-v2' table:
- opp-supported-hw: Two bitfields indicating:
	1. Which revision of the SoC the OPP is supported by
	2. Which eFuse bits indicate this OPP is available

	A bitwise AND is performed against these values and if any bit
	matches, the OPP gets enabled.

Example:
--------

/* From arch/arm/boot/dts/am33xx.dtsi */
cpus {
	#address-cells = <1>;
	#size-cells = <0>;
	cpu@0 {
		compatible = "arm,cortex-a8";
		device_type = "cpu";
		reg = <0>;

		operating-points-v2 = <&cpu0_opp_table>;

		clocks = <&dpll_mpu_ck>;
		clock-names = "cpu";

		clock-latency = <300000>; /* From omap-cpufreq driver */
	};
};

/*
 * cpu0 has different OPPs depending on SoC revision and some on revisions
 * 0x2 and 0x4 have eFuse bits that indicate if they are available or not
 */
cpu0_opp_table: opp-table {
	compatible = "operating-points-v2-ti-cpu";
	syscon = <&scm_conf>;

	/*
	 * The three following nodes are marked with opp-suspend
	 * because they can not be enabled simultaneously on a
	 * single SoC.
	 */
	opp50-300000000 {
		opp-hz = /bits/ 64 <300000000>;
		opp-microvolt = <950000 931000 969000>;
		opp-supported-hw = <0x06 0x0010>;
		opp-suspend;
	};

	opp100-275000000 {
		opp-hz = /bits/ 64 <275000000>;
		opp-microvolt = <1100000 1078000 1122000>;
		opp-supported-hw = <0x01 0x00FF>;
		opp-suspend;
	};

	opp100-300000000 {
		opp-hz = /bits/ 64 <300000000>;
		opp-microvolt = <1100000 1078000 1122000>;
		opp-supported-hw = <0x06 0x0020>;
		opp-suspend;
	};

	opp100-500000000 {
		opp-hz = /bits/ 64 <500000000>;
		opp-microvolt = <1100000 1078000 1122000>;
		opp-supported-hw = <0x01 0xFFFF>;
	};

	opp100-600000000 {
		opp-hz = /bits/ 64 <600000000>;
		opp-microvolt = <1100000 1078000 1122000>;
		opp-supported-hw = <0x06 0x0040>;
	};

	opp120-600000000 {
		opp-hz = /bits/ 64 <600000000>;
		opp-microvolt = <1200000 1176000 1224000>;
		opp-supported-hw = <0x01 0xFFFF>;
	};

	opp120-720000000 {
		opp-hz = /bits/ 64 <720000000>;
		opp-microvolt = <1200000 1176000 1224000>;
		opp-supported-hw = <0x06 0x0080>;
	};

	oppturbo-720000000 {
		opp-hz = /bits/ 64 <720000000>;
		opp-microvolt = <1260000 1234800 1285200>;
		opp-supported-hw = <0x01 0xFFFF>;
	};

	oppturbo-800000000 {
		opp-hz = /bits/ 64 <800000000>;
		opp-microvolt = <1260000 1234800 1285200>;
		opp-supported-hw = <0x06 0x0100>;
	};

	oppnitro-1000000000 {
		opp-hz = /bits/ 64 <1000000000>;
		opp-microvolt = <1325000 1298500 1351500>;
		opp-supported-hw = <0x04 0x0200>;
	};
};
```

## Documentation/devicetree/bindings/cris/axis.txt
```
Axis Communications AB
ARTPEC series SoC Device Tree Bindings


CRISv32 based SoCs are ETRAX FS and ARTPEC-3:

    - compatible = "axis,crisv32";
```

## Documentation/devicetree/bindings/cris/boards.txt
```
Boards based on the CRIS SoCs:

Required root node properties:
    - compatible = should be one or more of the following:
	- "axis,dev88"	- for Axis devboard 88 with ETRAX FS

Optional:
```

## Documentation/devicetree/bindings/crypto/allwinner,sun4i-a10-crypto.yaml
```yaml
# SPDX-License-Identifier: GPL-2.0
%YAML 1.2
---
$id: http://devicetree.org/schemas/crypto/allwinner,sun4i-a10-crypto.yaml#
$schema: http://devicetree.org/meta-schemas/core.yaml#

title: Allwinner A10 Security System Device Tree Bindings

maintainers:
  - Chen-Yu Tsai <wens@csie.org>
  - Maxime Ripard <mripard@kernel.org>

properties:
  compatible:
    oneOf:
      - const: allwinner,sun4i-a10-crypto
      - items:
          - const: allwinner,sun5i-a13-crypto
          - const: allwinner,sun4i-a10-crypto
      - items:
          - const: allwinner,sun6i-a31-crypto
          - const: allwinner,sun4i-a10-crypto
      - items:
          - const: allwinner,sun7i-a20-crypto
          - const: allwinner,sun4i-a10-crypto
      - const: allwinner,sun8i-a33-crypto
      - items:
          - const: allwinner,sun8i-v3s-crypto
          - const: allwinner,sun8i-a33-crypto

  reg:
    maxItems: 1

  interrupts:
    maxItems: 1

  clocks:
    items:
      - description: Bus Clock
      - description: Module Clock

  clock-names:
    items:
      - const: ahb
      - const: mod

  dmas:
    items:
      - description: RX DMA Channel
      - description: TX DMA Channel

  dma-names:
    items:
      - const: rx
      - const: tx

  resets:
    maxItems: 1

  reset-names:
    const: ahb

required:
  - compatible
  - reg
  - interrupts
  - clocks
  - clock-names

if:
  properties:
    compatible:
      contains:
        enum:
          - allwinner,sun6i-a31-crypto
          - allwinner,sun8i-a33-crypto

then:
  required:
    - resets
    - reset-names

additionalProperties: false

examples:
  - |
    crypto: crypto-engine@1c15000 {
      compatible = "allwinner,sun4i-a10-crypto";
      reg = <0x01c15000 0x1000>;
      interrupts = <86>;
      clocks = <&ahb_gates 5>, <&ss_clk>;
      clock-names = "ahb", "mod";
    };

...
```

## Documentation/devicetree/bindings/crypto/allwinner,sun8i-ce.yaml
```yaml
# SPDX-License-Identifier: GPL-2.0
%YAML 1.2
---
$id: http://devicetree.org/schemas/crypto/allwinner,sun8i-ce.yaml#
$schema: http://devicetree.org/meta-schemas/core.yaml#

title: Allwinner Crypto Engine driver

maintainers:
  - Corentin Labbe <clabbe.montjoie@gmail.com>

properties:
  compatible:
    enum:
      - allwinner,sun8i-h3-crypto
      - allwinner,sun8i-r40-crypto
      - allwinner,sun50i-a64-crypto
      - allwinner,sun50i-h5-crypto
      - allwinner,sun50i-h6-crypto

  reg:
    maxItems: 1

  interrupts:
    maxItems: 1

  clocks:
    items:
      - description: Bus clock
      - description: Module clock
      - description: MBus clock
    minItems: 2
    maxItems: 3

  clock-names:
    items:
      - const: bus
      - const: mod
      - const: ram
    minItems: 2
    maxItems: 3

  resets:
    maxItems: 1

if:
  properties:
    compatible:
      items:
        const: allwinner,sun50i-h6-crypto
then:
  properties:
      clocks:
        minItems: 3
      clock-names:
        minItems: 3
else:
  properties:
      clocks:
        maxItems: 2
      clock-names:
        maxItems: 2

required:
  - compatible
  - reg
  - interrupts
  - clocks
  - clock-names
  - resets

additionalProperties: false

examples:
  - |
    #include <dt-bindings/interrupt-controller/arm-gic.h>
    #include <dt-bindings/clock/sun50i-a64-ccu.h>
    #include <dt-bindings/reset/sun50i-a64-ccu.h>

    crypto: crypto@1c15000 {
      compatible = "allwinner,sun8i-h3-crypto";
      reg = <0x01c15000 0x1000>;
      interrupts = <GIC_SPI 94 IRQ_TYPE_LEVEL_HIGH>;
      clocks = <&ccu CLK_BUS_CE>, <&ccu CLK_CE>;
      clock-names = "bus", "mod";
      resets = <&ccu RST_BUS_CE>;
    };
```

## Documentation/devicetree/bindings/crypto/allwinner,sun8i-ss.yaml
```yaml
# SPDX-License-Identifier: GPL-2.0
%YAML 1.2
---
$id: http://devicetree.org/schemas/crypto/allwinner,sun8i-ss.yaml#
$schema: http://devicetree.org/meta-schemas/core.yaml#

title: Allwinner Security System v2 driver

maintainers:
  - Corentin Labbe <corentin.labbe@gmail.com>

properties:
  compatible:
    enum:
      - allwinner,sun8i-a83t-crypto
      - allwinner,sun9i-a80-crypto

  reg:
    maxItems: 1

  interrupts:
    maxItems: 1

  clocks:
    items:
      - description: Bus clock
      - description: Module clock

  clock-names:
    items:
      - const: bus
      - const: mod

  resets:
    maxItems: 1

required:
  - compatible
  - reg
  - interrupts
  - clocks
  - clock-names
  - resets

additionalProperties: false

examples:
  - |
    #include <dt-bindings/interrupt-controller/arm-gic.h>
    #include <dt-bindings/clock/sun8i-a83t-ccu.h>
    #include <dt-bindings/reset/sun8i-a83t-ccu.h>

    crypto: crypto@1c15000 {
      compatible = "allwinner,sun8i-a83t-crypto";
      reg = <0x01c15000 0x1000>;
      interrupts = <GIC_SPI 94 IRQ_TYPE_LEVEL_HIGH>;
      resets = <&ccu RST_BUS_SS>;
      clocks = <&ccu CLK_BUS_SS>, <&ccu CLK_SS>;
      clock-names = "bus", "mod";
    };
```

## Documentation/devicetree/bindings/crypto/amd,ccp-seattle-v1a.yaml
```yaml
# SPDX-License-Identifier: (GPL-2.0-only OR BSD-2-Clause)
%YAML 1.2
---
$id: http://devicetree.org/schemas/amd,ccp-seattle-v1a.yaml#
$schema: http://devicetree.org/meta-schemas/core.yaml#

title: AMD Cryptographic Coprocessor (ccp)

maintainers:
  - Tom Lendacky <thomas.lendacky@amd.com>

properties:
  compatible:
    const: amd,ccp-seattle-v1a

  reg:
    maxItems: 1

  interrupts:
    maxItems: 1

  dma-coherent: true

required:
  - compatible
  - reg
  - interrupts

additionalProperties: false

examples:
  - |
    crypto@e0100000 {
        compatible = "amd,ccp-seattle-v1a";
        reg = <0xe0100000 0x10000>;
        interrupts = <0 3 4>;
        dma-coherent;
    };
```
