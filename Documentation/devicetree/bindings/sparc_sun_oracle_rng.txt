## Documentation/devicetree/bindings/spi/andestech,ae350-spi.yaml
```yaml
# SPDX-License-Identifier: (GPL-2.0-only OR BSD-2-Clause)
%YAML 1.2
---
$id: http://devicetree.org/schemas/spi/andestech,ae350-spi.yaml#
$schema: http://devicetree.org/meta-schemas/core.yaml#

title: Andes ATCSPI200 SPI controller

maintainers:
  - CL Wang <cl634@andestech.com>

properties:
  compatible:
    oneOf:
      - items:
          - enum:
              - andestech,qilai-spi
          - const: andestech,ae350-spi
      - const: andestech,ae350-spi

  reg:
    maxItems: 1

  clocks:
    maxItems: 1

  num-cs:
    description: Number of chip selects supported
    maxItems: 1

  dmas:
    items:
      - description: Transmit FIFO DMA channel
      - description: Receive FIFO DMA channel

  dma-names:
    items:
      - const: tx
      - const: rx

patternProperties:
  "@[0-9a-f]+$":
    type: object
    additionalProperties: true

    properties:
      spi-rx-bus-width:
        items:
          - enum: [1, 4]

      spi-tx-bus-width:
        items:
          - enum: [1, 4]

allOf:
  - $ref: spi-controller.yaml#

required:
  - compatible
  - reg
  - clocks
  - dmas
  - dma-names

unevaluatedProperties: false

examples:
  - |
    spi@f0b00000 {
        compatible = "andestech,ae350-spi";
        reg = <0xf0b00000 0x100>;
        clocks = <&clk_spi>;
        dmas = <&dma0 0>, <&dma0 1>;
        dma-names = "tx", "rx";

        #address-cells = <1>;
        #size-cells = <0>;

        flash@0 {
            compatible = "jedec,spi-nor";
            reg = <0>;
            spi-tx-bus-width = <4>;
            spi-rx-bus-width = <4>;
            spi-cpol;
            spi-cpha;
        };
    };
```

## Documentation/devicetree/bindings/spi/apple,spi.yaml
```yaml
# SPDX-License-Identifier: (GPL-2.0-only OR BSD-2-Clause)
%YAML 1.2
---
$id: http://devicetree.org/schemas/spi/apple,spi.yaml#
$schema: http://devicetree.org/meta-schemas/core.yaml#

title: Apple ARM SoC SPI controller

allOf:
  - $ref: spi-controller.yaml#

maintainers:
  - Hector Martin <marcan@marcan.st>

properties:
  compatible:
    oneOf:
      - items:
          - const: apple,t6020-spi
          - const: apple,t8103-spi
      - items:
          - enum:
              - apple,t8103-spi
              - apple,t8112-spi
              - apple,t6000-spi
          - const: apple,spi

  reg:
    maxItems: 1

  clocks:
    maxItems: 1

  interrupts:
    maxItems: 1

  power-domains:
    maxItems: 1

required:
  - compatible
  - reg
  - clocks
  - interrupts

unevaluatedProperties: false

examples:
  - |
    #include <dt-bindings/interrupt-controller/apple-aic.h>
    #include <dt-bindings/interrupt-controller/irq.h>

    soc {
      #address-cells = <2>;
      #size-cells = <2>;

      spi@39b104000 {
        compatible = "apple,t6000-spi", "apple,spi";
        reg = <0x3 0x9b104000 0x0 0x4000>;
        interrupt-parent = <&aic>;
        interrupts = <AIC_IRQ 0 1107 IRQ_TYPE_LEVEL_HIGH>;
        #address-cells = <1>;
        #size-cells = <0>;
        clocks = <&clk>;
      };
    };
```

## Documentation/devicetree/bindings/spi/arm,pl022-peripheral-props.yaml
```yaml
# SPDX-License-Identifier: GPL-2.0
%YAML 1.2
---
$id: http://devicetree.org/schemas/spi/arm,pl022-peripheral-props.yaml#
$schema: http://devicetree.org/meta-schemas/core.yaml#

title: Peripheral-specific properties for Arm PL022 SPI controller

maintainers:
  - Linus Walleij <linus.walleij@linaro.org>

select: false

properties:
  pl022,interface:
    description: SPI interface type
    $ref: /schemas/types.yaml#/definitions/uint32
    enum:
      - 0      # SPI
      - 1      # Texas Instruments Synchronous Serial Frame Format
      - 2      # Microwire (Half Duplex)

  pl022,com-mode:
    description: Specifies the transfer mode
    $ref: /schemas/types.yaml#/definitions/uint32
    enum:
      - 0      # interrupt mode
      - 1      # polling mode
      - 2      # DMA mode
    default: 1

  pl022,rx-level-trig:
    description: Rx FIFO watermark level
    $ref: /schemas/types.yaml#/definitions/uint32
    minimum: 0
    maximum: 4

  pl022,tx-level-trig:
    description: Tx FIFO watermark level
    $ref: /schemas/types.yaml#/definitions/uint32
    minimum: 0
    maximum: 4

  pl022,ctrl-len:
    description: Microwire interface - Control length
    $ref: /schemas/types.yaml#/definitions/uint32
    minimum: 0x03
    maximum: 0x1f

  pl022,wait-state:
    description: Microwire interface - Wait state
    $ref: /schemas/types.yaml#/definitions/uint32
    enum: [0, 1]

  pl022,duplex:
    description: Microwire interface - Full/Half duplex
    $ref: /schemas/types.yaml#/definitions/uint32
    enum: [0, 1]

additionalProperties: true
...
```

## Documentation/devicetree/bindings/spi/aspeed,ast2600-fmc.yaml
```yaml
# SPDX-License-Identifier: (GPL-2.0 OR BSD-2-Clause)
%YAML 1.2
---
$id: http://devicetree.org/schemas/spi/aspeed,ast2600-fmc.yaml#
$schema: http://devicetree.org/meta-schemas/core.yaml#

title: Aspeed SMC controllers bindings

maintainers:
  - Chin-Ting Kuo <chin-ting_kuo@aspeedtech.com>
  - Cédric Le Goater <clg@kaod.org>

description: |
  This binding describes the Aspeed Static Memory Controllers (FMC and
  SPI) of the AST2400, AST2500 and AST2600 SOCs.

allOf:
  - $ref: "spi-controller.yaml#"

properties:
  compatible:
    enum:
      - aspeed,ast2600-fmc
      - aspeed,ast2600-spi
      - aspeed,ast2500-fmc
      - aspeed,ast2500-spi
      - aspeed,ast2400-fmc
      - aspeed,ast2400-spi

  reg:
    items:
      - description: registers
      - description: memory mapping

  clocks:
    maxItems: 1

  interrupts:
    maxItems: 1

required:
  - compatible
  - reg
  - clocks

unevaluatedProperties: false

examples:
  - |
    #include <dt-bindings/interrupt-controller/arm-gic.h>
    #include <dt-bindings/interrupt-controller/aspeed-scu-ic.h>
    #include <dt-bindings/clock/ast2600-clock.h>

    spi@1e620000 {
        reg = <0x1e620000 0xc4>, <0x20000000 0x10000000>;
        #address-cells = <1>;
        #size-cells = <0>;
        compatible = "aspeed,ast2600-fmc";
        clocks = <&syscon ASPEED_CLK_AHB>;
        interrupts = <GIC_SPI 39 IRQ_TYPE_LEVEL_HIGH>;

        flash@0 {
                reg = < 0 >;
                compatible = "jedec,spi-nor";
                spi-max-frequency = <50000000>;
                spi-rx-bus-width = <2>;
        };

        flash@1 {
                reg = < 1 >;
                compatible = "jedec,spi-nor";
                spi-max-frequency = <50000000>;
                spi-rx-bus-width = <2>;
        };

        flash@2 {
                reg = < 2 >;
                compatible = "jedec,spi-nor";
                spi-max-frequency = <50000000>;
                spi-rx-bus-width = <2>;
        };
    };
```

## Documentation/devicetree/bindings/spi/atmel,at91rm9200-spi.yaml
```yaml
# SPDX-License-Identifier: (GPL-2.0-only OR BSD-2-Clause)
# Copyright (C) 2022 Microchip Technology, Inc. and its subsidiaries
%YAML 1.2
---
$id: http://devicetree.org/schemas/spi/atmel,at91rm9200-spi.yaml#
$schema: http://devicetree.org/meta-schemas/core.yaml#

title: Atmel SPI device

maintainers:
  - Tudor Ambarus <tudor.ambarus@linaro.org>

allOf:
  - $ref: spi-controller.yaml#

properties:
  compatible:
    oneOf:
      - const: atmel,at91rm9200-spi
      - items:
          - const: microchip,sam9x60-spi
          - const: atmel,at91rm9200-spi
      - items:
          - const: microchip,sam9x7-spi
          - const: atmel,at91rm9200-spi

  reg:
    maxItems: 1

  interrupts:
    maxItems: 1

  clock-names:
    contains:
      const: spi_clk

  clocks:
    maxItems: 1

  dmas:
    items:
      - description: TX DMA Channel
      - description: RX DMA Channel

  dma-names:
    items:
      - const: tx
      - const: rx

  atmel,fifo-size:
    $ref: /schemas/types.yaml#/definitions/uint32
    description: |
      Maximum number of data the RX and TX FIFOs can store for FIFO
      capable SPI controllers.
    enum: [ 16, 32 ]

required:
  - compatible
  - reg
  - interrupts
  - clock-names
  - clocks

unevaluatedProperties: false

examples:
  - |
    #include <dt-bindings/gpio/gpio.h>
    #include <dt-bindings/interrupt-controller/irq.h>

    spi1: spi@fffcc000 {
        compatible = "atmel,at91rm9200-spi";
        reg = <0xfffcc000 0x4000>;
        interrupts = <13 IRQ_TYPE_LEVEL_HIGH 5>;
        #address-cells = <1>;
        #size-cells = <0>;
        clocks = <&spi1_clk>;
        clock-names = "spi_clk";
        cs-gpios = <&pioB 3 GPIO_ACTIVE_HIGH>;
        atmel,fifo-size = <32>;

        mmc@0 {
            compatible = "mmc-spi-slot";
            reg = <0>;
            gpios = <&pioC 4 GPIO_ACTIVE_HIGH>;    /* CD */
            spi-max-frequency = <25000000>;
        };
    };
```

## Documentation/devicetree/bindings/spi/atmel,quadspi.yaml
```yaml
# SPDX-License-Identifier: GPL-2.0-only OR BSD-2-Clause
%YAML 1.2
---
$id: http://devicetree.org/schemas/spi/atmel,quadspi.yaml#
$schema: http://devicetree.org/meta-schemas/core.yaml#

title: Atmel Quad Serial Peripheral Interface (QSPI)

maintainers:
  - Tudor Ambarus <tudor.ambarus@linaro.org>

allOf:
  - $ref: spi-controller.yaml#

properties:
  compatible:
    enum:
      - atmel,sama5d2-qspi
      - microchip,sam9x60-qspi
      - microchip,sam9x7-ospi
      - microchip,sama7d65-qspi
      - microchip,sama7d65-ospi
      - microchip,sama7g5-qspi
      - microchip,sama7g5-ospi

  reg:
    items:
      - description: base registers
      - description: mapped memory

  reg-names:
    items:
      - const: qspi_base
      - const: qspi_mmap

  clocks:
    minItems: 1
    items:
      - description: peripheral clock
      - description: system clock or generic clock, if available

  clock-names:
    minItems: 1
    items:
      - const: pclk
      - enum: [ qspick, gclk ]

  interrupts:
    maxItems: 1

  dmas:
    items:
      - description: tx DMA channel
      - description: rx DMA channel

  dma-names:
    items:
      - const: tx
      - const: rx

  '#address-cells':
    const: 1

  '#size-cells':
    const: 0

required:
  - compatible
  - reg
  - reg-names
  - interrupts
  - clocks
  - clock-names
  - '#address-cells'
  - '#size-cells'

unevaluatedProperties: false

examples:
  - |
    #include <dt-bindings/interrupt-controller/irq.h>
    #include <dt-bindings/clock/at91.h>
    spi@f0020000 {
        compatible = "atmel,sama5d2-qspi";
        reg = <0xf0020000 0x100>, <0xd0000000 0x8000000>;
        reg-names = "qspi_base", "qspi_mmap";
        interrupts = <52 IRQ_TYPE_LEVEL_HIGH 7>;
        clocks = <&pmc PMC_TYPE_PERIPHERAL 52>;
        clock-names = "pclk";
        #address-cells = <1>;
        #size-cells = <0>;
        pinctrl-names = "default";
        pinctrl-0 = <&pinctrl_spi0_default>;

        flash@0 {
            compatible = "jedec,spi-nor";
            spi-max-frequency = <50000000>;
            reg = <0>;
            spi-rx-bus-width = <4>;
            spi-tx-bus-width = <4>;
        };
    };
```

## Documentation/devicetree/bindings/spi/atmel-quadspi.txt
```
* Atmel Quad Serial Peripheral Interface (QSPI)

Required properties:
- compatible:     Should be one of the following:
		  - "atmel,sama5d2-qspi"
		  - "microchip,sam9x60-qspi"
- reg:            Should contain the locations and lengths of the base registers
                  and the mapped memory.
- reg-names:      Should contain the resource reg names:
                  - qspi_base: configuration register address space
                  - qspi_mmap: memory mapped address space
- interrupts:     Should contain the interrupt for the device.
- clocks:         Should reference the peripheral clock and the QSPI system
                  clock if available.
- clock-names:    Should contain "pclk" for the peripheral clock and "qspick"
                  for the system clock when available.
- #address-cells: Should be <1>.
- #size-cells:    Should be <0>.

Example:

spi@f0020000 {
	compatible = "atmel,sama5d2-qspi";
	reg = <0xf0020000 0x100>, <0xd0000000 0x8000000>;
	reg-names = "qspi_base", "qspi_mmap";
	interrupts = <52 IRQ_TYPE_LEVEL_HIGH 7>;
	clocks = <&pmc PMC_TYPE_PERIPHERAL 52>;
	clock-names = "pclk";
	#address-cells = <1>;
	#size-cells = <0>;
	pinctrl-names = "default";
	pinctrl-0 = <&pinctrl_spi0_default>;

	m25p80@0 {
		...
	};
};
```

## Documentation/devicetree/bindings/spi/axiado,ax3000-spi.yaml
```yaml
# SPDX-License-Identifier: (GPL-2.0-only OR BSD-2-Clause)
%YAML 1.2
---
$id: http://devicetree.org/schemas/spi/axiado,ax3000-spi.yaml#
$schema: http://devicetree.org/meta-schemas/core.yaml#

title: Axiado AX3000 SoC SPI controller

maintainers:
  - Vladimir Moravcevic <vmoravcevic@axiado.com>
  - Tzu-Hao Wei <twei@axiado.com>
  - Swark Yang <syang@axiado.com>
  - Prasad Bolisetty <pbolisetty@axiado.com>

allOf:
  - $ref: spi-controller.yaml#

properties:
  compatible:
    enum:
      - axiado,ax3000-spi

  reg:
    maxItems: 1

  interrupts:
    maxItems: 1

  clock-names:
    items:
      - const: ref
      - const: pclk

  clocks:
    maxItems: 2

  num-cs:
    description: |
      Number of chip selects used.
    $ref: /schemas/types.yaml#/definitions/uint32
    minimum: 1
    maximum: 4
    default: 4

required:
  - compatible
  - reg
  - interrupts
  - clock-names
  - clocks

unevaluatedProperties: false

examples:
  - |
   #include <dt-bindings/interrupt-controller/irq.h>
   #include <dt-bindings/interrupt-controller/arm-gic.h>

   soc {
      #address-cells = <2>;
      #size-cells = <2>;

      spi@80510000 {
         compatible = "axiado,ax3000-spi";
         reg = <0x00 0x80510000 0x00 0x1000>;
         clock-names = "ref", "pclk";
         clocks = <&spi_clk>, <&apb_pclk>;
         interrupt-parent = <&gic500>;
         interrupts = <GIC_SPI 115 IRQ_TYPE_LEVEL_HIGH>;
         num-cs = <4>;
      };
   };
...
```

## Documentation/devicetree/bindings/spi/brcm,bcm2835-aux-spi.txt
```
Broadcom BCM2835 auxiliar SPI1/2 controller

The BCM2835 contains two forms of SPI master controller, one known simply as
SPI0, and the other known as the "Universal SPI Master"; part of the
auxiliary block. This binding applies to the SPI1/2 controller.

Required properties:
- compatible: Should be "brcm,bcm2835-aux-spi".
- reg: Should contain register location and length for the spi block
- interrupts: Should contain shared interrupt of the aux block
- clocks: The clock feeding the SPI controller - needs to
	  point to the auxiliar clock driver of the bcm2835,
	  as this clock will enable the output gate for the specific
	  clock.
- cs-gpios: the cs-gpios (native cs is NOT supported)
	    see also spi-bus.txt

Example:

spi1@7e215080 {
	compatible = "brcm,bcm2835-aux-spi";
	reg = <0x7e215080 0x40>;
	interrupts = <1 29>;
	clocks = <&aux_clocks BCM2835_AUX_CLOCK_SPI1>;
	#address-cells = <1>;
	#size-cells = <0>;
	cs-gpios = <&gpio 18>, <&gpio 17>, <&gpio 16>;
};

spi2@7e2150c0 {
	compatible = "brcm,bcm2835-aux-spi";
	reg = <0x7e2150c0 0x40>;
	interrupts = <1 29>;
	clocks = <&aux_clocks BCM2835_AUX_CLOCK_SPI2>;
	#address-cells = <1>;
	#size-cells = <0>;
	cs-gpios = <&gpio 43>, <&gpio 44>, <&gpio 45>;
};
```
