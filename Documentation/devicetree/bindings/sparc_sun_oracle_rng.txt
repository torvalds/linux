## Documentation/devicetree/bindings/spi/brcm,bcm2835-aux-spi.yaml
```yaml
# SPDX-License-Identifier: (GPL-2.0-only OR BSD-2-Clause)
%YAML 1.2
---
$id: http://devicetree.org/schemas/spi/brcm,bcm2835-aux-spi.yaml#
$schema: http://devicetree.org/meta-schemas/core.yaml#

title: Broadcom BCM2835 Auxiliary SPI1/2 Controller

maintainers:
  - Karan Sanghavi <karansanghvi98@gmail.com>

description:
  The BCM2835 contains two forms of SPI master controller. One is known simply
  as SPI0, and the other as the "Universal SPI Master," which is part of the
  auxiliary block. This binding applies to the SPI1 and SPI2 auxiliary
  controllers.

allOf:
  - $ref: spi-controller.yaml#

properties:
  compatible:
    enum:
      - brcm,bcm2835-aux-spi

  reg:
    maxItems: 1

  interrupts:
    maxItems: 1

  clocks:
    maxItems: 1

required:
  - compatible
  - reg
  - interrupts
  - clocks

unevaluatedProperties: false

examples:
  - |
    #include <dt-bindings/clock/bcm2835-aux.h>
    spi@7e215080 {
        compatible = "brcm,bcm2835-aux-spi";
        reg = <0x7e215080 0x40>;
        interrupts = <1 29>;
        clocks = <&aux_clocks BCM2835_AUX_CLOCK_SPI1>;
        #address-cells = <1>;
        #size-cells = <0>;
    };
```

## Documentation/devicetree/bindings/spi/brcm,bcm2835-spi.txt
```
Broadcom BCM2835 SPI0 controller

The BCM2835 contains two forms of SPI master controller, one known simply as
SPI0, and the other known as the "Universal SPI Master"; part of the
auxilliary block. This binding applies to the SPI0 controller.

Required properties:
- compatible: Should be "brcm,bcm2835-spi".
- reg: Should contain register location and length.
- interrupts: Should contain interrupt.
- clocks: The clock feeding the SPI controller.

Example:

spi@20204000 {
	compatible = "brcm,bcm2835-spi";
	reg = <0x7e204000 0x1000>;
	interrupts = <2 22>;
	clocks = <&clk_spi>;
	#address-cells = <1>;
	#size-cells = <0>;
};
```

## Documentation/devicetree/bindings/spi/brcm,bcm2835-spi.yaml
```yaml
# SPDX-License-Identifier: GPL-2.0 OR BSD-2-Clause
%YAML 1.2
---
$id: http://devicetree.org/schemas/spi/brcm,bcm2835-spi.yaml#
$schema: http://devicetree.org/meta-schemas/core.yaml#

title: Broadcom BCM2835 SPI0 controller

maintainers:
  - Florian Fainelli <florian.fainelli@broadcom.com>
  - Kanak Shilledar <kanakshilledar111@protonmail.com>
  - Stefan Wahren <wahrenst@gmx.net>

allOf:
  - $ref: spi-controller.yaml#

properties:
  compatible:
    enum:
      - brcm,bcm2835-spi
      - brcm,bcm2711-spi
      - brcm,bcm7211-spi

  reg:
    maxItems: 1

  interrupts:
    maxItems: 1

  clocks:
    maxItems: 1

required:
  - compatible
  - reg
  - interrupts
  - clocks

unevaluatedProperties: false

examples:
  - |
    spi@20204000 {
        compatible = "brcm,bcm2835-spi";
        reg = <0x7e204000 0x1000>;
        interrupts = <2 22>;
        clocks = <&clk_spi>;
        #address-cells = <1>;
        #size-cells = <0>;
    };
```

## Documentation/devicetree/bindings/spi/brcm,bcm63xx-hsspi.yaml
```yaml
# SPDX-License-Identifier: GPL-2.0 OR BSD-2-Clause
%YAML 1.2
---
$id: http://devicetree.org/schemas/spi/brcm,bcm63xx-hsspi.yaml#
$schema: http://devicetree.org/meta-schemas/core.yaml#

title: Broadcom Broadband SoC High Speed SPI controller

maintainers:
  - William Zhang <william.zhang@broadcom.com>
  - Kursad Oney <kursad.oney@broadcom.com>
  - Jonas Gorski <jonas.gorski@gmail.com>

description: |
  Broadcom Broadband SoC supports High Speed SPI master controller since the
  early MIPS based chips such as BCM6328 and BCM63268.  This initial rev 1.0
  controller was carried over to recent ARM based chips, such as BCM63138,
  BCM4908 and BCM6858. The old MIPS based chip should continue to use the
  brcm,bcm6328-hsspi compatible string. The recent ARM based chip is required to
  use the brcm,bcmbca-hsspi-v1.0 as part of its compatible string list as
  defined below to match the specific chip along with ip revision info.

  This rev 1.0 controller has a limitation that can not keep the chip select line
  active between the SPI transfers within the same SPI message. This can
  terminate the transaction to some SPI devices prematurely. The issue can be
  worked around by either the controller's prepend mode or using the dummy chip
  select workaround. Driver automatically picks the suitable mode based on
  transfer type so it is transparent to the user.

  The newer SoCs such as BCM6756, BCM4912 and BCM6855 include an updated SPI
  controller rev 1.1 that add the capability to allow the driver to control chip
  select explicitly. This solves the issue in the old controller.

properties:
  compatible:
    oneOf:
      - const: brcm,bcm6328-hsspi
      - items:
          - enum:
              - brcm,bcm47622-hsspi
              - brcm,bcm4908-hsspi
              - brcm,bcm63138-hsspi
              - brcm,bcm63146-hsspi
              - brcm,bcm63148-hsspi
              - brcm,bcm63158-hsspi
              - brcm,bcm63178-hsspi
              - brcm,bcm6846-hsspi
              - brcm,bcm6856-hsspi
              - brcm,bcm6858-hsspi
              - brcm,bcm6878-hsspi
          - const: brcm,bcmbca-hsspi-v1.0
      - items:
          - enum:
              - brcm,bcm4912-hsspi
              - brcm,bcm6756-hsspi
              - brcm,bcm6813-hsspi
              - brcm,bcm6855-hsspi
          - const: brcm,bcmbca-hsspi-v1.1

  reg:
    items:
      - description: main registers
      - description: miscellaneous control registers
    minItems: 1

  reg-names:
    items:
      - const: hsspi
      - const: spim-ctrl
    minItems: 1

  clocks:
    items:
      - description: SPI master reference clock
      - description: SPI master pll clock

  clock-names:
    items:
      - const: hsspi
      - const: pll

  interrupts:
    maxItems: 1

required:
  - compatible
  - reg
  - clocks
  - clock-names
  - interrupts

allOf:
  - $ref: spi-controller.yaml#
  - if:
      properties:
        compatible:
          contains:
            enum:
              - brcm,bcm6328-hsspi
              - brcm,bcmbca-hsspi-v1.0
    then:
      properties:
        reg:
          maxItems: 1
        reg-names:
          maxItems: 1
    else:
      properties:
        reg:
          minItems: 2
          maxItems: 2
        reg-names:
          minItems: 2
          maxItems: 2
      required:
        - reg-names

unevaluatedProperties: false

examples:
  - |
    #include <dt-bindings/interrupt-controller/arm-gic.h>
    spi@ff801000 {
        compatible = "brcm,bcm6756-hsspi", "brcm,bcmbca-hsspi-v1.1";
        reg = <0xff801000 0x1000>,
              <0xff802610 0x4>;
        reg-names = "hsspi", "spim-ctrl";
        interrupts = <GIC_SPI 36 IRQ_TYPE_LEVEL_HIGH>;
        clocks = <&hsspi>, <&hsspi_pll>;
        clock-names = "hsspi", "pll";
        num-cs = <8>;
        #address-cells = <1>;
        #size-cells = <0>;
    };
```

## Documentation/devicetree/bindings/spi/brcm,bcm63xx-spi.yaml
```yaml
# SPDX-License-Identifier: GPL-2.0 OR BSD-2-Clause
%YAML 1.2
---
$id: http://devicetree.org/schemas/spi/brcm,bcm63xx-spi.yaml#
$schema: http://devicetree.org/meta-schemas/core.yaml#

title: Broadcom BCM6348/BCM6358 SPI controller

maintainers:
  - Jonas Gorski <jonas.gorski@gmail.com>

description: |
  Broadcom "Low Speed" SPI controller found in many older MIPS based Broadband
  SoCs.

  This controller has a limitation that can not keep the chip select line active
  between the SPI transfers within the same SPI message. This can terminate the
  transaction to some SPI devices prematurely. The issue can be worked around by
  the controller's prepend mode.

allOf:
  - $ref: spi-controller.yaml#

properties:
  compatible:
    oneOf:
      - items:
          - enum:
              - brcm,bcm6368-spi
              - brcm,bcm6362-spi
              - brcm,bcm63268-spi
          - const: brcm,bcm6358-spi
      - enum:
          - brcm,bcm6348-spi
          - brcm,bcm6358-spi

  reg:
    maxItems: 1

  clocks:
    items:
      - description: SPI master reference clock

  clock-names:
    items:
      - const: spi

  interrupts:
    maxItems: 1

required:
  - compatible
  - reg
  - clocks
  - clock-names
  - interrupts

unevaluatedProperties: false

examples:
  - |
    spi@10000800 {
        compatible = "brcm,bcm6368-spi", "brcm,bcm6358-spi";
        reg = <0x10000800 0x70c>;
        interrupts = <1>;
        clocks = <&clkctl 9>;
        clock-names = "spi";
        num-cs = <5>;
        #address-cells = <1>;
        #size-cells = <0>;
    };
```

## Documentation/devicetree/bindings/spi/brcm,spi-bcm-qspi.txt
```
Broadcom SPI controller

The Broadcom SPI controller is a SPI master found on various SOCs, including
BRCMSTB (BCM7XXX), Cygnus, NSP and NS2. The Broadcom Master SPI hw IP consits
of :
 MSPI : SPI master controller can read and write to a SPI slave device
 BSPI : Broadcom SPI in combination with the MSPI hw IP provides acceleration
	for flash reads and be configured to do single, double, quad lane
	io with 3-byte and 4-byte addressing support.

 Supported Broadcom SoCs have one instance of MSPI+BSPI controller IP.
 MSPI master can be used wihout BSPI. BRCMSTB SoCs have an additional instance
 of a MSPI master without the BSPI to use with non flash slave devices that
 use SPI protocol.

Required properties:

- #address-cells:
    Must be <1>, as required by generic SPI binding.

- #size-cells:
    Must be <0>, also as required by generic SPI binding.

- compatible:
    Must be one of :
    "brcm,spi-bcm-qspi", "brcm,spi-brcmstb-qspi" : MSPI+BSPI on BRCMSTB SoCs
    "brcm,spi-bcm-qspi", "brcm,spi-brcmstb-mspi" : Second Instance of MSPI
						   BRCMSTB  SoCs
    "brcm,spi-bcm7425-qspi", "brcm,spi-bcm-qspi", "brcm,spi-brcmstb-mspi" : Second Instance of MSPI
    			     			  			    BRCMSTB  SoCs
    "brcm,spi-bcm7429-qspi", "brcm,spi-bcm-qspi", "brcm,spi-brcmstb-mspi" : Second Instance of MSPI
    			     			  			    BRCMSTB  SoCs
    "brcm,spi-bcm7435-qspi", "brcm,spi-bcm-qspi", "brcm,spi-brcmstb-mspi" : Second Instance of MSPI
    			     			  			    BRCMSTB  SoCs
    "brcm,spi-bcm7216-qspi", "brcm,spi-bcm-qspi", "brcm,spi-brcmstb-mspi" : Second Instance of MSPI
    			     			  			    BRCMSTB  SoCs
    "brcm,spi-bcm7278-qspi", "brcm,spi-bcm-qspi", "brcm,spi-brcmstb-mspi" : Second Instance of MSPI
    			     			  			    BRCMSTB  SoCs
    "brcm,spi-bcm-qspi", "brcm,spi-nsp-qspi"     : MSPI+BSPI on Cygnus, NSP
    "brcm,spi-bcm-qspi", "brcm,spi-ns2-qspi"     : NS2 SoCs

- reg:
    Define the bases and ranges of the associated I/O address spaces.
    The required range is MSPI controller registers.

- reg-names:
    First name does not matter, but must be reserved for the MSPI controller
    register range as mentioned in 'reg' above, and will typically contain
    - "bspi_regs": BSPI register range, not required with compatible
		   "spi-brcmstb-mspi"
    - "mspi_regs": MSPI register range is required for compatible strings
    - "intr_regs", "intr_status_reg" : Interrupt and status register for
      NSP, NS2, Cygnus SoC

- interrupts
    The interrupts used by the MSPI and/or BSPI controller.

- interrupt-names:
    Names of interrupts associated with MSPI
    - "mspi_halted" :
    - "mspi_done": Indicates that the requested SPI operation is complete.
    - "spi_lr_fullness_reached" : Linear read BSPI pipe full
    - "spi_lr_session_aborted"  : Linear read BSPI pipe aborted
    - "spi_lr_impatient" : Linear read BSPI requested when pipe empty
    - "spi_lr_session_done" : Linear read BSPI session done

- clocks:
    A phandle to the reference clock for this block.

Optional properties:


- native-endian
    Defined when using BE SoC and device uses BE register read/write

Recommended optional m25p80 properties:
- spi-rx-bus-width: Definition as per
                    Documentation/devicetree/bindings/spi/spi-bus.txt

Examples:

BRCMSTB SoC Example:

  SPI Master (MSPI+BSPI) for SPI-NOR access:

    spi@f03e3400 {
		#address-cells = <0x1>;
		#size-cells = <0x0>;
		compatible = "brcm,spi-brcmstb-qspi", "brcm,spi-brcmstb-qspi";
		reg = <0xf03e0920 0x4 0xf03e3400 0x188 0xf03e3200 0x50>;
		reg-names = "cs_reg", "mspi", "bspi";
		interrupts = <0x6 0x5 0x4 0x3 0x2 0x1 0x0>;
		interrupt-parent = <0x1c>;
		interrupt-names = "mspi_halted",
				  "mspi_done",
				  "spi_lr_overread",
				  "spi_lr_session_done",
				  "spi_lr_impatient",
				  "spi_lr_session_aborted",
				  "spi_lr_fullness_reached";

		clocks = <&hif_spi>;
		clock-names = "sw_spi";

		m25p80@0 {
			#size-cells = <0x2>;
			#address-cells = <0x2>;
			compatible = "m25p80";
			reg = <0x0>;
			spi-max-frequency = <0x2625a00>;
			spi-cpol;
			spi-cpha;
			m25p,fast-read;

			flash0.bolt@0 {
				reg = <0x0 0x0 0x0 0x100000>;
			};

			flash0.macadr@100000 {
				reg = <0x0 0x100000 0x0 0x10000>;
			};

			flash0.nvram@110000 {
				reg = <0x0 0x110000 0x0 0x10000>;
			};

			flash0.kernel@120000 {
				reg = <0x0 0x120000 0x0 0x400000>;
			};

			flash0.devtree@520000 {
				reg = <0x0 0x520000 0x0 0x10000>;
			};

			flash0.splash@530000 {
				reg = <0x0 0x530000 0x0 0x80000>;
			};

			flash0@0 {
				reg = <0x0 0x0 0x0 0x4000000>;
			};
		};
	};


    MSPI master for any SPI device :

	spi@f0416000 {
		#address-cells = <1>;
		#size-cells = <0>;
		clocks = <&upg_fixed>;
		compatible = "brcm,spi-brcmstb-qspi", "brcm,spi-brcmstb-mspi";
		reg = <0xf0416000 0x180>;
		reg-names = "mspi";
		interrupts = <0x14>;
		interrupt-parent = <&irq0_aon_intc>;
		interrupt-names = "mspi_done";
	};

iProc SoC Example:

    qspi: spi@18027200 {
	compatible = "brcm,spi-bcm-qspi", "brcm,spi-nsp-qspi";
	reg = <0x18027200 0x184>,
	      <0x18027000 0x124>,
	      <0x1811c408 0x004>,
	      <0x180273a0 0x01c>;
	reg-names = "mspi_regs", "bspi_regs", "intr_regs", "intr_status_reg";
	interrupts = <GIC_SPI 72 IRQ_TYPE_LEVEL_HIGH>,
		     <GIC_SPI 73 IRQ_TYPE_LEVEL_HIGH>,
		     <GIC_SPI 74 IRQ_TYPE_LEVEL_HIGH>,
		     <GIC_SPI 75 IRQ_TYPE_LEVEL_HIGH>,
		     <GIC_SPI 76 IRQ_TYPE_LEVEL_HIGH>,
		     <GIC_SPI 77 IRQ_TYPE_LEVEL_HIGH>,
		     <GIC_SPI 78 IRQ_TYPE_LEVEL_HIGH>;
	interrupt-names =
		     "spi_lr_fullness_reached",
		     "spi_lr_session_aborted",
		     "spi_lr_impatient",
		     "spi_lr_session_done",
		     "mspi_done",
		     "mspi_halted";
	clocks = <&iprocmed>;
	clock-names = "iprocmed";
	num-cs = <2>;
	#address-cells = <1>;
	#size-cells = <0>;
    };


 NS2 SoC Example:

	       qspi: spi@66470200 {
		       compatible = "brcm,spi-bcm-qspi", "brcm,spi-ns2-qspi";
		       reg = <0x66470200 0x184>,
			     <0x66470000 0x124>,
			     <0x67017408 0x004>,
			     <0x664703a0 0x01c>;
		       reg-names = "mspi", "bspi", "intr_regs",
			"intr_status_reg";
		       interrupts = <GIC_SPI 419 IRQ_TYPE_LEVEL_HIGH>;
		       interrupt-names = "spi_l1_intr";
			clocks = <&iprocmed>;
			clock-names = "iprocmed";
			num-cs = <2>;
			#address-cells = <1>;
			#size-cells = <0>;
	       };


 m25p80 node for NSP, NS2

	 &qspi {
		      flash: m25p80@0 {
		      #address-cells = <1>;
		      #size-cells = <1>;
		      compatible = "m25p80";
		      reg = <0x0>;
		      spi-max-frequency = <12500000>;
		      m25p,fast-read;
		      spi-cpol;
		      spi-cpha;

		      partition@0 {
				  label = "boot";
				  reg = <0x00000000 0x000a0000>;
		      };

		      partition@a0000 {
				  label = "env";
				  reg = <0x000a0000 0x00060000>;
		      };

		      partition@100000 {
				  label = "system";
				  reg = <0x00100000 0x00600000>;
		      };

		      partition@700000 {
				  label = "rootfs";
				  reg = <0x00700000 0x01900000>;
		      };
	};
```
