## Documentation/devicetree/bindings/sparc_sun_oracle_rng.txt
```
HWRNG support for the n2_rng driver

Required properties:
- reg		: base address to sample from
- compatible	: should contain one of the following
	RNG versions:
	- 'SUNW,n2-rng' for Niagara 2 Platform (SUN UltraSPARC T2 CPU)
	- 'SUNW,vf-rng' for Victoria Falls Platform (SUN UltraSPARC T2 Plus CPU)
	- 'SUNW,kt-rng' for Rainbow/Yosemite Falls Platform (SUN SPARC T3/T4), (UltraSPARC KT/Niagara 3 - development names)
	more recent systems (after Oracle acquisition of SUN)
	- 'ORCL,m4-rng' for SPARC T5/M5
	- 'ORCL,m7-rng' for SPARC T7/M7

Examples:
/* linux LDOM on SPARC T5-2 */
Node 0xf029a4f4
	.node:  f029a4f4
	rng-#units:  00000002
	compatible: 'ORCL,m4-rng'
	reg:  0000000e
	name: 'random-number-generator'

/* solaris on SPARC M7-8 */
Node 0xf028c08c
	rng-#units:  00000003
	compatible: 'ORCL,m7-rng'
	reg:  0000000e
	name:  'random-number-generator'

PS: see as well prtconfs.git by DaveM
```

## Documentation/devicetree/bindings/spi/adi,axi-spi-engine.txt
```
Analog Devices AXI SPI Engine controller Device Tree Bindings

Required properties:
- compatible		: Must be "adi,axi-spi-engine-1.00.a""
- reg			: Physical base address and size of the register map.
- interrupts		: Property with a value describing the interrupt
			  number.
- clock-names		: List of input clock names - "s_axi_aclk", "spi_clk"
- clocks		: Clock phandles and specifiers (See clock bindings for
			  details on clock-names and clocks).
- #address-cells	: Must be <1>
- #size-cells		: Must be <0>

Optional subnodes:
	Subnodes are use to represent the SPI slave devices connected to the SPI
	master. They follow the generic SPI bindings as outlined in spi-bus.txt.

Example:

    spi@@44a00000 {
		compatible = "adi,axi-spi-engine-1.00.a";
		reg = <0x44a00000 0x1000>;
		interrupts = <0 56 4>;
		clocks = <&clkc 15 &clkc 15>;
		clock-names = "s_axi_aclk", "spi_clk";

		#address-cells = <1>;
		#size-cells = <0>;

		/* SPI devices */
    };
```

## Documentation/devicetree/bindings/spi/adi,axi-spi-engine.yaml
```yaml
# SPDX-License-Identifier: (GPL-2.0-only OR BSD-2-Clause)
%YAML 1.2
---
$id: http://devicetree.org/schemas/spi/adi,axi-spi-engine.yaml#
$schema: http://devicetree.org/meta-schemas/core.yaml#

title: Analog Devices AXI SPI Engine Controller

description: |
  The AXI SPI Engine controller is part of the SPI Engine framework[1] and
  allows memory mapped access to the SPI Engine control bus. This allows it
  to be used as a general purpose software driven SPI controller as well as
  some optional advanced acceleration and offloading capabilities.

  [1] https://wiki.analog.com/resources/fpga/peripherals/spi_engine

maintainers:
  - Michael Hennerich <Michael.Hennerich@analog.com>
  - Nuno Sá <nuno.sa@analog.com>

allOf:
  - $ref: /schemas/spi/spi-controller.yaml#

properties:
  compatible:
    const: adi,axi-spi-engine-1.00.a

  reg:
    maxItems: 1

  interrupts:
    maxItems: 1

  clocks:
    items:
      - description: The AXI interconnect clock.
      - description: The SPI controller clock.

  clock-names:
    items:
      - const: s_axi_aclk
      - const: spi_clk

  trigger-sources:
    description:
      An array of trigger source phandles for offload instances. The index in
      the array corresponds to the offload instance number.
    minItems: 1
    maxItems: 32

  dmas:
    description:
      DMA channels connected to the input or output stream interface of an
      offload instance.
    minItems: 1
    maxItems: 32

  dma-names:
    items:
      pattern: "^offload(?:[12]?[0-9]|3[01])-[tr]x$"
    minItems: 1
    maxItems: 32

required:
  - compatible
  - reg
  - interrupts
  - clocks
  - clock-names

unevaluatedProperties: false

examples:
  - |
    spi@44a00000 {
        compatible = "adi,axi-spi-engine-1.00.a";
        reg = <0x44a00000 0x1000>;
        interrupts = <0 56 4>;
        clocks = <&clkc 15>, <&clkc 15>;
        clock-names = "s_axi_aclk", "spi_clk";

        trigger-sources = <&trigger_clock>;
        dmas = <&dma 0>;
        dma-names = "offload0-rx";

        #address-cells = <1>;
        #size-cells = <0>;

        /* SPI devices */
    };
```

## Documentation/devicetree/bindings/spi/airoha,en7581-snand.yaml
```yaml
# SPDX-License-Identifier: (GPL-2.0-only OR BSD-2-Clause)
%YAML 1.2
---
$id: http://devicetree.org/schemas/spi/airoha,en7581-snand.yaml#
$schema: http://devicetree.org/meta-schemas/core.yaml#

title: SPI-NAND flash controller for Airoha ARM SoCs

maintainers:
  - Lorenzo Bianconi <lorenzo@kernel.org>

allOf:
  - $ref: spi-controller.yaml#

properties:
  compatible:
    const: airoha,en7581-snand

  reg:
    items:
      - description: spi base address
      - description: nfi2spi base address

  clocks:
    maxItems: 1

  clock-names:
    items:
      - const: spi

required:
  - compatible
  - reg
  - clocks
  - clock-names

unevaluatedProperties: false

examples:
  - |
    #include <dt-bindings/clock/en7523-clk.h>

    soc {
      #address-cells = <2>;
      #size-cells = <2>;

      spi@1fa10000 {
        compatible = "airoha,en7581-snand";
        reg = <0x0 0x1fa10000 0x0 0x140>,
              <0x0 0x1fa11000 0x0 0x160>;

        clocks = <&scuclk EN7523_CLK_SPI>;
        clock-names = "spi";

        #address-cells = <1>;
        #size-cells = <0>;

        flash@0 {
          compatible = "spi-nand";
          reg = <0>;
          spi-tx-bus-width = <1>;
          spi-rx-bus-width = <2>;
        };
      };
    };
```

## Documentation/devicetree/bindings/spi/allwinner,sun4i-a10-spi.yaml
```yaml
# SPDX-License-Identifier: GPL-2.0
%YAML 1.2
---
$id: http://devicetree.org/schemas/spi/allwinner,sun4i-a10-spi.yaml#
$schema: http://devicetree.org/meta-schemas/core.yaml#

title: Allwinner A10 SPI Controller

allOf:
  - $ref: spi-controller.yaml

maintainers:
  - Chen-Yu Tsai <wens@csie.org>
  - Maxime Ripard <mripard@kernel.org>

properties:
  "#address-cells": true
  "#size-cells": true

  compatible:
    const: allwinner,sun4i-a10-spi

  reg:
    maxItems: 1

  interrupts:
    maxItems: 1

  clocks:
    items:
      - description: Bus Clock
      - description: Module Clock

  clock-names:
    items:
      - const: ahb
      - const: mod

  dmas:
    items:
      - description: RX DMA Channel
      - description: TX DMA Channel

  dma-names:
    items:
      - const: rx
      - const: tx

  num-cs: true

patternProperties:
  "^.*@[0-9a-f]+":
    type: object
    properties:
      reg:
        items:
          minimum: 0
          maximum: 4

      spi-rx-bus-width:
        const: 1

      spi-tx-bus-width:
        const: 1

required:
  - compatible
  - reg
  - interrupts
  - clocks
  - clock-names

additionalProperties: false

examples:
  - |
    spi1: spi@1c06000 {
        compatible = "allwinner,sun4i-a10-spi";
        reg = <0x01c06000 0x1000>;
        interrupts = <11>;
        clocks = <&ahb_gates 21>, <&spi1_clk>;
        clock-names = "ahb", "mod";
        #address-cells = <1>;
        #size-cells = <0>;
    };

...
```

## Documentation/devicetree/bindings/spi/allwinner,sun6i-a31-spi.yaml
```yaml
# SPDX-License-Identifier: GPL-2.0
%YAML 1.2
---
$id: http://devicetree.org/schemas/spi/allwinner,sun6i-a31-spi.yaml#
$schema: http://devicetree.org/meta-schemas/core.yaml#

title: Allwinner A31 SPI Controller

allOf:
  - $ref: spi-controller.yaml

maintainers:
  - Chen-Yu Tsai <wens@csie.org>
  - Maxime Ripard <mripard@kernel.org>

properties:
  compatible:
    oneOf:
      - const: allwinner,sun50i-r329-spi
      - const: allwinner,sun6i-a31-spi
      - const: allwinner,sun8i-h3-spi
      - items:
          - enum:
              - allwinner,sun8i-r40-spi
              - allwinner,sun50i-h6-spi
              - allwinner,sun50i-h616-spi
              - allwinner,suniv-f1c100s-spi
          - const: allwinner,sun8i-h3-spi
      - items:
          - enum:
              - allwinner,sun20i-d1-spi
              - allwinner,sun50i-r329-spi-dbi
          - const: allwinner,sun50i-r329-spi
      - items:
          - const: allwinner,sun20i-d1-spi-dbi
          - const: allwinner,sun50i-r329-spi-dbi
          - const: allwinner,sun50i-r329-spi

  reg:
    maxItems: 1

  interrupts:
    maxItems: 1

  clocks:
    items:
      - description: Bus Clock
      - description: Module Clock

  clock-names:
    items:
      - const: ahb
      - const: mod

  resets:
    maxItems: 1

  dmas:
    items:
      - description: RX DMA Channel
      - description: TX DMA Channel

  dma-names:
    items:
      - const: rx
      - const: tx

patternProperties:
  "^.*@[0-9a-f]+":
    type: object
    properties:
      reg:
        items:
          minimum: 0
          maximum: 4

      spi-rx-bus-width:
        const: 1

      spi-tx-bus-width:
        const: 1

required:
  - compatible
  - reg
  - interrupts
  - clocks
  - clock-names

unevaluatedProperties: false

examples:
  - |
    spi1: spi@1c69000 {
        compatible = "allwinner,sun6i-a31-spi";
        reg = <0x01c69000 0x1000>;
        interrupts = <0 66 4>;
        clocks = <&ahb1_gates 21>, <&spi1_clk>;
        clock-names = "ahb", "mod";
        resets = <&ahb1_rst 21>;
        #address-cells = <1>;
        #size-cells = <0>;
    };

  - |
    spi0: spi@1c68000 {
        compatible = "allwinner,sun8i-h3-spi";
        reg = <0x01c68000 0x1000>;
        interrupts = <0 65 4>;
        clocks = <&ccu 30>, <&ccu 82>;
        clock-names = "ahb", "mod";
        dmas = <&dma 23>, <&dma 23>;
        dma-names = "rx", "tx";
        resets = <&ccu 15>;
        #address-cells = <1>;
        #size-cells = <0>;
    };

...
```

## Documentation/devicetree/bindings/spi/amlogic,a1-spifc.yaml
```yaml
# SPDX-License-Identifier: (GPL-2.0 OR BSD-2-Clause)
%YAML 1.2
---
$id: http://devicetree.org/schemas/spi/amlogic,a1-spifc.yaml#
$schema: http://devicetree.org/meta-schemas/core.yaml#

title: Amlogic A1 SPI Flash Controller

maintainers:
  - Martin Kurbanov <mmkurbanov@sberdevices.ru>

allOf:
  - $ref: spi-controller.yaml#

properties:
  compatible:
    enum:
      - amlogic,a1-spifc

  reg:
    maxItems: 1

  clocks:
    maxItems: 1

  power-domains:
    maxItems: 1

required:
  - compatible
  - reg
  - clocks

unevaluatedProperties: false

examples:
  - |
    spi@fd000400 {
        compatible = "amlogic,a1-spifc";
        reg = <0xfd000400 0x290>;
        clocks = <&clkc_clkid_spifc>;
        #address-cells = <1>;
        #size-cells = <0>;
    };
```

## Documentation/devicetree/bindings/spi/amlogic,a4-spifc.yaml
```yaml
# SPDX-License-Identifier: (GPL-2.0-only OR BSD-2-Clause)
# Copyright (C) 2025 Amlogic, Inc. All rights reserved
%YAML 1.2
---
$id: http://devicetree.org/schemas/spi/amlogic,a4-spifc.yaml#
$schema: http://devicetree.org/meta-schemas/core.yaml#

title: SPI flash controller for Amlogic ARM SoCs

maintainers:
  - Liang Yang <liang.yang@amlogic.com>
  - Feng Chen <feng.chen@amlogic.com>
  - Xianwei Zhao <xianwei.zhao@amlogic.com>

description:
  The Amlogic SPI flash controller is an extended version of the Amlogic NAND
  flash controller. It supports SPI Nor Flash and SPI NAND Flash(where the Host
  ECC HW engine could be enabled).

allOf:
  - $ref: /schemas/spi/spi-controller.yaml#

properties:
  compatible:
    const: amlogic,a4-spifc

  reg:
    maxItems: 1

  clocks:
    items:
      - description: clock apb gate
      - description: clock used for the controller

  clock-names:
    items:
      - const: gate
      - const: core

  interrupts:
    maxItems: 1

  amlogic,rx-adj:
    description:
      Number of clock cycles by which sampling is delayed.
    $ref: /schemas/types.yaml#/definitions/uint32
    enum: [0, 1, 2, 3]
    default: 0

required:
  - compatible
  - reg
  - clocks
  - clock-names

unevaluatedProperties: false

examples:
  - |
    sfc0: spi@fe08d000 {
      compatible = "amlogic,a4-spifc";
      reg = <0xfe08d000 0x800>;
      clocks = <&clkc_periphs 31>,
               <&clkc_periphs 102>;
      clock-names = "gate", "core";

      pinctrl-0 = <&spiflash_default>;
      pinctrl-names = "default";

      #address-cells = <1>;
      #size-cells = <0>;

      flash@0 {
          compatible = "spi-nand";
          reg = <0>;
          #address-cells = <1>;
          #size-cells = <1>;
          nand-ecc-engine = <&sfc0>;
          nand-ecc-strength = <8>;
          nand-ecc-step-size = <512>;
      };
    };
```

## Documentation/devicetree/bindings/spi/amlogic,meson-gx-spicc.yaml
```yaml
# SPDX-License-Identifier: (GPL-2.0 OR BSD-2-Clause)
# Copyright 2019 BayLibre, SAS
%YAML 1.2
---
$id: "http://devicetree.org/schemas/spi/amlogic,meson-gx-spicc.yaml#"
$schema: "http://devicetree.org/meta-schemas/core.yaml#"

title: Amlogic Meson SPI Communication Controller

maintainers:
  - Neil Armstrong <narmstrong@baylibre.com>

allOf:
  - $ref: "spi-controller.yaml#"

description: |
  The Meson SPICC is a generic SPI controller for general purpose Full-Duplex
  communications with dedicated 16 words RX/TX PIO FIFOs.

properties:
  compatible:
    enum:
      - amlogic,meson-gx-spicc # SPICC controller on Amlogic GX and compatible SoCs
      - amlogic,meson-axg-spicc # SPICC controller on Amlogic AXG and compatible SoCs
      - amlogic,meson-g12a-spicc # SPICC controller on Amlogic G12A and compatible SoCs

  interrupts:
    maxItems: 1

  reg:
    maxItems: 1

  resets:
    maxItems: 1

  clocks:
    minItems: 1
    maxItems: 2
    items:
      - description: controller register bus clock
      - description: baud rate generator and delay control clock

  clock-names:
    minItems: 1
    maxItems: 2

if:
  properties:
    compatible:
      contains:
        enum:
          - amlogic,meson-g12a-spicc

then:
  properties:
    clocks:
      minItems: 2

    clock-names:
      items:
        - const: core
        - const: pclk

else:
  properties:
    clocks:
      maxItems: 1

    clock-names:
      items:
        - const: core

required:
  - compatible
  - reg
  - interrupts
  - clocks
  - clock-names

unevaluatedProperties: false

examples:
  - |
    spi@c1108d80 {
          compatible = "amlogic,meson-gx-spicc";
          reg = <0xc1108d80 0x80>;
          interrupts = <112>;
          clocks = <&clk81>;
          clock-names = "core";
          #address-cells = <1>;
          #size-cells = <0>;

          ethernet-switch@0 {
              compatible = "micrel,ks8995m";
              spi-max-frequency = <1000000>;
              reg = <0>;
          };
    };
```

## Documentation/devicetree/bindings/spi/amlogic,meson6-spifc.yaml
```yaml
# SPDX-License-Identifier: (GPL-2.0 OR BSD-2-Clause)
# Copyright 2019 BayLibre, SAS
%YAML 1.2
---
$id: http://devicetree.org/schemas/spi/amlogic,meson6-spifc.yaml#
$schema: http://devicetree.org/meta-schemas/core.yaml#

title: Amlogic Meson SPI Flash Controller

maintainers:
  - Neil Armstrong <neil.armstrong@linaro.org>

allOf:
  - $ref: spi-controller.yaml#

description: |
  The Meson SPIFC is a controller optimized for communication with SPI
  NOR memories, without DMA support and a 64-byte unified transmit /
  receive buffer.

properties:
  compatible:
    enum:
      - amlogic,meson6-spifc # SPI Flash Controller on Meson6 and compatible SoCs
      - amlogic,meson-gxbb-spifc # SPI Flash Controller on GXBB and compatible SoCs

  reg:
    maxItems: 1

  clocks:
    maxItems: 1

required:
  - compatible
  - reg
  - clocks

unevaluatedProperties: false

examples:
  - |
    spi@c1108c80 {
        compatible = "amlogic,meson6-spifc";
        reg = <0xc1108c80 0x80>;
        clocks = <&clk81>;
        #address-cells = <1>;
        #size-cells = <0>;

        flash: flash@0 {
            compatible = "spansion,m25p80", "jedec,spi-nor";
            reg = <0>;
            spi-max-frequency = <40000000>;
        };
    };
```
