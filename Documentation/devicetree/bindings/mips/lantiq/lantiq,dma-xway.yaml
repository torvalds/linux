## Documentation/devicetree/bindings/mips/lantiq/lantiq,dma-xway.yaml
```yaml
# SPDX-License-Identifier: (GPL-2.0-only OR BSD-2-Clause)
%YAML 1.2
---
$id: http://devicetree.org/schemas/mips/lantiq/lantiq,dma-xway.yaml#
$schema: http://devicetree.org/meta-schemas/core.yaml#

title: Lantiq Xway SoCs DMA Controller

maintainers:
  - John Crispin <john@phrozen.org>

properties:
  compatible:
    items:
      - enum:
          - lantiq,dma-xway

  reg:
    maxItems: 1

required:
  - compatible
  - reg

additionalProperties: false

examples:
  - |
    dma@e104100 {
        compatible = "lantiq,dma-xway";
        reg = <0xe104100 0x800>;
    };
```

## Documentation/devicetree/bindings/mips/lantiq/lantiq,ebu.yaml
```yaml
# SPDX-License-Identifier: (GPL-2.0-only OR BSD-2-Clause)
%YAML 1.2
---
$id: http://devicetree.org/schemas/mips/lantiq/lantiq,ebu.yaml#
$schema: http://devicetree.org/meta-schemas/core.yaml#

title: Lantiq Xway SoC series External Bus Unit (EBU)

maintainers:
  - John Crispin <john@phrozen.org>

properties:
  compatible:
    items:
      - enum:
          - lantiq,ebu-xway

  reg:
    maxItems: 1

required:
  - compatible
  - reg

additionalProperties: false

examples:
  - |
    ebu@105300 {
        compatible = "lantiq,ebu-xway";
        reg = <0x105300 0x100>;
    };
```

## Documentation/devicetree/bindings/mips/lantiq/lantiq,pmu.yaml
```yaml
# SPDX-License-Identifier: (GPL-2.0-only OR BSD-2-Clause)
%YAML 1.2
---
$id: http://devicetree.org/schemas/mips/lantiq/lantiq,pmu.yaml#
$schema: http://devicetree.org/meta-schemas/core.yaml#

title: Lantiq Xway SoC series Power Management Unit (PMU)

maintainers:
  - John Crispin <john@phrozen.org>

properties:
  compatible:
    items:
      - enum:
          - lantiq,pmu-xway

  reg:
    maxItems: 1

required:
  - compatible
  - reg

additionalProperties: false

examples:
  - |
    pmu@102000 {
        compatible = "lantiq,pmu-xway";
        reg = <0x102000 0x1000>;
    };
```

## Documentation/devicetree/bindings/mips/lantiq/rcu-gphy.txt
```
Lantiq XWAY SoC GPHY binding
============================

This binding describes a software-defined ethernet PHY, provided by the RCU
module on newer Lantiq XWAY SoCs (xRX200 and newer).

-------------------------------------------------------------------------------
Required properties:
- compatible		: Should be one of
				"lantiq,xrx200a1x-gphy"
				"lantiq,xrx200a2x-gphy"
				"lantiq,xrx300-gphy"
				"lantiq,xrx330-gphy"
- reg			: Addrress of the GPHY FW load address register
- resets		: Must reference the RCU GPHY reset bit
- reset-names		: One entry, value must be "gphy" or optional "gphy2"
- clocks		: A reference to the (PMU) GPHY clock gate

Optional properties:
- lantiq,gphy-mode	: GPHY_MODE_GE (default) or GPHY_MODE_FE as defined in
			  <dt-bindings/mips/lantiq_xway_gphy.h>


-------------------------------------------------------------------------------
Example for the GPHys on the xRX200 SoCs:

#include <dt-bindings/mips/lantiq_rcu_gphy.h>
	gphy0: gphy@20 {
		compatible = "lantiq,xrx200a2x-gphy";
		reg = <0x20 0x4>;

		resets = <&reset0 31 30>, <&reset1 7 7>;
		reset-names = "gphy", "gphy2";
		clocks = <&pmu0 XRX200_PMU_GATE_GPHY>;
		lantiq,gphy-mode = <GPHY_MODE_GE>;
	};
```

## Documentation/devicetree/bindings/mips/lantiq/rcu.txt
```
Lantiq XWAY SoC RCU binding
===========================

This binding describes the RCU (reset controller unit) multifunction device,
where each sub-device has it's own set of registers.

The RCU register range is used for multiple purposes. Mostly one device
uses one or multiple register exclusively, but for some registers some
bits are for one driver and some other bits are for a different driver.
With this patch all accesses to the RCU registers will go through
syscon.


-------------------------------------------------------------------------------
Required properties:
- compatible	: The first and second values must be:
		  "lantiq,xrx200-rcu", "simple-mfd", "syscon"
- reg		: The address and length of the system control registers


-------------------------------------------------------------------------------
Example of the RCU bindings on a xRX200 SoC:
	rcu0: rcu@203000 {
		compatible = "lantiq,xrx200-rcu", "simple-mfd", "syscon";
		reg = <0x203000 0x100>;
		ranges = <0x0 0x203000 0x100>;
		big-endian;

		reset0: reset-controller@10 {
			compatible = "lantiq,xrx200-reset";
			reg = <0x10 4>, <0x14 4>;

			#reset-cells = <2>;
		};

		reset1: reset-controller@48 {
			compatible = "lantiq,xrx200-reset";
			reg = <0x48 4>, <0x24 4>;

			#reset-cells = <2>;
		};

		usb_phy0: usb2-phy@18 {
			compatible = "lantiq,xrx200-usb2-phy";
			reg = <0x18 4>, <0x38 4>;

			resets = <&reset1 4 4>, <&reset0 4 4>;
			reset-names = "phy", "ctrl";
			#phy-cells = <0>;
		};

		usb_phy1: usb2-phy@34 {
			compatible = "lantiq,xrx200-usb2-phy";
			reg = <0x34 4>, <0x3C 4>;

			resets = <&reset1 5 4>, <&reset0 4 4>;
			reset-names = "phy", "ctrl";
			#phy-cells = <0>;
		};

		reboot@10 {
			compatible = "syscon-reboot";
			reg = <0x10 4>;

			regmap = <&rcu0>;
			offset = <0x10>;
			mask = <0x40000000>;
		};
	};
```

## Documentation/devicetree/bindings/mips/loongson/devices.yaml
```yaml
# SPDX-License-Identifier: (GPL-2.0-only OR BSD-2-Clause)
%YAML 1.2
---
$id: http://devicetree.org/schemas/mips/loongson/devices.yaml#
$schema: http://devicetree.org/meta-schemas/core.yaml#

title: Loongson based Platforms

maintainers:
  - Jiaxun Yang <jiaxun.yang@flygoat.com>
description: |
  Devices with a Loongson CPU shall have the following properties.

properties:
  $nodename:
    const: '/'
  compatible:
    oneOf:

      - description: Classic Loongson64 Quad Core + LS7A
        items:
          - const: loongson,loongson64c-4core-ls7a

      - description: Classic Loongson64 Quad Core + RS780E
        items:
          - const: loongson,loongson64c-4core-rs780e

      - description: Classic Loongson64 Octa Core + RS780E
        items:
          - const: loongson,loongson64c-8core-rs780e

      - description: Generic Loongson64 Quad Core + LS7A
        items:
          - const: loongson,loongson64g-4core-ls7a

      - description: Virtual Loongson64 Quad Core + VirtIO
        items:
          - const: loongson,loongson64v-4core-virtio

      - description: LS1B based boards
        items:
          - enum:
              - loongson,ls1b-demo
              - loongson,lsgz-1b-dev
          - const: loongson,ls1b

      - description: LS1C based boards
        items:
          - enum:
              - loongmasses,smartloong-1c
              - loongson,cq-t300b
          - const: loongson,ls1c

additionalProperties: true

...
```

## Documentation/devicetree/bindings/mips/loongson/ls2k-reset.yaml
```yaml
# SPDX-License-Identifier: (GPL-2.0-only OR BSD-2-Clause)
%YAML 1.2
---
$id: http://devicetree.org/schemas/mips/loongson/ls2k-reset.yaml#
$schema: http://devicetree.org/meta-schemas/core.yaml#

title: Loongson 2K1000 PM Controller

maintainers:
  - Qing Zhang <zhangqing@loongson.cn>

description: |
  This controller can be found in Loongson-2K1000 Soc systems.

properties:
  compatible:
    const: loongson,ls2k-pm

  reg:
    maxItems: 1

required:
  - compatible
  - reg

additionalProperties: false

examples:
  - |
    bus {
        #address-cells = <2>;
        #size-cells = <2>;
        pm: reset-controller@1fe07000 {
            compatible = "loongson,ls2k-pm";
            reg = <0 0x1fe07000 0 0x422>;
        };
    };
...
```

## Documentation/devicetree/bindings/mips/loongson/rs780e-acpi.yaml
```yaml
# SPDX-License-Identifier: (GPL-2.0-only OR BSD-2-Clause)
%YAML 1.2
---
$id: "http://devicetree.org/schemas/mips/loongson/rs780e-acpi.yaml#"
$schema: "http://devicetree.org/meta-schemas/core.yaml#"

title: Loongson RS780E PCH ACPI Controller

maintainers:
  - Jiaxun Yang <jiaxun.yang@flygoat.com>

description: |
  This controller can be found in Loongson-3 systems with RS780E PCH.

properties:
  compatible:
    const: loongson,rs780e-acpi

  reg:
    maxItems: 1

required:
  - compatible
  - reg

examples:
  - |
    isa@0 {
      compatible = "isa";
      #address-cells = <2>;
      #size-cells = <1>;
      ranges = <1 0 0 0x1000>;

      acpi@800 {
        compatible = "loongson,rs780e-acpi";
        reg = <1 0x800 0x100>;
      };
    };

...
```

## Documentation/devicetree/bindings/mips/mobileye.yaml
```yaml
# SPDX-License-Identifier: GPL-2.0-only OR BSD-2-Clause
# Copyright 2023 Mobileye Vision Technologies Ltd.
%YAML 1.2
---
$id: http://devicetree.org/schemas/mips/mobileye.yaml#
$schema: http://devicetree.org/meta-schemas/core.yaml#

title: Mobileye SoC series

maintainers:
  - Vladimir Kondratiev <vladimir.kondratiev@intel.com>
  - Gregory CLEMENT <gregory.clement@bootlin.com>
  - Théo Lebrun <theo.lebrun@bootlin.com>

description:
  Boards with a Mobileye SoC shall have the following properties.

properties:
  $nodename:
    const: '/'

  compatible:
    oneOf:
      - description: Boards with Mobileye EyeQ5 SoC
        items:
          - enum:
              - mobileye,eyeq5-epm5
          - const: mobileye,eyeq5

additionalProperties: true

...
```

## Documentation/devicetree/bindings/mips/mscc.txt
```
* Microsemi MIPS CPUs

Boards with a SoC of the Microsemi MIPS family shall have the following
properties:

Required properties:
- compatible: "mscc,ocelot", "mscc,luton", "mscc,serval" or "mscc,jr2"


* Other peripherals:

o CPU chip regs:

The SoC has a few registers (DEVCPU_GCB:CHIP_REGS) handling miscellaneous
functionalities: chip ID, general purpose register for software use, reset
controller, hardware status and configuration, efuses.

Required properties:
- compatible: Should be "mscc,ocelot-chip-regs", "simple-mfd", "syscon"
- reg : Should contain registers location and length

Example:
	syscon@71070000 {
		compatible = "mscc,ocelot-chip-regs", "simple-mfd", "syscon";
		reg = <0x71070000 0x1c>;
	};

o HSIO regs:

The SoC has a few registers (HSIO) handling miscellaneous functionalities:
configuration and status of PLL5, RCOMP, SyncE, SerDes configurations and
status, SerDes muxing and a thermal sensor.

Required properties:
- compatible: Should be "mscc,ocelot-hsio", "syscon", "simple-mfd"
- reg : Should contain registers location and length

Example:
	syscon@10d0000 {
		compatible = "mscc,ocelot-hsio", "syscon", "simple-mfd";
		reg = <0x10d0000 0x10000>;
	};
```

## Documentation/devicetree/bindings/mips/mti,mips-cm.yaml
```yaml
# SPDX-License-Identifier: (GPL-2.0-only OR BSD-2-Clause)
%YAML 1.2
---
$id: http://devicetree.org/schemas/mips/mti,mips-cm.yaml#
$schema: http://devicetree.org/meta-schemas/core.yaml#

title: MIPS Coherence Manager

description:
  The Coherence Manager (CM) is responsible for establishing the
  global ordering of requests from all elements of the system and
  sending the correct data back to the requester. It supports Cache
  to Cache transfers.
  https://training.mips.com/cps_mips/PDF/CPS_Introduction.pdf
  https://training.mips.com/cps_mips/PDF/Coherency_Manager.pdf

maintainers:
  - Jiaxun Yang <jiaxun.yang@flygoat.com>

properties:
  compatible:
    oneOf:
      - const: mti,mips-cm
      - const: mobileye,eyeq6-cm
        description:
          On EyeQ6 the HCI (Hardware Cache Initialization) information for
          the L2 cache in multi-cluster configuration is broken.

  reg:
    description:
      Base address and size of the Global Configuration Registers
      referred to as CMGCR.They are the system programmer's interface
      to the Coherency Manager. Their location in the memory map is
      determined at core build time. In a functional system, the base
      address is provided by the Coprocessor 0, but some
      System-on-Chip (SoC) designs may not provide an accurate address
      that needs to be described statically.

    maxItems: 1

required:
  - compatible

additionalProperties: false

examples:
  - |
    coherency-manager@1fbf8000 {
      compatible = "mti,mips-cm";
      reg = <0x1bde8000 0x8000>;
    };

  - |
    coherency-manager {
      compatible = "mobileye,eyeq6-cm";
    };
...
```

## Documentation/devicetree/bindings/mips/ni.txt
```
National Instruments MIPS platforms

required root analde properties:
	- compatible: must be "ni,169445"

CPU Analdes
	- compatible: must be "mti,mips14KEc"
```

## Documentation/devicetree/bindings/mips/pic32/microchip,pic32mzda.txt
```
* Microchip PIC32MZDA Platforms

PIC32MZDA Starter Kit
Required root node properties:
    - compatible = "microchip,pic32mzda-sk", "microchip,pic32mzda"

CPU nodes:
----------
A "cpus" node is required.  Required properties:
 - #address-cells: Must be 1.
 - #size-cells: Must be 0.
A CPU sub-node is also required.  Required properties:
 - device_type: Must be "cpu".
 - compatible: Must be "mti,mips14KEc".
Example:
	cpus {
		#address-cells = <1>;
		#size-cells = <0>;

		cpu0: cpu@0 {
			device_type = "cpu";
			compatible = "mti,mips14KEc";
		};
	};

Boot protocol
--------------
In accordance with Unified Hosting Interface Reference Manual (MD01069), the
bootloader must pass the following arguments to the kernel:
 - $a0: -2.
 - $a1: KSEG0 address of the flattened device-tree blob.
```

## Documentation/devicetree/bindings/mips/ralink.txt
```
Ralink MIPS SoC device tree bindings

1. SoCs

Each device tree must specify a compatible value for the Ralink SoC
it uses in the compatible property of the root node. The compatible
value must be one of the following values:

  ralink,rt2880-soc
  ralink,rt3050-soc
  ralink,rt3052-soc
  ralink,rt3350-soc
  ralink,rt3352-soc
  ralink,rt3883-soc
  ralink,rt5350-soc
  ralink,mt7620a-soc
  ralink,mt7620n-soc
  ralink,mt7628a-soc
  ralink,mt7688a-soc

2. Boards

GARDENA smart Gateway (MT7688)

This board is based on the MediaTek MT7688 and equipped with 128 MiB
of DDR and 8 MiB of flash (SPI NOR) and additional 128MiB SPI NAND
storage.

------------------------------
Required root node properties:
- compatible = "gardena,smart-gateway-mt7688", "ralink,mt7688a-soc",
		"ralink,mt7628a-soc";
```
