## Documentation/devicetree/bindings/mips/ralink.yaml
```yaml
# SPDX-License-Identifier: (GPL-2.0-only OR BSD-2-Clause)
%YAML 1.2
---
$id: http://devicetree.org/schemas/mips/ralink.yaml#
$schema: http://devicetree.org/meta-schemas/core.yaml#

title: Ralink SoC based Platforms

maintainers:
  - Sergio Paracuellos <sergio.paracuellos@gmail.com>

description: |
    Boards with a Ralink SoC shall have the following properties.

properties:
  $nodename:
    const: '/'
  compatible:
    oneOf:
      - description: Boards with Ralink RT2880 SoC
        items:
          - enum:
              - ralink,rt2880-eval-board
          - const: ralink,rt2880-soc

      - description: Boards with Ralink RT3050 SoC
        items:
          - const: ralink,rt3050-soc

      - description: Boards with Ralink RT3052 SoC
        items:
          - enum:
              - ralink,rt3052-eval-board
          - const: ralink,rt3052-soc

      - description: Boards with Ralink RT3350 SoC
        items:
          - const: ralink,rt3350-soc

      - description: Boards with Ralink RT3352 SoC
        items:
          - const: ralink,rt3352-soc

      - description: Boards with Ralink RT3383 SoC
        items:
          - enum:
              - ralink,rt3883-eval-board
          - const: ralink,rt3383-soc

      - description: Boards with Ralink RT5350 SoC
        items:
          - const: ralink,rt5350-soc

      - description: Boards with Mediatek/Ralink MT7620A SoC
        items:
          - enum:
              - ralink,mt7620a-eval-board
          - const: ralink,mt7620a-soc

      - description: Boards with Mediatek/Ralink MT7620N SoC
        items:
          - const: ralink,mt7620n-soc

      - description: Boards with Mediatek/Ralink MT7628A SoC
        items:
          - enum:
              - onion,omega2+
              - vocore,vocore2
          - const: ralink,mt7628a-soc

      - description: Boards with Mediatek/Ralink MT7688A SoC
        items:
          - enum:
              - gardena,smart-gateway-mt7688
              - onion,omega2+
          - const: ralink,mt7628a-soc

      - description: Boards with Mediatek/Ralink MT7621 SoC
        items:
          - enum:
              - gnubee,gb-pc1
              - gnubee,gb-pc2
              - tplink,hc220-g5-v1
          - const: mediatek,mt7621-soc

additionalProperties: true

...
```

## Documentation/devicetree/bindings/mips/realtek-rtl.yaml
```yaml
# SPDX-License-Identifier: GPL-2.0-or-later OR BSD-2-Clause
%YAML 1.2
---
$id: http://devicetree.org/schemas/mips/realtek-rtl.yaml#
$schema: http://devicetree.org/meta-schemas/core.yaml#

title: Realtek RTL83xx/93xx SoC series

maintainers:
  - Bert Vermeulen <bert@biot.com>
  - Sander Vanheule <sander@svanheule.net>

properties:
  $nodename:
    const: "/"
  compatible:
    oneOf:
      # RTL8382-based boards
      - items:
          - enum:
              - cisco,sg220-26
          - const: realtek,rtl8382-soc

additionalProperties: true
```

## Documentation/devicetree/bindings/misc/ad525x_dpot.txt
~~~~
# Digital Potentiometers  compatible with Analog Devices family

# Required properties:
- compatible <I2C>: 
  * "ad5258"
  * "ad5259"
  * "ad5251"
  * "ad5252"
  * "ad5253"
  * "ad5254"
  * "ad5255"
  * "ad5241"
  * "ad5242"
  * "ad5243"
  * "ad5245"
  * "ad5246"
  * "ad5247"
  * "ad5248"
  * "ad5280"
  * "ad5282"
  * "adn2860"
  * "ad5273"
  * "ad5161"
  * "ad5171"
  * "ad5170"
  * "ad5172"
  * "ad5173"
  * "ad5272"
  * "ad5274"
- compatible <SPI>: 
  * "ad,ad5160"
  * "ad,ad5161"
  * "ad,ad5162"
  * "ad,ad5165"
  * "ad,ad5200"
  * "ad,ad5201"
  * "ad,ad5203"
  * "ad,ad5204"
  * "ad,ad5206"
  * "ad,ad5207"
  * "ad,ad5231"
  * "ad,ad5232"
  * "ad,ad5233"
  * "ad,ad5235"
  * "ad,ad5260"
  * "ad,ad5262"
  * "ad,ad5263"
  * "ad,ad5290"
  * "ad,ad5291"
  * "ad,ad5292"
  * "ad,ad5293"
  * "ad,ad7376"
  * "ad,ad8400"
  * "ad,ad8402"
  * "ad,ad8403"
  * "ad,adn2850"
  * "ad,ad5270"
  * "ad,ad5271"
- reg : spi chip select number for the device / I2C address
- spi-max-frequency : max spi frequency to use
Example for SPI:
```
ad5204@1 {
address-cells = <1>;
size-cells = <1>;
compatible = "ad,ad5204";
spi-max-frequency = <5000000>;
reg = <1>;
};
```
Example for I2C:
```
ad5242@2c {
compatible = "ad,ad5242";
reg = <2c>;
};
```
~~~~

## Documentation/devicetree/bindings/misc/allwinner,sunxi-sid.txt
```
Allwinner sunxi-sid

Required properties:
- compatible: "allwinner,sun4i-sid" or "allwinner,sun7i-a20-sid".
- reg: Should contain registers location and length

Example for sun4i:
	sid@01c23800 {
		compatible = "allwinner,sun4i-sid";
		reg = <0x01c23800 0x10>
	};

Example for sun7i:
	sid@01c23800 {
		compatible = "allwinner,sun7i-a20-sid";
		reg = <0x01c23800 0x200>
	};
```

## Documentation/devicetree/bindings/misc/allwinner,syscon.txt
```
* Allwinner sun8i system controller

This file describes the bindings for the system controller present in
Allwinner SoC H3, A83T and A64.
The principal function of this syscon is to control EMAC PHY choice and
config.

Required properties for the system controller:
- reg: address and length of the register for the device.
- compatible: should be "syscon" and one of the following string:
		"allwinner,sun8i-h3-system-controller"
		"allwinner,sun8i-v3s-system-controller"
		"allwinner,sun50i-a64-system-controller"
		"allwinner,sun8i-a83t-system-controller"

Example:
syscon: syscon@1c00000 {
	compatible = "allwinner,sun8i-h3-system-controller", "syscon";
	reg = <0x01c00000 0x1000>;
};
```

## Documentation/devicetree/bindings/misc/altera-hwmutex.txt
```
Altera hardware mutex
Altera hardware mutex can provide hardware assistance for synchronization and
mutual exclusion between processors in asymmetric/symmetric multiprocessing
(AMP/SMP) system or multi processes/threads in uniprocessor system.

Required properties:
- compatible : "altr,mutex-1.0".
- reg : physical base address of the mutex and length of memory mapped
     region.

Example:
	mutex0: mutex0@0x100 {
		compatible = "altr,hwmutex-1.0";
		reg = <0x100 0x8>;
	};

Example of mutex's client node that includes mutex phandle.
	mclient0: mclient0@0x200 {
		compatible = "client-1.0";
		reg = <0x200 0x10>;
		mutex = <&mutex0>;
	};
```

## Documentation/devicetree/bindings/misc/altera-interrupt-latency-counter.txt
```
Altera Interrupt Latency Counter soft IP
Altera Interrupt Latency Counter IP core driver provides a sysfs interface
for user to obtain interrupt latency values from Altera Interrupt Latency
Counter soft IP.

The sysfs interface is located at path,
/sys/bus/platform/devices/{addr}.ilc/ilc_data/{int_#}
with
- {addr}  = the base address of the soft ip
- {int_#} = the interrupt number

Example use case:
# cat /sys/bus/platform/devices/c0010000.ilc/ilc_data/40

Required properties:
- compatible :
  - "altr,ilc-1.0"
- reg :
  - physical base address of the soft ip and length of memory mapped region
- interrupt-parent :
  - interrupt source phandle similiar to the interrupt source node
- interrupts :
  -interrupt number. The interrupt specifier format depends on the interrupt
   controller parent

Altera specific properties:
- altr,sw-fifo-depth :
  - define software fifo depth needed to record latency values

Note:
- For edge triggered interrupt, the order of loading the ILC driver relative
 to driver of the actual interrupt source affects the meaning of the ILC
 values. If the ILC driver is loaded first, then the count values represent
 the time to the start of the interrupt handler of the of the interrupt source.
 If the order is switched, then the counts represent the time to finish the
 interrupt handler for the interrupt source.

- The driver for the interrupt source must be changed to request a shared irq.

Example:
	interrupt_latency_counter_0: intc@0x10000000 {
		compatible = "altr,ilc-1.0";
		reg = <0x10000000 0x00000100>;
		interrupt-parent = < &interrupt_parent >;
		interrupts = < 0 1 4 >;
		altr,sw-fifo-depth = < 32 >;
	};
```

## Documentation/devicetree/bindings/misc/altera_sysid.txt
```
Altera Sysid IP core driver

Required properties:
- compatible: altr,sysid-1.0

Example:

sysid_qsys: sysid@0x10000 {
	compatible = "altr,sysid-1.0";
	reg = < 0x10000 0x00000008 >;
};
```

## Documentation/devicetree/bindings/misc/arm,scpi-mhu.txt
```
ARM SCPI MHU driver.

This driver uses the Message Handling Unit hardware to talk with
a System Controll Processor using the SCPI interface.

Required properties:
  - compatible: "arm,scpi-mhu"
  - reg: two pairs of register address and size data, first for the
    start of the MHU registers area, second for the payload area.
  - interrupts: Interrupt list for low priority and high priority
    channel, in that order.
  - #clock-cells: from common clock bindings; should be set to 1 if
    the SCP offers support for controlling oscillator frequencies, 0
    otherwise.
  - clock-output-names: List of names for the the oscillator output(s).


Examples:
   scp: scp@2b1f0000 {
	compatible = "arm,scpi-mhu";
	reg = <0x0 0x2b1f0000 0x0 0x10000>,   /* MHU registers */
	      <0x0 0x2e000000 0x0 0x10000>;   /* Payload area */
	interrupts = <0 36 4>,    /* low priority channel interrupt */
		     <0 35 4>,	  /* high priority channel interrupt */
		     <0 37 4>;    /* secure channel interrupt */
	#clock-cells = <1>;
	clock-output-names= "a57", "a53", "gpu", hdlcd0", "hdlcd1";
   };
```

## Documentation/devicetree/bindings/misc/arm-charlcd.txt
```
ARM Versatile Character LCD
-----------------------------------------------------
This binding defines the character LCD interface found on ARM Versatile AB
and PB reference platforms.

Required properties:
- compatible : "arm,versatile-clcd"
- reg : Location and size of character LCD registers

Optional properties:
- interrupts - single interrupt for character LCD. The character LCD can
  operate in polled mode without an interrupt.

Example:
	lcd@10008000 {
		compatible = "arm,versatile-lcd";
		reg = <0x10008000 0x1000>;
	};
```

## Documentation/devicetree/bindings/misc/aspeed,ast2400-cvic.yaml
```yaml
# SPDX-License-Identifier: (GPL-2.0-only OR BSD-2-Clause)
%YAML 1.2
---
$id: http://devicetree.org/schemas/misc/aspeed,ast2400-cvic.yaml#
$schema: http://devicetree.org/meta-schemas/core.yaml#

title: Aspeed Coprocessor Vectored Interrupt Controller

maintainers:
  - Andrew Jeffery <andrew@codeconstruct.com.au>

description:
  The Aspeed AST2400 and AST2500 SoCs have a controller that provides interrupts
  to the ColdFire coprocessor. It's not a normal interrupt controller and it
  would be rather inconvenient to create an interrupt tree for it, as it
  somewhat shares some of the same sources as the main ARM interrupt controller
  but with different numbers.

  The AST2500 also supports a software generated interrupt.

properties:
  compatible:
    items:
      - enum:
          - aspeed,ast2400-cvic
          - aspeed,ast2500-cvic
      - const: aspeed,cvic

  reg:
    maxItems: 1

  valid-sources:
    $ref: /schemas/types.yaml#/definitions/uint32-array
    maxItems: 1
    description:
      A bitmap of supported sources for the implementation.

  copro-sw-interrupts:
    $ref: /schemas/types.yaml#/definitions/uint32-array
    minItems: 1
    maxItems: 32
    description:
      A list of interrupt numbers that can be used as software interrupts from
      the ARM to the coprocessor.

required:
  - compatible
  - reg
  - valid-sources

additionalProperties: false

examples:
  - |
    interrupt-controller@1e6c2000 {
        compatible = "aspeed,ast2500-cvic", "aspeed,cvic";
        reg = <0x1e6c2000 0x80>;
        valid-sources = <0xffffffff>;
        copro-sw-interrupts = <1>;
    };
```
