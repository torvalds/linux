## Documentation/devicetree/bindings/clock/qcom,krait-cc.yaml
```yaml
# SPDX-License-Identifier: (GPL-2.0-only OR BSD-2-Clause)
%YAML 1.2
---
$id: http://devicetree.org/schemas/clock/qcom,krait-cc.yaml#
$schema: http://devicetree.org/meta-schemas/core.yaml#

title: Krait Clock Controller

maintainers:
  - Stephen Boyd <sboyd@kernel.org>

properties:
  compatible:
    enum:
      - qcom,krait-cc-v1
      - qcom,krait-cc-v2

  '#clock-cells':
    const: 1

  clocks:
    items:
      - description: Parent clock phandle for hfpll0
      - description: Parent clock phandle for hfpll1
      - description: Parent clock phandle for acpu0_aux
      - description: Parent clock phandle for acpu1_aux
      - description: Parent clock phandle for qsb

  clock-names:
    items:
      - const: hfpll0
      - const: hfpll1
      - const: acpu0_aux
      - const: acpu1_aux
      - const: qsb

required:
  - compatible
  - '#clock-cells'
  - clocks
  - clock-names

additionalProperties: false
```

## Documentation/devicetree/bindings/clock/qcom,lcc.txt
```
Qualcomm LPASS Clock & Reset Controller Binding
------------------------------------------------

Required properties :
- compatible : shall contain only one of the following:

			"qcom,lcc-msm8960"
			"qcom,lcc-apq8064"
			"qcom,lcc-ipq8064"

- reg : shall contain base register location and length
- #clock-cells : shall contain 1
- #reset-cells : shall contain 1

Example:
	clock-controller@28000000 {
		compatible = "qcom,lcc-ipq8064";
		reg = <0x28000000 0x1000>;
		#clock-cells = <1>;
		#reset-cells = <1>;
	};
```

## Documentation/devicetree/bindings/clock/qcom,lcc.yaml
```yaml
# SPDX-License-Identifier: GPL-2.0-only
%YAML 1.2
---
$id: http://devicetree.org/schemas/clock/qcom,lcc.yaml#
$schema: http://devicetree.org/meta-schemas/core.yaml#

title: Qualcomm LPASS Clock & Reset Controller

maintainers:
  - Bjorn Andersson <andersson@kernel.org>

properties:
  compatible:
    enum:
      - qcom,lcc-apq8064
      - qcom,lcc-ipq8064
      - qcom,lcc-mdm9615
      - qcom,lcc-msm8960

  clocks:
    maxItems: 8

  clock-names:
    maxItems: 8

  '#clock-cells':
    const: 1

  '#reset-cells':
    const: 1

  reg:
    maxItems: 1

required:
  - compatible
  - reg
  - '#clock-cells'
  - '#reset-cells'

additionalProperties: false

allOf:
  - if:
      properties:
        compatible:
          contains:
            enum:
              - qcom,lcc-apq8064
              - qcom,lcc-msm8960
    then:
      properties:
        clocks:
          items:
            - description: Board PXO source
            - description: PLL 4 Vote clock
            - description: MI2S codec clock
            - description: Mic I2S codec clock
            - description: Mic I2S spare clock
            - description: Speaker I2S codec clock
            - description: Speaker I2S spare clock
            - description: PCM codec clock

        clock-names:
          items:
            - const: pxo
            - const: pll4_vote
            - const: mi2s_codec_clk
            - const: codec_i2s_mic_codec_clk
            - const: spare_i2s_mic_codec_clk
            - const: codec_i2s_spkr_codec_clk
            - const: spare_i2s_spkr_codec_clk
            - const: pcm_codec_clk

      required:
        - clocks
        - clock-names

  - if:
      properties:
        compatible:
          contains:
            enum:
              - qcom,lcc-mdm9615
    then:
      properties:
        clocks:
          items:
            - description: Board CXO source
            - description: PLL 4 Vote clock
            - description: MI2S codec clock
            - description: Mic I2S codec clock
            - description: Mic I2S spare clock
            - description: Speaker I2S codec clock
            - description: Speaker I2S spare clock
            - description: PCM codec clock

        clock-names:
          items:
            - const: cxo
            - const: pll4_vote
            - const: mi2s_codec_clk
            - const: codec_i2s_mic_codec_clk
            - const: spare_i2s_mic_codec_clk
            - const: codec_i2s_spkr_codec_clk
            - const: spare_i2s_spkr_codec_clk
            - const: pcm_codec_clk

      required:
        - clocks
        - clock-names

examples:
  - |
    clock-controller@28000000 {
        compatible = "qcom,lcc-ipq8064";
        reg = <0x28000000 0x1000>;
        #clock-cells = <1>;
        #reset-cells = <1>;
    };
```

## Documentation/devicetree/bindings/clock/qcom,lpasscc.txt
```
Qualcomm LPASS Clock Controller Binding
-----------------------------------------------

Required properties :
- compatible		: shall contain "qcom,sdm845-lpasscc"
- #clock-cells		: from common clock binding, shall contain 1.
- reg			: shall contain base register address and size,
			  in the order
			Index-0 maps to LPASS_CC register region
			Index-1 maps to LPASS_QDSP6SS register region

Optional properties :
- reg-names	: register names of LPASS domain
		 "cc", "qdsp6ss".

Example:

The below node has to be defined in the cases where the LPASS peripheral loader
would bring the subsystem out of reset.

	lpasscc: clock-controller@17014000 {
		compatible = "qcom,sdm845-lpasscc";
		reg = <0x17014000 0x1f004>, <0x17300000 0x200>;
		reg-names = "cc", "qdsp6ss";
		#clock-cells = <1>;
	};
```

## Documentation/devicetree/bindings/clock/qcom,milos-dispcc.yaml
```yaml
# SPDX-License-Identifier: (GPL-2.0-only OR BSD-2-Clause)
%YAML 1.2
---
$id: http://devicetree.org/schemas/clock/qcom,milos-dispcc.yaml#
$schema: http://devicetree.org/meta-schemas/core.yaml#

title: Qualcomm Display Clock & Reset Controller on Milos

maintainers:
  - Luca Weiss <luca.weiss@fairphone.com>

description: |
  Qualcomm display clock control module provides the clocks, resets and power
  domains on Milos.

  See also: include/dt-bindings/clock/qcom,milos-dispcc.h

properties:
  compatible:
    const: qcom,milos-dispcc

  clocks:
    items:
      - description: Board XO source
      - description: Sleep clock source
      - description: Display's AHB clock
      - description: GPLL0 source from GCC
      - description: Byte clock from DSI PHY0
      - description: Pixel clock from DSI PHY0
      - description: Link clock from DP PHY0
      - description: VCO DIV clock from DP PHY0

required:
  - compatible
  - clocks
  - '#power-domain-cells'

allOf:
  - $ref: qcom,gcc.yaml#

unevaluatedProperties: false

examples:
  - |
    #include <dt-bindings/clock/qcom,milos-gcc.h>
    #include <dt-bindings/phy/phy-qcom-qmp.h>
    clock-controller@af00000 {
        compatible = "qcom,milos-dispcc";
        reg = <0x0af00000 0x20000>;
        clocks = <&bi_tcxo_div2>,
                 <&sleep_clk>,
                 <&gcc GCC_DISP_AHB_CLK>,
                 <&gcc GCC_DISP_GPLL0_DIV_CLK_SRC>,
                 <&mdss_dsi0_phy 0>,
                 <&mdss_dsi0_phy 1>,
                 <&usb_dp_qmpphy QMP_USB43DP_DP_LINK_CLK>,
                 <&usb_dp_qmpphy QMP_USB43DP_DP_VCO_DIV_CLK>;
        #clock-cells = <1>;
        #reset-cells = <1>;
        #power-domain-cells = <1>;
    };

...
```

## Documentation/devicetree/bindings/clock/qcom,milos-gcc.yaml
```yaml
# SPDX-License-Identifier: (GPL-2.0-only OR BSD-2-Clause)
%YAML 1.2
---
$id: http://devicetree.org/schemas/clock/qcom,milos-gcc.yaml#
$schema: http://devicetree.org/meta-schemas/core.yaml#

title: Qualcomm Global Clock & Reset Controller on Milos

maintainers:
  - Luca Weiss <luca.weiss@fairphone.com>

description: |
  Qualcomm global clock control module provides the clocks, resets and power
  domains on Milos.

  See also: include/dt-bindings/clock/qcom,milos-gcc.h

properties:
  compatible:
    const: qcom,milos-gcc

  clocks:
    items:
      - description: Board XO source
      - description: Sleep clock source
      - description: PCIE 0 Pipe clock source
      - description: PCIE 1 Pipe clock source
      - description: UFS Phy Rx symbol 0 clock source
      - description: UFS Phy Rx symbol 1 clock source
      - description: UFS Phy Tx symbol 0 clock source
      - description: USB3 Phy wrapper pipe clock source

required:
  - compatible
  - clocks
  - '#power-domain-cells'

allOf:
  - $ref: qcom,gcc.yaml#

unevaluatedProperties: false

examples:
  - |
    #include <dt-bindings/clock/qcom,rpmh.h>
    clock-controller@100000 {
        compatible = "qcom,milos-gcc";
        reg = <0x00100000 0x1f4200>;
        clocks = <&rpmhcc RPMH_CXO_CLK>,
                 <&sleep_clk>,
                 <&pcie0_phy>,
                 <&pcie1_phy>,
                 <&ufs_mem_phy 0>,
                 <&ufs_mem_phy 1>,
                 <&ufs_mem_phy 2>,
                 <&usb_1_qmpphy>;
        #clock-cells = <1>;
        #reset-cells = <1>;
        #power-domain-cells = <1>;
    };

...
```

## Documentation/devicetree/bindings/clock/qcom,milos-gxclkctl.yaml
```yaml
# SPDX-License-Identifier: (GPL-2.0-only OR BSD-2-Clause)
%YAML 1.2
---
$id: http://devicetree.org/schemas/clock/qcom,milos-gxclkctl.yaml#
$schema: http://devicetree.org/meta-schemas/core.yaml#

title: Qualcomm Graphics Power Domain Controller on Milos

maintainers:
  - Luca Weiss <luca.weiss@fairphone.com>

description: |
  Qualcomm GX(graphics) is a clock controller which has PLLs, clocks and
  Power domains (GDSC). This module provides the power domains control
  of gxclkctl on Qualcomm SoCs which helps the recovery of Graphics subsystem.

  See also:
    include/dt-bindings/clock/qcom,kaanapali-gxclkctl.h

properties:
  compatible:
    enum:
      - qcom,milos-gxclkctl

  reg:
    maxItems: 1

  power-domains:
    description:
      Power domains required for the clock controller to operate
    items:
      - description: GFX power domain
      - description: GPUCC(CX) power domain

  '#power-domain-cells':
    const: 1

required:
  - compatible
  - reg
  - power-domains
  - '#power-domain-cells'

additionalProperties: false

examples:
  - |
    #include <dt-bindings/power/qcom,rpmhpd.h>
    soc {
        #address-cells = <2>;
        #size-cells = <2>;

        clock-controller@3d64000 {
            compatible = "qcom,milos-gxclkctl";
            reg = <0x0 0x03d64000 0x0 0x6000>;
            power-domains = <&rpmhpd RPMHPD_GFX>,
                            <&gpucc 0>;
            #power-domain-cells = <1>;
        };
    };
...
```

## Documentation/devicetree/bindings/clock/qcom,mmcc.txt
```
Qualcomm Multimedia Clock & Reset Controller Binding
----------------------------------------------------

Required properties :
- compatible : shall contain only one of the following:

			"qcom,mmcc-msm8660"
			"qcom,mmcc-msm8960"
			"qcom,mmcc-msm8974"

- reg : shall contain base register location and length
- #clock-cells : shall contain 1
- #reset-cells : shall contain 1

Example:
	clock-controller@4000000 {
		compatible = "qcom,mmcc-msm8960";
		reg = <0x4000000 0x1000>;
		#clock-cells = <1>;
		#reset-cells = <1>;
	};
```
