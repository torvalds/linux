## Documentation/devicetree/bindings/clock/qcom,qca8k-nsscc.yaml
```yaml
# SPDX-License-Identifier: (GPL-2.0-only OR BSD-2-Clause)
%YAML 1.2
---
$id: http://devicetree.org/schemas/clock/qcom,qca8k-nsscc.yaml#
$schema: http://devicetree.org/meta-schemas/core.yaml#

title: Qualcomm NSS Clock & Reset Controller on QCA8386/QCA8084

maintainers:
  - Bjorn Andersson <andersson@kernel.org>
  - Luo Jie <quic_luoj@quicinc.com>

description: |
  Qualcomm NSS clock control module provides the clocks and resets
  on QCA8386(switch mode)/QCA8084(PHY mode)

  See also::
    include/dt-bindings/clock/qcom,qca8k-nsscc.h
    include/dt-bindings/reset/qcom,qca8k-nsscc.h

properties:
  compatible:
    oneOf:
      - const: qcom,qca8084-nsscc
      - items:
          - enum:
              - qcom,qca8082-nsscc
              - qcom,qca8085-nsscc
              - qcom,qca8384-nsscc
              - qcom,qca8385-nsscc
              - qcom,qca8386-nsscc
          - const: qcom,qca8084-nsscc

  clocks:
    items:
      - description: Chip reference clock source
      - description: UNIPHY0 RX 312P5M/125M clock source
      - description: UNIPHY0 TX 312P5M/125M clock source
      - description: UNIPHY1 RX 312P5M/125M clock source
      - description: UNIPHY1 TX 312P5M/125M clock source
      - description: UNIPHY1 RX 312P5M clock source
      - description: UNIPHY1 TX 312P5M clock source

  reg:
    items:
      - description: MDIO bus address for Clock & Reset Controller register

  reset-gpios:
    description: GPIO connected to the chip
    maxItems: 1

required:
  - compatible
  - clocks
  - reg
  - reset-gpios

allOf:
  - $ref: qcom,gcc.yaml#

unevaluatedProperties: false

examples:
  - |
    #include <dt-bindings/gpio/gpio.h>
    mdio {
      #address-cells = <1>;
      #size-cells = <0>;

      clock-controller@18 {
        compatible = "qcom,qca8084-nsscc";
        reg = <0x18>;
        reset-gpios = <&tlmm 51 GPIO_ACTIVE_LOW>;
        clocks = <&pcs0_pll>,
                 <&qca8k_uniphy0_rx>,
                 <&qca8k_uniphy0_tx>,
                 <&qca8k_uniphy1_rx>,
                 <&qca8k_uniphy1_tx>,
                 <&qca8k_uniphy1_rx312p5m>,
                 <&qca8k_uniphy1_tx312p5m>;
        #clock-cells = <1>;
        #reset-cells = <1>;
        #power-domain-cells = <1>;
      };
    };
...
```

## Documentation/devicetree/bindings/clock/qcom,qcm2290-dispcc.yaml
```yaml
# SPDX-License-Identifier: (GPL-2.0-only OR BSD-2-Clause)
%YAML 1.2
---
$id: http://devicetree.org/schemas/clock/qcom,qcm2290-dispcc.yaml#
$schema: http://devicetree.org/meta-schemas/core.yaml#

title: Qualcomm Display Clock & Reset Controller on QCM2290

maintainers:
  - Loic Poulain <loic.poulain@linaro.org>

description: |
  Qualcomm display clock control module provides the clocks, resets and power
  domains on qcm2290.

  See also:: include/dt-bindings/clock/qcom,dispcc-qcm2290.h

properties:
  compatible:
    const: qcom,qcm2290-dispcc

  clocks:
    items:
      - description: Board XO source
      - description: Board active-only XO source
      - description: GPLL0 source from GCC
      - description: GPLL0 div source from GCC
      - description: Byte clock from DSI PHY
      - description: Pixel clock from DSI PHY

  clock-names:
    items:
      - const: bi_tcxo
      - const: bi_tcxo_ao
      - const: gcc_disp_gpll0_clk_src
      - const: gcc_disp_gpll0_div_clk_src
      - const: dsi0_phy_pll_out_byteclk
      - const: dsi0_phy_pll_out_dsiclk

required:
  - compatible
  - clocks
  - clock-names
  - '#power-domain-cells'

allOf:
  - $ref: qcom,gcc.yaml#

unevaluatedProperties: false

examples:
  - |
    #include <dt-bindings/clock/qcom,dispcc-qcm2290.h>
    #include <dt-bindings/clock/qcom,gcc-qcm2290.h>
    #include <dt-bindings/clock/qcom,rpmcc.h>
    clock-controller@5f00000 {
            compatible = "qcom,qcm2290-dispcc";
            reg = <0x5f00000 0x20000>;
            clocks = <&rpmcc RPM_SMD_XO_CLK_SRC>,
                     <&rpmcc RPM_SMD_XO_A_CLK_SRC>,
                     <&gcc GCC_DISP_GPLL0_CLK_SRC>,
                     <&gcc GCC_DISP_GPLL0_DIV_CLK_SRC>,
                     <&dsi0_phy 0>,
                     <&dsi0_phy 1>;
            clock-names = "bi_tcxo",
                          "bi_tcxo_ao",
                          "gcc_disp_gpll0_clk_src",
                          "gcc_disp_gpll0_div_clk_src",
                          "dsi0_phy_pll_out_byteclk",
                          "dsi0_phy_pll_out_dsiclk";
            #clock-cells = <1>;
            #reset-cells = <1>;
            #power-domain-cells = <1>;
    };
...
```

## Documentation/devicetree/bindings/clock/qcom,qcm2290-gpucc.yaml
```yaml
# SPDX-License-Identifier: (GPL-2.0-only OR BSD-2-Clause)
%YAML 1.2
---
$id: http://devicetree.org/schemas/clock/qcom,qcm2290-gpucc.yaml#
$schema: http://devicetree.org/meta-schemas/core.yaml#

title: Qualcomm Graphics Clock & Reset Controller on QCM2290

maintainers:
  - Konrad Dybcio <konradybcio@kernel.org>

description: |
  Qualcomm graphics clock control module provides the clocks, resets and power
  domains on Qualcomm SoCs.

  See also::
    include/dt-bindings/clock/qcom,qcm2290-gpucc.h

properties:
  compatible:
    const: qcom,qcm2290-gpucc

  reg:
    maxItems: 1

  clocks:
    items:
      - description: AHB interface clock,
      - description: SoC CXO clock
      - description: GPLL0 main branch source
      - description: GPLL0 div branch source

  power-domains:
    description:
      A phandle and PM domain specifier for the CX power domain.
    maxItems: 1

  required-opps:
    description:
      A phandle to an OPP node describing required CX performance point.
    maxItems: 1

required:
  - compatible
  - clocks
  - power-domains

allOf:
  - $ref: qcom,gcc.yaml#

unevaluatedProperties: false

examples:
  - |
    #include <dt-bindings/clock/qcom,gcc-qcm2290.h>
    #include <dt-bindings/clock/qcom,rpmcc.h>
    #include <dt-bindings/power/qcom-rpmpd.h>

    soc {
        #address-cells = <2>;
        #size-cells = <2>;

        clock-controller@5990000 {
            compatible = "qcom,qcm2290-gpucc";
            reg = <0x0 0x05990000 0x0 0x9000>;
            clocks = <&gcc GCC_GPU_CFG_AHB_CLK>,
                     <&rpmcc RPM_SMD_XO_CLK_SRC>,
                     <&gcc GCC_GPU_GPLL0_CLK_SRC>,
                     <&gcc GCC_GPU_GPLL0_DIV_CLK_SRC>;
            power-domains = <&rpmpd QCM2290_VDDCX>;
            required-opps = <&rpmpd_opp_low_svs>;
            #clock-cells = <1>;
            #reset-cells = <1>;
            #power-domain-cells = <1>;
        };
    };
...
```

## Documentation/devicetree/bindings/clock/qcom,qcs404-turingcc.yaml
```yaml
# SPDX-License-Identifier: (GPL-2.0-only OR BSD-2-Clause)
%YAML 1.2
---
$id: http://devicetree.org/schemas/clock/qcom,qcs404-turingcc.yaml#
$schema: http://devicetree.org/meta-schemas/core.yaml#

title: Qualcomm Turing Clock & Reset Controller on QCS404

maintainers:
  - Bjorn Andersson <andersson@kernel.org>

properties:
  compatible:
    const: qcom,qcs404-turingcc

  reg:
    maxItems: 1

  clocks:
    maxItems: 1

  '#clock-cells':
    const: 1

  '#reset-cells':
    const: 1

required:
  - compatible
  - reg
  - clocks
  - '#clock-cells'
  - '#reset-cells'

additionalProperties: false

examples:
  - |
    #include <dt-bindings/clock/qcom,gcc-qcs404.h>
    clock-controller@800000 {
        compatible = "qcom,qcs404-turingcc";
        reg = <0x00800000 0x30000>;
        clocks = <&gcc GCC_CDSP_CFG_AHB_CLK>;

        #clock-cells = <1>;
        #reset-cells = <1>;
    };
```

## Documentation/devicetree/bindings/clock/qcom,qcs615-dispcc.yaml
```yaml
# SPDX-License-Identifier: (GPL-2.0-only OR BSD-2-Clause)
%YAML 1.2
---
$id: http://devicetree.org/schemas/clock/qcom,qcs615-dispcc.yaml#
$schema: http://devicetree.org/meta-schemas/core.yaml#

title: Qualcomm Display Clock & Reset Controller on QCS615

maintainers:
  - Taniya Das <quic_tdas@quicinc.com>

description: |
  Qualcomm display clock control module provides the clocks, resets and power
  domains on QCS615.

  See also: include/dt-bindings/clock/qcom,qcs615-dispcc.h

properties:
  compatible:
    const: qcom,qcs615-dispcc

  clocks:
    items:
      - description: Board XO source
      - description: GPLL0 clock source from GCC
      - description: Byte clock from DSI PHY0
      - description: Pixel clock from DSI PHY0
      - description: Pixel clock from DSI PHY1
      - description: Display port PLL link clock
      - description: Display port PLL VCO DIV clock

allOf:
  - $ref: qcom,gcc.yaml#

unevaluatedProperties: false

examples:
  - |
    #include <dt-bindings/clock/qcom,rpmh.h>
    #include <dt-bindings/clock/qcom,qcs615-gcc.h>
    clock-controller@af00000 {
      compatible = "qcom,qcs615-dispcc";
      reg = <0x0af00000 0x20000>;
      clocks = <&rpmhcc RPMH_CXO_CLK>,
               <&gcc GCC_DISP_GPLL0_DIV_CLK_SRC>,
               <&mdss_dsi0_phy 0>,
               <&mdss_dsi0_phy 1>,
               <&mdss_dsi1_phy 0>,
               <&mdss_dp_phy 0>,
               <&mdss_dp_vco 0>;
      #clock-cells = <1>;
      #reset-cells = <1>;
      #power-domain-cells = <1>;
    };
...
```

## Documentation/devicetree/bindings/clock/qcom,qcs615-gpucc.yaml
```yaml
# SPDX-License-Identifier: (GPL-2.0-only OR BSD-2-Clause)
%YAML 1.2
---
$id: http://devicetree.org/schemas/clock/qcom,qcs615-gpucc.yaml#
$schema: http://devicetree.org/meta-schemas/core.yaml#

title: Qualcomm Graphics Clock & Reset Controller on QCS615

maintainers:
  - Taniya Das <quic_tdas@quicinc.com>

description: |
  Qualcomm graphics clock control module provides clocks, resets and power
  domains on QCS615 Qualcomm SoCs.

  See also: include/dt-bindings/clock/qcom,qcs615-gpucc.h

properties:
  compatible:
    const: qcom,qcs615-gpucc

  clocks:
    items:
      - description: Board XO source
      - description: GPLL0 main branch source
      - description: GPLL0 GPUCC div branch source

allOf:
  - $ref: qcom,gcc.yaml#

unevaluatedProperties: false

examples:
  - |
    #include <dt-bindings/clock/qcom,rpmh.h>
    #include <dt-bindings/clock/qcom,qcs615-gcc.h>

    clock-controller@5090000 {
      compatible = "qcom,qcs615-gpucc";
      reg = <0x5090000 0x9000>;
      clocks = <&rpmhcc RPMH_CXO_CLK>,
               <&gcc GPLL0>,
               <&gcc GCC_GPU_GPLL0_DIV_CLK_SRC>;

      #clock-cells = <1>;
      #reset-cells = <1>;
      #power-domain-cells = <1>;
    };
...
```

## Documentation/devicetree/bindings/clock/qcom,qcs615-videocc.yaml
```yaml
# SPDX-License-Identifier: (GPL-2.0-only OR BSD-2-Clause)
%YAML 1.2
---
$id: http://devicetree.org/schemas/clock/qcom,qcs615-videocc.yaml#
$schema: http://devicetree.org/meta-schemas/core.yaml#

title: Qualcomm Video Clock & Reset Controller on QCS615

maintainers:
  - Taniya Das <quic_tdas@quicinc.com>

description: |
  Qualcomm video clock control module provides clocks, resets and power
  domains on QCS615 Qualcomm SoCs.

  See also: include/dt-bindings/clock/qcom,qcs615-videocc.h

properties:
  compatible:
    const: qcom,qcs615-videocc

  clocks:
    items:
      - description: Board XO source
      - description: Sleep clock source

allOf:
  - $ref: qcom,gcc.yaml#

unevaluatedProperties: false

examples:
  - |
    #include <dt-bindings/clock/qcom,rpmh.h>
    #include <dt-bindings/clock/qcom,qcs615-gcc.h>

    clock-controller@ab00000 {
      compatible = "qcom,qcs615-videocc";
      reg = <0xab00000 0x10000>;
      clocks = <&rpmhcc RPMH_CXO_CLK>,
               <&sleep_clk>;

      #clock-cells = <1>;
      #reset-cells = <1>;
      #power-domain-cells = <1>;
    };
...
```

## Documentation/devicetree/bindings/clock/qcom,qcs8300-gcc.yaml
```yaml
# SPDX-License-Identifier: (GPL-2.0-only OR BSD-2-Clause)
%YAML 1.2
---
$id: http://devicetree.org/schemas/clock/qcom,qcs8300-gcc.yaml#
$schema: http://devicetree.org/meta-schemas/core.yaml#

title: Qualcomm Technologies, Inc. Global Clock & Reset Controller on QCS8300

maintainers:
  - Taniya Das <quic_tdas@quicinc.com>
  - Imran Shaik <quic_imrashai@quicinc.com>

description: |
  Qualcomm Technologies, Inc. Global clock control module provides the clocks, resets and
  power domains on QCS8300

  See also: include/dt-bindings/clock/qcom,qcs8300-gcc.h

properties:
  compatible:
    const: qcom,qcs8300-gcc

  clocks:
    items:
      - description: Board XO source
      - description: Sleep clock source
      - description: PCIE 0 Pipe clock source
      - description: PCIE 1 Pipe clock source
      - description: PCIE Phy Auxiliary clock source
      - description: First EMAC controller reference clock
      - description: UFS Phy Rx symbol 0 clock source
      - description: UFS Phy Rx symbol 1 clock source
      - description: UFS Phy Tx symbol 0 clock source
      - description: USB3 Phy wrapper pipe clock source

required:
  - compatible
  - clocks
  - '#power-domain-cells'

allOf:
  - $ref: qcom,gcc.yaml#

unevaluatedProperties: false

examples:
  - |
    #include <dt-bindings/clock/qcom,rpmh.h>
    clock-controller@100000 {
      compatible = "qcom,qcs8300-gcc";
      reg = <0x00100000 0xc7018>;
      clocks = <&rpmhcc RPMH_CXO_CLK>,
               <&sleep_clk>,
               <&pcie_0_pipe_clk>,
               <&pcie_1_pipe_clk>,
               <&pcie_phy_aux_clk>,
               <&rxc0_ref_clk>,
               <&ufs_phy_rx_symbol_0_clk>,
               <&ufs_phy_rx_symbol_1_clk>,
               <&ufs_phy_tx_symbol_0_clk>,
               <&usb3_phy_wrapper_gcc_usb30_prim_pipe_clk>;
      #clock-cells = <1>;
      #reset-cells = <1>;
      #power-domain-cells = <1>;
    };
...
```

## Documentation/devicetree/bindings/clock/qcom,qdu1000-ecpricc.yaml
```yaml
# SPDX-License-Identifier: (GPL-2.0-only OR BSD-2-Clause)
%YAML 1.2
---
$id: http://devicetree.org/schemas/clock/qcom,qdu1000-ecpricc.yaml#
$schema: http://devicetree.org/meta-schemas/core.yaml#

title: Qualcomm ECPRI Clock & Reset Controller for QDU1000 and QRU1000

maintainers:
  - Taniya Das <quic_tdas@quicinc.com>
  - Imran Shaik <quic_imrashai@quicinc.com>

description: |
  Qualcomm ECPRI Specification V2.0 Common Public Radio Interface clock control
  module which supports the clocks, resets on QDU1000 and QRU1000

  See also:: include/dt-bindings/clock/qcom,qdu1000-ecpricc.h

properties:
  compatible:
    enum:
      - qcom,qdu1000-ecpricc

  reg:
    maxItems: 1

  clocks:
    items:
      - description: Board XO source
      - description: GPLL0 source from GCC
      - description: GPLL1 source from GCC
      - description: GPLL2 source from GCC
      - description: GPLL3 source from GCC
      - description: GPLL4 source from GCC
      - description: GPLL5 source from GCC

  '#clock-cells':
    const: 1

  '#reset-cells':
    const: 1

required:
  - compatible
  - reg
  - clocks
  - '#clock-cells'
  - '#reset-cells'

additionalProperties: false

examples:
  - |
    #include <dt-bindings/clock/qcom,qdu1000-gcc.h>
    #include <dt-bindings/clock/qcom,rpmh.h>
    clock-controller@280000 {
      compatible = "qcom,qdu1000-ecpricc";
      reg = <0x00280000 0x31c00>;
      clocks = <&rpmhcc RPMH_CXO_CLK>,
               <&gcc GCC_ECPRI_CC_GPLL0_CLK_SRC>,
               <&gcc GCC_ECPRI_CC_GPLL1_EVEN_CLK_SRC>,
               <&gcc GCC_ECPRI_CC_GPLL2_EVEN_CLK_SRC>,
               <&gcc GCC_ECPRI_CC_GPLL3_CLK_SRC>,
               <&gcc GCC_ECPRI_CC_GPLL4_CLK_SRC>,
               <&gcc GCC_ECPRI_CC_GPLL5_EVEN_CLK_SRC>;
      #clock-cells = <1>;
      #reset-cells = <1>;
    };
```
