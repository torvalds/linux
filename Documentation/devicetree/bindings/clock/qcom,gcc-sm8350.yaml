## Documentation/devicetree/bindings/clock/qcom,gcc-sm8350.yaml
```yaml
# SPDX-License-Identifier: (GPL-2.0-only OR BSD-2-Clause)
%YAML 1.2
---
$id: http://devicetree.org/schemas/clock/qcom,gcc-sm8350.yaml#
$schema: http://devicetree.org/meta-schemas/core.yaml#

title: Qualcomm Global Clock & Reset Controller on SM8350

maintainers:
  - Vinod Koul <vkoul@kernel.org>

description: |
  Qualcomm global clock control module provides the clocks, resets and power
  domains on SM8350.

  See also:: include/dt-bindings/clock/qcom,gcc-sm8350.h

properties:
  compatible:
    const: qcom,gcc-sm8350

  clocks:
    items:
      - description: Board XO source
      - description: Sleep clock source
      - description: PLL test clock source (Optional clock)
      - description: PCIE 0 Pipe clock source (Optional clock)
      - description: PCIE 1 Pipe clock source (Optional clock)
      - description: UFS card Rx symbol 0 clock source (Optional clock)
      - description: UFS card Rx symbol 1 clock source (Optional clock)
      - description: UFS card Tx symbol 0 clock source (Optional clock)
      - description: UFS phy Rx symbol 0 clock source (Optional clock)
      - description: UFS phy Rx symbol 1 clock source (Optional clock)
      - description: UFS phy Tx symbol 0 clock source (Optional clock)
      - description: USB3 phy wrapper pipe clock source (Optional clock)
      - description: USB3 phy sec pipe clock source (Optional clock)
    minItems: 2

  clock-names:
    items:
      - const: bi_tcxo
      - const: sleep_clk
      - const: core_bi_pll_test_se # Optional clock
      - const: pcie_0_pipe_clk # Optional clock
      - const: pcie_1_pipe_clk # Optional clock
      - const: ufs_card_rx_symbol_0_clk # Optional clock
      - const: ufs_card_rx_symbol_1_clk # Optional clock
      - const: ufs_card_tx_symbol_0_clk # Optional clock
      - const: ufs_phy_rx_symbol_0_clk # Optional clock
      - const: ufs_phy_rx_symbol_1_clk # Optional clock
      - const: ufs_phy_tx_symbol_0_clk # Optional clock
      - const: usb3_phy_wrapper_gcc_usb30_pipe_clk # Optional clock
      - const: usb3_uni_phy_sec_gcc_usb30_pipe_clk # Optional clock
    minItems: 2

required:
  - compatible
  - clocks
  - clock-names

allOf:
  - $ref: qcom,gcc.yaml#

unevaluatedProperties: false

examples:
  - |
    #include <dt-bindings/clock/qcom,rpmh.h>
    clock-controller@100000 {
      compatible = "qcom,gcc-sm8350";
      reg = <0x00100000 0x1f0000>;
      clocks = <&rpmhcc RPMH_CXO_CLK>,
               <&sleep_clk>;
      clock-names = "bi_tcxo", "sleep_clk";
      #clock-cells = <1>;
      #reset-cells = <1>;
      #power-domain-cells = <1>;
    };

...
```

## Documentation/devicetree/bindings/clock/qcom,gcc-sm8450.yaml
```yaml
# SPDX-License-Identifier: (GPL-2.0-only OR BSD-2-Clause)
%YAML 1.2
---
$id: http://devicetree.org/schemas/clock/qcom,gcc-sm8450.yaml#
$schema: http://devicetree.org/meta-schemas/core.yaml#

title: Qualcomm Global Clock & Reset Controller on SM8450

maintainers:
  - Vinod Koul <vkoul@kernel.org>

description: |
  Qualcomm global clock control module provides the clocks, resets and power
  domains on SM8450

  See also:: include/dt-bindings/clock/qcom,gcc-sm8450.h

properties:
  compatible:
    const: qcom,gcc-sm8450

  clocks:
    items:
      - description: Board XO source
      - description: Sleep clock source
      - description: PCIE 0 Pipe clock source (Optional clock)
      - description: PCIE 1 Pipe clock source (Optional clock)
      - description: PCIE 1 Phy Auxiliary clock source (Optional clock)
      - description: UFS Phy Rx symbol 0 clock source (Optional clock)
      - description: UFS Phy Rx symbol 1 clock source (Optional clock)
      - description: UFS Phy Tx symbol 0 clock source (Optional clock)
      - description: USB3 Phy wrapper pipe clock source (Optional clock)
    minItems: 2

  clock-names:
    items:
      - const: bi_tcxo
      - const: sleep_clk
      - const: pcie_0_pipe_clk # Optional clock
      - const: pcie_1_pipe_clk # Optional clock
      - const: pcie_1_phy_aux_clk # Optional clock
      - const: ufs_phy_rx_symbol_0_clk # Optional clock
      - const: ufs_phy_rx_symbol_1_clk # Optional clock
      - const: ufs_phy_tx_symbol_0_clk # Optional clock
      - const: usb3_phy_wrapper_gcc_usb30_pipe_clk # Optional clock
    minItems: 2

required:
  - compatible
  - clocks
  - clock-names
  - '#power-domain-cells'

allOf:
  - $ref: qcom,gcc.yaml#

unevaluatedProperties: false

examples:
  - |
    #include <dt-bindings/clock/qcom,rpmh.h>
    clock-controller@100000 {
      compatible = "qcom,gcc-sm8450";
      reg = <0x00100000 0x001f4200>;
      clocks = <&rpmhcc RPMH_CXO_CLK>, <&sleep_clk>;
      clock-names = "bi_tcxo", "sleep_clk";
      #clock-cells = <1>;
      #reset-cells = <1>;
      #power-domain-cells = <1>;
    };

...
```

## Documentation/devicetree/bindings/clock/qcom,gcc.txt
```
Qualcomm Global Clock & Reset Controller Binding
------------------------------------------------

Required properties :
- compatible : shall contain only one of the following:

			"qcom,gcc-apq8064"
			"qcom,gcc-apq8084"
			"qcom,gcc-ipq8064"
			"qcom,gcc-ipq4019"
			"qcom,gcc-ipq8074"
			"qcom,gcc-msm8660"
			"qcom,gcc-msm8916"
			"qcom,gcc-msm8960"
			"qcom,gcc-msm8974"
			"qcom,gcc-msm8974pro"
			"qcom,gcc-msm8974pro-ac"
			"qcom,gcc-msm8994"
			"qcom,gcc-msm8996"
			"qcom,gcc-msm8998"
			"qcom,gcc-mdm9615"
			"qcom,gcc-qcs404"
			"qcom,gcc-sdm630"
			"qcom,gcc-sdm660"
			"qcom,gcc-sdm845"
			"qcom,gcc-sm8150"

- reg : shall contain base register location and length
- #clock-cells : shall contain 1
- #reset-cells : shall contain 1

Optional properties :
- #power-domain-cells : shall contain 1
- Qualcomm TSENS (thermal sensor device) on some devices can
be part of GCC and hence the TSENS properties can also be
part of the GCC/clock-controller node.
For more details on the TSENS properties please refer
Documentation/devicetree/bindings/thermal/qcom-tsens.txt
- protected-clocks : Protected clock specifier list as per common clock
 binding.

For SM8150 only:
       - clocks: a list of phandles and clock-specifier pairs,
                 one for each entry in clock-names.
       - clock-names: "bi_tcxo" (required)
                      "sleep_clk" (optional)
                      "aud_ref_clock" (optional)

Example:
	clock-controller@900000 {
		compatible = "qcom,gcc-msm8960";
		reg = <0x900000 0x4000>;
		#clock-cells = <1>;
		#reset-cells = <1>;
		#power-domain-cells = <1>;
	};

Example of GCC with TSENS properties:
	clock-controller@900000 {
		compatible = "qcom,gcc-apq8064";
		reg = <0x00900000 0x4000>;
		nvmem-cells = <&tsens_calib>, <&tsens_backup>;
		nvmem-cell-names = "calib", "calib_backup";
		#clock-cells = <1>;
		#reset-cells = <1>;
		#thermal-sensor-cells = <1>;
	};

Example of GCC with protected-clocks properties:
	clock-controller@100000 {
		compatible = "qcom,gcc-sdm845";
		reg = <0x100000 0x1f0000>;
		#clock-cells = <1>;
		#reset-cells = <1>;
		#power-domain-cells = <1>;
		protected-clocks = <GCC_QSPI_CORE_CLK>,
				   <GCC_QSPI_CORE_CLK_SRC>,
				   <GCC_QSPI_CNOC_PERIPH_AHB_CLK>,
				   <GCC_LPASS_Q6_AXI_CLK>,
				   <GCC_LPASS_SWAY_CLK>;
	};

Example of GCC with clocks
	gcc: clock-controller@100000 {
		compatible = "qcom,gcc-sm8150";
		reg = <0x00100000 0x1f0000>;
		#clock-cells = <1>;
		#reset-cells = <1>;
		#power-domain-cells = <1>;
		clock-names = "bi_tcxo",
		              "sleep_clk";
		clocks = <&rpmcc RPM_SMD_XO_CLK_SRC>,
			 <&sleep_clk>;
	};
```

## Documentation/devicetree/bindings/clock/qcom,gcc.yaml
```yaml
# SPDX-License-Identifier: GPL-2.0-only
%YAML 1.2
---
$id: http://devicetree.org/schemas/clock/qcom,gcc.yaml#
$schema: http://devicetree.org/meta-schemas/core.yaml#

title: Qualcomm Global Clock & Reset Controller Binding Common Bindings

maintainers:
  - Stephen Boyd <sboyd@kernel.org>
  - Taniya Das <tdas@codeaurora.org>

description: |
  Common bindings for Qualcomm global clock control module which supports
  the clocks, resets and power domains.

properties:
  '#clock-cells':
    const: 1

  '#reset-cells':
    const: 1

  '#power-domain-cells':
    const: 1

  reg:
    maxItems: 1

  protected-clocks:
    description:
      Protected clock specifier list as per common clock binding.

required:
  - reg
  - '#clock-cells'
  - '#reset-cells'
  - '#power-domain-cells'

additionalProperties: true

...
```

## Documentation/devicetree/bindings/clock/qcom,glymur-dispcc.yaml
```yaml
# SPDX-License-Identifier: (GPL-2.0-only OR BSD-2-Clause)
%YAML 1.2
---
$id: http://devicetree.org/schemas/clock/qcom,glymur-dispcc.yaml#
$schema: http://devicetree.org/meta-schemas/core.yaml#

title: Qualcomm Display Clock & Reset Controller on GLYMUR

maintainers:
  - Taniya Das <taniya.das@oss.qualcomm.com>

description: |
  Qualcomm display clock control module which supports the clocks, resets and
  power domains for the MDSS instances on GLYMUR SoC.

  See also:
    include/dt-bindings/clock/qcom,dispcc-glymur.h

properties:
  compatible:
    enum:
      - qcom,glymur-dispcc

  clocks:
    items:
      - description: Board CXO clock
      - description: Board sleep clock
      - description: DisplayPort 0 link clock
      - description: DisplayPort 0 VCO div clock
      - description: DisplayPort 1 link clock
      - description: DisplayPort 1 VCO div clock
      - description: DisplayPort 2 link clock
      - description: DisplayPort 2 VCO div clock
      - description: DisplayPort 3 link clock
      - description: DisplayPort 3 VCO div clock
      - description: DSI 0 PLL byte clock
      - description: DSI 0 PLL DSI clock
      - description: DSI 1 PLL byte clock
      - description: DSI 1 PLL DSI clock
      - description: Standalone PHY 0 PLL link clock
      - description: Standalone PHY 0 VCO div clock
      - description: Standalone PHY 1 PLL link clock
      - description: Standalone PHY 1 VCO div clock

  power-domains:
    description:
      A phandle and PM domain specifier for the MMCX power domain.
    maxItems: 1

  required-opps:
    description:
      A phandle to an OPP node describing required MMCX performance point.
    maxItems: 1

required:
  - compatible
  - clocks
  - power-domains
  - '#power-domain-cells'

allOf:
  - $ref: qcom,gcc.yaml#

unevaluatedProperties: false

examples:
  - |
    #include <dt-bindings/clock/qcom,rpmh.h>
    #include <dt-bindings/power/qcom,rpmhpd.h>

    clock-controller@af00000 {
      compatible = "qcom,glymur-dispcc";
      reg = <0x0af00000 0x20000>;
      clocks = <&rpmhcc RPMH_CXO_CLK>,
               <&sleep_clk>,
               <&mdss_dp_phy0 0>,
               <&mdss_dp_phy0 1>,
               <&mdss_dp_phy1 0>,
               <&mdss_dp_phy1 1>,
               <&mdss_dp_phy2 0>,
               <&mdss_dp_phy2 1>,
               <&mdss_dp_phy3 0>,
               <&mdss_dp_phy3 1>,
               <&mdss_dsi0_phy 0>,
               <&mdss_dsi0_phy 1>,
               <&mdss_dsi1_phy 0>,
               <&mdss_dsi1_phy 1>,
               <&mdss_phy0_link 0>,
               <&mdss_phy0_vco_div 0>,
               <&mdss_phy1_link 1>,
               <&mdss_phy1_vco_div 1>;
      power-domains = <&rpmhpd RPMHPD_MMCX>;
      required-opps = <&rpmhpd_opp_low_svs>;
      #clock-cells = <1>;
      #reset-cells = <1>;
      #power-domain-cells = <1>;
    };
...
```

## Documentation/devicetree/bindings/clock/qcom,glymur-evacc.yaml
```yaml
# SPDX-License-Identifier: (GPL-2.0-only OR BSD-2-Clause)
%YAML 1.2
---
$id: http://devicetree.org/schemas/clock/qcom,glymur-evacc.yaml#
$schema: http://devicetree.org/meta-schemas/core.yaml#

title: Qualcomm EVA Clock & Reset Controller on Glymur SoC

maintainers:
  - Taniya Das <taniya.das@oss.qualcomm.com>

description: |
  Qualcomm EVA clock control module which supports the clocks, resets and
  power domains for the EVA instances on Glymur SoC.

  See also:
  - include/dt-bindings/clock/qcom,glymur-evacc.h

properties:
  compatible:
    const: qcom,glymur-evacc

  clocks:
    items:
      - description: Interface clock from GCC
      - description: Board XO source
      - description: Sleep clock source

  power-domains:
    items:
      - description: MMCX power domain
      - description: MXC power domain

  required-opps:
    description:
      Required OPP nodes for the MMCX and MXC power domains.
    items:
      - description: MMCX performance point
      - description: MXC performance point

required:
  - compatible
  - clocks
  - power-domains
  - required-opps
  - '#power-domain-cells'

allOf:
  - $ref: qcom,gcc.yaml#

unevaluatedProperties: false

examples:
  - |
    #include <dt-bindings/clock/qcom,glymur-gcc.h>
    #include <dt-bindings/clock/qcom,rpmh.h>
    #include <dt-bindings/power/qcom,rpmhpd.h>
    clock-controller@ab00000 {
        compatible = "qcom,glymur-evacc";
        reg = <0x0ab00000 0x10000>;
        clocks = <&gcc GCC_EVA_AHB_CLK>,
                 <&rpmhcc RPMH_CXO_CLK>,
                 <&sleep_clk>;
        power-domains = <&rpmhpd RPMHPD_MMCX>,
                        <&rpmhpd RPMHPD_MXC>;
        required-opps = <&rpmhpd_opp_low_svs>,
                        <&rpmhpd_opp_low_svs>;
        #clock-cells = <1>;
        #reset-cells = <1>;
        #power-domain-cells = <1>;
    };
...
```
