## Documentation/devicetree/bindings/clock/qcom,glymur-gcc.yaml
```yaml
# SPDX-License-Identifier: (GPL-2.0-only OR BSD-2-Clause)
%YAML 1.2
---
$id: http://devicetree.org/schemas/clock/qcom,glymur-gcc.yaml#
$schema: http://devicetree.org/meta-schemas/core.yaml#

title: Qualcomm Global Clock & Reset Controller on Glymur SoC

maintainers:
  - Taniya Das <taniya.das@oss.qualcomm.com>

description: |
  Qualcomm global clock control module provides the clocks, resets and power
  domains on Glymur SoC.

  See also: include/dt-bindings/clock/qcom,glymur-gcc.h

properties:
  compatible:
    const: qcom,glymur-gcc

  clocks:
    items:
      - description: Board XO source
      - description: Board XO_A source
      - description: Sleep clock source
      - description: USB 0 Phy DP0 GMUX clock source
      - description: USB 0 Phy DP1 GMUX clock source
      - description: USB 0 Phy PCIE PIPEGMUX clock source
      - description: USB 0 Phy PIPEGMUX clock source
      - description: USB 0 Phy SYS PCIE PIPEGMUX clock source
      - description: USB 1 Phy DP0 GMUX 2 clock source
      - description: USB 1 Phy DP1 GMUX 2 clock source
      - description: USB 1 Phy PCIE PIPEGMUX clock source
      - description: USB 1 Phy PIPEGMUX clock source
      - description: USB 1 Phy SYS PCIE PIPEGMUX clock source
      - description: USB 2 Phy DP0 GMUX 2 clock source
      - description: USB 2 Phy DP1 GMUX 2 clock source
      - description: USB 2 Phy PCIE PIPEGMUX clock source
      - description: USB 2 Phy PIPEGMUX clock source
      - description: USB 2 Phy SYS PCIE PIPEGMUX clock source
      - description: PCIe 3a pipe clock
      - description: PCIe 3b pipe clock
      - description: PCIe 4 pipe clock
      - description: PCIe 5 pipe clock
      - description: PCIe 6 pipe clock
      - description: QUSB4 0 PHY RX 0 clock source
      - description: QUSB4 0 PHY RX 1 clock source
      - description: QUSB4 1 PHY RX 0 clock source
      - description: QUSB4 1 PHY RX 1 clock source
      - description: QUSB4 2 PHY RX 0 clock source
      - description: QUSB4 2 PHY RX 1 clock source
      - description: UFS PHY RX Symbol 0 clock source
      - description: UFS PHY RX Symbol 1 clock source
      - description: UFS PHY TX Symbol 0 clock source
      - description: USB3 PHY 0 pipe clock source
      - description: USB3 PHY 1 pipe clock source
      - description: USB3 PHY 2 pipe clock source
      - description: USB3 UNI PHY pipe 0 clock source
      - description: USB3 UNI PHY pipe 1 clock source
      - description: USB4 PHY 0 pcie pipe clock source
      - description: USB4 PHY 0 Max pipe clock source
      - description: USB4 PHY 1 pcie pipe clock source
      - description: USB4 PHY 1 Max pipe clock source
      - description: USB4 PHY 2 pcie pipe clock source
      - description: USB4 PHY 2 Max pipe clock source

required:
  - compatible
  - clocks
  - '#power-domain-cells'

allOf:
  - $ref: qcom,gcc.yaml#

unevaluatedProperties: false

examples:
  - |
    #include <dt-bindings/clock/qcom,rpmh.h>
    clock-controller@100000 {
      compatible = "qcom,glymur-gcc";
      reg = <0x100000 0x1f9000>;
      clocks = <&rpmhcc RPMH_CXO_CLK>,
               <&rpmhcc RPMH_CXO_CLK_A>,
               <&sleep_clk>,
               <&usb_0_phy_dp0_gmux>,
               <&usb_0_phy_dp1_gmux>,
               <&usb_0_phy_pcie_pipegmux>,
               <&usb_0_phy_pipegmux>,
               <&usb_0_phy_sys_pcie_pipegmux>,
               <&usb_1_phy_dp0_gmux_2>,
               <&usb_1_phy_dp1_gmux_2>,
               <&usb_1_phy_pcie_pipegmux>,
               <&usb_1_phy_pipegmux>,
               <&usb_1_phy_sys_pcie_pipegmux>,
               <&usb_2_phy_dp0_gmux 2>,
               <&usb_2_phy_dp1_gmux 2>,
               <&usb_2_phy_pcie_pipegmux>,
               <&usb_2_phy_pipegmux>,
               <&usb_2_phy_sys_pcie_pipegmux>,
               <&pcie_3a_pipe>, <&pcie_3b_pipe>,
               <&pcie_4_pipe>, <&pcie_5_pipe>,
               <&pcie_6_pipe>,
               <&qusb4_0_phy_rx_0>, <&qusb4_0_phy_rx_1>,
               <&qusb4_1_phy_rx_0>, <&qusb4_1_phy_rx_1>,
               <&qusb4_2_phy_rx_0>, <&qusb4_2_phy_rx_1>,
               <&ufs_phy_rx_symbol_0>, <&ufs_phy_rx_symbol_1>,
               <&ufs_phy_tx_symbol_0>,
               <&usb3_phy_0_pipe>, <&usb3_phy_1_pipe>,
               <&usb3_phy_2_pipe>,
               <&usb3_uni_phy_pipe_0>, <&usb3_uni_phy_pipe_1>,
               <&usb4_phy_0_pcie_pipe>, <&usb4_phy_0_max_pipe>,
               <&usb4_phy_1_pcie_pipe>, <&usb4_phy_1_max_pipe>,
               <&usb4_phy_2_pcie_pipe>, <&usb4_phy_2_max_pipe>;
      #clock-cells = <1>;
      #reset-cells = <1>;
      #power-domain-cells = <1>;
    };

...
```

## Documentation/devicetree/bindings/clock/qcom,glymur-tcsr.yaml
```yaml
# SPDX-License-Identifier: (GPL-2.0-only OR BSD-2-Clause)
%YAML 1.2
---
$id: http://devicetree.org/schemas/clock/qcom,glymur-tcsr.yaml#
$schema: http://devicetree.org/meta-schemas/core.yaml#

title: Qualcomm TCSR Clock Controller on Glymur

maintainers:
  - Bjorn Andersson <andersson@kernel.org>
  - Taniya Das <taniya.das@oss.qualcomm.com>

description: |
  Qualcomm TCSR clock control module provides the clocks, resets and
  power domains on Glymur

  See also:
  - include/dt-bindings/clock/qcom,glymur-tcsr.h

properties:
  compatible:
    items:
      - enum:
          - qcom,glymur-tcsr
      - const: syscon

  clocks:
    items:
      - description: TCXO pad clock

  reg:
    maxItems: 1

  '#clock-cells':
    const: 1

  '#reset-cells':
    const: 1

  vdda-qrefrpt0-0p9-supply: true
  vdda-qrefrpt1-0p9-supply: true
  vdda-qrefrpt2-0p9-supply: true
  vdda-qrefrpt3-0p9-supply: true
  vdda-qrefrpt4-0p9-supply: true
  vdda-qrefrpt5-0p9-supply: true
  vdda-qrefrx0-0p9-supply: true
  vdda-qrefrx1-0p9-supply: true
  vdda-qrefrx2-0p9-supply: true
  vdda-qrefrx3-0p9-supply: true
  vdda-qrefrx4-0p9-supply: true
  vdda-qrefrx5-0p9-supply: true
  vdda-qreftx0-0p9-supply: true
  vdda-qreftx0-1p2-supply: true
  vdda-qreftx1-0p9-supply: true
  vdda-refgen3-0p9-supply: true
  vdda-refgen3-1p2-supply: true
  vdda-refgen4-0p9-supply: true
  vdda-refgen4-1p2-supply: true

allOf:
  - if:
      properties:
        compatible:
          contains:
            const: qcom,glymur-tcsr
    then:
      required:
        - vdda-qrefrpt0-0p9-supply
        - vdda-qrefrpt1-0p9-supply
        - vdda-qrefrpt2-0p9-supply
        - vdda-qrefrpt3-0p9-supply
        - vdda-qrefrpt4-0p9-supply
        - vdda-qrefrx0-0p9-supply
        - vdda-qrefrx1-0p9-supply
        - vdda-qrefrx2-0p9-supply
        - vdda-qrefrx4-0p9-supply
        - vdda-qrefrx5-0p9-supply
        - vdda-qreftx0-0p9-supply
        - vdda-qreftx0-1p2-supply
        - vdda-qreftx1-0p9-supply
        - vdda-refgen3-0p9-supply
        - vdda-refgen3-1p2-supply
        - vdda-refgen4-0p9-supply
        - vdda-refgen4-1p2-supply

required:
  - compatible
  - clocks

additionalProperties: false

examples:
  - |
    #include <dt-bindings/clock/qcom,rpmh.h>

    soc {
      #address-cells = <2>;
      #size-cells = <2>;

      clock-controller@1fd5000 {
        compatible = "qcom,glymur-tcsr", "syscon";
        reg = <0x0 0x1fd5000 0x0 0x21000>;
        clocks = <&rpmhcc RPMH_CXO_CLK>;
        #clock-cells = <1>;
        #reset-cells = <1>;
        vdda-qrefrpt0-0p9-supply = <&vreg_l1a>;
        vdda-qrefrpt1-0p9-supply = <&vreg_l1a>;
        vdda-qrefrpt2-0p9-supply = <&vreg_l1a>;
        vdda-qrefrpt3-0p9-supply = <&vreg_l1a>;
        vdda-qrefrpt4-0p9-supply = <&vreg_l1a>;
        vdda-qrefrx0-0p9-supply = <&vreg_l1a>;
        vdda-qrefrx1-0p9-supply = <&vreg_l1a>;
        vdda-qrefrx2-0p9-supply = <&vreg_l1a>;
        vdda-qrefrx4-0p9-supply = <&vreg_l1a>;
        vdda-qrefrx5-0p9-supply = <&vreg_l1a>;
        vdda-qreftx0-0p9-supply = <&vreg_l1a>;
        vdda-qreftx0-1p2-supply = <&vreg_l2a>;
        vdda-qreftx1-0p9-supply = <&vreg_l1a>;
        vdda-refgen3-0p9-supply = <&vreg_l1a>;
        vdda-refgen3-1p2-supply = <&vreg_l2a>;
        vdda-refgen4-0p9-supply = <&vreg_l1a>;
        vdda-refgen4-1p2-supply = <&vreg_l2a>;
      };
    };

...
```

## Documentation/devicetree/bindings/clock/qcom,gpucc-sdm660.yaml
```yaml
# SPDX-License-Identifier: (GPL-2.0-only OR BSD-2-Clause)
%YAML 1.2
---
$id: http://devicetree.org/schemas/clock/qcom,gpucc-sdm660.yaml#
$schema: http://devicetree.org/meta-schemas/core.yaml#

title: Qualcomm Graphics Clock & Reset Controller on SDM630 and SDM660

maintainers:
  - AngeloGioacchino Del Regno <angelogioacchino.delregno@somainline.org>

description: |
  Qualcomm graphics clock control module provides the clocks, resets and
  power domains on SDM630 and SDM660.

  See also dt-bindings/clock/qcom,gpucc-sdm660.h.

properties:
  compatible:
    enum:
      - qcom,gpucc-sdm630
      - qcom,gpucc-sdm660

  clocks:
    items:
      - description: Board XO source
      - description: GPLL0 main gpu branch
      - description: GPLL0 divider gpu branch

  clock-names:
    items:
      - const: xo
      - const: gcc_gpu_gpll0_clk
      - const: gcc_gpu_gpll0_div_clk

  '#clock-cells':
    const: 1

  '#reset-cells':
    const: 1

  '#power-domain-cells':
    const: 1

  reg:
    maxItems: 1

required:
  - compatible
  - reg
  - clocks
  - clock-names
  - '#clock-cells'
  - '#reset-cells'
  - '#power-domain-cells'

additionalProperties: false

examples:
  - |
    #include <dt-bindings/clock/qcom,gcc-sdm660.h>
    #include <dt-bindings/clock/qcom,rpmcc.h>

    clock-controller@5065000 {
      compatible = "qcom,gpucc-sdm660";
      reg = <0x05065000 0x9038>;
      clocks = <&rpmcc RPM_SMD_XO_CLK_SRC>,
               <&gcc GCC_GPU_GPLL0_CLK>,
               <&gcc GCC_GPU_GPLL0_DIV_CLK>;
      clock-names = "xo", "gcc_gpu_gpll0_clk",
                    "gcc_gpu_gpll0_div_clk";
      #clock-cells = <1>;
      #power-domain-cells = <1>;
      #reset-cells = <1>;
    };
...
```

## Documentation/devicetree/bindings/clock/qcom,gpucc-sm8350.yaml
```yaml
# SPDX-License-Identifier: (GPL-2.0-only OR BSD-2-Clause)
%YAML 1.2
---
$id: http://devicetree.org/schemas/clock/qcom,gpucc-sm8350.yaml#
$schema: http://devicetree.org/meta-schemas/core.yaml#

title: Qualcomm Graphics Clock & Reset Controller on SM8350

maintainers:
  - Robert Foss <robert.foss@linaro.org>

description: |
  Qualcomm graphics clock control module provides the clocks, resets and power
  domains on Qualcomm SoCs.

  See also:: include/dt-bindings/clock/qcom,gpucc-sm8350.h

properties:
  compatible:
    enum:
      - qcom,sm8350-gpucc

  clocks:
    items:
      - description: Board XO source
      - description: GPLL0 main branch source
      - description: GPLL0 div branch source

  '#clock-cells':
    const: 1

  '#reset-cells':
    const: 1

  '#power-domain-cells':
    const: 1

  reg:
    maxItems: 1

required:
  - compatible
  - reg
  - clocks
  - '#clock-cells'
  - '#reset-cells'
  - '#power-domain-cells'

additionalProperties: false

examples:
  - |
    #include <dt-bindings/clock/qcom,gcc-sm8350.h>
    #include <dt-bindings/clock/qcom,rpmh.h>

    soc {
        #address-cells = <2>;
        #size-cells = <2>;

        clock-controller@3d90000 {
            compatible = "qcom,sm8350-gpucc";
            reg = <0 0x03d90000 0 0x9000>;
            clocks = <&rpmhcc RPMH_CXO_CLK>,
                     <&gcc GCC_GPU_GPLL0_CLK_SRC>,
                     <&gcc GCC_GPU_GPLL0_DIV_CLK_SRC>;
            #clock-cells = <1>;
            #reset-cells = <1>;
            #power-domain-cells = <1>;
        };
    };
...
```

## Documentation/devicetree/bindings/clock/qcom,gpucc.txt
```
Qualcomm Graphics Clock & Reset Controller Binding
--------------------------------------------------

Required properties :
- compatible : shall contain "qcom,sdm845-gpucc" or "qcom,msm8998-gpucc"
- reg : shall contain base register location and length
- #clock-cells : from common clock binding, shall contain 1
- #reset-cells : from common reset binding, shall contain 1
- #power-domain-cells : from generic power domain binding, shall contain 1
- clocks : shall contain the XO clock
	   shall contain the gpll0 out main clock (msm8998)
- clock-names : shall be "xo"
		shall be "gpll0" (msm8998)

Example:
	gpucc: clock-controller@5090000 {
		compatible = "qcom,sdm845-gpucc";
		reg = <0x5090000 0x9000>;
		#clock-cells = <1>;
		#reset-cells = <1>;
		#power-domain-cells = <1>;
		clocks = <&rpmhcc RPMH_CXO_CLK>;
		clock-names = "xo";
	};
```

## Documentation/devicetree/bindings/clock/qcom,gpucc.yaml
```yaml
# SPDX-License-Identifier: (GPL-2.0-only OR BSD-2-Clause)
%YAML 1.2
---
$id: http://devicetree.org/schemas/clock/qcom,gpucc.yaml#
$schema: http://devicetree.org/meta-schemas/core.yaml#

title: Qualcomm Graphics Clock & Reset Controller

maintainers:
  - Taniya Das <tdas@codeaurora.org>

description: |
  Qualcomm graphics clock control module provides the clocks, resets and power
  domains on Qualcomm SoCs.

  See also::
    include/dt-bindings/clock/qcom,gpucc-sdm845.h
    include/dt-bindings/clock/qcom,gpucc-sa8775p.h
    include/dt-bindings/clock/qcom,gpucc-sc7180.h
    include/dt-bindings/clock/qcom,gpucc-sc7280.h
    include/dt-bindings/clock/qcom,gpucc-sc8280xp.h
    include/dt-bindings/clock/qcom,gpucc-sm6350.h
    include/dt-bindings/clock/qcom,gpucc-sm8150.h
    include/dt-bindings/clock/qcom,gpucc-sm8250.h
    include/dt-bindings/clock/qcom,gpucc-sm8350.h

properties:
  compatible:
    enum:
      - qcom,sdm845-gpucc
      - qcom,sa8775p-gpucc
      - qcom,sc7180-gpucc
      - qcom,sc7280-gpucc
      - qcom,sc8180x-gpucc
      - qcom,sc8280xp-gpucc
      - qcom,sm6350-gpucc
      - qcom,sm8150-gpucc
      - qcom,sm8250-gpucc
      - qcom,sm8350-gpucc

  clocks:
    items:
      - description: Board XO source
      - description: GPLL0 main branch source
      - description: GPLL0 div branch source

  clock-names:
    items:
      - const: bi_tcxo
      - const: gcc_gpu_gpll0_clk_src
      - const: gcc_gpu_gpll0_div_clk_src

  '#clock-cells':
    const: 1

  '#reset-cells':
    const: 1

  '#power-domain-cells':
    const: 1

  reg:
    maxItems: 1

required:
  - compatible
  - reg
  - clocks
  - clock-names
  - '#clock-cells'
  - '#reset-cells'
  - '#power-domain-cells'

additionalProperties: false

examples:
  - |
    #include <dt-bindings/clock/qcom,gcc-sdm845.h>
    #include <dt-bindings/clock/qcom,rpmh.h>
    clock-controller@5090000 {
      compatible = "qcom,sdm845-gpucc";
      reg = <0x05090000 0x9000>;
      clocks = <&rpmhcc RPMH_CXO_CLK>,
               <&gcc GCC_GPU_GPLL0_CLK_SRC>,
               <&gcc GCC_GPU_GPLL0_DIV_CLK_SRC>;
      clock-names = "bi_tcxo",
                    "gcc_gpu_gpll0_clk_src",
                    "gcc_gpu_gpll0_div_clk_src";
      #clock-cells = <1>;
      #reset-cells = <1>;
      #power-domain-cells = <1>;
    };
...
```
