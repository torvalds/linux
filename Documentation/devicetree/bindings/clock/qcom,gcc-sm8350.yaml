## Documentation/devicetree/bindings/clock/qcom,ipq9574-nsscc.yaml
```yaml
# SPDX-License-Identifier: (GPL-2.0-only OR BSD-2-Clause)
%YAML 1.2
---
$id: http://devicetree.org/schemas/clock/qcom,ipq9574-nsscc.yaml#
$schema: http://devicetree.org/meta-schemas/core.yaml#

title: Qualcomm Networking Sub System Clock & Reset Controller on IPQ9574

maintainers:
  - Bjorn Andersson <andersson@kernel.org>
  - Anusha Rao <quic_anusha@quicinc.com>

description: |
  Qualcomm networking sub system clock control module provides the clocks,
  resets on IPQ9574

  See also::
    include/dt-bindings/clock/qcom,ipq9574-nsscc.h
    include/dt-bindings/reset/qcom,ipq9574-nsscc.h

properties:
  compatible:
    const: qcom,ipq9574-nsscc

  clocks:
    items:
      - description: Board XO source
      - description: CMN_PLL NSS 1200MHz (Bias PLL cc) clock source
      - description: CMN_PLL PPE 353MHz (Bias PLL ubi nc) clock source
      - description: GCC GPLL0 OUT AUX clock source
      - description: Uniphy0 NSS Rx clock source
      - description: Uniphy0 NSS Tx clock source
      - description: Uniphy1 NSS Rx clock source
      - description: Uniphy1 NSS Tx clock source
      - description: Uniphy2 NSS Rx clock source
      - description: Uniphy2 NSS Tx clock source
      - description: GCC NSSCC clock source

  '#interconnect-cells':
    const: 1

  clock-names:
    items:
      - const: xo
      - const: nss_1200
      - const: ppe_353
      - const: gpll0_out
      - const: uniphy0_rx
      - const: uniphy0_tx
      - const: uniphy1_rx
      - const: uniphy1_tx
      - const: uniphy2_rx
      - const: uniphy2_tx
      - const: bus

required:
  - compatible
  - clocks
  - clock-names

allOf:
  - $ref: qcom,gcc.yaml#

unevaluatedProperties: false

examples:
  - |
    #include <dt-bindings/clock/qcom,ipq9574-gcc.h>
    #include <dt-bindings/clock/qcom,ipq-cmn-pll.h>
    clock-controller@39b00000 {
      compatible = "qcom,ipq9574-nsscc";
      reg = <0x39b00000 0x80000>;
      clocks = <&xo_board_clk>,
               <&cmn_pll NSS_1200MHZ_CLK>,
               <&cmn_pll PPE_353MHZ_CLK>,
               <&gcc GPLL0_OUT_AUX>,
               <&uniphy 0>,
               <&uniphy 1>,
               <&uniphy 2>,
               <&uniphy 3>,
               <&uniphy 4>,
               <&uniphy 5>,
               <&gcc GCC_NSSCC_CLK>;
      clock-names = "xo",
                    "nss_1200",
                    "ppe_353",
                    "gpll0_out",
                    "uniphy0_rx",
                    "uniphy0_tx",
                    "uniphy1_rx",
                    "uniphy1_tx",
                    "uniphy2_rx",
                    "uniphy2_tx",
                    "bus";
      #clock-cells = <1>;
      #reset-cells = <1>;
    };
...
```

## Documentation/devicetree/bindings/clock/qcom,ipq9650-gcc.yaml
```yaml
# SPDX-License-Identifier: (GPL-2.0-only OR BSD-2-Clause)
%YAML 1.2
---
$id: http://devicetree.org/schemas/clock/qcom,ipq9650-gcc.yaml#
$schema: http://devicetree.org/meta-schemas/core.yaml#

title: Qualcomm Global Clock & Reset Controller on IPQ9650

maintainers:
  - Bjorn Andersson <andersson@kernel.org>
  - Kathiravan Thirumoorthy <kathiravan.thirumoorthy@oss.qualcomm.com>

description: |
  Qualcomm global clock control module provides the clocks, resets and power
  domains on IPQ9650

  See also:
    include/dt-bindings/clock/qcom,ipq9650-gcc.h
    include/dt-bindings/reset/qcom,ipq9650-gcc.h

properties:
  compatible:
    const: qcom,ipq9650-gcc

  clocks:
    items:
      - description: Board XO source
      - description: Sleep clock source
      - description: PCIE30 PHY0 pipe clock source
      - description: PCIE30 PHY1 pipe clock source
      - description: PCIE30 PHY2 pipe clock source
      - description: PCIE30 PHY3 pipe clock source
      - description: PCIE30 PHY4 pipe clock source
      - description: USB PCIE wrapper pipe clock source
      - description: NSS common clock source

  '#power-domain-cells': false

  '#interconnect-cells':
    const: 1

required:
  - compatible
  - clocks

allOf:
  - $ref: qcom,gcc.yaml#

unevaluatedProperties: false

examples:
  - |
    clock-controller@1800000 {
      compatible = "qcom,ipq9650-gcc";
      reg = <0x01800000 0x40000>;
      clocks = <&xo_board_clk>,
               <&sleep_clk>,
               <&pcie30_phy0_pipe_clk>,
               <&pcie30_phy1_pipe_clk>,
               <&pcie30_phy2_pipe_clk>,
               <&pcie30_phy3_pipe_clk>,
               <&pcie30_phy4_pipe_clk>,
               <&usb3phy_0_cc_pipe_clk>,
               <&nss_cmn_clk>;
      #clock-cells = <1>;
      #reset-cells = <1>;
    };
...
```

## Documentation/devicetree/bindings/clock/qcom,kpss-acc-v1.yaml
```yaml
# SPDX-License-Identifier: GPL-2.0-only OR BSD-2-Clause
%YAML 1.2
---
$id: http://devicetree.org/schemas/clock/qcom,kpss-acc-v1.yaml#
$schema: http://devicetree.org/meta-schemas/core.yaml#

title: Krait Processor Sub-system (KPSS) Application Clock Controller (ACC) v1

maintainers:
  - Christian Marangi <ansuelsmth@gmail.com>

description:
  The KPSS ACC provides clock, power domain, and reset control to a Krait CPU.
  There is one ACC register region per CPU within the KPSS remapped region as
  well as an alias register region that remaps accesses to the ACC associated
  with the CPU accessing the region. ACC v1 is currently used as a
  clock-controller for enabling the cpu and handling the aux clocks.

properties:
  compatible:
    const: qcom,kpss-acc-v1

  reg:
    items:
      - description: Base address and size of the register region
      - description: Optional base address and size of the alias register region
    minItems: 1

  clocks:
    minItems: 2
    maxItems: 2

  clock-names:
    items:
      - const: pll8_vote
      - const: pxo

  clock-output-names:
    description: Name of the aux clock. Krait can have at most 4 cpu.
    enum:
      - acpu0_aux
      - acpu1_aux
      - acpu2_aux
      - acpu3_aux

  '#clock-cells':
    const: 0

required:
  - compatible
  - reg
  - clocks
  - clock-names
  - clock-output-names
  - '#clock-cells'

additionalProperties: false

examples:
  - |
    #include <dt-bindings/clock/qcom,gcc-ipq806x.h>

    clock-controller@2088000 {
      compatible = "qcom,kpss-acc-v1";
      reg = <0x02088000 0x1000>, <0x02008000 0x1000>;
      clocks = <&gcc PLL8_VOTE>, <&pxo_board>;
      clock-names = "pll8_vote", "pxo";
      clock-output-names = "acpu0_aux";
      #clock-cells = <0>;
    };

...
```

## Documentation/devicetree/bindings/clock/qcom,kpss-gcc.yaml
```yaml
# SPDX-License-Identifier: GPL-2.0-only OR BSD-2-Clause
%YAML 1.2
---
$id: http://devicetree.org/schemas/clock/qcom,kpss-gcc.yaml#
$schema: http://devicetree.org/meta-schemas/core.yaml#

title: Krait Processor Sub-system (KPSS) Global Clock Controller (GCC)

maintainers:
  - Christian Marangi <ansuelsmth@gmail.com>

description:
  Krait Processor Sub-system (KPSS) Global Clock Controller (GCC). Used
  to control L2 mux (in the current implementation) and provide access
  to the kpss-gcc registers.

properties:
  compatible:
    items:
      - enum:
          - qcom,kpss-gcc-ipq8064
          - qcom,kpss-gcc-apq8064
          - qcom,kpss-gcc-msm8974
          - qcom,kpss-gcc-msm8960
          - qcom,kpss-gcc-msm8660
          - qcom,kpss-gcc-mdm9615
      - const: qcom,kpss-gcc
      - const: syscon

  reg:
    maxItems: 1

  clocks:
    minItems: 2
    maxItems: 2

  clock-names:
    items:
      - const: pll8_vote
      - const: pxo

  '#clock-cells':
    const: 0

required:
  - compatible
  - reg

if:
  properties:
    compatible:
      contains:
        enum:
          - qcom,kpss-gcc-ipq8064
          - qcom,kpss-gcc-apq8064
          - qcom,kpss-gcc-msm8974
          - qcom,kpss-gcc-msm8960
then:
  required:
    - clocks
    - clock-names
    - '#clock-cells'
else:
  properties:
    clock: false
    clock-names: false
    '#clock-cells': false

additionalProperties: false

examples:
  - |
    #include <dt-bindings/clock/qcom,gcc-ipq806x.h>

    clock-controller@2011000 {
      compatible = "qcom,kpss-gcc-ipq8064", "qcom,kpss-gcc", "syscon";
      reg = <0x2011000 0x1000>;
      clocks = <&gcc PLL8_VOTE>, <&pxo_board>;
      clock-names = "pll8_vote", "pxo";
      #clock-cells = <0>;
    };

  - |
    clock-controller@2011000 {
      compatible = "qcom,kpss-gcc-mdm9615", "qcom,kpss-gcc", "syscon";
      reg = <0x02011000 0x1000>;
    };
...
```

## Documentation/devicetree/bindings/clock/qcom,krait-cc.txt
```
Krait Clock Controller

PROPERTIES

- compatible:
	Usage: required
	Value type: <string>
	Definition: must be one of:
			"qcom,krait-cc-v1"
			"qcom,krait-cc-v2"

- #clock-cells:
	Usage: required
	Value type: <u32>
	Definition: must be 1

- clocks:
	Usage: required
	Value type: <prop-encoded-array>
	Definition: reference to the clock parents of hfpll, secondary muxes.

- clock-names:
	Usage: required
	Value type: <stringlist>
	Definition: must be "hfpll0", "hfpll1", "acpu0_aux", "acpu1_aux", "qsb".

Example:

	kraitcc: clock-controller {
		compatible = "qcom,krait-cc-v1";
		clocks = <&hfpll0>, <&hfpll1>, <&acpu0_aux>, <&acpu1_aux>, <qsb>;
		clock-names = "hfpll0", "hfpll1", "acpu0_aux", "acpu1_aux", "qsb";
		#clock-cells = <1>;
	};
```
