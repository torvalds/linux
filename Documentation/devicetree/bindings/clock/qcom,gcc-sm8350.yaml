## Documentation/devicetree/bindings/clock/qcom,hawi-gcc.yaml
```yaml
# SPDX-License-Identifier: (GPL-2.0-only OR BSD-2-Clause)
%YAML 1.2
---
$id: http://devicetree.org/schemas/clock/qcom,hawi-gcc.yaml#
$schema: http://devicetree.org/meta-schemas/core.yaml#

title: Qualcomm Global Clock & Reset Controller on Hawi

maintainers:
  - Vivek Aknurwar <vivek.aknurwar@oss.qualcomm.com>

description: |
  Qualcomm global clock control module provides the clocks, resets and power
  domains on Hawi.

  See also: include/dt-bindings/clock/qcom,hawi-gcc.h

properties:
  compatible:
    const: qcom,hawi-gcc

  clocks:
    items:
      - description: Board XO source
      - description: Board Always On XO source
      - description: Sleep clock source
      - description: PCIE 0 Pipe clock source
      - description: PCIE 1 Pipe clock source
      - description: UFS PHY RX symbol 0 clock
      - description: UFS PHY RX symbol 1 clock
      - description: UFS PHY TX symbol 0 clock
      - description: USB3 PHY wrapper pipe clock

required:
  - compatible
  - clocks
  - '#power-domain-cells'

allOf:
  - $ref: qcom,gcc.yaml#

unevaluatedProperties: false

examples:
  - |
    #include <dt-bindings/clock/qcom,rpmh.h>
    clock-controller@100000 {
      compatible = "qcom,hawi-gcc";
      reg = <0x00100000 0x1f4200>;
      clocks = <&rpmhcc RPMH_CXO_CLK>,
               <&rpmhcc RPMH_CXO_CLK_A>,
               <&sleep_clk>,
               <&pcie0_phy>,
               <&pcie1_phy>,
               <&ufs_mem_phy 0>,
               <&ufs_mem_phy 1>,
               <&ufs_mem_phy 2>,
               <&usb_1_qmpphy>;
      #clock-cells = <1>;
      #reset-cells = <1>;
      #power-domain-cells = <1>;
    };
...
```

## Documentation/devicetree/bindings/clock/qcom,hfpll.txt
```
High-Frequency PLL (HFPLL)

PROPERTIES

- compatible:
	Usage: required
	Value type: <string>:
		shall contain only one of the following. The generic
		compatible "qcom,hfpll" should be also included.

                        "qcom,hfpll-ipq8064", "qcom,hfpll"
                        "qcom,hfpll-apq8064", "qcom,hfpll"
                        "qcom,hfpll-msm8974", "qcom,hfpll"
                        "qcom,hfpll-msm8960", "qcom,hfpll"

- reg:
	Usage: required
	Value type: <prop-encoded-array>
	Definition: address and size of HPLL registers. An optional second
		    element specifies the address and size of the alias
		    register region.

- clocks:
	Usage: required
	Value type: <prop-encoded-array>
	Definition: reference to the xo clock.

- clock-names:
	Usage: required
	Value type: <stringlist>
	Definition: must be "xo".

- clock-output-names:
	Usage: required
	Value type: <string>
	Definition: Name of the PLL. Typically hfpllX where X is a CPU number
		    starting at 0. Otherwise hfpll_Y where Y is more specific
		    such as "l2".

Example:

1) An HFPLL for the L2 cache.

	clock-controller@f9016000 {
		compatible = "qcom,hfpll-ipq8064", "qcom,hfpll";
		reg = <0xf9016000 0x30>;
		clocks = <&xo_board>;
		clock-names = "xo";
		clock-output-names = "hfpll_l2";
	};

2) An HFPLL for CPU0. This HFPLL has the alias register region.

	clock-controller@f908a000 {
		compatible = "qcom,hfpll-ipq8064", "qcom,hfpll";
		reg = <0xf908a000 0x30>, <0xf900a000 0x30>;
		clocks = <&xo_board>;
		clock-names = "xo";
		clock-output-names = "hfpll0";
	};
```

## Documentation/devicetree/bindings/clock/qcom,hfpll.yaml
```yaml
# SPDX-License-Identifier: (GPL-2.0-only OR BSD-2-Clause)
%YAML 1.2
---
$id: http://devicetree.org/schemas/clock/qcom,hfpll.yaml#
$schema: http://devicetree.org/meta-schemas/core.yaml#

title: Qualcomm High-Frequency PLL

maintainers:
  - Bjorn Andersson <andersson@kernel.org>

description:
  The HFPLL is used as CPU PLL on various Qualcomm SoCs.

properties:
  compatible:
    oneOf:
      - enum:
          - qcom,msm8974-hfpll
          - qcom,msm8976-hfpll-a53
          - qcom,msm8976-hfpll-a72
          - qcom,msm8976-hfpll-cci
          - qcom,qcs404-hfpll
      - const: qcom,hfpll
        deprecated: true

  reg:
    items:
      - description: HFPLL registers
      - description: Alias register region
    minItems: 1

  '#clock-cells':
    const: 0

  clocks:
    items:
      - description: board XO clock

  clock-names:
    items:
      - const: xo

  clock-output-names:
    description:
      Name of the PLL. Typically hfpllX where X is a CPU number starting at 0.
      Otherwise hfpll_Y where Y is more specific such as "l2".
    maxItems: 1

required:
  - compatible
  - reg
  - '#clock-cells'
  - clocks
  - clock-names
  - clock-output-names

additionalProperties: false

examples:
  - |
    clock-controller@f908a000 {
        compatible = "qcom,msm8974-hfpll";
        reg = <0xf908a000 0x30>, <0xf900a000 0x30>;
        #clock-cells = <0>;
        clock-output-names = "hfpll0";
        clocks = <&xo_board>;
        clock-names = "xo";
    };
```

## Documentation/devicetree/bindings/clock/qcom,ipq5018-gcc.yaml
```yaml
# SPDX-License-Identifier: (GPL-2.0-only OR BSD-2-Clause)
%YAML 1.2
---
$id: http://devicetree.org/schemas/clock/qcom,ipq5018-gcc.yaml#
$schema: http://devicetree.org/meta-schemas/core.yaml#

title: Qualcomm Global Clock & Reset Controller on IPQ5018

maintainers:
  - Sricharan Ramabadhran <quic_srichara@quicinc.com>

description: |
  Qualcomm global clock control module provides the clocks, resets and power
  domains on IPQ5018

  See also::
    include/dt-bindings/clock/qcom,ipq5018-gcc.h
    include/dt-bindings/reset/qcom,ipq5018-gcc.h

properties:
  compatible:
    const: qcom,gcc-ipq5018

  clocks:
    items:
      - description: Board XO source
      - description: Sleep clock source
      - description: PCIE20 PHY0 pipe clock source
      - description: PCIE20 PHY1 pipe clock source
      - description: USB3 PHY pipe clock source
      - description: GEPHY RX clock source
      - description: GEPHY TX clock source
      - description: UNIPHY RX clock source
      - description: UNIPHY TX clk source

required:
  - compatible
  - clocks

allOf:
  - $ref: qcom,gcc.yaml#

unevaluatedProperties: false

examples:
  - |
    clock-controller@1800000 {
      compatible = "qcom,gcc-ipq5018";
      reg = <0x01800000 0x80000>;
      clocks = <&xo_board_clk>,
               <&sleep_clk>,
               <&pcie20_phy0_pipe_clk>,
               <&pcie20_phy1_pipe_clk>,
               <&usb3_phy0_pipe_clk>,
               <&gephy_rx_clk>,
               <&gephy_tx_clk>,
               <&uniphy_rx_clk>,
               <&uniphy_tx_clk>;
      #clock-cells = <1>;
      #reset-cells = <1>;
      #power-domain-cells = <1>;
    };
...
```

## Documentation/devicetree/bindings/clock/qcom,ipq5332-gcc.yaml
```yaml
# SPDX-License-Identifier: (GPL-2.0-only OR BSD-2-Clause)
%YAML 1.2
---
$id: http://devicetree.org/schemas/clock/qcom,ipq5332-gcc.yaml#
$schema: http://devicetree.org/meta-schemas/core.yaml#

title: Qualcomm Global Clock & Reset Controller on IPQ5332 and IPQ5424

maintainers:
  - Bjorn Andersson <andersson@kernel.org>

description: |
  Qualcomm global clock control module provides the clocks, resets and power
  domains on IPQ5332 and IPQ5424.

  See also:
    include/dt-bindings/clock/qcom,gcc-ipq5332.h
    include/dt-bindings/clock/qcom,gcc-ipq5424.h

properties:
  compatible:
    enum:
      - qcom,ipq5332-gcc
      - qcom,ipq5424-gcc

  clocks:
    minItems: 5
    items:
      - description: Board XO clock source
      - description: Sleep clock source
      - description: PCIE 2lane PHY pipe clock source
      - description: PCIE 2lane x1 PHY pipe clock source (For second lane)
      - description: USB PCIE wrapper pipe clock source
      - description: PCIE 2-lane PHY2 pipe clock source
      - description: PCIE 2-lane PHY3 pipe clock source

  '#power-domain-cells': false
  '#interconnect-cells':
    const: 1

required:
  - compatible
  - clocks

allOf:
  - $ref: qcom,gcc.yaml#
  - if:
      properties:
        compatible:
          contains:
            const: qcom,ipq5332-gcc
    then:
      properties:
        clocks:
          maxItems: 5

  - if:
      properties:
        compatible:
          contains:
            const: qcom,ipq5424-gcc
    then:
      properties:
        clocks:
          minItems: 7
          maxItems: 7

unevaluatedProperties: false

examples:
  - |
    clock-controller@1800000 {
      compatible = "qcom,ipq5332-gcc";
      reg = <0x01800000 0x80000>;
      clocks = <&xo_board>,
               <&sleep_clk>,
               <&pcie_2lane_phy_pipe_clk>,
               <&pcie_2lane_phy_pipe_clk_x1>,
               <&usb_pcie_wrapper_pipe_clk>;
      #clock-cells = <1>;
      #reset-cells = <1>;
    };
...
```

## Documentation/devicetree/bindings/clock/qcom,ipq5424-apss-clk.yaml
```yaml
# SPDX-License-Identifier: (GPL-2.0-only OR BSD-2-Clause)
%YAML 1.2
---
$id: http://devicetree.org/schemas/clock/qcom,ipq5424-apss-clk.yaml#
$schema: http://devicetree.org/meta-schemas/core.yaml#

title: Qualcomm APSS IPQ5424 Clock Controller

maintainers:
  - Varadarajan Narayanan <quic_varada@quicinc.com>

description:
  The CPU core in ipq5424 is clocked by a huayra PLL with RCG support.
  The RCG and PLL have a separate register space from the GCC.

properties:
  compatible:
    enum:
      - qcom,ipq5424-apss-clk

  reg:
    maxItems: 1

  clocks:
    items:
      - description: Reference to the XO clock.
      - description: Reference to the GPLL0 clock.

  '#clock-cells':
    const: 1

  '#interconnect-cells':
    const: 1

required:
  - compatible
  - reg
  - clocks
  - '#clock-cells'
  - '#interconnect-cells'

additionalProperties: false

examples:
  - |
    #include <dt-bindings/clock/qcom,ipq5424-gcc.h>

    apss_clk: clock-controller@fa80000 {
      compatible = "qcom,ipq5424-apss-clk";
      reg = <0x0fa80000 0x20000>;
      clocks = <&xo_board>,
               <&gcc GPLL0>;
      #clock-cells = <1>;
      #interconnect-cells = <1>;
    };
```

## Documentation/devicetree/bindings/clock/qcom,ipq9574-cmn-pll.yaml
```yaml
# SPDX-License-Identifier: GPL-2.0-only OR BSD-2-Clause
%YAML 1.2
---
$id: http://devicetree.org/schemas/clock/qcom,ipq9574-cmn-pll.yaml#
$schema: http://devicetree.org/meta-schemas/core.yaml#

title: Qualcomm CMN PLL Clock Controller on IPQ SoC

maintainers:
  - Bjorn Andersson <andersson@kernel.org>
  - Luo Jie <quic_luoj@quicinc.com>

description:
  The CMN (or common) PLL clock controller expects a reference
  input clock. This reference clock is from the on-board Wi-Fi.
  The CMN PLL supplies a number of fixed rate output clocks to
  the devices providing networking functions and to GCC. These
  networking hardware include PPE (packet process engine), PCS
  and the externally connected switch or PHY devices. The CMN
  PLL block also outputs fixed rate clocks to GCC. The PLL's
  primary function is to enable fixed rate output clocks for
  networking hardware functions used with the IPQ SoC.

properties:
  compatible:
    enum:
      - qcom,ipq9574-cmn-pll

  reg:
    maxItems: 1

  clocks:
    items:
      - description: The reference clock. The supported clock rates include
          25000000, 31250000, 40000000, 48000000, 50000000 and 96000000 HZ.
      - description: The AHB clock
      - description: The SYS clock
    description:
      The reference clock is the source clock of CMN PLL, which is from the
      Wi-Fi. The AHB and SYS clocks must be enabled to access CMN PLL
      clock registers.

  clock-names:
    items:
      - const: ref
      - const: ahb
      - const: sys

  "#clock-cells":
    const: 1

required:
  - compatible
  - reg
  - clocks
  - clock-names
  - "#clock-cells"

additionalProperties: false

examples:
  - |
    #include <dt-bindings/clock/qcom,ipq-cmn-pll.h>
    #include <dt-bindings/clock/qcom,ipq9574-gcc.h>

    cmn_pll: clock-controller@9b000 {
        compatible = "qcom,ipq9574-cmn-pll";
        reg = <0x0009b000 0x800>;
        clocks = <&cmn_pll_ref_clk>,
                 <&gcc GCC_CMN_12GPLL_AHB_CLK>,
                 <&gcc GCC_CMN_12GPLL_SYS_CLK>;
        clock-names = "ref", "ahb", "sys";
        #clock-cells = <1>;
        assigned-clocks = <&cmn_pll CMN_PLL_CLK>;
        assigned-clock-rates-u64 = /bits/ 64 <12000000000>;
    };
...
```

## Documentation/devicetree/bindings/clock/qcom,ipq9574-gcc.yaml
```yaml
# SPDX-License-Identifier: (GPL-2.0-only OR BSD-2-Clause)
%YAML 1.2
---
$id: http://devicetree.org/schemas/clock/qcom,ipq9574-gcc.yaml#
$schema: http://devicetree.org/meta-schemas/core.yaml#

title: Qualcomm Global Clock & Reset Controller on IPQ9574

maintainers:
  - Bjorn Andersson <andersson@kernel.org>
  - Anusha Rao <quic_anusha@quicinc.com>

description: |
  Qualcomm global clock control module provides the clocks, resets and power
  domains on IPQ9574

  See also::
    include/dt-bindings/clock/qcom,ipq9574-gcc.h
    include/dt-bindings/reset/qcom,ipq9574-gcc.h

properties:
  compatible:
    const: qcom,ipq9574-gcc

  clocks:
    items:
      - description: Board XO source
      - description: Sleep clock source
      - description: Bias PLL ubi clock source
      - description: PCIE30 PHY0 pipe clock source
      - description: PCIE30 PHY1 pipe clock source
      - description: PCIE30 PHY2 pipe clock source
      - description: PCIE30 PHY3 pipe clock source
      - description: USB3 PHY pipe clock source

  '#power-domain-cells': false

  '#interconnect-cells':
    const: 1

required:
  - compatible
  - clocks

allOf:
  - $ref: qcom,gcc.yaml#

unevaluatedProperties: false

examples:
  - |
    clock-controller@1800000 {
      compatible = "qcom,ipq9574-gcc";
      reg = <0x01800000 0x80000>;
      clocks = <&xo_board_clk>,
               <&sleep_clk>,
               <&bias_pll_ubi_nc_clk>,
               <&pcie30_phy0_pipe_clk>,
               <&pcie30_phy1_pipe_clk>,
               <&pcie30_phy2_pipe_clk>,
               <&pcie30_phy3_pipe_clk>,
               <&usb3phy_0_cc_pipe_clk>;
      #clock-cells = <1>;
      #reset-cells = <1>;
    };
...
```
