## Documentation/devicetree/bindings/clock/imxrt1050-clock.yaml
```yaml
# SPDX-License-Identifier: (GPL-2.0-only OR BSD-2-Clause)
%YAML 1.2
---
$id: http://devicetree.org/schemas/clock/imxrt1050-clock.yaml#
$schema: http://devicetree.org/meta-schemas/core.yaml#

title: Freescale i.MXRT Clock Controller

maintainers:
  - Giulio Benetti <giulio.benetti@benettiengineering.com>
  - Jesse Taube <Mr.Bossman075@gmail.com>

description: |
  The clock consumer should specify the desired clock by having the clock
  ID in its "clocks" phandle cell. See include/dt-bindings/clock/imxrt*-clock.h
  for the full list of i.MXRT clock IDs.

properties:
  compatible:
    const: fsl,imxrt1050-ccm

  reg:
    maxItems: 1

  interrupts:
    maxItems: 2

  clocks:
    description: 24m osc
    maxItems: 1

  clock-names:
    const: osc

  '#clock-cells':
    const: 1

required:
  - compatible
  - reg
  - interrupts
  - clocks
  - clock-names
  - '#clock-cells'

additionalProperties: false

examples:
  - |
    #include <dt-bindings/clock/imxrt1050-clock.h>

    clks: clock-controller@400fc000 {
        compatible = "fsl,imxrt1050-ccm";
        reg = <0x400fc000 0x4000>;
        interrupts = <95>, <96>;
        clocks = <&osc>;
        clock-names = "osc";
        #clock-cells = <1>;
    };
```
