## Documentation/devicetree/bindings/clock/imx5-clock.yaml
```yaml
# SPDX-License-Identifier: (GPL-2.0-only OR BSD-2-Clause)
%YAML 1.2
---
$id: http://devicetree.org/schemas/clock/imx5-clock.yaml#
$schema: http://devicetree.org/meta-schemas/core.yaml#

title: Clock bindings for Freescale i.MX5

maintainers:
  - Fabio Estevam <fabio.estevam@nxp.com>

description: |
  The clock consumer should specify the desired clock by having the clock
  ID in its "clocks" phandle cell. See include/dt-bindings/clock/imx5-clock.h
  for the full list of i.MX5 clock IDs.

properties:
  compatible:
    enum:
      - fsl,imx53-ccm
      - fsl,imx51-ccm
      - fsl,imx50-ccm

  reg:
    maxItems: 1

  interrupts:
    description: CCM provides 2 interrupt requests, request 1 is to generate
      interrupt for frequency or mux change, request 2 is to generate
      interrupt for oscillator read or PLL lock.
    items:
      - description: CCM interrupt request 1
      - description: CCM interrupt request 2

  '#clock-cells':
    const: 1

required:
  - compatible
  - reg
  - interrupts
  - '#clock-cells'

additionalProperties: false

examples:
  - |
    #include <dt-bindings/clock/imx5-clock.h>
    #include <dt-bindings/interrupt-controller/arm-gic.h>

    clock-controller@53fd4000{
        compatible = "fsl,imx53-ccm";
        reg = <0x53fd4000 0x4000>;
        interrupts = <0 71 IRQ_TYPE_LEVEL_HIGH>,
                     <0 72 IRQ_TYPE_LEVEL_HIGH>;
        #clock-cells = <1>;
    };

    can@53fc8000 {
        compatible = "fsl,imx53-flexcan", "fsl,imx25-flexcan";
        reg = <0x53fc8000 0x4000>;
        interrupts = <82>;
        clocks = <&clks IMX5_CLK_CAN1_IPG_GATE>, <&clks IMX5_CLK_CAN1_SERIAL_GATE>;
        clock-names = "ipg", "per";
    };
```

## Documentation/devicetree/bindings/clock/imx6q-clock.txt
```
* Clock bindings for Freescale i.MX6 Quad

Required properties:
- compatible: Should be "fsl,imx6q-ccm"
- reg: Address and length of the register set
- interrupts: Should contain CCM interrupt
- #clock-cells: Should be <1>

Optional properties:
- fsl,pmic-stby-poweroff: Configure CCM to assert PMIC_STBY_REQ signal
  on power off.
  Use this property if the SoC should be powered off by external power
  management IC (PMIC) triggered via PMIC_STBY_REQ signal.
  Boards that are designed to initiate poweroff on PMIC_ON_REQ signal should
  be using "syscon-poweroff" driver instead.
- clocks: list of clock specifiers, must contain an entry for each entry
          in clock-names
- clock-names: valid names are "osc", "ckil", "ckih1", "anaclk1" and "anaclk2"

The clock consumer should specify the desired clock by having the clock
ID in its "clocks" phandle cell.  See include/dt-bindings/clock/imx6qdl-clock.h
for the full list of i.MX6 Quad and DualLite clock IDs.

Examples:

#include <dt-bindings/clock/imx6qdl-clock.h>

clks: ccm@20c4000 {
	compatible = "fsl,imx6q-ccm";
	reg = <0x020c4000 0x4000>;
	interrupts = <0 87 0x04 0 88 0x04>;
	#clock-cells = <1>;
};

uart1: serial@2020000 {
	compatible = "fsl,imx6q-uart", "fsl,imx21-uart";
	reg = <0x02020000 0x4000>;
	interrupts = <0 26 0x04>;
	clocks = <&clks IMX6QDL_CLK_UART_IPG>, <&clks IMX6QDL_CLK_UART_SERIAL>;
	clock-names = "ipg", "per";
};
```

## Documentation/devicetree/bindings/clock/imx6q-clock.yaml
```yaml
# SPDX-License-Identifier: (GPL-2.0-only OR BSD-2-Clause)
%YAML 1.2
---
$id: http://devicetree.org/schemas/clock/imx6q-clock.yaml#
$schema: http://devicetree.org/meta-schemas/core.yaml#

title: Clock bindings for Freescale i.MX6 Quad

maintainers:
  - Anson Huang <Anson.Huang@nxp.com>

properties:
  compatible:
    const: fsl,imx6q-ccm

  reg:
    maxItems: 1

  interrupts:
    description: CCM provides 2 interrupt requests, request 1 is to generate
      interrupt for frequency or mux change, request 2 is to generate
      interrupt for oscillator read or PLL lock.
    items:
      - description: CCM interrupt request 1
      - description: CCM interrupt request 2

  '#clock-cells':
    const: 1

  clocks:
    items:
      - description: 24m osc
      - description: 32k osc
      - description: ckih1 clock input
      - description: anaclk1 clock input
      - description: anaclk2 clock input

  clock-names:
    items:
      - const: osc
      - const: ckil
      - const: ckih1
      - const: anaclk1
      - const: anaclk2

  fsl,pmic-stby-poweroff:
    $ref: /schemas/types.yaml#/definitions/flag
    description: |
      Use this property if the SoC should be powered off by external power
      management IC (PMIC) triggered via PMIC_STBY_REQ signal.
      Boards that are designed to initiate poweroff on PMIC_ON_REQ signal should
      be using "syscon-poweroff" driver instead.

required:
  - compatible
  - reg
  - interrupts
  - '#clock-cells'

examples:
  # Clock Control Module node:
  - |
    #include <dt-bindings/interrupt-controller/arm-gic.h>

    clock-controller@20c4000 {
        compatible = "fsl,imx6q-ccm";
        reg = <0x020c4000 0x4000>;
        interrupts = <0 87 IRQ_TYPE_LEVEL_HIGH>,
                     <0 88 IRQ_TYPE_LEVEL_HIGH>;
        #clock-cells = <1>;
    };
```

## Documentation/devicetree/bindings/clock/imx6sl-clock.txt
```
* Clock bindings for Freescale i.MX6 SoloLite

Required properties:
- compatible: Should be "fsl,imx6sl-ccm"
- reg: Address and length of the register set
- #clock-cells: Should be <1>

The clock consumer should specify the desired clock by having the clock
ID in its "clocks" phandle cell.  See include/dt-bindings/clock/imx6sl-clock.h
for the full list of i.MX6 SoloLite clock IDs.
```

## Documentation/devicetree/bindings/clock/imx6sl-clock.yaml
```yaml
# SPDX-License-Identifier: (GPL-2.0-only OR BSD-2-Clause)
%YAML 1.2
---
$id: http://devicetree.org/schemas/clock/imx6sl-clock.yaml#
$schema: http://devicetree.org/meta-schemas/core.yaml#

title: Freescale i.MX6 SoloLite Clock Controller

maintainers:
  - Abel Vesa <abelvesa@kernel.org>
  - Peng Fan <peng.fan@nxp.com>

properties:
  compatible:
    const: fsl,imx6sl-ccm

  reg:
    maxItems: 1

  interrupts:
    description: CCM provides 2 interrupt requests, request 1 is to generate
      interrupt for frequency or mux change, request 2 is to generate
      interrupt for oscillator read or PLL lock.
    items:
      - description: CCM interrupt request 1
      - description: CCM interrupt request 2

  '#clock-cells':
    const: 1

required:
  - compatible
  - reg
  - interrupts
  - '#clock-cells'

additionalProperties: false

examples:
  # Clock Control Module node:
  - |
    #include <dt-bindings/interrupt-controller/arm-gic.h>

    clock-controller@20c4000 {
        compatible = "fsl,imx6sl-ccm";
        reg = <0x020c4000 0x4000>;
        interrupts = <0 87 IRQ_TYPE_LEVEL_HIGH>,
                     <0 88 IRQ_TYPE_LEVEL_HIGH>;
        #clock-cells = <1>;
    };
```

## Documentation/devicetree/bindings/clock/imx6sll-clock.txt
```
* Clock bindings for Freescale i.MX6 SLL

Required properties:
- compatible: Should be "fsl,imx6sll-ccm"
- reg: Address and length of the register set
- #clock-cells: Should be <1>
- clocks: list of clock specifiers, must contain an entry for each required
  entry in clock-names
- clock-names: should include entries "ckil", "osc", "ipp_di0" and "ipp_di1"

The clock consumer should specify the desired clock by having the clock
ID in its "clocks" phandle cell.  See include/dt-bindings/clock/imx6sll-clock.h
for the full list of i.MX6 SLL clock IDs.

Examples:

#include <dt-bindings/clock/imx6sll-clock.h>

clks: clock-controller@20c4000 {
		compatible = "fsl,imx6sll-ccm";
		reg = <0x020c4000 0x4000>;
		interrupts = <GIC_SPI 87 IRQ_TYPE_LEVEL_HIGH>,
			     <GIC_SPI 88 IRQ_TYPE_LEVEL_HIGH>;
		#clock-cells = <1>;
		clocks = <&ckil>, <&osc>, <&ipp_di0>, <&ipp_di1>;
		clock-names = "ckil", "osc", "ipp_di0", "ipp_di1";
};

uart1: serial@2020000 {
		compatible = "fsl,imx6sl-uart", "fsl,imx6q-uart", "fsl,imx21-uart";
		reg = <0x02020000 0x4000>;
		interrupts = <GIC_SPI 26 IRQ_TYPE_LEVEL_HIGH>;
		clocks = <&clks IMX6SLL_CLK_UART1_IPG>,
			 <&clks IMX6SLL_CLK_UART1_SERIAL>;
		clock-names = "ipg", "per";
};
```

## Documentation/devicetree/bindings/clock/imx6sx-clock.txt
```
* Clock bindings for Freescale i.MX6 SoloX

Required properties:
- compatible: Should be "fsl,imx6sx-ccm"
- reg: Address and length of the register set
- #clock-cells: Should be <1>
- clocks: list of clock specifiers, must contain an entry for each required
  entry in clock-names
- clock-names: should include entries "ckil", "osc", "ipp_di0" and "ipp_di1"

The clock consumer should specify the desired clock by having the clock
ID in its "clocks" phandle cell.  See include/dt-bindings/clock/imx6sx-clock.h
for the full list of i.MX6 SoloX clock IDs.
```

## Documentation/devicetree/bindings/clock/imx6ul-clock.yaml
```yaml
# SPDX-License-Identifier: (GPL-2.0-only OR BSD-2-Clause)
%YAML 1.2
---
$id: http://devicetree.org/schemas/clock/imx6ul-clock.yaml#
$schema: http://devicetree.org/meta-schemas/core.yaml#

title: Clock bindings for Freescale i.MX6 UltraLite

maintainers:
  - Anson Huang <Anson.Huang@nxp.com>

properties:
  compatible:
    const: fsl,imx6ul-ccm

  reg:
    maxItems: 1

  interrupts:
    description: CCM provides 2 interrupt requests, request 1 is to generate
      interrupt for frequency or mux change, request 2 is to generate
      interrupt for oscillator read or PLL lock.
    items:
      - description: CCM interrupt request 1
      - description: CCM interrupt request 2

  '#clock-cells':
    const: 1

  clocks:
    items:
      - description: 32k osc
      - description: 24m osc
      - description: ipp_di0 clock input
      - description: ipp_di1 clock input

  clock-names:
    items:
      - const: ckil
      - const: osc
      - const: ipp_di0
      - const: ipp_di1

required:
  - compatible
  - reg
  - interrupts
  - '#clock-cells'
  - clocks
  - clock-names

additionalProperties: false

examples:
  # Clock Control Module node:
  - |
    #include <dt-bindings/interrupt-controller/arm-gic.h>

    clock-controller@20c4000 {
        compatible = "fsl,imx6ul-ccm";
        reg = <0x020c4000 0x4000>;
        interrupts = <GIC_SPI 87 IRQ_TYPE_LEVEL_HIGH>,
                     <GIC_SPI 88 IRQ_TYPE_LEVEL_HIGH>;
        #clock-cells = <1>;
        clocks = <&ckil>, <&osc>, <&ipp_di0>, <&ipp_di1>;
        clock-names = "ckil", "osc", "ipp_di0", "ipp_di1";
    };
```

## Documentation/devicetree/bindings/clock/imx7d-clock.txt
```
* Clock bindings for Freescale i.MX7 Dual

Required properties:
- compatible: Should be "fsl,imx7d-ccm"
- reg: Address and length of the register set
- #clock-cells: Should be <1>
- clocks: list of clock specifiers, must contain an entry for each required
  entry in clock-names
- clock-names: should include entries "ckil", "osc"

The clock consumer should specify the desired clock by having the clock
ID in its "clocks" phandle cell.  See include/dt-bindings/clock/imx7d-clock.h
for the full list of i.MX7 Dual clock IDs.
```

## Documentation/devicetree/bindings/clock/imx7d-clock.yaml
```yaml
# SPDX-License-Identifier: (GPL-2.0-only OR BSD-2-Clause)
%YAML 1.2
---
$id: http://devicetree.org/schemas/clock/imx7d-clock.yaml#
$schema: http://devicetree.org/meta-schemas/core.yaml#

title: Clock bindings for Freescale i.MX7 Dual

maintainers:
  - Frank Li <Frank.Li@nxp.com>
  - Anson Huang <Anson.Huang@nxp.com>

description: |
  The clock consumer should specify the desired clock by having the clock
  ID in its "clocks" phandle cell. See include/dt-bindings/clock/imx7d-clock.h
  for the full list of i.MX7 Dual clock IDs.

properties:
  compatible:
    const: fsl,imx7d-ccm

  reg:
    maxItems: 1

  interrupts:
    items:
      - description: CCM interrupt request 1
      - description: CCM interrupt request 2

  '#clock-cells':
    const: 1

  clocks:
    items:
      - description: 32k osc
      - description: 24m osc

  clock-names:
    items:
      - const: ckil
      - const: osc

required:
  - compatible
  - reg
  - interrupts
  - clocks
  - clock-names
  - '#clock-cells'

additionalProperties: false

examples:
  - |
    #include <dt-bindings/interrupt-controller/arm-gic.h>

    clock-controller@30380000 {
        compatible = "fsl,imx7d-ccm";
        reg = <0x30380000 0x10000>;
        interrupts = <GIC_SPI 85 IRQ_TYPE_LEVEL_HIGH>,
                     <GIC_SPI 86 IRQ_TYPE_LEVEL_HIGH>;
        #clock-cells = <1>;
        clocks = <&ckil>, <&osc>;
        clock-names = "ckil", "osc";
    };
```
