## Documentation/devicetree/bindings/clock/imx8mn-clock.yaml
```yaml
# SPDX-License-Identifier: GPL-2.0
%YAML 1.2
---
$id: http://devicetree.org/schemas/clock/imx8mn-clock.yaml#
$schema: http://devicetree.org/meta-schemas/core.yaml#

title: NXP i.MX8M Nano Clock Control Module Binding

maintainers:
  - Anson Huang <Anson.Huang@nxp.com>

description: |
  NXP i.MX8M Nano clock control module is an integrated clock controller, which
  generates and supplies to all modules.

properties:
  compatible:
    const: fsl,imx8mn-ccm

  reg:
    maxItems: 1

  clocks:
    items:
      - description: 32k osc
      - description: 24m osc
      - description: ext1 clock input
      - description: ext2 clock input
      - description: ext3 clock input
      - description: ext4 clock input

  clock-names:
    items:
      - const: osc_32k
      - const: osc_24m
      - const: clk_ext1
      - const: clk_ext2
      - const: clk_ext3
      - const: clk_ext4

  '#clock-cells':
    const: 1
    description:
      The clock consumer should specify the desired clock by having the clock
      ID in its "clocks" phandle cell. See include/dt-bindings/clock/imx8mn-clock.h
      for the full list of i.MX8M Nano clock IDs.

required:
  - compatible
  - reg
  - clocks
  - clock-names
  - '#clock-cells'

additionalProperties: false

examples:
  # Clock Control Module node:
  - |
    clk: clock-controller@30380000 {
        compatible = "fsl,imx8mn-ccm";
        reg = <0x30380000 0x10000>;
        #clock-cells = <1>;
        clocks = <&osc_32k>, <&osc_24m>, <&clk_ext1>,
                 <&clk_ext2>, <&clk_ext3>, <&clk_ext4>;
        clock-names = "osc_32k", "osc_24m", "clk_ext1",
                      "clk_ext2", "clk_ext3", "clk_ext4";
    };

...
```

## Documentation/devicetree/bindings/clock/imx8mp-audiomix.yaml
```yaml
# SPDX-License-Identifier: (GPL-2.0-only OR BSD-2-Clause)
%YAML 1.2
---
$id: http://devicetree.org/schemas/clock/imx8mp-audiomix.yaml#
$schema: http://devicetree.org/meta-schemas/core.yaml#

title: NXP i.MX8MP AudioMIX Block Control

maintainers:
  - Marek Vasut <marex@denx.de>

description: |
  NXP i.MX8M Plus AudioMIX is dedicated clock muxing and gating IP
  used to control Audio related clock on the SoC.

properties:
  compatible:
    const: fsl,imx8mp-audio-blk-ctrl

  reg:
    maxItems: 1

  power-domains:
    maxItems: 1

  clocks:
    minItems: 7
    maxItems: 7

  clock-names:
    items:
      - const: ahb
      - const: sai1
      - const: sai2
      - const: sai3
      - const: sai5
      - const: sai6
      - const: sai7

  '#clock-cells':
    const: 1
    description:
      The clock consumer should specify the desired clock by having the clock
      ID in its "clocks" phandle cell. See include/dt-bindings/clock/imx8mp-clock.h
      for the full list of i.MX8MP IMX8MP_CLK_AUDIOMIX_ clock IDs.

required:
  - compatible
  - reg
  - clocks
  - clock-names
  - power-domains
  - '#clock-cells'

additionalProperties: false

examples:
  # Clock Control Module node:
  - |
    #include <dt-bindings/clock/imx8mp-clock.h>

    clock-controller@30e20000 {
        compatible = "fsl,imx8mp-audio-blk-ctrl";
        reg = <0x30e20000 0x10000>;
        #clock-cells = <1>;
        clocks = <&clk IMX8MP_CLK_AUDIO_ROOT>,
                 <&clk IMX8MP_CLK_SAI1>,
                 <&clk IMX8MP_CLK_SAI2>,
                 <&clk IMX8MP_CLK_SAI3>,
                 <&clk IMX8MP_CLK_SAI5>,
                 <&clk IMX8MP_CLK_SAI6>,
                 <&clk IMX8MP_CLK_SAI7>;
        clock-names = "ahb",
                      "sai1", "sai2", "sai3",
                      "sai5", "sai6", "sai7";
        power-domains = <&pgc_audio>;
    };

...
```

## Documentation/devicetree/bindings/clock/imx8mq-clock.txt
```
* Clock bindings for NXP i.MX8M Quad

Required properties:
- compatible: Should be "fsl,imx8mq-ccm"
- reg: Address and length of the register set
- #clock-cells: Should be <1>
- clocks: list of clock specifiers, must contain an entry for each required
          entry in clock-names
- clock-names: should include the following entries:
    - "ckil"
    - "osc_25m"
    - "osc_27m"
    - "clk_ext1"
    - "clk_ext2"
    - "clk_ext3"
    - "clk_ext4"

The clock consumer should specify the desired clock by having the clock
ID in its "clocks" phandle cell.  See include/dt-bindings/clock/imx8mq-clock.h
for the full list of i.MX8M Quad clock IDs.
```

## Documentation/devicetree/bindings/clock/imx8mq-clock.yaml
```yaml
# SPDX-License-Identifier: GPL-2.0
%YAML 1.2
---
$id: http://devicetree.org/schemas/bindings/clock/imx8mq-clock.yaml#
$schema: http://devicetree.org/meta-schemas/core.yaml#

title: NXP i.MX8M Quad Clock Control Module Binding

maintainers:
  - Anson Huang <Anson.Huang@nxp.com>

description: |
  NXP i.MX8M Quad clock control module is an integrated clock controller, which
  generates and supplies to all modules.

properties:
  compatible:
    const: fsl,imx8mq-ccm

  reg:
    maxItems: 1

  clocks:
    items:
      - description: 32k osc
      - description: 25m osc
      - description: 27m osc
      - description: ext1 clock input
      - description: ext2 clock input
      - description: ext3 clock input
      - description: ext4 clock input

  clock-names:
    items:
      - const: ckil
      - const: osc_25m
      - const: osc_27m
      - const: clk_ext1
      - const: clk_ext2
      - const: clk_ext3
      - const: clk_ext4

  '#clock-cells':
    const: 1
    description:
      The clock consumer should specify the desired clock by having the clock
      ID in its "clocks" phandle cell. See include/dt-bindings/clock/imx8mq-clock.h
      for the full list of i.MX8M Quad clock IDs.

required:
  - compatible
  - reg
  - clocks
  - clock-names
  - '#clock-cells'

examples:
  # Clock Control Module node:
  - |
    clk: clock-controller@30380000 {
        compatible = "fsl,imx8mq-ccm";
        reg = <0x30380000 0x10000>;
        #clock-cells = <1>;
        clocks = <&ckil>, <&osc_25m>, <&osc_27m>,
                 <&clk_ext1>, <&clk_ext2>,
                 <&clk_ext3>, <&clk_ext4>;
        clock-names = "ckil", "osc_25m", "osc_27m",
                      "clk_ext1", "clk_ext2",
                      "clk_ext3", "clk_ext4";
    };

...
```

## Documentation/devicetree/bindings/clock/imx8qxp-lpcg.txt
```
* NXP i.MX8QXP LPCG (Low-Power Clock Gating) Clock bindings

The Low-Power Clock Gate (LPCG) modules contain a local programming
model to control the clock gates for the peripherals. An LPCG module
is used to locally gate the clocks for the associated peripheral.

Note:
This level of clock gating is provided after the clocks are generated
by the SCU resources and clock controls. Thus even if the clock is
enabled by these control bits, it might still not be running based
on the base resource.

Required properties:
- compatible:	Should be one of:
		  "fsl,imx8qxp-lpcg-adma",
		  "fsl,imx8qxp-lpcg-conn",
		  "fsl,imx8qxp-lpcg-dc",
		  "fsl,imx8qxp-lpcg-dsp",
		  "fsl,imx8qxp-lpcg-gpu",
		  "fsl,imx8qxp-lpcg-hsio",
		  "fsl,imx8qxp-lpcg-img",
		  "fsl,imx8qxp-lpcg-lsio",
		  "fsl,imx8qxp-lpcg-vpu"
- reg:		Address and length of the register set
- #clock-cells:	Should be <1>

The clock consumer should specify the desired clock by having the clock
ID in its "clocks" phandle cell.
See the full list of clock IDs from:
include/dt-bindings/clock/imx8qxp-clock.h

Examples:

#include <dt-bindings/clock/imx8qxp-clock.h>

conn_lpcg: clock-controller@5b200000 {
	compatible = "fsl,imx8qxp-lpcg-conn";
	reg = <0x5b200000 0xb0000>;
	#clock-cells = <1>;
};

usdhc1: mmc@5b010000 {
	compatible = "fsl,imx8qxp-usdhc", "fsl,imx7d-usdhc";
	interrupt-parent = <&gic>;
	interrupts = <GIC_SPI 232 IRQ_TYPE_LEVEL_HIGH>;
	reg = <0x5b010000 0x10000>;
	clocks = <&conn_lpcg IMX8QXP_CONN_LPCG_SDHC0_IPG_CLK>,
		 <&conn_lpcg IMX8QXP_CONN_LPCG_SDHC0_PER_CLK>,
		 <&conn_lpcg IMX8QXP_CONN_LPCG_SDHC0_HCLK>;
	clock-names = "ipg", "per", "ahb";
};
```

## Documentation/devicetree/bindings/clock/imx8qxp-lpcg.yaml
```yaml
# SPDX-License-Identifier: (GPL-2.0-only OR BSD-2-Clause)
%YAML 1.2
---
$id: http://devicetree.org/schemas/clock/imx8qxp-lpcg.yaml#
$schema: http://devicetree.org/meta-schemas/core.yaml#

title: NXP i.MX8QXP LPCG (Low-Power Clock Gating) Clock bindings

maintainers:
  - Aisheng Dong <aisheng.dong@nxp.com>

description: |
  The Low-Power Clock Gate (LPCG) modules contain a local programming
  model to control the clock gates for the peripherals. An LPCG module
  is used to locally gate the clocks for the associated peripheral.

  This level of clock gating is provided after the clocks are generated
  by the SCU resources and clock controls. Thus even if the clock is
  enabled by these control bits, it might still not be running based
  on the base resource.

  The clock consumer should specify the desired clock by having the clock
  ID in its "clocks" phandle cell. See the full list of clock IDs from:
  include/dt-bindings/clock/imx8-lpcg.h

properties:
  compatible:
    oneOf:
      - const: fsl,imx8qxp-lpcg
      - items:
          - enum:
              - fsl,imx8qm-lpcg
          - const: fsl,imx8qxp-lpcg
      - enum:
          - fsl,imx8qxp-lpcg-adma
          - fsl,imx8qxp-lpcg-conn
          - fsl,imx8qxp-lpcg-dc
          - fsl,imx8qxp-lpcg-dsp
          - fsl,imx8qxp-lpcg-gpu
          - fsl,imx8qxp-lpcg-hsio
          - fsl,imx8qxp-lpcg-img
          - fsl,imx8qxp-lpcg-lsio
          - fsl,imx8qxp-lpcg-vpu
        deprecated: true
  reg:
    maxItems: 1

  '#clock-cells':
    const: 1

  clocks:
    description: |
      Input parent clocks phandle array for each clock
    minItems: 1
    maxItems: 8

  clock-indices:
    description: |
      An integer array indicating the bit offset for each clock.
      Refer to <include/dt-bindings/clock/imx8-lpcg.h> for the
      supported LPCG clock indices.
    minItems: 1
    maxItems: 8

  clock-output-names:
    description: |
      Shall be the corresponding names of the outputs.
      NOTE this property must be specified in the same order
      as the clock-indices property.
    minItems: 1
    maxItems: 8

  power-domains:
    maxItems: 1

required:
  - compatible
  - reg
  - '#clock-cells'

additionalProperties: false

examples:
  - |
    #include <dt-bindings/clock/imx8-lpcg.h>
    #include <dt-bindings/firmware/imx/rsrc.h>
    #include <dt-bindings/interrupt-controller/arm-gic.h>

    sdhc0_lpcg: clock-controller@5b200000 {
        compatible = "fsl,imx8qxp-lpcg";
        reg = <0x5b200000 0x10000>;
        #clock-cells = <1>;
        clocks = <&sdhc0_clk IMX_SC_PM_CLK_PER>,
                 <&conn_ipg_clk>,
                 <&conn_axi_clk>;
        clock-indices = <IMX_LPCG_CLK_0>,
                        <IMX_LPCG_CLK_4>,
                        <IMX_LPCG_CLK_5>;
        clock-output-names = "sdhc0_lpcg_per_clk",
                             "sdhc0_lpcg_ipg_clk",
                             "sdhc0_lpcg_ahb_clk";
        power-domains = <&pd IMX_SC_R_SDHC_0>;
    };

    mmc@5b010000 {
        compatible = "fsl,imx8qxp-usdhc", "fsl,imx7d-usdhc";
        interrupts = <GIC_SPI 232 IRQ_TYPE_LEVEL_HIGH>;
        reg = <0x5b010000 0x10000>;
        clocks = <&sdhc0_lpcg IMX_LPCG_CLK_4>,
                 <&sdhc0_lpcg IMX_LPCG_CLK_0>,
                 <&sdhc0_lpcg IMX_LPCG_CLK_5>;
        clock-names = "ipg", "per", "ahb";
        power-domains = <&pd IMX_SC_R_SDHC_0>;
    };
```

## Documentation/devicetree/bindings/clock/imx8ulp-cgc-clock.yaml
```yaml
# SPDX-License-Identifier: (GPL-2.0-only OR BSD-2-Clause)
%YAML 1.2
---
$id: http://devicetree.org/schemas/clock/imx8ulp-cgc-clock.yaml#
$schema: http://devicetree.org/meta-schemas/core.yaml#

title: NXP i.MX8ULP Clock Generation & Control(CGC) Module Binding

maintainers:
  - Jacky Bai <ping.bai@nxp.com>

description: |
  On i.MX8ULP, The clock sources generation, distribution and management is
  under the control of several CGCs & PCCs modules. The CGC modules generate
  and distribute clocks on the device.

properties:
  compatible:
    enum:
      - fsl,imx8ulp-cgc1
      - fsl,imx8ulp-cgc2

  reg:
    maxItems: 1

  '#clock-cells':
    const: 1

required:
  - compatible
  - reg
  - '#clock-cells'

additionalProperties: false

examples:
  # Clock Generation & Control Module node:
  - |
    clock-controller@292c0000 {
        compatible = "fsl,imx8ulp-cgc1";
        reg = <0x292c0000 0x10000>;
        #clock-cells = <1>;
    };
```

## Documentation/devicetree/bindings/clock/imx8ulp-pcc-clock.yaml
```yaml
# SPDX-License-Identifier: (GPL-2.0-only OR BSD-2-Clause)
%YAML 1.2
---
$id: http://devicetree.org/schemas/clock/imx8ulp-pcc-clock.yaml#
$schema: http://devicetree.org/meta-schemas/core.yaml#

title: NXP i.MX8ULP Peripheral Clock Controller(PCC) Module Binding

maintainers:
  - Jacky Bai <ping.bai@nxp.com>

description: |
  On i.MX8ULP, The clock sources generation, distribution and management is
  under the control of several CGCs & PCCs modules. The PCC modules control
  software reset, clock selection, optional division and clock gating mode
  for peripherals.

properties:
  compatible:
    enum:
      - fsl,imx8ulp-pcc3
      - fsl,imx8ulp-pcc4
      - fsl,imx8ulp-pcc5

  reg:
    maxItems: 1

  '#clock-cells':
    const: 1

  '#reset-cells':
    const: 1

required:
  - compatible
  - reg
  - '#clock-cells'
  - '#reset-cells'

additionalProperties: false

examples:
  # Peripheral Clock Control Module node:
  - |
    clock-controller@292d0000 {
        compatible = "fsl,imx8ulp-pcc3";
        reg = <0x292d0000 0x10000>;
        #clock-cells = <1>;
        #reset-cells = <1>;
    };
```

## Documentation/devicetree/bindings/clock/imx93-clock.yaml
```yaml
# SPDX-License-Identifier: (GPL-2.0-only OR BSD-2-Clause)
%YAML 1.2
---
$id: http://devicetree.org/schemas/clock/imx93-clock.yaml#
$schema: http://devicetree.org/meta-schemas/core.yaml#

title: NXP i.MX93 Clock Control Module

maintainers:
  - Peng Fan <peng.fan@nxp.com>

description: |
  i.MX93 clock control module is an integrated clock controller, which
  includes clock generator, clock gate and supplies to all modules.

properties:
  compatible:
    enum:
      - fsl,imx91-ccm
      - fsl,imx93-ccm

  reg:
    maxItems: 1

  clocks:
    description:
      specify the external clocks used by the CCM module.
    items:
      - description: 32k osc
      - description: 24m osc
      - description: ext1 clock input

  clock-names:
    description:
      specify the external clocks names used by the CCM module.
    items:
      - const: osc_32k
      - const: osc_24m
      - const: clk_ext1

  '#clock-cells':
    const: 1
    description:
      See include/dt-bindings/clock/imx93-clock.h for the full list of
      i.MX93 clock IDs.

required:
  - compatible
  - reg
  - '#clock-cells'

additionalProperties: false

examples:
  # Clock Control Module node:
  - |
    clock-controller@44450000 {
        compatible = "fsl,imx93-ccm";
        reg = <0x44450000 0x10000>;
        #clock-cells = <1>;
    };

...
```
