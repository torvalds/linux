## Documentation/devicetree/bindings/clock/qcom,sdx75-gcc.yaml
```yaml
# SPDX-License-Identifier: (GPL-2.0-only OR BSD-2-Clause)
%YAML 1.2
---
$id: http://devicetree.org/schemas/clock/qcom,sdx75-gcc.yaml#
$schema: http://devicetree.org/meta-schemas/core.yaml#

title: Qualcomm Global Clock & Reset Controller on SDX75

maintainers:
  - Imran Shaik <quic_imrashai@quicinc.com>
  - Taniya Das <quic_tdas@quicinc.com>

description: |
  Qualcomm global clock control module provides the clocks, resets and power
  domains on SDX75

  See also:: include/dt-bindings/clock/qcom,sdx75-gcc.h

properties:
  compatible:
    const: qcom,sdx75-gcc

  clocks:
    items:
      - description: Board XO source
      - description: Sleep clock source
      - description: EMAC0 sgmiiphy mac rclk source
      - description: EMAC0 sgmiiphy mac tclk source
      - description: EMAC0 sgmiiphy rclk source
      - description: EMAC0 sgmiiphy tclk source
      - description: EMAC1 sgmiiphy mac rclk source
      - description: EMAC1 sgmiiphy mac tclk source
      - description: EMAC1 sgmiiphy rclk source
      - description: EMAC1 sgmiiphy tclk source
      - description: PCIE20 phy aux clock source
      - description: PCIE_1 Pipe clock source
      - description: PCIE_2 Pipe clock source
      - description: PCIE Pipe clock source
      - description: USB3 phy wrapper pipe clock source

required:
  - compatible
  - clocks
  - '#power-domain-cells'

allOf:
  - $ref: qcom,gcc.yaml#

unevaluatedProperties: false

examples:
  - |
    #include <dt-bindings/clock/qcom,rpmh.h>
    clock-controller@80000 {
      compatible = "qcom,sdx75-gcc";
      reg = <0x80000 0x1f7400>;
      clocks = <&rpmhcc RPMH_CXO_CLK>, <&sleep_clk>, <&emac0_sgmiiphy_mac_rclk>,
               <&emac0_sgmiiphy_mac_tclk>, <&emac0_sgmiiphy_rclk>, <&emac0_sgmiiphy_tclk>,
               <&emac1_sgmiiphy_mac_rclk>, <&emac1_sgmiiphy_mac_tclk>, <&emac1_sgmiiphy_rclk>,
               <&emac1_sgmiiphy_tclk>, <&pcie20_phy_aux_clk>, <&pcie_1_pipe_clk>,
               <&pcie_2_pipe_clk>, <&pcie_pipe_clk>, <&usb3_phy_wrapper_gcc_usb30_pipe_clk>;
      #clock-cells = <1>;
      #reset-cells = <1>;
      #power-domain-cells = <1>;
    };
...
```

## Documentation/devicetree/bindings/clock/qcom,shikra-gcc.yaml
```yaml
# SPDX-License-Identifier: (GPL-2.0-only OR BSD-2-Clause)
%YAML 1.2
---
$id: http://devicetree.org/schemas/clock/qcom,shikra-gcc.yaml#
$schema: http://devicetree.org/meta-schemas/core.yaml#

title: Global Clock & Reset Controller on Qualcomm Shikra SoC

maintainers:
  - Imran Shaik <imran.shaik@oss.qualcomm.com>
  - Taniya Das <taniya.das@oss.qualcomm.com>

description: |
  Global clock control module provides the clocks, resets and power
  domains on Qualcomm Shikra SoC platform.

  See also: include/dt-bindings/clock/qcom,shikra-gcc.h

properties:
  compatible:
    const: qcom,shikra-gcc

  clocks:
    items:
      - description: Board XO source
      - description: Sleep clock source
      - description: EMAC0 sgmiiphy mac rclk source
      - description: EMAC0 sgmiiphy mac tclk source
      - description: EMAC1 sgmiiphy mac rclk source
      - description: EMAC1 sgmiiphy mac tclk source
      - description: PCIE Pipe clock source
      - description: USB3 phy wrapper pipe clock source

  power-domains:
    items:
      - description: CX domain

required:
  - compatible
  - clocks
  - power-domains
  - '#power-domain-cells'

allOf:
  - $ref: qcom,gcc.yaml#

unevaluatedProperties: false

examples:
  - |
    #include <dt-bindings/clock/qcom,rpmcc.h>
    #include <dt-bindings/power/qcom-rpmpd.h>
    clock-controller@1400000 {
        compatible = "qcom,shikra-gcc";
        reg = <0x01400000 0x1f0000>;
        clocks = <&rpmcc RPM_SMD_XO_CLK_SRC>,
                 <&sleep_clk>,
                 <&emac0_sgmiiphy_rclk>,
                 <&emac0_sgmiiphy_tclk>,
                 <&emac1_sgmiiphy_rclk>,
                 <&emac1_sgmiiphy_tclk>,
                 <&pcie_pipe_clk>,
                 <&usb3_phy_wrapper_gcc_usb30_pipe_clk>;
        power-domains = <&rpmpd RPMPD_VDDCX>;
        #clock-cells = <1>;
        #power-domain-cells = <1>;
        #reset-cells = <1>;
    };

...
```

## Documentation/devicetree/bindings/clock/qcom,sm4450-camcc.yaml
```yaml
# SPDX-License-Identifier: (GPL-2.0-only OR BSD-2-Clause)
%YAML 1.2
---
$id: http://devicetree.org/schemas/clock/qcom,sm4450-camcc.yaml#
$schema: http://devicetree.org/meta-schemas/core.yaml#

title: Qualcomm Camera Clock & Reset Controller on SM4450

maintainers:
  - Ajit Pandey <quic_ajipan@quicinc.com>
  - Taniya Das <quic_tdas@quicinc.com>

description: |
  Qualcomm camera clock control module provides the clocks, resets and power
  domains on SM4450

  See also:: include/dt-bindings/clock/qcom,sm4450-camcc.h

properties:
  compatible:
    const: qcom,sm4450-camcc

  reg:
    maxItems: 1

  clocks:
    items:
      - description: Board XO source
      - description: Camera AHB clock source from GCC

  '#clock-cells':
    const: 1

  '#reset-cells':
    const: 1

  '#power-domain-cells':
    const: 1

required:
  - compatible
  - reg
  - clocks
  - '#clock-cells'
  - '#reset-cells'
  - '#power-domain-cells'

additionalProperties: false

examples:
  - |
    #include <dt-bindings/clock/qcom,rpmh.h>
    #include <dt-bindings/clock/qcom,sm4450-gcc.h>
    clock-controller@ade0000 {
      compatible = "qcom,sm4450-camcc";
      reg = <0x0ade0000 0x20000>;
      clocks = <&rpmhcc RPMH_CXO_CLK>,
               <&gcc GCC_CAMERA_AHB_CLK>;
      #clock-cells = <1>;
      #reset-cells = <1>;
      #power-domain-cells = <1>;
    };
...
```

## Documentation/devicetree/bindings/clock/qcom,sm4450-dispcc.yaml
```yaml
# SPDX-License-Identifier: (GPL-2.0-only OR BSD-2-Clause)
%YAML 1.2
---
$id: http://devicetree.org/schemas/clock/qcom,sm4450-dispcc.yaml#
$schema: http://devicetree.org/meta-schemas/core.yaml#

title: Qualcomm Display Clock & Reset Controller on SM4450

maintainers:
  - Ajit Pandey <quic_ajipan@quicinc.com>
  - Taniya Das <quic_tdas@quicinc.com>

description: |
  Qualcomm display clock control module provides the clocks, resets and power
  domains on SM4450

  See also: include/dt-bindings/clock/qcom,sm4450-dispcc.h

properties:
  compatible:
    const: qcom,sm4450-dispcc

  clocks:
    items:
      - description: Board XO source
      - description: Board active XO source
      - description: Display AHB clock source from GCC
      - description: sleep clock source
      - description: Byte clock from DSI PHY0
      - description: Pixel clock from DSI PHY0

required:
  - compatible
  - clocks
  - '#power-domain-cells'

allOf:
  - $ref: qcom,gcc.yaml#

unevaluatedProperties: false

examples:
  - |
    #include <dt-bindings/clock/qcom,rpmh.h>
    #include <dt-bindings/clock/qcom,sm4450-gcc.h>
    clock-controller@af00000 {
      compatible = "qcom,sm4450-dispcc";
      reg = <0x0af00000 0x20000>;
      clocks = <&rpmhcc RPMH_CXO_CLK>,
               <&rpmhcc RPMH_CXO_CLK_A>,
               <&gcc GCC_DISP_AHB_CLK>,
               <&sleep_clk>,
               <&dsi0_phy_pll_out_byteclk>,
               <&dsi0_phy_pll_out_dsiclk>;
      #clock-cells = <1>;
      #reset-cells = <1>;
      #power-domain-cells = <1>;
    };
...
```
