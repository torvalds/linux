## Documentation/devicetree/bindings/clock/qcom,sc7180-dispcc.yaml
```yaml
# SPDX-License-Identifier: GPL-2.0-only
%YAML 1.2
---
$id: http://devicetree.org/schemas/clock/qcom,sc7180-dispcc.yaml#
$schema: http://devicetree.org/meta-schemas/core.yaml#

title: Qualcomm Display Clock & Reset Controller Binding for SC7180

maintainers:
  - Taniya Das <tdas@codeaurora.org>

description: |
  Qualcomm display clock control module which supports the clocks, resets and
  power domains on SC7180.

  See also dt-bindings/clock/qcom,dispcc-sc7180.h.

properties:
  compatible:
    const: qcom,sc7180-dispcc

  clocks:
    items:
      - description: Board XO source
      - description: GPLL0 source from GCC
      - description: Byte clock from DSI PHY
      - description: Pixel clock from DSI PHY
      - description: Link clock from DP PHY
      - description: VCO DIV clock from DP PHY

  clock-names:
    items:
      - const: bi_tcxo
      - const: gcc_disp_gpll0_clk_src
      - const: dsi0_phy_pll_out_byteclk
      - const: dsi0_phy_pll_out_dsiclk
      - const: dp_phy_pll_link_clk
      - const: dp_phy_pll_vco_div_clk

  '#clock-cells':
    const: 1

  '#reset-cells':
    const: 1

  '#power-domain-cells':
    const: 1

  reg:
    maxItems: 1

required:
  - compatible
  - reg
  - clocks
  - clock-names
  - '#clock-cells'
  - '#reset-cells'
  - '#power-domain-cells'

examples:
  - |
    #include <dt-bindings/clock/qcom,gcc-sc7180.h>
    #include <dt-bindings/clock/qcom,rpmh.h>
    clock-controller@af00000 {
      compatible = "qcom,sc7180-dispcc";
      reg = <0 0x0af00000 0 0x200000>;
      clocks = <&rpmhcc RPMH_CXO_CLK>,
               <&gcc GCC_DISP_GPLL0_CLK_SRC>,
               <&dsi_phy 0>,
               <&dsi_phy 1>,
               <&dp_phy 0>,
               <&dp_phy 1>;
      clock-names = "bi_tcxo",
                    "gcc_disp_gpll0_clk_src",
                    "dsi0_phy_pll_out_byteclk",
                    "dsi0_phy_pll_out_dsiclk",
                    "dp_phy_pll_link_clk",
                    "dp_phy_pll_vco_div_clk";
      #clock-cells = <1>;
      #reset-cells = <1>;
      #power-domain-cells = <1>;
    };
...
```

## Documentation/devicetree/bindings/clock/qcom,sc7180-lpasscorecc.yaml
```yaml
# SPDX-License-Identifier: (GPL-2.0-only OR BSD-2-Clause)
%YAML 1.2
---
$id: http://devicetree.org/schemas/clock/qcom,sc7180-lpasscorecc.yaml#
$schema: http://devicetree.org/meta-schemas/core.yaml#

title: Qualcomm LPASS Core Clock Controller on SC7180

maintainers:
  - Taniya Das <quic_tdas@quicinc.com>

description: |
  Qualcomm LPASS core clock control module provides the clocks and power
  domains on SC7180.

  See also:: include/dt-bindings/clock/qcom,lpasscorecc-sc7180.h

properties:
  compatible:
    enum:
      - qcom,sc7180-lpasshm
      - qcom,sc7180-lpasscorecc

  clocks:
    items:
      - description: gcc_lpass_sway clock from GCC
      - description: Board XO source

  clock-names:
    items:
      - const: iface
      - const: bi_tcxo

  power-domains:
    maxItems: 1

  '#clock-cells':
    const: 1

  '#power-domain-cells':
    const: 1

  reg:
    minItems: 1
    items:
      - description: lpass core cc register
      - description: lpass audio cc register

  reg-names:
    items:
      - const: lpass_core_cc
      - const: lpass_audio_cc

if:
  properties:
    compatible:
      contains:
        const: qcom,sc7180-lpasshm
then:
  properties:
    reg:
      maxItems: 1

else:
  properties:
    reg:
      minItems: 2

required:
  - compatible
  - reg
  - clocks
  - clock-names
  - '#clock-cells'
  - '#power-domain-cells'

additionalProperties: false

examples:
  - |
    #include <dt-bindings/clock/qcom,rpmh.h>
    #include <dt-bindings/clock/qcom,gcc-sc7180.h>
    #include <dt-bindings/clock/qcom,lpasscorecc-sc7180.h>
    clock-controller@63000000 {
      compatible = "qcom,sc7180-lpasshm";
      reg = <0x63000000 0x28>;
      clocks = <&gcc GCC_LPASS_CFG_NOC_SWAY_CLK>, <&rpmhcc RPMH_CXO_CLK>;
      clock-names = "iface", "bi_tcxo";
      #clock-cells = <1>;
      #power-domain-cells = <1>;
    };

  - |
    #include <dt-bindings/clock/qcom,rpmh.h>
    #include <dt-bindings/clock/qcom,gcc-sc7180.h>
    #include <dt-bindings/clock/qcom,lpasscorecc-sc7180.h>
    clock-controller@62d00000 {
      compatible = "qcom,sc7180-lpasscorecc";
      reg = <0x62d00000 0x50000>, <0x62780000 0x30000>;
      reg-names = "lpass_core_cc", "lpass_audio_cc";
      clocks = <&gcc GCC_LPASS_CFG_NOC_SWAY_CLK>, <&rpmhcc RPMH_CXO_CLK>;
      clock-names = "iface", "bi_tcxo";
      power-domains = <&lpass_hm LPASS_CORE_HM_GDSCR>;
      #clock-cells = <1>;
      #power-domain-cells = <1>;
    };
...
```

## Documentation/devicetree/bindings/clock/qcom,sc7180-mss.yaml
```yaml
# SPDX-License-Identifier: (GPL-2.0-only OR BSD-2-Clause)
%YAML 1.2
---
$id: http://devicetree.org/schemas/clock/qcom,sc7180-mss.yaml#
$schema: http://devicetree.org/meta-schemas/core.yaml#

title: Qualcomm Modem Clock Controller Binding for SC7180

maintainers:
  - Taniya Das <tdas@codeaurora.org>

description: |
  Qualcomm modem clock control module which supports the clocks on SC7180.

  See also:
  - dt-bindings/clock/qcom,mss-sc7180.h

properties:
  compatible:
    const: qcom,sc7180-mss

  clocks:
    items:
      - description: gcc_mss_mfab_axi clock from GCC
      - description: gcc_mss_nav_axi clock from GCC
      - description: gcc_mss_cfg_ahb clock from GCC

  clock-names:
    items:
      - const: gcc_mss_mfab_axis
      - const: gcc_mss_nav_axi
      - const: cfg_ahb

  '#clock-cells':
    const: 1

  reg:
    maxItems: 1

required:
  - compatible
  - reg
  - clocks
  - '#clock-cells'

additionalProperties: false

examples:
  - |
    #include <dt-bindings/clock/qcom,gcc-sc7180.h>
    clock-controller@41a8000 {
      compatible = "qcom,sc7180-mss";
      reg = <0x041a8000 0x8000>;
      clocks = <&gcc GCC_MSS_MFAB_AXIS_CLK>,
               <&gcc GCC_MSS_NAV_AXI_CLK>,
               <&gcc GCC_MSS_CFG_AHB_CLK>;
      clock-names = "gcc_mss_mfab_axis",
                    "gcc_mss_nav_axi",
                    "cfg_ahb";
      #clock-cells = <1>;
    };
...
```

## Documentation/devicetree/bindings/clock/qcom,sc7280-camcc.yaml
```yaml
# SPDX-License-Identifier: (GPL-2.0-only OR BSD-2-Clause)
%YAML 1.2
---
$id: http://devicetree.org/schemas/clock/qcom,sc7280-camcc.yaml#
$schema: http://devicetree.org/meta-schemas/core.yaml#

title: Qualcomm Camera Clock & Reset Controller on SC7280

maintainers:
  - Taniya Das <tdas@codeaurora.org>

description: |
  Qualcomm camera clock control module provides the clocks, resets and
  power domains on SC7280.

  See also:: include/dt-bindings/clock/qcom,camcc-sc7280.h

properties:
  compatible:
    const: qcom,sc7280-camcc

  clocks:
    items:
      - description: Board XO source
      - description: Board XO active source
      - description: Sleep clock source

  clock-names:
    items:
      - const: bi_tcxo
      - const: bi_tcxo_ao
      - const: sleep_clk

  '#clock-cells':
    const: 1

  '#reset-cells':
    const: 1

  '#power-domain-cells':
    const: 1

  reg:
    maxItems: 1

required:
  - compatible
  - reg
  - clocks
  - clock-names
  - '#clock-cells'
  - '#reset-cells'
  - '#power-domain-cells'

additionalProperties: false

examples:
  - |
    #include <dt-bindings/clock/qcom,rpmh.h>
    clock-controller@ad00000 {
      compatible = "qcom,sc7280-camcc";
      reg = <0x0ad00000 0x10000>;
      clocks = <&rpmhcc RPMH_CXO_CLK>,
               <&rpmhcc RPMH_CXO_CLK_A>,
               <&sleep_clk>;
      clock-names = "bi_tcxo", "bi_tcxo_ao", "sleep_clk";
      #clock-cells = <1>;
      #reset-cells = <1>;
      #power-domain-cells = <1>;
    };
...
```

## Documentation/devicetree/bindings/clock/qcom,sc7280-dispcc.yaml
```yaml
# SPDX-License-Identifier: (GPL-2.0-only OR BSD-2-Clause)
%YAML 1.2
---
$id: http://devicetree.org/schemas/clock/qcom,sc7280-dispcc.yaml#
$schema: http://devicetree.org/meta-schemas/core.yaml#

title: Qualcomm Display Clock & Reset Controller on SC7280

maintainers:
  - Taniya Das <quic_tdas@quicinc.com>

description: |
  Qualcomm display clock control module provides the clocks, resets and power
  domains on SC7280.

  See also:: include/dt-bindings/clock/qcom,dispcc-sc7280.h

properties:
  compatible:
    const: qcom,sc7280-dispcc

  clocks:
    items:
      - description: Board XO source
      - description: GPLL0 source from GCC
      - description: Byte clock from DSI PHY
      - description: Pixel clock from DSI PHY
      - description: Link clock from DP PHY
      - description: VCO DIV clock from DP PHY
      - description: Link clock from EDP PHY
      - description: VCO DIV clock from EDP PHY

  clock-names:
    items:
      - const: bi_tcxo
      - const: gcc_disp_gpll0_clk
      - const: dsi0_phy_pll_out_byteclk
      - const: dsi0_phy_pll_out_dsiclk
      - const: dp_phy_pll_link_clk
      - const: dp_phy_pll_vco_div_clk
      - const: edp_phy_pll_link_clk
      - const: edp_phy_pll_vco_div_clk

required:
  - compatible
  - clocks
  - clock-names
  - '#power-domain-cells'

allOf:
  - $ref: qcom,gcc.yaml#

unevaluatedProperties: false

examples:
  - |
    #include <dt-bindings/clock/qcom,gcc-sc7280.h>
    #include <dt-bindings/clock/qcom,rpmh.h>
    clock-controller@af00000 {
      compatible = "qcom,sc7280-dispcc";
      reg = <0x0af00000 0x200000>;
      clocks = <&rpmhcc RPMH_CXO_CLK>,
               <&gcc GCC_DISP_GPLL0_CLK_SRC>,
               <&dsi_phy 0>,
               <&dsi_phy 1>,
               <&dp_phy 0>,
               <&dp_phy 1>,
               <&edp_phy 0>,
               <&edp_phy 1>;
      clock-names = "bi_tcxo",
                    "gcc_disp_gpll0_clk",
                    "dsi0_phy_pll_out_byteclk",
                    "dsi0_phy_pll_out_dsiclk",
                    "dp_phy_pll_link_clk",
                    "dp_phy_pll_vco_div_clk",
                    "edp_phy_pll_link_clk",
                    "edp_phy_pll_vco_div_clk";
      #clock-cells = <1>;
      #reset-cells = <1>;
      #power-domain-cells = <1>;
    };
...
```

## Documentation/devicetree/bindings/clock/qcom,sc7280-lpasscc.yaml
```yaml
# SPDX-License-Identifier: (GPL-2.0-only OR BSD-2-Clause)
%YAML 1.2
---
$id: http://devicetree.org/schemas/clock/qcom,sc7280-lpasscc.yaml#
$schema: http://devicetree.org/meta-schemas/core.yaml#

title: Qualcomm LPASS Core Clock Controller on SC7280

maintainers:
  - Taniya Das <quic_tdas@quicinc.com>

description: |
  Qualcomm LPASS core clock control module provides the clocks and power
  domains on SC7280.

  See also: include/dt-bindings/clock/qcom,lpass-sc7280.h

properties:
  compatible:
    enum:
      - qcom,sc7280-lpasscc

  clocks:
    items:
      - description: gcc_cfg_noc_lpass_clk from GCC

  clock-names:
    items:
      - const: iface

  '#clock-cells':
    const: 1

  reg:
    items:
      - description: LPASS qdsp6ss register
      - description: LPASS top-cc register

  reg-names:
    items:
      - const: qdsp6ss
      - const: top_cc

  qcom,adsp-pil-mode:
    description:
      Indicates if the LPASS would be brought out of reset using
      remoteproc peripheral loader.
    type: boolean

required:
  - compatible
  - reg
  - clocks
  - clock-names
  - '#clock-cells'

additionalProperties: false

examples:
  - |
    #include <dt-bindings/clock/qcom,gcc-sc7280.h>
    #include <dt-bindings/clock/qcom,lpass-sc7280.h>
    clock-controller@3000000 {
      compatible = "qcom,sc7280-lpasscc";
      reg = <0x03000000 0x40>, <0x03c04000 0x4>;
      reg-names = "qdsp6ss", "top_cc";
      clocks = <&gcc GCC_CFG_NOC_LPASS_CLK>;
      clock-names = "iface";
      qcom,adsp-pil-mode;
      #clock-cells = <1>;
    };
...
```
