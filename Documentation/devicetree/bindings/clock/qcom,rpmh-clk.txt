## Documentation/devicetree/bindings/clock/qcom,rpmh-clk.txt
```
Qualcomm Technologies, Inc. RPMh Clocks
-------------------------------------------------------

Resource Power Manager Hardened (RPMh) manages shared resources on
some Qualcomm Technologies Inc. SoCs. It accepts clock requests from
other hardware subsystems via RSC to control clocks.

Required properties :
- compatible : must be one of:
	       "qcom,sdm845-rpmh-clk"
	       "qcom,sm8150-rpmh-clk"

- #clock-cells : must contain 1
- clocks: a list of phandles and clock-specifier pairs,
	  one for each entry in clock-names.
- clock-names: Parent board clock: "xo".

Example :

#include <dt-bindings/clock/qcom,rpmh.h>

	&apps_rsc {
		rpmhcc: clock-controller {
			compatible = "qcom,sdm845-rpmh-clk";
			#clock-cells = <1>;
		};
	};
```

## Documentation/devicetree/bindings/clock/qcom,rpmhcc.yaml
```yaml
# SPDX-License-Identifier: GPL-2.0-only
%YAML 1.2
---
$id: http://devicetree.org/schemas/clock/qcom,rpmhcc.yaml#
$schema: http://devicetree.org/meta-schemas/core.yaml#

title: Qualcomm Technologies, Inc. RPMh Clocks

maintainers:
  - Taniya Das <quic_tdas@quicinc.com>

description: |
  Resource Power Manager Hardened (RPMh) manages shared resources on
  some Qualcomm Technologies Inc. SoCs. It accepts clock requests from
  other hardware subsystems via RSC to control clocks.

properties:
  compatible:
    enum:
      - qcom,qdu1000-rpmh-clk
      - qcom,sa8775p-rpmh-clk
      - qcom,sc7180-rpmh-clk
      - qcom,sc7280-rpmh-clk
      - qcom,sc8180x-rpmh-clk
      - qcom,sc8280xp-rpmh-clk
      - qcom,sdm670-rpmh-clk
      - qcom,sdm845-rpmh-clk
      - qcom,sdx55-rpmh-clk
      - qcom,sdx65-rpmh-clk
      - qcom,sdx75-rpmh-clk
      - qcom,sm4450-rpmh-clk
      - qcom,sm6350-rpmh-clk
      - qcom,sm8150-rpmh-clk
      - qcom,sm8250-rpmh-clk
      - qcom,sm8350-rpmh-clk
      - qcom,sm8450-rpmh-clk
      - qcom,sm8550-rpmh-clk
      - qcom,sm8650-rpmh-clk
      - qcom,x1e80100-rpmh-clk

  clocks:
    maxItems: 1

  clock-names:
    items:
      - const: xo

  '#clock-cells':
    const: 1

required:
  - compatible
  - '#clock-cells'

additionalProperties: false

examples:
  # Example for GCC for SDM845: The below node should be defined inside
  # &apps_rsc node.
  - |
    #include <dt-bindings/clock/qcom,rpmh.h>
    rpmhcc: clock-controller {
      compatible = "qcom,sdm845-rpmh-clk";
      clocks = <&xo_board>;
      clock-names = "xo";
      #clock-cells = <1>;
    };
...
```

## Documentation/devicetree/bindings/clock/qcom,sa8775p-camcc.yaml
```yaml
# SPDX-License-Identifier: (GPL-2.0-only OR BSD-2-Clause)
%YAML 1.2
---
$id: http://devicetree.org/schemas/clock/qcom,sa8775p-camcc.yaml#
$schema: http://devicetree.org/meta-schemas/core.yaml#

title: Qualcomm Camera Clock & Reset Controller on SA8775P

maintainers:
  - Taniya Das <quic_tdas@quicinc.com>
  - Imran Shaik <quic_imrashai@quicinc.com>

description: |
  Qualcomm camera clock control module provides the clocks, resets and power
  domains on SA8775p.

  See also:
    include/dt-bindings/clock/qcom,qcs8300-camcc.h
    include/dt-bindings/clock/qcom,sa8775p-camcc.h
    include/dt-bindings/clock/qcom,sc8280xp-camcc.h

properties:
  compatible:
    enum:
      - qcom,qcs8300-camcc
      - qcom,sa8775p-camcc
      - qcom,sc8280xp-camcc

  clocks:
    items:
      - description: Camera AHB clock from GCC
      - description: Board XO source
      - description: Board active XO source
      - description: Sleep clock source

  power-domains:
    maxItems: 1
    description: MMCX power domain

  required-opps:
    description:
      OPP node describing required MMCX performance point.
    maxItems: 1

required:
  - compatible
  - clocks
  - power-domains
  - '#power-domain-cells'

allOf:
  - $ref: qcom,gcc.yaml#
  - if:
      properties:
        compatible:
          contains:
            const: qcom,sc8280xp-camcc
    then:
      required:
        - required-opps

unevaluatedProperties: false

examples:
  - |
    #include <dt-bindings/clock/qcom,rpmh.h>
    #include <dt-bindings/power/qcom-rpmpd.h>
    #include <dt-bindings/clock/qcom,sa8775p-gcc.h>
    clock-controller@ade0000 {
      compatible = "qcom,sa8775p-camcc";
      reg = <0x0ade0000 0x20000>;
      clocks = <&gcc GCC_CAMERA_AHB_CLK>,
               <&rpmhcc RPMH_CXO_CLK>,
               <&rpmhcc RPMH_CXO_CLK_A>,
               <&sleep_clk>;
      power-domains = <&rpmhpd SA8775P_MMCX>;
      #clock-cells = <1>;
      #reset-cells = <1>;
      #power-domain-cells = <1>;
    };
...
```

## Documentation/devicetree/bindings/clock/qcom,sa8775p-dispcc.yaml
```yaml
# SPDX-License-Identifier: (GPL-2.0-only OR BSD-2-Clause)
%YAML 1.2
---
$id: http://devicetree.org/schemas/clock/qcom,sa8775p-dispcc.yaml#
$schema: http://devicetree.org/meta-schemas/core.yaml#

title: Qualcomm Display Clock & Reset Controller on SA8775P

maintainers:
  - Taniya Das <quic_tdas@quicinc.com>

description: |
  Qualcomm display clock control module provides the clocks, resets and power
  domains on SA8775P.

  See also: include/dt-bindings/clock/qcom,sa8775p-dispcc.h

properties:
  compatible:
    enum:
      - qcom,sa8775p-dispcc0
      - qcom,sa8775p-dispcc1

  clocks:
    items:
      - description: GCC AHB clock source
      - description: Board XO source
      - description: Board XO_AO source
      - description: Sleep clock source
      - description: Link clock from DP0 PHY
      - description: VCO DIV clock from DP0 PHY
      - description: Link clock from DP1 PHY
      - description: VCO DIV clock from DP1 PHY
      - description: Byte clock from DSI0 PHY
      - description: Pixel clock from DSI0 PHY
      - description: Byte clock from DSI1 PHY
      - description: Pixel clock from DSI1 PHY

  power-domains:
    maxItems: 1
    description: MMCX power domain

required:
  - compatible
  - clocks
  - power-domains
  - '#power-domain-cells'

allOf:
  - $ref: qcom,gcc.yaml#

unevaluatedProperties: false

examples:
  - |
    #include <dt-bindings/clock/qcom,rpmh.h>
    #include <dt-bindings/power/qcom-rpmpd.h>
    #include <dt-bindings/clock/qcom,sa8775p-gcc.h>
    clock-controller@af00000 {
      compatible = "qcom,sa8775p-dispcc0";
      reg = <0x0af00000 0x20000>;
      clocks = <&gcc GCC_DISP_AHB_CLK>,
               <&rpmhcc RPMH_CXO_CLK>,
               <&rpmhcc RPMH_CXO_CLK_A>,
               <&sleep_clk>,
               <&dp_phy0 0>,
               <&dp_phy0 1>,
               <&dp_phy1 2>,
               <&dp_phy1 3>,
               <&dsi_phy0 0>,
               <&dsi_phy0 1>,
               <&dsi_phy1 2>,
               <&dsi_phy1 3>;
      power-domains = <&rpmhpd SA8775P_MMCX>;
      #clock-cells = <1>;
      #reset-cells = <1>;
      #power-domain-cells = <1>;
    };
...
```

## Documentation/devicetree/bindings/clock/qcom,sa8775p-gcc.yaml
```yaml
# SPDX-License-Identifier: (GPL-2.0-only OR BSD-2-Clause)
%YAML 1.2
---
$id: http://devicetree.org/schemas/clock/qcom,sa8775p-gcc.yaml#
$schema: http://devicetree.org/meta-schemas/core.yaml#

title: Qualcomm Global Clock & Reset Controller on sa8775p

maintainers:
  - Bartosz Golaszewski <bartosz.golaszewski@linaro.org>

description: |
  Qualcomm global clock control module provides the clocks, resets and
  power domains on sa8775p.

  See also:: include/dt-bindings/clock/qcom,sa8775p-gcc.h

properties:
  compatible:
    const: qcom,sa8775p-gcc

  clocks:
    items:
      - description: XO reference clock
      - description: Sleep clock
      - description: UFS memory first RX symbol clock
      - description: UFS memory second RX symbol clock
      - description: UFS memory first TX symbol clock
      - description: UFS card first RX symbol clock
      - description: UFS card second RX symbol clock
      - description: UFS card first TX symbol clock
      - description: Primary USB3 PHY wrapper pipe clock
      - description: Secondary USB3 PHY wrapper pipe clock
      - description: PCIe 0 pipe clock
      - description: PCIe 1 pipe clock
      - description: PCIe PHY clock
      - description: First EMAC controller reference clock
      - description: Second EMAC controller reference clock

  protected-clocks:
    maxItems: 240

  power-domains:
    maxItems: 1

required:
  - compatible
  - clocks

allOf:
  - $ref: qcom,gcc.yaml#

unevaluatedProperties: false

examples:
  - |
    #include <dt-bindings/clock/qcom,rpmh.h>
    #include <dt-bindings/power/qcom-rpmpd.h>

    gcc: clock-controller@100000 {
        compatible = "qcom,sa8775p-gcc";
        reg = <0x100000 0xc7018>;
        clocks = <&rpmhcc RPMH_CXO_CLK>,
                 <&sleep_clk>,
                 <&ufs_phy_rx_symbol_0_clk>,
                 <&ufs_phy_rx_symbol_1_clk>,
                 <&ufs_phy_tx_symbol_0_clk>,
                 <&ufs_card_rx_symbol_0_clk>,
                 <&ufs_card_rx_symbol_1_clk>,
                 <&ufs_card_tx_symbol_0_clk>,
                 <&usb_0_ssphy>,
                 <&usb_1_ssphy>,
                 <&pcie_0_pipe_clk>,
                 <&pcie_1_pipe_clk>,
                 <&pcie_phy_pipe_clk>,
                 <&rxc0_ref_clk>,
                 <&rxc1_ref_clk>;
        power-domains = <&rpmhpd SA8775P_CX>;

        #clock-cells = <1>;
        #reset-cells = <1>;
        #power-domain-cells = <1>;
    };
...
```

## Documentation/devicetree/bindings/clock/qcom,sa8775p-videocc.yaml
```yaml
# SPDX-License-Identifier: (GPL-2.0-only OR BSD-2-Clause)
%YAML 1.2
---
$id: http://devicetree.org/schemas/clock/qcom,sa8775p-videocc.yaml#
$schema: http://devicetree.org/meta-schemas/core.yaml#

title: Qualcomm Video Clock & Reset Controller on SA8775P

maintainers:
  - Taniya Das <quic_tdas@quicinc.com>

description: |
  Qualcomm video clock control module provides the clocks, resets and power
  domains on SA8775P.

  See also: include/dt-bindings/clock/qcom,sa8775p-videocc.h

properties:
  compatible:
    enum:
      - qcom,sa8775p-videocc

  clocks:
    items:
      - description: Video AHB clock from GCC
      - description: Board XO source
      - description: Board active XO source
      - description: Sleep Clock source

  power-domains:
    maxItems: 1
    description: MMCX power domain

required:
  - compatible
  - clocks
  - power-domains
  - '#power-domain-cells'

allOf:
  - $ref: qcom,gcc.yaml#

unevaluatedProperties: false

examples:
  - |
    #include <dt-bindings/clock/qcom,rpmh.h>
    #include <dt-bindings/power/qcom-rpmpd.h>
    #include <dt-bindings/clock/qcom,sa8775p-gcc.h>
    videocc: clock-controller@abf0000 {
      compatible = "qcom,sa8775p-videocc";
      reg = <0x0abf0000 0x10000>;
      clocks = <&gcc GCC_VIDEO_AHB_CLK>,
               <&rpmhcc RPMH_CXO_CLK>,
               <&rpmhcc RPMH_CXO_CLK_A>,
               <&sleep_clk>;
      power-domains = <&rpmhpd SA8775P_MMCX>;
      #clock-cells = <1>;
      #reset-cells = <1>;
      #power-domain-cells = <1>;
    };
...
```

## Documentation/devicetree/bindings/clock/qcom,sar2130p-gcc.yaml
```yaml
# SPDX-License-Identifier: (GPL-2.0-only OR BSD-2-Clause)
%YAML 1.2
---
$id: http://devicetree.org/schemas/clock/qcom,sar2130p-gcc.yaml#
$schema: http://devicetree.org/meta-schemas/core.yaml#

title: Qualcomm Global Clock & Reset Controller on sar2130p

maintainers:
  - Dmitry Baryshkov <dmitry.baryshkov@linaro.org>

description: |
  Qualcomm global clock control module provides the clocks, resets and
  power domains on sar2130p.

  See also: include/dt-bindings/clock/qcom,sar2130p-gcc.h

properties:
  compatible:
    const: qcom,sar2130p-gcc

  clocks:
    items:
      - description: XO reference clock
      - description: Sleep clock
      - description: PCIe 0 pipe clock
      - description: PCIe 1 pipe clock
      - description: Primary USB3 PHY wrapper pipe clock

  protected-clocks:
    maxItems: 240

  power-domains:
    maxItems: 1

required:
  - compatible
  - clocks
  - '#power-domain-cells'

allOf:
  - $ref: qcom,gcc.yaml#

unevaluatedProperties: false

examples:
  - |
    #include <dt-bindings/clock/qcom,rpmh.h>
    #include <dt-bindings/power/qcom,rpmhpd.h>

    gcc: clock-controller@100000 {
        compatible = "qcom,sar2130p-gcc";
        reg = <0x100000 0x1f4200>;
        clocks = <&rpmhcc RPMH_CXO_CLK>,
                 <&sleep_clk>,
                 <&pcie_0_pipe_clk>,
                 <&pcie_1_pipe_clk>,
                 <&usb_0_ssphy>;
        power-domains = <&rpmhpd RPMHPD_CX>;

        #clock-cells = <1>;
        #reset-cells = <1>;
        #power-domain-cells = <1>;
    };
...
```

## Documentation/devicetree/bindings/clock/qcom,sc7180-camcc.yaml
```yaml
# SPDX-License-Identifier: (GPL-2.0-only OR BSD-2-Clause)
%YAML 1.2
---
$id: http://devicetree.org/schemas/clock/qcom,sc7180-camcc.yaml#
$schema: http://devicetree.org/meta-schemas/core.yaml#

title: Qualcomm Camera Clock & Reset Controller on SC7180

maintainers:
  - Taniya Das <tdas@codeaurora.org>

description: |
  Qualcomm camera clock control module provides the clocks, resets and power
  domains on SC7180.

  See also:: include/dt-bindings/clock/qcom,camcc-sc7180.h

properties:
  compatible:
    const: qcom,sc7180-camcc

  clocks:
    items:
      - description: Board XO source
      - description: Camera_ahb clock from GCC
      - description: Camera XO clock from GCC

  clock-names:
    items:
      - const: bi_tcxo
      - const: iface
      - const: xo

  '#clock-cells':
    const: 1

  '#reset-cells':
    const: 1

  '#power-domain-cells':
    const: 1

  reg:
    maxItems: 1

required:
  - compatible
  - reg
  - clocks
  - clock-names
  - '#clock-cells'
  - '#reset-cells'
  - '#power-domain-cells'

additionalProperties: false

examples:
  - |
    #include <dt-bindings/clock/qcom,gcc-sc7180.h>
    #include <dt-bindings/clock/qcom,rpmh.h>
    clock-controller@ad00000 {
      compatible = "qcom,sc7180-camcc";
      reg = <0x0ad00000 0x10000>;
      clocks = <&rpmhcc RPMH_CXO_CLK>,
               <&gcc GCC_CAMERA_AHB_CLK>,
               <&gcc GCC_CAMERA_XO_CLK>;
      clock-names = "bi_tcxo", "iface", "xo";
      #clock-cells = <1>;
      #reset-cells = <1>;
      #power-domain-cells = <1>;
    };
...
```
