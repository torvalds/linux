## Documentation/devicetree/bindings/clock/rockchip,rk3399-cru.yaml
```yaml
# SPDX-License-Identifier: (GPL-2.0+ OR MIT)
%YAML 1.2
---
$id: http://devicetree.org/schemas/clock/rockchip,rk3399-cru.yaml#
$schema: http://devicetree.org/meta-schemas/core.yaml#

title: Rockchip RK3399 Clock and Reset Unit

maintainers:
  - Elaine Zhang <zhangqing@rock-chips.com>
  - Heiko Stuebner <heiko@sntech.de>

description: |
  The RK3399 clock controller generates and supplies clock to various
  controllers within the SoC and also implements a reset controller for SoC
  peripherals.
  Each clock is assigned an identifier and client nodes can use this identifier
  to specify the clock which they consume. All available clocks are defined as
  preprocessor macros in the dt-bindings/clock/rk3399-cru.h headers and can be
  used in device tree sources. Similar macros exist for the reset sources in
  these files.
  There are several clocks that are generated outside the SoC. It is expected
  that they are defined using standard clock bindings with following
  clock-output-names:
    - "xin24m"           - crystal input                          - required,
    - "xin32k"           - rtc clock                              - optional,
    - "clkin_gmac"       - external GMAC clock                    - optional,
    - "clkin_i2s"        - external I2S clock                     - optional,
    - "pclkin_cif"       - external ISP clock                     - optional,
    - "clk_usbphy0_480m" - output clock of the pll in the usbphy0
    - "clk_usbphy1_480m" - output clock of the pll in the usbphy1

properties:
  compatible:
    enum:
      - rockchip,rk3399-pmucru
      - rockchip,rk3399-cru

  reg:
    maxItems: 1

  "#clock-cells":
    const: 1

  "#reset-cells":
    const: 1

  clocks:
    maxItems: 1

  clock-names:
    const: xin24m

  rockchip,grf:
    $ref: /schemas/types.yaml#/definitions/phandle
    description:
      Phandle to the syscon managing the "general register files". It is used
      for GRF muxes, if missing any muxes present in the GRF will not be
      available.

required:
  - compatible
  - reg
  - "#clock-cells"
  - "#reset-cells"

additionalProperties: false

examples:
  - |
    pmucru: clock-controller@ff750000 {
      compatible = "rockchip,rk3399-pmucru";
      reg = <0xff750000 0x1000>;
      #clock-cells = <1>;
      #reset-cells = <1>;
    };
  - |
    cru: clock-controller@ff760000 {
      compatible = "rockchip,rk3399-cru";
      reg = <0xff760000 0x1000>;
      #clock-cells = <1>;
      #reset-cells = <1>;
    };
```

## Documentation/devicetree/bindings/clock/rockchip,rk3506-cru.yaml
```yaml
# SPDX-License-Identifier: GPL-2.0-only OR BSD-2-Clause
%YAML 1.2
---
$id: http://devicetree.org/schemas/clock/rockchip,rk3506-cru.yaml#
$schema: http://devicetree.org/meta-schemas/core.yaml#

title: Rockchip RK3506 Clock and Reset Unit (CRU)

maintainers:
  - Finley Xiao <finley.xiao@rock-chips.com>
  - Heiko Stuebner <heiko@sntech.de>

description:
  The RK3506 CRU generates the clock and also implements reset for SoC
  peripherals.

properties:
  compatible:
    const: rockchip,rk3506-cru

  reg:
    maxItems: 1

  "#clock-cells":
    const: 1

  "#reset-cells":
    const: 1

  clocks:
    maxItems: 1

  clock-names:
    const: xin

required:
  - compatible
  - reg
  - "#clock-cells"
  - "#reset-cells"
  - clocks
  - clock-names

additionalProperties: false

examples:
  - |
    clock-controller@ff9a0000 {
      compatible = "rockchip,rk3506-cru";
      reg = <0xff9a0000 0x20000>;
      #clock-cells = <1>;
      #reset-cells = <1>;
      clocks = <&xin24m>;
      clock-names = "xin";
    };
```

## Documentation/devicetree/bindings/clock/rockchip,rk3528-cru.yaml
```yaml
# SPDX-License-Identifier: (GPL-2.0-only OR BSD-2-Clause)
%YAML 1.2
---
$id: http://devicetree.org/schemas/clock/rockchip,rk3528-cru.yaml#
$schema: http://devicetree.org/meta-schemas/core.yaml#

title: Rockchip RK3528 Clock and Reset Controller

maintainers:
  - Yao Zi <ziyao@disroot.org>

description: |
  The RK3528 clock controller generates the clock and also implements a reset
  controller for SoC peripherals. For example, it provides SCLK_UART0 and
  PCLK_UART0 as well as SRST_P_UART0 and SRST_S_UART0 for the first UART
  module.
  Each clock is assigned an identifier, consumer nodes can use it to specify
  the clock. All available clock and reset IDs are defined in dt-binding
  headers.

properties:
  compatible:
    const: rockchip,rk3528-cru

  reg:
    maxItems: 1

  clocks:
    items:
      - description: External 24MHz oscillator clock
      - description: >
          50MHz clock generated by PHY module, for generating GMAC0 clocks only.

  clock-names:
    items:
      - const: xin24m
      - const: gmac0

  "#clock-cells":
    const: 1

  "#reset-cells":
    const: 1

required:
  - compatible
  - reg
  - clocks
  - clock-names
  - "#clock-cells"
  - "#reset-cells"

additionalProperties: false

examples:
  - |
    clock-controller@ff4a0000 {
        compatible = "rockchip,rk3528-cru";
        reg = <0xff4a0000 0x30000>;
        clocks = <&xin24m>, <&gmac0_clk>;
        clock-names = "xin24m", "gmac0";
        #clock-cells = <1>;
        #reset-cells = <1>;
    };
```

## Documentation/devicetree/bindings/clock/rockchip,rk3562-cru.yaml
```yaml
# SPDX-License-Identifier: GPL-2.0-only OR BSD-2-Clause
%YAML 1.2
---
$id: http://devicetree.org/schemas/clock/rockchip,rk3562-cru.yaml#
$schema: http://devicetree.org/meta-schemas/core.yaml#

title: Rockchip rk3562 Clock and Reset Control Module

maintainers:
  - Elaine Zhang <zhangqing@rock-chips.com>
  - Heiko Stuebner <heiko@sntech.de>

description:
  The RK3562 clock controller generates the clock and also implements a reset
  controller for SoC peripherals. For example it provides SCLK_UART2 and
  PCLK_UART2, as well as SRST_P_UART2 and SRST_S_UART2 for the second UART
  module.

properties:
  compatible:
    const: rockchip,rk3562-cru

  reg:
    maxItems: 1

  "#clock-cells":
    const: 1

  "#reset-cells":
    const: 1

  clocks:
    maxItems: 2

  clock-names:
    items:
      - const: xin24m
      - const: xin32k

required:
  - compatible
  - reg
  - "#clock-cells"
  - "#reset-cells"

additionalProperties: false

examples:
  - |
    clock-controller@ff100000 {
      compatible = "rockchip,rk3562-cru";
      reg = <0xff100000 0x40000>;
      #clock-cells = <1>;
      #reset-cells = <1>;
    };
```

## Documentation/devicetree/bindings/clock/rockchip,rk3568-cru.txt
```
* Rockchip RK3568 Clock and Reset Unit

The RK3568 clock controller generates and supplies clock to various
controllers within the SoC and also implements a reset controller for SoC
peripherals.

Required Properties:

- compatible: PMU for CRU should be "rockchip,rk3568-pmucru"
- compatible: CRU should be "rockchip,rk3568-cru"
- reg: physical base address of the controller and length of memory mapped
  region.
- #clock-cells: should be 1.
- #reset-cells: should be 1.

Optional Properties:

- rockchip,grf: phandle to the syscon managing the "general register files"
  If missing, pll rates are not changeable, due to the missing pll lock status.

Each clock is assigned an identifier and client nodes can use this identifier
to specify the clock which they consume. All available clocks are defined as
preprocessor macros in the dt-bindings/clock/rk3568-cru.h headers and can be
used in device tree sources. Similar macros exist for the reset sources in
these files.

External clocks:

There are several clocks that are generated outside the SoC. It is expected
that they are defined using standard clock bindings with following
clock-output-names:
 - "xin24m" - crystal input - required,
 - "xin32k" - rtc clock - optional,
 - "i2sx_mclkin" - external I2S clock - optional,
 - "xin_osc0_usbphyx_g" - external USBPHY clock - optional,
 - "xin_osc0_mipidsiphyx_g" - external MIPIDSIPHY clock - optional,

Example: Clock controller node:

	pmucru: clock-controller@fdd00000 {
		compatible = "rockchip,rK3568-pmucru";
		reg = <0x0 0xfdd00000 0x0 0x1000>;
		#clock-cells = <1>;
		#reset-cells = <1>;
	};

	cru: clock-controller@fdd20000 {
		compatible = "rockchip,rK3568-cru";
		reg = <0x0 0xfdd20000 0x0 0x1000>;
		rockchip,grf = <&grf>;
		#clock-cells = <1>;
		#reset-cells = <1>;
	};

Example: UART controller node that consumes the clock generated by the clock
  controller:

	uart1: serial@fe650000 {
		compatible = "rockchip,rK3568-uart", "snps,dw-apb-uart";
		reg = <0x0 0xfe650000 0x0 0x100>;
		interrupts = <GIC_SPI 117 IRQ_TYPE_LEVEL_HIGH>;
		reg-shift = <2>;
		reg-io-width = <4>;
		clocks = <&cru SCLK_UART1>, <&cru PCLK_UART1>;
		clock-names = "baudclk", "apb_pclk";
	};
```

## Documentation/devicetree/bindings/clock/rockchip,rk3568-cru.yaml
```yaml
# SPDX-License-Identifier: GPL-2.0-only OR BSD-2-Clause
%YAML 1.2
---
$id: http://devicetree.org/schemas/clock/rockchip,rk3568-cru.yaml#
$schema: http://devicetree.org/meta-schemas/core.yaml#

title: ROCKCHIP rk3568 Family Clock Control Module Binding

maintainers:
  - Elaine Zhang <zhangqing@rock-chips.com>
  - Heiko Stuebner <heiko@sntech.de>

description: |
  The RK3568 clock controller generates the clock and also implements a
  reset controller for SoC peripherals.
  (examples: provide SCLK_UART1\PCLK_UART1 and SRST_P_UART1\SRST_S_UART1 for UART module)
  Each clock is assigned an identifier and client nodes can use this identifier
  to specify the clock which they consume. All available clocks are defined as
  preprocessor macros in the dt-bindings/clock/rk3568-cru.h headers and can be
  used in device tree sources.

properties:
  compatible:
    enum:
      - rockchip,rk3568-cru
      - rockchip,rk3568-pmucru

  reg:
    maxItems: 1

  "#clock-cells":
    const: 1

  "#reset-cells":
    const: 1

required:
  - compatible
  - reg
  - "#clock-cells"
  - "#reset-cells"

additionalProperties: false

examples:
  # Clock Control Module node:
  - |
    pmucru: clock-controller@fdd00000 {
      compatible = "rockchip,rk3568-pmucru";
      reg = <0xfdd00000 0x1000>;
      #clock-cells = <1>;
      #reset-cells = <1>;
    };
  - |
    cru: clock-controller@fdd20000 {
      compatible = "rockchip,rk3568-cru";
      reg = <0xfdd20000 0x1000>;
      #clock-cells = <1>;
      #reset-cells = <1>;
    };
```

## Documentation/devicetree/bindings/clock/rockchip,rk3576-cru.yaml
```yaml
# SPDX-License-Identifier: GPL-2.0-only OR BSD-2-Clause
%YAML 1.2
---
$id: http://devicetree.org/schemas/clock/rockchip,rk3576-cru.yaml#
$schema: http://devicetree.org/meta-schemas/core.yaml#

title: Rockchip rk3576 Family Clock and Reset Control Module

maintainers:
  - Elaine Zhang <zhangqing@rock-chips.com>
  - Heiko Stuebner <heiko@sntech.de>
  - Detlev Casanova <detlev.casanova@collabora.com>

description:
  The RK3576 clock controller generates the clock and also implements a reset
  controller for SoC peripherals. For example it provides SCLK_UART2 and
  PCLK_UART2, as well as SRST_P_UART2 and SRST_S_UART2 for the second UART
  module.

properties:
  compatible:
    const: rockchip,rk3576-cru

  reg:
    maxItems: 1

  "#clock-cells":
    const: 1

  "#reset-cells":
    const: 1

  clocks:
    maxItems: 2

  clock-names:
    items:
      - const: xin24m
      - const: xin32k

required:
  - compatible
  - reg
  - "#clock-cells"
  - "#reset-cells"

additionalProperties: false

examples:
  - |
    clock-controller@27200000 {
      compatible = "rockchip,rk3576-cru";
      reg = <0xfd7c0000 0x5c000>;
      #clock-cells = <1>;
      #reset-cells = <1>;
    };
```

## Documentation/devicetree/bindings/clock/rockchip,rk3588-cru.yaml
```yaml
# SPDX-License-Identifier: GPL-2.0-only OR BSD-2-Clause
%YAML 1.2
---
$id: http://devicetree.org/schemas/clock/rockchip,rk3588-cru.yaml#
$schema: http://devicetree.org/meta-schemas/core.yaml#

title: Rockchip rk3588 Family Clock and Reset Control Module

maintainers:
  - Elaine Zhang <zhangqing@rock-chips.com>
  - Heiko Stuebner <heiko@sntech.de>

description: |
  The RK3588 clock controller generates the clock and also implements a reset
  controller for SoC peripherals. For example it provides SCLK_UART2 and
  PCLK_UART2, as well as SRST_P_UART2 and SRST_S_UART2 for the second UART
  module.
  Each clock is assigned an identifier and client nodes can use this identifier
  to specify the clock which they consume. All available clock and reset IDs
  are defined as preprocessor macros in dt-binding headers.

properties:
  compatible:
    enum:
      - rockchip,rk3588-cru

  reg:
    maxItems: 1

  "#clock-cells":
    const: 1

  "#reset-cells":
    const: 1

  clocks:
    minItems: 2
    maxItems: 2

  clock-names:
    items:
      - const: xin24m
      - const: xin32k

  rockchip,grf:
    $ref: /schemas/types.yaml#/definitions/phandle
    description: >
      phandle to the syscon managing the "general register files". It is used
      for GRF muxes, if missing any muxes present in the GRF will not be
      available.

required:
  - compatible
  - reg
  - "#clock-cells"
  - "#reset-cells"

additionalProperties: false

examples:
  - |
    cru: clock-controller@fd7c0000 {
      compatible = "rockchip,rk3588-cru";
      reg = <0xfd7c0000 0x5c000>;
      #clock-cells = <1>;
      #reset-cells = <1>;
    };
```

## Documentation/devicetree/bindings/clock/rockchip,rk618-cru.txt
```
Rockchip RK618 Clock and Reset Unit

This binding uses the common clock binding:
Documentation/devicetree/bindings/clock/clock-bindings.txt

Required properties :
- compatible : Should be "rockchip,rk618-cru"
- clocks : Should contain phandle and clock specifiers for the input clock:
  the AP I2S master clock output(mclk) "clkin", and the AP LCDC master
  dclk output(dclk) "lcdc0_dclkp".
- #clock-cells : Should be 1.

Example:

&rk618 {
	CRU: cru {
		compatible = "rockchip,rk618-cru";
		clocks = <&cru SCLK_I2S_8CH_OUT>, <&cru DCLK_VOP>;
		clock-names = "clkin", "lcdc0_dclkp";
		assigned-clocks = <&CRU SCALER_PLLIN_CLK>, <&CRU VIF_PLLIN_CLK>,
				  <&CRU HDMI_CLK>, <&CRU SCALER_CLK>,
				  <&CRU CODEC_CLK>;
		assigned-clock-parents = <&CRU LCDC0_CLK>, <&CRU LCDC0_CLK>,
					 <&CRU VIF0_CLK>, <&CRU SCALER_PLL_CLK>,
					 <&cru SCLK_I2S_8CH_OUT>;
		#clock-cells = <1>;
		status = "okay";
	};
};
```
