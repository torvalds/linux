## Documentation/devicetree/bindings/clock/rockchip,rv1108-cru.yaml
```yaml
# SPDX-License-Identifier: GPL-2.0
%YAML 1.2
---
$id: http://devicetree.org/schemas/clock/rockchip,rv1108-cru.yaml#
$schema: http://devicetree.org/meta-schemas/core.yaml#

title: Rockchip RV1108 Clock and Reset Unit (CRU)

maintainers:
  - Elaine Zhang <zhangqing@rock-chips.com>
  - Heiko Stuebner <heiko@sntech.de>

description: |
  The RV1108 clock controller generates and supplies clocks to various
  controllers within the SoC and also implements a reset controller for SoC
  peripherals.
  Each clock is assigned an identifier and client nodes can use this identifier
  to specify the clock which they consume. All available clocks are defined as
  preprocessor macros in the dt-bindings/clock/rv1108-cru.h headers and can be
  used in device tree sources. Similar macros exist for the reset sources in
  these files.
  There are several clocks that are generated outside the SoC. It is expected
  that they are defined using standard clock bindings with following
  clock-output-names:
    - "xin24m"   - crystal input                              - required
    - "ext_vip"  - external VIP clock                         - optional
    - "ext_i2s"  - external I2S clock                         - optional
    - "ext_gmac" - external GMAC clock                        - optional
    - "hdmiphy"  - external clock input derived from HDMI PHY - optional
    - "usbphy"   - external clock input derived from USB PHY  - optional

properties:
  compatible:
    enum:
      - rockchip,rv1108-cru

  reg:
    maxItems: 1

  "#clock-cells":
    const: 1

  "#reset-cells":
    const: 1

  clocks:
    maxItems: 1

  clock-names:
    const: xin24m

  rockchip,grf:
    $ref: /schemas/types.yaml#/definitions/phandle
    description:
      Phandle to the syscon managing the "general register files" (GRF),
      if missing pll rates are not changeable, due to the missing pll
      lock status.

required:
  - compatible
  - reg
  - "#clock-cells"
  - "#reset-cells"

additionalProperties: false

examples:
  - |
    cru: clock-controller@20200000 {
      compatible = "rockchip,rv1108-cru";
      reg = <0x20200000 0x1000>;
      rockchip,grf = <&grf>;
      #clock-cells = <1>;
      #reset-cells = <1>;
    };
```

## Documentation/devicetree/bindings/clock/rockchip,rv1126-cru.txt
```
* Rockchip RV1126 Clock and Reset Unit

The RV1126 clock controller generates and supplies clock to various
controllers within the SoC and also implements a reset controller for SoC
peripherals.

Required Properties:

- compatible: PMU for CRU should be "rockchip,rv1126-pmucru"
- compatible: CRU should be "rockchip,rv1126-cru"
- reg: physical base address of the controller and length of memory mapped
  region.
- #clock-cells: should be 1.
- #reset-cells: should be 1.

Optional Properties:

- rockchip,grf: phandle to the syscon managing the "general register files"
  If missing, pll rates are not changeable, due to the missing pll lock status.

Each clock is assigned an identifier and client nodes can use this identifier
to specify the clock which they consume. All available clocks are defined as
preprocessor macros in the dt-bindings/clock/rv1126-cru.h headers and can be
used in device tree sources. Similar macros exist for the reset sources in
these files.

External clocks:

There are several clocks that are generated outside the SoC. It is expected
that they are defined using standard clock bindings with following
clock-output-names:
 - "xin24m" - crystal input - required,
 - "xin32k" - rtc clock - optional,
 - "i2s8ch_mclkin" - external I2S clock - optional,
 - "i2s2ch0_mclkin" - external I2S clock - optional,
 - "i2s2ch1_mclkin" - external I2S clock - optional,
 - "clk_gmac_rgmii_clkin_m0" - external GMAC clock - optional
 - "clk_gmac_rgmii_clkin_m1" - external GMAC clock - optional

Example: Clock controller node:

	pmucru: clock-controller@ff480000 {
		compatible = "rockchip,rv1126-pmucru";
		reg = <0x0 0xff480000 0x0 0x1000>;
		#clock-cells = <1>;
		#reset-cells = <1>;
	};

	cru: clock-controller@ff490000 {
		compatible = "rockchip,rv1126-cru";
		reg = <0x0 0xff490000 0x0 0x1000>;
		rockchip,grf = <&grf>;
		#clock-cells = <1>;
		#reset-cells = <1>;
	};

Example: UART controller node that consumes the clock generated by the clock
  controller:

	uart0: serial@ff560000 {
		compatible = "rockchip,rv1126-uart", "snps,dw-apb-uart";
		reg = <0xff560000 0x100>;
		interrupts = <GIC_SPI 12 IRQ_TYPE_LEVEL_HIGH>;
		reg-shift = <2>;
		reg-io-width = <4>;
		clocks = <&cru SCLK_UART0>, <&cru PCLK_UART0>;
		clock-names = "baudclk", "apb_pclk";
	};
```

## Documentation/devicetree/bindings/clock/rockchip,rv1126-cru.yaml
```yaml
# SPDX-License-Identifier: GPL-2.0-only OR BSD-2-Clause
%YAML 1.2
---
$id: http://devicetree.org/schemas/clock/rockchip,rv1126-cru.yaml#
$schema: http://devicetree.org/meta-schemas/core.yaml#

title: Rockchip RV1126 Clock and Reset Unit

maintainers:
  - Jagan Teki <jagan@edgeble.ai>
  - Finley Xiao <finley.xiao@rock-chips.com>
  - Heiko Stuebner <heiko@sntech.de>

description:
  The RV1126 clock controller generates the clock and also implements a
  reset controller for SoC peripherals.

properties:
  compatible:
    enum:
      - rockchip,rv1126-cru
      - rockchip,rv1126-pmucru

  reg:
    maxItems: 1

  "#clock-cells":
    const: 1

  "#reset-cells":
    const: 1

  clocks:
    maxItems: 1

  clock-names:
    const: xin24m

  rockchip,grf:
    $ref: /schemas/types.yaml#/definitions/phandle
    description:
      Phandle to the syscon managing the "general register files" (GRF),
      if missing pll rates are not changeable, due to the missing pll
      lock status.

required:
  - compatible
  - reg
  - "#clock-cells"
  - "#reset-cells"

additionalProperties: false

examples:
  - |
    cru: clock-controller@ff490000 {
      compatible = "rockchip,rv1126-cru";
      reg = <0xff490000 0x1000>;
      rockchip,grf = <&grf>;
      #clock-cells = <1>;
      #reset-cells = <1>;
    };
```

## Documentation/devicetree/bindings/clock/rockchip,rv1126b-cru.yaml
```yaml
# SPDX-License-Identifier: GPL-2.0-only OR BSD-2-Clause
%YAML 1.2
---
$id: http://devicetree.org/schemas/clock/rockchip,rv1126b-cru.yaml#
$schema: http://devicetree.org/meta-schemas/core.yaml#

title: Rockchip RV1126B Clock and Reset Unit

maintainers:
  - Elaine Zhang <zhangqing@rock-chips.com>
  - Heiko Stuebner <heiko@sntech.de>

description:
  The rv1126b clock controller generates the clock and also implements a
  reset controller for SoC peripherals.

properties:
  compatible:
    enum:
      - rockchip,rv1126b-cru

  reg:
    maxItems: 1

  "#clock-cells":
    const: 1

  "#reset-cells":
    const: 1

  clocks:
    maxItems: 1

  clock-names:
    const: xin24m

required:
  - compatible
  - reg
  - "#clock-cells"
  - "#reset-cells"

additionalProperties: false

examples:
  - |
    clock-controller@20000000 {
      compatible = "rockchip,rv1126b-cru";
      reg = <0x20000000 0xc0000>;
      #clock-cells = <1>;
      #reset-cells = <1>;
    };
```

## Documentation/devicetree/bindings/clock/rockchip.txt
```
Device Tree Clock bindings for arch-rockchip

This binding uses the common clock binding[1].

[1] Documentation/devicetree/bindings/clock/clock-bindings.txt

== Gate clocks ==

The gate registers form a continuos block which makes the dt node
structure a matter of taste, as either all gates can be put into
one gate clock spanning all registers or they can be divided into
the 10 individual gates containing 16 clocks each.
The code supports both approaches.

Required properties:
- compatible : "rockchip,rk2928-gate-clk"
- reg : shall be the control register address(es) for the clock.
- #clock-cells : from common clock binding; shall be set to 1
- clock-output-names : the corresponding gate names that the clock controls
- clocks : should contain the parent clock for each individual gate,
  therefore the number of clocks elements should match the number of
  clock-output-names

Example using multiple gate clocks:

		clk_gates0: gate-clk@200000d0 {
			compatible = "rockchip,rk2928-gate-clk";
			reg = <0x200000d0 0x4>;
			clocks = <&dummy>, <&dummy>,
				 <&dummy>, <&dummy>,
				 <&dummy>, <&dummy>,
				 <&dummy>, <&dummy>,
				 <&dummy>, <&dummy>,
				 <&dummy>, <&dummy>,
				 <&dummy>, <&dummy>,
				 <&dummy>, <&dummy>;

			clock-output-names =
				"gate_core_periph", "gate_cpu_gpll",
				"gate_ddrphy", "gate_aclk_cpu",
				"gate_hclk_cpu", "gate_pclk_cpu",
				"gate_atclk_cpu", "gate_i2s0",
				"gate_i2s0_frac", "gate_i2s1",
				"gate_i2s1_frac", "gate_i2s2",
				"gate_i2s2_frac", "gate_spdif",
				"gate_spdif_frac", "gate_testclk";

			#clock-cells = <1>;
		};

		clk_gates1: gate-clk@200000d4 {
			compatible = "rockchip,rk2928-gate-clk";
			reg = <0x200000d4 0x4>;
			clocks = <&xin24m>, <&xin24m>,
				 <&xin24m>, <&dummy>,
				 <&dummy>, <&xin24m>,
				 <&xin24m>, <&dummy>,
				 <&xin24m>, <&dummy>,
				 <&xin24m>, <&dummy>,
				 <&xin24m>, <&dummy>,
				 <&xin24m>, <&dummy>;

			clock-output-names =
				"gate_timer0", "gate_timer1",
				"gate_timer2", "gate_jtag",
				"gate_aclk_lcdc1_src", "gate_otgphy0",
				"gate_otgphy1", "gate_ddr_gpll",
				"gate_uart0", "gate_frac_uart0",
				"gate_uart1", "gate_frac_uart1",
				"gate_uart2", "gate_frac_uart2",
				"gate_uart3", "gate_frac_uart3";

			#clock-cells = <1>;
		};
```

## Documentation/devicetree/bindings/clock/samsung,exynos-audss-clock.yaml
```yaml
# SPDX-License-Identifier: (GPL-2.0-only OR BSD-2-Clause)
%YAML 1.2
---
$id: http://devicetree.org/schemas/clock/samsung,exynos-audss-clock.yaml#
$schema: http://devicetree.org/meta-schemas/core.yaml#

title: Samsung Exynos SoC Audio SubSystem clock controller

maintainers:
  - Chanwoo Choi <cw00.choi@samsung.com>
  - Krzysztof Kozlowski <krzk@kernel.org>
  - Sylwester Nawrocki <s.nawrocki@samsung.com>
  - Tomasz Figa <tomasz.figa@gmail.com>

description: |
  All available clocks are defined as preprocessor macros in
  include/dt-bindings/clock/exynos-audss-clk.h header.

properties:
  compatible:
    enum:
      - samsung,exynos4210-audss-clock
      - samsung,exynos5250-audss-clock
      - samsung,exynos5410-audss-clock
      - samsung,exynos5420-audss-clock

  clocks:
    minItems: 2
    items:
      - description:
          Fixed rate PLL reference clock, parent of mout_audss. "fin_pll" is
          used if not specified.
      - description:
          Input PLL to the AudioSS block, parent of mout_audss. "fout_epll" is
          used if not specified.
      - description:
          Audio bus clock, parent of mout_i2s. "sclk_audio0" is used if not
          specified.
      - description:
          PCM clock, parent of sclk_pcm.  "sclk_pcm0" is used if not specified.
      - description:
          External i2s clock, parent of mout_i2s. "cdclk0" is used if not
          specified.

  clock-names:
    minItems: 2
    items:
      - const: pll_ref
      - const: pll_in
      - const: sclk_audio
      - const: sclk_pcm_in
      - const: cdclk

  "#clock-cells":
    const: 1

  power-domains:
    maxItems: 1

  reg:
    maxItems: 1

required:
  - compatible
  - clocks
  - clock-names
  - "#clock-cells"
  - reg

additionalProperties: false

examples:
  - |
    clock-controller@3810000 {
        compatible = "samsung,exynos5250-audss-clock";
        reg = <0x03810000 0x0c>;
        #clock-cells = <1>;
        clocks = <&clock 1>, <&clock 7>, <&clock 138>, <&clock 160>, <&ext_i2s_clk>;
        clock-names = "pll_ref", "pll_in", "sclk_audio", "sclk_pcm_in", "cdclk";
    };
```

## Documentation/devicetree/bindings/clock/samsung,exynos-clock.yaml
```yaml
# SPDX-License-Identifier: (GPL-2.0-only OR BSD-2-Clause)
%YAML 1.2
---
$id: http://devicetree.org/schemas/clock/samsung,exyanals-clock.yaml#
$schema: http://devicetree.org/meta-schemas/core.yaml#

title: Samsung Exyanals SoC clock controller

maintainers:
  - Chanwoo Choi <cw00.choi@samsung.com>
  - Krzysztof Kozlowski <krzk@kernel.org>
  - Sylwester Nawrocki <s.nawrocki@samsung.com>
  - Tomasz Figa <tomasz.figa@gmail.com>

description: |
  All available clocks are defined as preprocessor macros in
  dt-bindings/clock/ headers.

properties:
  compatible:
    oneOf:
      - enum:
          - samsung,exyanals3250-cmu
          - samsung,exyanals3250-cmu-dmc
          - samsung,exyanals3250-cmu-isp
          - samsung,exyanals4210-clock
          - samsung,exyanals4212-clock
          - samsung,exyanals4412-clock
          - samsung,exyanals5250-clock
      - items:
          - enum:
              - samsung,exyanals5420-clock
              - samsung,exyanals5800-clock
          - const: syscon

  clocks:
    minItems: 1
    maxItems: 4

  "#clock-cells":
    const: 1

  reg:
    maxItems: 1

required:
  - compatible
  - "#clock-cells"
  - reg

additionalProperties: false

examples:
  - |
    #include <dt-bindings/clock/exyanals5250.h>
    clock: clock-controller@10010000 {
        compatible = "samsung,exyanals5250-clock";
        reg = <0x10010000 0x30000>;
        #clock-cells = <1>;
    };
```

## Documentation/devicetree/bindings/clock/samsung,exynos-ext-clock.yaml
```yaml
# SPDX-License-Identifier: (GPL-2.0-only OR BSD-2-Clause)
%YAML 1.2
---
$id: http://devicetree.org/schemas/clock/samsung,exynos-ext-clock.yaml#
$schema: http://devicetree.org/meta-schemas/core.yaml#

title: Samsung SoC external/osc/XXTI/XusbXTI clock

maintainers:
  - Chanwoo Choi <cw00.choi@samsung.com>
  - Krzysztof Kozlowski <krzk@kernel.org>
  - Sylwester Nawrocki <s.nawrocki@samsung.com>
  - Tomasz Figa <tomasz.figa@gmail.com>

description: |
  Samsung SoCs require an external clock supplied through XXTI or XusbXTI pins.

properties:
  compatible:
    enum:
      - samsung,clock-xxti
      - samsung,clock-xusbxti
      - samsung,exynos5420-oscclk

  "#clock-cells":
    const: 0

  clock-frequency: true

  clock-output-names:
    maxItems: 1

required:
  - compatible
  - clock-frequency

additionalProperties: false

examples:
  - |
    fixed-rate-clocks {
        clock {
            compatible = "samsung,clock-xxti";
            clock-frequency = <24000000>;
        };
    };
```
