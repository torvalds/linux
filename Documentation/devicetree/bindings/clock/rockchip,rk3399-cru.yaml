## Documentation/devicetree/bindings/clock/samsung,exynos2200-cmu.yaml
```yaml
# SPDX-License-Identifier: (GPL-2.0-only OR BSD-2-Clause)
%YAML 1.2
---
$id: http://devicetree.org/schemas/clock/samsung,exynos2200-cmu.yaml#
$schema: http://devicetree.org/meta-schemas/core.yaml#

title: Samsung Exynos2200 SoC clock controller

maintainers:
  - Ivaylo Ivanov <ivo.ivanov.ivanov1@gmail.com>
  - Chanwoo Choi <cw00.choi@samsung.com>
  - Krzysztof Kozlowski <krzk@kernel.org>

description: |
  Exynos2200 clock controller is comprised of several CMU units, generating
  clocks for different domains. Those CMU units are modeled as separate device
  tree nodes, and might depend on each other. The root clocks in that root tree
  are two external clocks: XTCXO (76.8 MHz) and RTCCLK (32768 Hz). XTCXO must be
  defined as a fixed-rate clock in dts, whereas RTCCLK originates from PMIC.

  CMU_TOP is a top-level CMU, where all base clocks are prepared using PLLs and
  dividers; all other clocks of function blocks (other CMUs) are usually
  derived from CMU_TOP.

  Each clock is assigned an identifier and client nodes can use this identifier
  to specify the clock which they consume. All clocks available for usage
  in clock consumer nodes are defined as preprocessor macros in
  'include/dt-bindings/clock/samsung,exynos2200-cmu.h' header.

properties:
  compatible:
    enum:
      - samsung,exynos2200-cmu-alive
      - samsung,exynos2200-cmu-cmgp
      - samsung,exynos2200-cmu-hsi0
      - samsung,exynos2200-cmu-peric0
      - samsung,exynos2200-cmu-peric1
      - samsung,exynos2200-cmu-peric2
      - samsung,exynos2200-cmu-peris
      - samsung,exynos2200-cmu-top
      - samsung,exynos2200-cmu-ufs
      - samsung,exynos2200-cmu-vts

  clocks:
    minItems: 1
    maxItems: 6

  clock-names:
    minItems: 1
    maxItems: 6

  "#clock-cells":
    const: 1

  reg:
    maxItems: 1

required:
  - compatible
  - clocks
  - clock-names
  - reg
  - "#clock-cells"

allOf:
  - if:
      properties:
        compatible:
          contains:
            const: samsung,exynos2200-cmu-alive

    then:
      properties:
        clocks:
          items:
            - description: External reference clock (76.8 MHz)
            - description: CMU_ALIVE NOC clock (from CMU_TOP)

        clock-names:
          items:
            - const: oscclk
            - const: noc

  - if:
      properties:
        compatible:
          contains:
            const: samsung,exynos2200-cmu-cmgp

    then:
      properties:
        clocks:
          items:
            - description: External reference clock (76.8 MHz)
            - description: CMU_CMGP NOC clock (from CMU_TOP)
            - description: CMU_CMGP PERI clock (from CMU_TOP)

        clock-names:
          items:
            - const: oscclk
            - const: noc
            - const: peri

  - if:
      properties:
        compatible:
          contains:
            const: samsung,exynos2200-cmu-hsi0

    then:
      properties:
        clocks:
          items:
            - description: External reference clock (76.8 MHz)
            - description: External RTC clock (32768 Hz)
            - description: CMU_HSI0 NOC clock (from CMU_TOP)
            - description: CMU_HSI0 DPGTC clock (from CMU_TOP)
            - description: CMU_HSI0 DPOSC clock (from CMU_TOP)
            - description: CMU_HSI0 USB32DRD clock (from CMU_TOP)

        clock-names:
          items:
            - const: oscclk
            - const: rtcclk
            - const: noc
            - const: dpgtc
            - const: dposc
            - const: usb

  - if:
      properties:
        compatible:
          contains:
            enum:
              - samsung,exynos2200-cmu-peric0
              - samsung,exynos2200-cmu-peric1
              - samsung,exynos2200-cmu-peric2

    then:
      properties:
        clocks:
          items:
            - description: External reference clock (76.8 MHz)
            - description: CMU_PERICn NOC clock (from CMU_TOP)
            - description: CMU_PERICn IP0 clock (from CMU_TOP)
            - description: CMU_PERICn IP1 clock (from CMU_TOP)

        clock-names:
          items:
            - const: oscclk
            - const: noc
            - const: ip0
            - const: ip1

  - if:
      properties:
        compatible:
          contains:
            const: samsung,exynos2200-cmu-peris

    then:
      properties:
        clocks:
          items:
            - description: External reference clock (25.6 MHz)
            - description: CMU_PERIS NOC clock (from CMU_TOP)
            - description: CMU_PERIS GIC clock (from CMU_TOP)

        clock-names:
          items:
            - const: tcxo_div3
            - const: noc
            - const: gic

  - if:
      properties:
        compatible:
          contains:
            const: samsung,exynos2200-cmu-top

    then:
      properties:
        clocks:
          items:
            - description: External reference clock (76.8 MHz)

        clock-names:
          items:
            - const: oscclk

  - if:
      properties:
        compatible:
          contains:
            const: samsung,exynos2200-cmu-ufs

    then:
      properties:
        clocks:
          items:
            - description: External reference clock (76.8 MHz)
            - description: CMU_UFS NOC clock (from CMU_TOP)
            - description: CMU_UFS MMC clock (from CMU_TOP)
            - description: CMU_UFS UFS clock (from CMU_TOP)

        clock-names:
          items:
            - const: oscclk
            - const: noc
            - const: mmc
            - const: ufs

  - if:
      properties:
        compatible:
          contains:
            const: samsung,exynos2200-cmu-vts

    then:
      properties:
        clocks:
          items:
            - description: External reference clock (76.8 MHz)
            - description: CMU_VTS DMIC clock (from CMU_TOP)

        clock-names:
          items:
            - const: oscclk
            - const: dmic

additionalProperties: false

examples:
  - |
    #include <dt-bindings/clock/samsung,exynos2200-cmu.h>

    cmu_vts: clock-controller@15300000 {
        compatible = "samsung,exynos2200-cmu-vts";
        reg = <0x15300000 0x8000>;
        #clock-cells = <1>;

        clocks = <&oscclk>,
                 <&cmu_top CLK_DOUT_CMU_VTS_DMIC>;
        clock-names = "oscclk", "dmic";
    };

...
```

## Documentation/devicetree/bindings/clock/samsung,exynos4412-isp-clock.yaml
```yaml
# SPDX-License-Identifier: (GPL-2.0-only OR BSD-2-Clause)
%YAML 1.2
---
$id: http://devicetree.org/schemas/clock/samsung,exynos4412-isp-clock.yaml#
$schema: http://devicetree.org/meta-schemas/core.yaml#

title: Samsung Exynos4412 SoC ISP clock controller

maintainers:
  - Chanwoo Choi <cw00.choi@samsung.com>
  - Krzysztof Kozlowski <krzk@kernel.org>
  - Sylwester Nawrocki <s.nawrocki@samsung.com>
  - Tomasz Figa <tomasz.figa@gmail.com>

description: |
  Clock controller for Samsung Exynos4412 SoC FIMC-ISP (Camera ISP)
  All available clocks are defined as preprocessor macros in
  dt-bindings/clock/ headers.

properties:
  compatible:
    const: samsung,exynos4412-isp-clock

  clocks:
    items:
      - description: CLK_ACLK200 from the main clock controller
      - description: CLK_ACLK400_MCUISP from the main clock controller

  clock-names:
    items:
      - const: aclk200
      - const: aclk400_mcuisp

  "#clock-cells":
    const: 1

  power-domains:
    maxItems: 1

  reg:
    maxItems: 1

required:
  - compatible
  - "#clock-cells"
  - clocks
  - clock-names
  - power-domains
  - reg

additionalProperties: false

examples:
  - |
    #include <dt-bindings/clock/exynos4.h>
    clock-controller@10048000 {
        compatible = "samsung,exynos4412-isp-clock";
        reg = <0x10048000 0x1000>;
        #clock-cells = <1>;
        power-domains = <&pd_isp>;
        clocks = <&clock CLK_ACLK200>, <&clock CLK_ACLK400_MCUISP>;
        clock-names = "aclk200", "aclk400_mcuisp";
    };
```
