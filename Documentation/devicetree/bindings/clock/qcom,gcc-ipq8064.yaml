## Documentation/devicetree/bindings/clock/qcom,gcc-msm8996.yaml
```yaml
# SPDX-License-Identifier: GPL-2.0-only
%YAML 1.2
---
$id: http://devicetree.org/schemas/clock/qcom,gcc-msm8996.yaml#
$schema: http://devicetree.org/meta-schemas/core.yaml#

title: Qualcomm Global Clock & Reset Controller on MSM8996

maintainers:
  - Stephen Boyd <sboyd@kernel.org>
  - Taniya Das <quic_tdas@quicinc.com>

description: |
  Qualcomm global clock control module which provides the clocks, resets and
  power domains on MSM8996.

  See also:: include/dt-bindings/clock/qcom,gcc-msm8996.h

properties:
  compatible:
    const: qcom,gcc-msm8996

  clocks:
    minItems: 3
    items:
      - description: XO source
      - description: Second XO source
      - description: Sleep clock source
      - description: PCIe 0 PIPE clock (optional)
      - description: PCIe 1 PIPE clock (optional)
      - description: PCIe 2 PIPE clock (optional)
      - description: USB3 PIPE clock (optional)
      - description: UFS RX symbol 0 clock (optional)
      - description: UFS RX symbol 1 clock (optional)
      - description: UFS TX symbol 0 clock (optional)

  clock-names:
    minItems: 3
    items:
      - const: cxo
      - const: cxo2
      - const: sleep_clk
      - const: pcie_0_pipe_clk_src
      - const: pcie_1_pipe_clk_src
      - const: pcie_2_pipe_clk_src
      - const: usb3_phy_pipe_clk_src
      - const: ufs_rx_symbol_0_clk_src
      - const: ufs_rx_symbol_1_clk_src
      - const: ufs_tx_symbol_0_clk_src

required:
  - compatible

allOf:
  - $ref: qcom,gcc.yaml#

unevaluatedProperties: false

examples:
  - |
    clock-controller@300000 {
      compatible = "qcom,gcc-msm8996";
      #clock-cells = <1>;
      #reset-cells = <1>;
      #power-domain-cells = <1>;
      reg = <0x300000 0x90000>;
    };
...
```

## Documentation/devicetree/bindings/clock/qcom,gcc-msm8998.yaml
```yaml
# SPDX-License-Identifier: GPL-2.0-only
%YAML 1.2
---
$id: http://devicetree.org/schemas/clock/qcom,gcc-msm8998.yaml#
$schema: http://devicetree.org/meta-schemas/core.yaml#

title: Qualcomm Global Clock & Reset Controller on MSM8998

maintainers:
  - Stephen Boyd <sboyd@kernel.org>
  - Taniya Das <quic_tdas@quicinc.com>

description: |
  Qualcomm global clock control module provides the clocks, resets and power
  domains on MSM8998.

  See also:: include/dt-bindings/clock/qcom,gcc-msm8998.h

properties:
  compatible:
    const: qcom,gcc-msm8998

  clocks:
    items:
      - description: Board XO source
      - description: Sleep clock source
      - description: Audio reference clock (Optional clock)
    minItems: 2

  clock-names:
    items:
      - const: xo
      - const: sleep_clk
      - const: aud_ref_clk # Optional clock
    minItems: 2

required:
  - compatible
  - clocks
  - clock-names

allOf:
  - $ref: qcom,gcc.yaml#

unevaluatedProperties: false

examples:
  - |
    #include <dt-bindings/clock/qcom,rpmcc.h>
    clock-controller@100000 {
      compatible = "qcom,gcc-msm8998";
      #clock-cells = <1>;
      #reset-cells = <1>;
      #power-domain-cells = <1>;
      reg = <0x00100000 0xb0000>;
      clocks = <&rpmcc RPM_SMD_XO_CLK_SRC>,
               <&sleep>,
               <0>;
      clock-names = "xo",
                    "sleep_clk",
                    "aud_ref_clk";
    };
...
```

## Documentation/devicetree/bindings/clock/qcom,gcc-other.yaml
```yaml
# SPDX-License-Identifier: GPL-2.0-only
%YAML 1.2
---
$id: http://devicetree.org/schemas/clock/qcom,gcc-other.yaml#
$schema: http://devicetree.org/meta-schemas/core.yaml#

title: Qualcomm Global Clock & Reset Controller

maintainers:
  - Stephen Boyd <sboyd@kernel.org>
  - Taniya Das <quic_tdas@quicinc.com>

description: |
  Qualcomm global clock control module provides the clocks, resets and power
  domains.

  See also::
    include/dt-bindings/clock/qcom,gcc-ipq6018.h
    include/dt-bindings/reset/qcom,gcc-ipq6018.h
    include/dt-bindings/clock/qcom,gcc-msm8953.h
    include/dt-bindings/clock/qcom,gcc-mdm9607.h

allOf:
  - $ref: qcom,gcc.yaml#

properties:
  compatible:
    enum:
      - qcom,gcc-ipq6018
      - qcom,gcc-mdm9607

required:
  - compatible

unevaluatedProperties: false

examples:
  - |
    clock-controller@900000 {
      compatible = "qcom,gcc-mdm9607";
      reg = <0x900000 0x4000>;
      #clock-cells = <1>;
      #reset-cells = <1>;
      #power-domain-cells = <1>;
    };
...
```

## Documentation/devicetree/bindings/clock/qcom,gcc-qcm2290.yaml
```yaml
# SPDX-License-Identifier: (GPL-2.0-only OR BSD-2-Clause)
%YAML 1.2
---
$id: http://devicetree.org/schemas/clock/qcom,gcc-qcm2290.yaml#
$schema: http://devicetree.org/meta-schemas/core.yaml#

title: Qualcomm Global Clock & Reset Controller Binding for QCM2290

maintainers:
  - Shawn Guo <shawn.guo@linaro.org>

description: |
  Qualcomm global clock control module which supports the clocks, resets
  and power domains on QCM2290.

  See also:
  - dt-bindings/clock/qcom,gcc-qcm2290.h

properties:
  compatible:
    const: qcom,gcc-qcm2290

  clocks:
    items:
      - description: Board XO source
      - description: Sleep clock source

  clock-names:
    items:
      - const: bi_tcxo
      - const: sleep_clk

  '#clock-cells':
    const: 1

  '#reset-cells':
    const: 1

  '#power-domain-cells':
    const: 1

  reg:
    maxItems: 1

  protected-clocks:
    description:
      Protected clock specifier list as per common clock binding.

required:
  - compatible
  - clocks
  - clock-names
  - reg
  - '#clock-cells'
  - '#reset-cells'
  - '#power-domain-cells'

additionalProperties: false

examples:
  - |
    #include <dt-bindings/clock/qcom,rpmcc.h>
    clock-controller@1400000 {
        compatible = "qcom,gcc-qcm2290";
        reg = <0x01400000 0x1f0000>;
        #clock-cells = <1>;
        #reset-cells = <1>;
        #power-domain-cells = <1>;
        clock-names = "bi_tcxo", "sleep_clk";
        clocks = <&rpmcc RPM_SMD_XO_CLK_SRC>, <&sleep_clk>;
    };
...
```

## Documentation/devicetree/bindings/clock/qcom,gcc-qcs404.yaml
```yaml
# SPDX-License-Identifier: GPL-2.0-only
%YAML 1.2
---
$id: http://devicetree.org/schemas/clock/qcom,gcc-qcs404.yaml#
$schema: http://devicetree.org/meta-schemas/core.yaml#

title: Qualcomm Global Clock & Reset Controller on QCS404

maintainers:
  - Stephen Boyd <sboyd@kernel.org>
  - Taniya Das <quic_tdas@quicinc.com>

description: |
  Qualcomm global clock control module provides the clocks, resets and power
  domains on QCS404.

  See also:: include/dt-bindings/clock/qcom,gcc-qcs404.h

properties:
  compatible:
    const: qcom,gcc-qcs404

  clocks:
    items:
      - description: XO source
      - description: Sleep clock source
      - description: PCIe 0 PIPE clock (optional)
      - description: DSI phy instance 0 dsi clock
      - description: DSI phy instance 0 byte clock
      - description: HDMI phy PLL clock

  clock-names:
    items:
      - const: cxo
      - const: sleep_clk
      - const: pcie_0_pipe_clk_src
      - const: dsi0pll
      - const: dsi0pllbyte
      - const: hdmi_pll

required:
  - compatible
  - '#power-domain-cells'

allOf:
  - $ref: qcom,gcc.yaml#

unevaluatedProperties: false

examples:
  - |
    clock-controller@1800000 {
      compatible = "qcom,gcc-qcs404";
      reg = <0x01800000 0x80000>;
      #clock-cells = <1>;
      #reset-cells = <1>;
      #power-domain-cells = <1>;
    };
...
```

## Documentation/devicetree/bindings/clock/qcom,gcc-sc7180.yaml
```yaml
# SPDX-License-Identifier: GPL-2.0-only
%YAML 1.2
---
$id: http://devicetree.org/schemas/clock/qcom,gcc-sc7180.yaml#
$schema: http://devicetree.org/meta-schemas/core.yaml#

title: Qualcomm Global Clock & Reset Controller Binding for SC7180

maintainers:
  - Stephen Boyd <sboyd@kernel.org>
  - Taniya Das <tdas@codeaurora.org>

description: |
  Qualcomm global clock control module which supports the clocks, resets and
  power domains on SC7180.

  See also:
  - dt-bindings/clock/qcom,gcc-sc7180.h

properties:
  compatible:
    const: qcom,gcc-sc7180

  clocks:
    items:
      - description: Board XO source
      - description: Board active XO source
      - description: Sleep clock source

  clock-names:
    items:
      - const: bi_tcxo
      - const: bi_tcxo_ao
      - const: sleep_clk

  '#clock-cells':
    const: 1

  '#reset-cells':
    const: 1

  '#power-domain-cells':
    const: 1

  reg:
    maxItems: 1

  protected-clocks:
    description:
      Protected clock specifier list as per common clock binding.

required:
  - compatible
  - clocks
  - clock-names
  - reg
  - '#clock-cells'
  - '#reset-cells'
  - '#power-domain-cells'

additionalProperties: false

examples:
  - |
    #include <dt-bindings/clock/qcom,rpmh.h>
    clock-controller@100000 {
      compatible = "qcom,gcc-sc7180";
      reg = <0x00100000 0x1f0000>;
      clocks = <&rpmhcc RPMH_CXO_CLK>,
               <&rpmhcc RPMH_CXO_CLK_A>,
               <&sleep_clk>;
      clock-names = "bi_tcxo", "bi_tcxo_ao", "sleep_clk";
      #clock-cells = <1>;
      #reset-cells = <1>;
      #power-domain-cells = <1>;
    };
...
```

## Documentation/devicetree/bindings/clock/qcom,gcc-sc7280.yaml
```yaml
# SPDX-License-Identifier: (GPL-2.0-only OR BSD-2-Clause)
%YAML 1.2
---
$id: http://devicetree.org/schemas/clock/qcom,gcc-sc7280.yaml#
$schema: http://devicetree.org/meta-schemas/core.yaml#

title: Qualcomm Global Clock & Reset Controller on SC7280

maintainers:
  - Taniya Das <tdas@codeaurora.org>

description: |
  Qualcomm global clock control module provides the clocks, resets and power
  domains on SC7280.

  See also:: include/dt-bindings/clock/qcom,gcc-sc7280.h

properties:
  compatible:
    const: qcom,gcc-sc7280

  clocks:
    items:
      - description: Board XO source
      - description: Board active XO source
      - description: Sleep clock source
      - description: PCIE-0 pipe clock source
      - description: PCIE-1 pipe clock source
      - description: USF phy rx symbol 0 clock source
      - description: USF phy rx symbol 1 clock source
      - description: USF phy tx symbol 0 clock source
      - description: USB30 phy wrapper pipe clock source

  clock-names:
    items:
      - const: bi_tcxo
      - const: bi_tcxo_ao
      - const: sleep_clk
      - const: pcie_0_pipe_clk
      - const: pcie_1_pipe_clk
      - const: ufs_phy_rx_symbol_0_clk
      - const: ufs_phy_rx_symbol_1_clk
      - const: ufs_phy_tx_symbol_0_clk
      - const: usb3_phy_wrapper_gcc_usb30_pipe_clk

  power-domains:
    items:
      - description: CX domain

required:
  - compatible
  - clocks
  - clock-names

allOf:
  - $ref: qcom,gcc.yaml#

unevaluatedProperties: false

examples:
  - |
    #include <dt-bindings/clock/qcom,rpmh.h>
    #include <dt-bindings/power/qcom-rpmpd.h>

    clock-controller@100000 {
      compatible = "qcom,gcc-sc7280";
      reg = <0x00100000 0x1f0000>;
      clocks = <&rpmhcc RPMH_CXO_CLK>,
               <&rpmhcc RPMH_CXO_CLK_A>,
               <&sleep_clk>,
               <&pcie_0_pipe_clk>, <&pcie_1_pipe_clk>,
               <&ufs_phy_rx_symbol_0_clk>, <&ufs_phy_rx_symbol_1_clk>,
               <&ufs_phy_tx_symbol_0_clk>,
               <&usb3_phy_wrapper_gcc_usb30_pipe_clk>;

      clock-names = "bi_tcxo", "bi_tcxo_ao", "sleep_clk", "pcie_0_pipe_clk",
                     "pcie_1_pipe_clk", "ufs_phy_rx_symbol_0_clk",
                     "ufs_phy_rx_symbol_1_clk", "ufs_phy_tx_symbol_0_clk",
                     "usb3_phy_wrapper_gcc_usb30_pipe_clk";
      power-domains = <&rpmhpd SC7280_CX>;
      #clock-cells = <1>;
      #reset-cells = <1>;
      #power-domain-cells = <1>;
    };
...
```

## Documentation/devicetree/bindings/clock/qcom,gcc-sc8180x.yaml
```yaml
# SPDX-License-Identifier: (GPL-2.0-only OR BSD-2-Clause)
%YAML 1.2
---
$id: http://devicetree.org/schemas/clock/qcom,gcc-sc8180x.yaml#
$schema: http://devicetree.org/meta-schemas/core.yaml#

title: Qualcomm Global Clock & Reset Controller on SC8180x

maintainers:
  - Bjorn Andersson <bjorn.andersson@linaro.org>

description: |
  Qualcomm global clock control module provides the clocks, resets and power
  domains on SC8180x.

  See also:: include/dt-bindings/clock/qcom,gcc-sc8180x.h

properties:
  compatible:
    const: qcom,gcc-sc8180x

  clocks:
    items:
      - description: Board XO source
      - description: Board active XO source
      - description: Sleep clock source

  clock-names:
    items:
      - const: bi_tcxo
      - const: bi_tcxo_ao
      - const: sleep_clk

  power-domains:
    items:
      - description: CX domain

required:
  - compatible
  - clocks
  - clock-names
  - power-domains

allOf:
  - $ref: qcom,gcc.yaml#

unevaluatedProperties: false

examples:
  - |
    #include <dt-bindings/clock/qcom,rpmh.h>
    #include <dt-bindings/power/qcom-rpmpd.h>
    clock-controller@100000 {
      compatible = "qcom,gcc-sc8180x";
      reg = <0x00100000 0x1f0000>;
      clocks = <&rpmhcc RPMH_CXO_CLK>,
               <&rpmhcc RPMH_CXO_CLK_A>,
               <&sleep_clk>;
      clock-names = "bi_tcxo", "bi_tcxo_ao", "sleep_clk";
      power-domains = <&rpmhpd SC8180X_CX>;
      #clock-cells = <1>;
      #reset-cells = <1>;
      #power-domain-cells = <1>;
    };
...
```
