## Documentation/devicetree/bindings/clock/qcom,gcc-ipq8064.yaml
```yaml
# SPDX-License-Identifier: GPL-2.0-only OR BSD-2-Clause
%YAML 1.2
---
$id: http://devicetree.org/schemas/clock/qcom,gcc-ipq8064.yaml#
$schema: http://devicetree.org/meta-schemas/core.yaml#

title: Qualcomm Global Clock & Reset Controller Binding for IPQ8064

allOf:
  - $ref: qcom,gcc.yaml#

maintainers:
  - Ansuel Smith <ansuelsmth@gmail.com>

description: |
  Qualcomm global clock control module which supports the clocks, resets and
  power domains on IPQ8064.

  See also:
  - dt-bindings/clock/qcom,gcc-ipq806x.h (qcom,gcc-ipq8064)
  - dt-bindings/reset/qcom,gcc-ipq806x.h (qcom,gcc-ipq8064)

properties:
  compatible:
    items:
      - const: qcom,gcc-ipq8064
      - const: syscon

  clocks:
    items:
      - description: PXO source
      - description: CXO source

  clock-names:
    items:
      - const: pxo
      - const: cxo

  thermal-sensor:
    type: object

    allOf:
      - $ref: /schemas/thermal/qcom-tsens.yaml#

required:
  - compatible
  - clocks
  - clock-names

unevaluatedProperties: false

examples:
  - |
    #include <dt-bindings/interrupt-controller/arm-gic.h>

    gcc: clock-controller@900000 {
      compatible = "qcom,gcc-ipq8064", "syscon";
      reg = <0x00900000 0x4000>;
      clocks = <&pxo_board>, <&cxo_board>;
      clock-names = "pxo", "cxo";
      #clock-cells = <1>;
      #reset-cells = <1>;
      #power-domain-cells = <1>;

      tsens: thermal-sensor {
        compatible = "qcom,ipq8064-tsens";

        nvmem-cells = <&tsens_calib>, <&tsens_calib_backup>;
        nvmem-cell-names = "calib", "calib_backup";
        interrupts = <GIC_SPI 178 IRQ_TYPE_LEVEL_HIGH>;
        interrupt-names = "uplow";

        #qcom,sensors = <11>;
        #thermal-sensor-cells = <1>;
      };
    };
```

## Documentation/devicetree/bindings/clock/qcom,gcc-ipq8074.yaml
```yaml
# SPDX-License-Identifier: GPL-2.0-only
%YAML 1.2
---
$id: http://devicetree.org/schemas/clock/qcom,gcc-ipq8074.yaml#
$schema: http://devicetree.org/meta-schemas/core.yaml#

title: Qualcomm Global Clock & Reset Controller on IPQ8074

maintainers:
  - Stephen Boyd <sboyd@kernel.org>
  - Taniya Das <quic_tdas@quicinc.com>

description: |
  Qualcomm global clock control module provides the clocks, resets and power
  domains on IPQ8074.

  See also:: include/dt-bindings/clock/qcom,gcc-ipq8074.h

allOf:
  - $ref: qcom,gcc.yaml#

properties:
  compatible:
    const: qcom,gcc-ipq8074

  clocks:
    items:
      - description: board XO clock
      - description: sleep clock
      - description: Gen3 QMP PCIe PHY PIPE clock
      - description: Gen2 QMP PCIe PHY PIPE clock

  clock-names:
    items:
      - const: xo
      - const: sleep_clk
      - const: pcie0_pipe
      - const: pcie1_pipe

required:
  - compatible

unevaluatedProperties: false

examples:
  - |
    clock-controller@1800000 {
      compatible = "qcom,gcc-ipq8074";
      reg = <0x01800000 0x80000>;
      #clock-cells = <1>;
      #power-domain-cells = <1>;
      #reset-cells = <1>;
    };
...
```

## Documentation/devicetree/bindings/clock/qcom,gcc-mdm9615.yaml
```yaml
# SPDX-License-Identifier: GPL-2.0-only
%YAML 1.2
---
$id: http://devicetree.org/schemas/clock/qcom,gcc-mdm9615.yaml#
$schema: http://devicetree.org/meta-schemas/core.yaml#

title: Qualcomm Global Clock & Reset Controller

maintainers:
  - Stephen Boyd <sboyd@kernel.org>
  - Taniya Das <quic_tdas@quicinc.com>

description: |
  Qualcomm global clock control module provides the clocks, resets and power
  domains.

  See also::
    include/dt-bindings/clock/qcom,gcc-mdm9615.h

allOf:
  - $ref: qcom,gcc.yaml#

properties:
  compatible:
    enum:
      - qcom,gcc-mdm9615

  clocks:
    items:
      - description: CXO clock
      - description: PLL4 from LLC

  '#power-domain-cells': false

required:
  - compatible

unevaluatedProperties: false

examples:
  - |
    clock-controller@900000 {
      compatible = "qcom,gcc-mdm9615";
      reg = <0x900000 0x4000>;
      #clock-cells = <1>;
      #reset-cells = <1>;
      clocks = <&cxo_board>,
               <&lcc_pll4>;
    };
...
```

## Documentation/devicetree/bindings/clock/qcom,gcc-msm8660.yaml
```yaml
# SPDX-License-Identifier: GPL-2.0-only
%YAML 1.2
---
$id: http://devicetree.org/schemas/clock/qcom,gcc-msm8660.yaml#
$schema: http://devicetree.org/meta-schemas/core.yaml#

title: Qualcomm Global Clock & Reset Controller on MSM8660

maintainers:
  - Stephen Boyd <sboyd@kernel.org>
  - Taniya Das <quic_tdas@quicinc.com>

description: |
  Qualcomm global clock control module provides the clocks and resets on
  MSM8660

  See also::
    include/dt-bindings/clock/qcom,gcc-msm8660.h
    include/dt-bindings/reset/qcom,gcc-msm8660.h

allOf:
  - $ref: qcom,gcc.yaml#

properties:
  compatible:
    enum:
      - qcom,gcc-msm8660

  clocks:
    maxItems: 2

  clock-names:
    items:
      - const: pxo
      - const: cxo

required:
  - compatible

unevaluatedProperties: false

examples:
  # Example for GCC for MSM8974:
  - |
    clock-controller@900000 {
      compatible = "qcom,gcc-msm8660";
      reg = <0x900000 0x4000>;
      #clock-cells = <1>;
      #reset-cells = <1>;
      #power-domain-cells = <1>;
      clocks = <&pxo_board>, <&cxo_board>;
      clock-names = "pxo", "cxo";
    };
...
```

## Documentation/devicetree/bindings/clock/qcom,gcc-msm8909.yaml
```yaml
# SPDX-License-Identifier: (GPL-2.0-only OR BSD-2-Clause)
%YAML 1.2
---
$id: http://devicetree.org/schemas/clock/qcom,gcc-msm8909.yaml#
$schema: http://devicetree.org/meta-schemas/core.yaml#

title: Qualcomm Global Clock & Reset Controller Binding for MSM8909

maintainers:
  - Stephan Gerhold <stephan@gerhold.net>

description: |
  Qualcomm global clock control module which supports the clocks, resets and
  power domains on MSM8909.

  See also:
  - dt-bindings/clock/qcom,gcc-msm8909.h

properties:
  compatible:
    const: qcom,gcc-msm8909

  clocks:
    items:
      - description: XO source
      - description: Sleep clock source
      - description: DSI phy instance 0 dsi clock
      - description: DSI phy instance 0 byte clock

  clock-names:
    items:
      - const: xo
      - const: sleep_clk
      - const: dsi0pll
      - const: dsi0pllbyte

required:
  - compatible
  - clocks
  - clock-names

allOf:
  - $ref: qcom,gcc.yaml#

unevaluatedProperties: false

examples:
  - |
    gcc: clock-controller@1800000 {
      compatible = "qcom,gcc-msm8909";
      reg = <0x01800000 0x80000>;
      #clock-cells = <1>;
      #reset-cells = <1>;
      #power-domain-cells = <1>;
      clocks = <&xo_board>, <&sleep_clk>, <&dsi0_phy 1>, <&dsi0_phy 0>;
      clock-names = "xo", "sleep_clk", "dsi0pll", "dsi0pllbyte";
    };
...
```

## Documentation/devicetree/bindings/clock/qcom,gcc-msm8916.yaml
```yaml
# SPDX-License-Identifier: GPL-2.0-only
%YAML 1.2
---
$id: http://devicetree.org/schemas/clock/qcom,gcc-msm8916.yaml#
$schema: http://devicetree.org/meta-schemas/core.yaml#

title: Qualcomm Global Clock & Reset Controller on MSM8916 and MSM8939

maintainers:
  - Stephen Boyd <sboyd@kernel.org>
  - Taniya Das <quic_tdas@quicinc.com>

description: |
  Qualcomm global clock control module provides the clocks, resets and power
  domains on MSM8916 or MSM8939.

  See also::
    include/dt-bindings/clock/qcom,gcc-msm8916.h
    include/dt-bindings/clock/qcom,gcc-msm8939.h
    include/dt-bindings/reset/qcom,gcc-msm8916.h
    include/dt-bindings/reset/qcom,gcc-msm8939.h

properties:
  compatible:
    enum:
      - qcom,gcc-msm8916
      - qcom,gcc-msm8939

  clocks:
    items:
      - description: XO source
      - description: Sleep clock source
      - description: DSI phy instance 0 dsi clock
      - description: DSI phy instance 0 byte clock
      - description: External MCLK clock
      - description: External Primary I2S clock
      - description: External Secondary I2S clock

  clock-names:
    items:
      - const: xo
      - const: sleep_clk
      - const: dsi0pll
      - const: dsi0pllbyte
      - const: ext_mclk
      - const: ext_pri_i2s
      - const: ext_sec_i2s

required:
  - compatible

allOf:
  - $ref: qcom,gcc.yaml#

unevaluatedProperties: false

examples:
  - |
    clock-controller@300000 {
      compatible = "qcom,gcc-msm8916";
      #clock-cells = <1>;
      #reset-cells = <1>;
      #power-domain-cells = <1>;
      reg = <0x300000 0x90000>;
    };
...
```

## Documentation/devicetree/bindings/clock/qcom,gcc-msm8953.yaml
```yaml
# SPDX-License-Identifier: (GPL-2.0-only OR BSD-2-Clause)
%YAML 1.2
---
$id: http://devicetree.org/schemas/clock/qcom,gcc-msm8953.yaml#
$schema: http://devicetree.org/meta-schemas/core.yaml#

title: Qualcomm Global Clock & Reset Controller on MSM8953

maintainers:
  - Adam Skladowski <a_skl39@protonmail.com>
  - Sireesh Kodali <sireeshkodali@protonmail.com>

description: |
  Qualcomm global clock control module provides the clocks, resets and power
  domains on MSM8953.

  See also: include/dt-bindings/clock/qcom,gcc-msm8953.h

properties:
  compatible:
    const: qcom,gcc-msm8953

  clocks:
    items:
      - description: Board XO source
      - description: Sleep clock source
      - description: Byte clock from DSI PHY0
      - description: Pixel clock from DSI PHY0
      - description: Byte clock from DSI PHY1
      - description: Pixel clock from DSI PHY1

  clock-names:
    items:
      - const: xo
      - const: sleep
      - const: dsi0pll
      - const: dsi0pllbyte
      - const: dsi1pll
      - const: dsi1pllbyte

required:
  - compatible
  - clocks
  - clock-names
  - '#power-domain-cells'

allOf:
  - $ref: qcom,gcc.yaml#

unevaluatedProperties: false

examples:
  - |
    #include <dt-bindings/clock/qcom,rpmcc.h>

    clock-controller@1800000 {
        compatible = "qcom,gcc-msm8953";
        reg = <0x01800000 0x80000>;
        clocks = <&rpmcc RPM_SMD_XO_CLK_SRC>,
                 <&sleep_clk>,
                 <&dsi0_phy 1>,
                 <&dsi0_phy 0>,
                 <&dsi1_phy 1>,
                 <&dsi1_phy 0>;
        clock-names = "xo",
                      "sleep",
                      "dsi0pll",
                      "dsi0pllbyte",
                      "dsi1pll",
                      "dsi1pllbyte";
        #clock-cells = <1>;
        #reset-cells = <1>;
        #power-domain-cells = <1>;
    };
```

## Documentation/devicetree/bindings/clock/qcom,gcc-msm8974.yaml
```yaml
# SPDX-License-Identifier: (GPL-2.0-only OR BSD-2-Clause)
%YAML 1.2
---
$id: http://devicetree.org/schemas/clock/qcom,gcc-msm8974.yaml#
$schema: http://devicetree.org/meta-schemas/core.yaml#

title: Qualcomm Global Clock & Reset Controller on MSM8974 (including Pro) and MSM8226
  Controller

maintainers:
  - Stephen Boyd <sboyd@kernel.org>
  - Taniya Das <quic_tdas@quicinc.com>

description: |
  Qualcomm global clock control module provides the clocks, resets and power
  domains on MSM8974 (all variants) and MSM8226.

  See also::
    include/dt-bindings/clock/qcom,gcc-msm8974.h (qcom,gcc-msm8226 and qcom,gcc-msm8974)
    include/dt-bindings/reset/qcom,gcc-msm8974.h (qcom,gcc-msm8226 and qcom,gcc-msm8974)

$ref: qcom,gcc.yaml#

properties:
  compatible:
    enum:
      - qcom,gcc-msm8226
      - qcom,gcc-msm8974
      - qcom,gcc-msm8974pro
      - qcom,gcc-msm8974pro-ac

  clocks:
    items:
      - description: XO source
      - description: Sleep clock source

  clock-names:
    items:
      - const: xo
      - const: sleep_clk

required:
  - compatible

unevaluatedProperties: false

examples:
  - |
    #include <dt-bindings/clock/qcom,rpmh.h>
    clock-controller@fc400000 {
        compatible = "qcom,gcc-msm8974";
        reg = <0x00100000 0x94000>;
        #clock-cells = <1>;
        #reset-cells = <1>;
        #power-domain-cells = <1>;

        clock-names = "xo", "sleep_clk";
        clocks = <&xo_board>,
                 <&sleep_clk>;
    };
...
```

## Documentation/devicetree/bindings/clock/qcom,gcc-msm8976.yaml
```yaml
# SPDX-License-Identifier: (GPL-2.0-only OR BSD-2-Clause)
%YAML 1.2
---
$id: http://devicetree.org/schemas/clock/qcom,gcc-msm8976.yaml#
$schema: http://devicetree.org/meta-schemas/core.yaml#

title: Qualcomm Global Clock & Reset Controller Binding for MSM8976

maintainers:
  - Stephen Boyd <sboyd@kernel.org>
  - Taniya Das <tdas@codeaurora.org>

description: |
  Qualcomm global clock control module which supports the clocks, resets and
  power domains on MSM8976.

  See also:
  - dt-bindings/clock/qcom,gcc-msm8976.h

properties:
  compatible:
    enum:
      - qcom,gcc-msm8976
      - qcom,gcc-msm8976-v1.1

  clocks:
    items:
      - description: XO source
      - description: Always-on XO source
      - description: Pixel clock from DSI PHY0
      - description: Byte clock from DSI PHY0
      - description: Pixel clock from DSI PHY1
      - description: Byte clock from DSI PHY1

  clock-names:
    items:
      - const: xo
      - const: xo_a
      - const: dsi0pll
      - const: dsi0pllbyte
      - const: dsi1pll
      - const: dsi1pllbyte

  vdd_gfx-supply:
    description:
      Phandle to voltage regulator providing power to the GX domain.

required:
  - compatible
  - clocks
  - clock-names
  - vdd_gfx-supply

allOf:
  - $ref: qcom,gcc.yaml#

unevaluatedProperties: false

examples:
  - |
    clock-controller@1800000 {
      compatible = "qcom,gcc-msm8976";
      #clock-cells = <1>;
      #reset-cells = <1>;
      #power-domain-cells = <1>;
      reg = <0x1800000 0x80000>;

      clocks = <&xo_board>,
               <&xo_board>,
               <&dsi0_phy 1>,
               <&dsi0_phy 0>,
               <&dsi1_phy 1>,
               <&dsi1_phy 0>;

      clock-names = "xo",
                    "xo_a",
                    "dsi0pll",
                    "dsi0pllbyte",
                    "dsi1pll",
                    "dsi1pllbyte";

      vdd_gfx-supply = <&pm8004_s5>;
    };
...
```

## Documentation/devicetree/bindings/clock/qcom,gcc-msm8994.yaml
```yaml
# SPDX-License-Identifier: (GPL-2.0-only OR BSD-2-Clause)
%YAML 1.2
---
$id: http://devicetree.org/schemas/clock/qcom,gcc-msm8994.yaml#
$schema: http://devicetree.org/meta-schemas/core.yaml#

title: Qualcomm Global Clock & Reset Controller on MSM8994

maintainers:
  - Konrad Dybcio <konradybcio@kernel.org>

description: |
  Qualcomm global clock control module provides the clocks, resets and power
  domains on MSM8994 and MSM8992.

  See also:: include/dt-bindings/clock/qcom,gcc-msm8994.h

properties:
  compatible:
    enum:
      - qcom,gcc-msm8992
      - qcom,gcc-msm8994

  clocks:
    items:
      - description: Board XO source
      - description: Sleep clock source

  clock-names:
    items:
      - const: xo
      - const: sleep

required:
  - compatible
  - clocks
  - clock-names
  - '#power-domain-cells'

allOf:
  - $ref: qcom,gcc.yaml#

unevaluatedProperties: false

examples:
  - |
    clock-controller@300000 {
      compatible = "qcom,gcc-msm8994";
      reg = <0x00300000 0x90000>;
      clocks = <&xo_board>, <&sleep_clk>;
      clock-names = "xo", "sleep";
      #clock-cells = <1>;
      #reset-cells = <1>;
      #power-domain-cells = <1>;
    };

...
```
