## Documentation/devicetree/bindings/clock/brcm,bcm2835-aux-clock.yaml
```yaml
# SPDX-License-Identifier: (GPL-2.0-only OR BSD-2-Clause)
%YAML 1.2
---
$id: http://devicetree.org/schemas/clock/brcm,bcm2835-aux-clock.yaml#
$schema: http://devicetree.org/meta-schemas/core.yaml#

title: Broadcom BCM2835 auxiliary peripheral clock

maintainers:
  - Stefan Wahren <wahrenst@gmx.net>
  - Raspberry Pi Kernel Maintenance <kernel-list@raspberrypi.com>

description:
  The auxiliary peripherals (UART, SPI1, and SPI2) have a small register
  area controlling clock gating to the peripherals, and providing an IRQ
  status register.

properties:
  compatible:
    const: brcm,bcm2835-aux

  reg:
    maxItems: 1

  "#clock-cells":
    const: 1

  clocks:
    maxItems: 1

required:
  - compatible
  - reg
  - "#clock-cells"
  - clocks

additionalProperties: false

examples:
  - |
    #include <dt-bindings/clock/bcm2835.h>
    clock@7e215000 {
        compatible = "brcm,bcm2835-aux";
        reg = <0x7e215000 0x8>;
        #clock-cells = <1>;
        clocks = <&clocks BCM2835_CLOCK_VPU>;
    };
```

## Documentation/devicetree/bindings/clock/brcm,bcm2835-cprman.txt
```
Broadcom BCM2835 CPRMAN clocks

This binding uses the common clock binding:
    Documentation/devicetree/bindings/clock/clock-bindings.txt

The CPRMAN clock controller generates clocks in the audio power domain
of the BCM2835.  There is a level of PLLs deriving from an external
oscillator, a level of PLL dividers that produce channels off of the
few PLLs, and a level of mostly-generic clock generators sourcing from
the PLL channels.  Most other hardware components source from the
clock generators, but a few (like the ARM or HDMI) will source from
the PLL dividers directly.

Required properties:
- compatible:	Should be "brcm,bcm2835-cprman"
- #clock-cells:	Should be <1>. The permitted clock-specifier values can be
		  found in include/dt-bindings/clock/bcm2835.h
- reg:		Specifies base physical address and size of the registers
- clocks:	The external oscillator clock phandle

Example:

	clk_osc: clock@3 {
		compatible = "fixed-clock";
		reg = <3>;
		#clock-cells = <0>;
		clock-output-names = "osc";
		clock-frequency = <19200000>;
	};

	clocks: cprman@7e101000 {
		compatible = "brcm,bcm2835-cprman";
		#clock-cells = <1>;
		reg = <0x7e101000 0x2000>;
		clocks = <&clk_osc>;
	};

	i2c0: i2c@7e205000 {
		compatible = "brcm,bcm2835-i2c";
		reg = <0x7e205000 0x1000>;
		interrupts = <2 21>;
		clocks = <&clocks BCM2835_CLOCK_VPU>;
		#address-cells = <1>;
		#size-cells = <0>;
	};
```

## Documentation/devicetree/bindings/clock/brcm,bcm2835-cprman.yaml
```yaml
# SPDX-License-Identifier: (GPL-2.0-only OR BSD-2-Clause)
%YAML 1.2
---
$id: http://devicetree.org/schemas/clock/brcm,bcm2835-cprman.yaml#
$schema: http://devicetree.org/meta-schemas/core.yaml#

title: Broadcom BCM2835 CPRMAN clocks

maintainers:
  - Stefan Wahren <wahrenst@gmx.net>
  - Raspberry Pi Kernel Maintenance <kernel-list@raspberrypi.com>

description:
  The CPRMAN clock controller generates clocks in the audio power domain of the
  BCM2835.  There is a level of PLLs deriving from an external oscillator, a
  level of PLL dividers that produce channels off of the few PLLs, and a level
  of mostly-generic clock generators sourcing from the PLL channels.  Most other
  hardware components source from the clock generators, but a few (like the ARM
  or HDMI) will source from the PLL dividers directly.

properties:
  compatible:
    enum:
      - brcm,bcm2711-cprman
      - brcm,bcm2835-cprman

  reg:
    maxItems: 1

  '#clock-cells':
    const: 1

  clocks:
    minItems: 1
    items:
      - description: External oscillator clock.
      - description: DSI0 byte clock.
      - description: DSI0 DDR2 clock.
      - description: DSI0 DDR clock.
      - description: DSI1 byte clock.
      - description: DSI1 DDR2 clock.
      - description: DSI1 DDR clock.

additionalProperties: false

required:
  - compatible
  - '#clock-cells'
  - reg
  - clocks

examples:
  - |
    clock-controller@7e101000 {
        compatible = "brcm,bcm2835-cprman";
        reg = <0x7e101000 0x2000>;
        #clock-cells = <1>;
        clocks = <&clk_osc>;
    };
```

## Documentation/devicetree/bindings/clock/brcm,bcm53573-ilp.txt
```
Broadcom BCM53573 ILP clock
===========================

This binding uses the common clock binding:
    Documentation/devicetree/bindings/clock/clock-bindings.txt

This binding is used for ILP clock (sometimes referred as "slow clock")
on Broadcom BCM53573 devices using Cortex-A7 CPU.

ILP's rate has to be calculated on runtime and it depends on ALP clock
which has to be referenced.

This clock is part of PMU (Power Management Unit), a Broadcom's device
handing power-related aspects. Its node must be sub-node of the PMU
device.

Required properties:
- compatible: "brcm,bcm53573-ilp"
- clocks: has to reference an ALP clock
- #clock-cells: should be <0>
- clock-output-names: from common clock bindings, should contain clock
		      name

Example:

pmu@18012000 {
	compatible = "simple-mfd", "syscon";
	reg = <0x18012000 0x00001000>;

	ilp {
		compatible = "brcm,bcm53573-ilp";
		clocks = <&alp>;
		#clock-cells = <0>;
		clock-output-names = "ilp";
	};
};
```

## Documentation/devicetree/bindings/clock/brcm,bcm53573-ilp.yaml
```yaml
# SPDX-License-Identifier: (GPL-2.0-only OR BSD-2-Clause)
%YAML 1.2
---
$id: http://devicetree.org/schemas/clock/brcm,bcm53573-ilp.yaml#
$schema: http://devicetree.org/meta-schemas/core.yaml#

title: Broadcom BCM53573 ILP clock

maintainers:
  - Rafał Miłecki <rafal@milecki.pl>

description: >
  ILP clock (sometimes referred as "slow clock") on Broadcom BCM53573 devices
  using Cortex-A7 CPU.

  ILP's rate has to be calculated on runtime and it depends on ALP clock which
  has to be referenced.

  This clock is part of PMU (Power Management Unit), a Broadcom device handling
  power-related aspects. Its node must be sub-node of the PMU device.

properties:
  compatible:
    items:
      - const: brcm,bcm53573-ilp

  clocks:
    maxItems: 1

  '#clock-cells':
    const: 0

  clock-output-names:
    items:
      - const: ilp

additionalProperties: false

examples:
  - |
    ilp {
        compatible = "brcm,bcm53573-ilp";
        clocks = <&alp>;
        #clock-cells = <0>;
        clock-output-names = "ilp";
    };
```

## Documentation/devicetree/bindings/clock/brcm,bcm63268-timer-clocks.yaml
```yaml
# SPDX-License-Identifier: (GPL-2.0-only OR BSD-2-Clause)
%YAML 1.2
---
$id: http://devicetree.org/schemas/clock/brcm,bcm63268-timer-clocks.yaml#
$schema: http://devicetree.org/meta-schemas/core.yaml#

title: Broadcom BCM63268 Timer Clock and Reset

maintainers:
  - Álvaro Fernández Rojas <noltari@gmail.com>

properties:
  compatible:
    const: brcm,bcm63268-timer-clocks

  reg:
    maxItems: 1

  "#clock-cells":
    const: 1

  "#reset-cells":
    const: 1

required:
  - compatible
  - reg
  - "#clock-cells"
  - "#reset-cells"

additionalProperties: false

examples:
  - |
    timer_clk: clock-controller@100000ac {
      compatible = "brcm,bcm63268-timer-clocks";
      reg = <0x100000ac 0x4>;
      #clock-cells = <1>;
      #reset-cells = <1>;
    };
```

## Documentation/devicetree/bindings/clock/brcm,bcm63xx-clocks.txt
```
Gated Clock Controller Bindings for MIPS based BCM63XX SoCs

Required properties:
- compatible: must be one of:
	 "brcm,bcm3368-clocks"
	 "brcm,bcm6318-clocks"
	 "brcm,bcm6318-ubus-clocks"
	 "brcm,bcm6328-clocks"
	 "brcm,bcm6358-clocks"
	 "brcm,bcm6362-clocks"
	 "brcm,bcm6368-clocks"
	 "brcm,bcm63268-clocks"

- reg: Address and length of the register set
- #clock-cells: must be <1>


Example:

clkctl: clock-controller@10000004 {
	compatible = "brcm,bcm6328-clocks";
	reg = <0x10000004 0x4>;
	#clock-cells = <1>;
};
```

## Documentation/devicetree/bindings/clock/brcm,bcm63xx-clocks.yaml
```yaml
# SPDX-License-Identifier: (GPL-2.0-only OR BSD-2-Clause)
%YAML 1.2
---
$id: http://devicetree.org/schemas/clock/brcm,bcm63xx-clocks.yaml#
$schema: http://devicetree.org/meta-schemas/core.yaml#

title: MIPS based BCM63XX SoCs Gated Clock Controller

maintainers:
  - Álvaro Fernández Rojas <noltari@gmail.com>
  - Jonas Gorski <jonas.gorski@gmail.com>

properties:
  compatible:
    enum:
      - brcm,bcm3368-clocks
      - brcm,bcm6318-clocks
      - brcm,bcm6318-ubus-clocks
      - brcm,bcm6328-clocks
      - brcm,bcm6358-clocks
      - brcm,bcm6362-clocks
      - brcm,bcm6368-clocks
      - brcm,bcm63268-clocks

  reg:
    maxItems: 1

  '#clock-cells':
    const: 1

required:
  - compatible
  - reg
  - '#clock-cells'

additionalProperties: false

examples:
  - |
    clock-controller@10000004 {
        compatible = "brcm,bcm6328-clocks";
        reg = <0x10000004 0x4>;
        #clock-cells = <1>;
    };
```
