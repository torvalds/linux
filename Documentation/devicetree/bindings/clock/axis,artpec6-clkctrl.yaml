## Documentation/devicetree/bindings/clock/axis,artpec6-clkctrl.yaml
```yaml
# SPDX-License-Identifier: (GPL-2.0-only OR BSD-2-Clause)
%YAML 1.2
---
$id: http://devicetree.org/schemas/axis,artpec6-clkctrl.yaml#
$schema: http://devicetree.org/meta-schemas/core.yaml#

title: Axis ARTPEC-6 clock controller

maintainers:
  - Lars Persson <lars.persson@axis.com>

properties:
  compatible:
    const: axis,artpec6-clkctrl

  reg:
    maxItems: 1

  "#clock-cells":
    const: 1

  clocks:
    minItems: 1
    items:
      - description: external 50 MHz oscillator.
      - description: optional audio reference clock.
      - description: fractional audio clock divider 0.
      - description: fractional audio clock divider 1.

  clock-names:
    minItems: 1
    items:
      - const: sys_refclk
      - const: i2s_refclk
      - const: frac_clk0
      - const: frac_clk1

required:
  - compatible
  - reg
  - "#clock-cells"
  - clocks
  - clock-names

additionalProperties: false

examples:
  - |
    clock-controller@f8000000 {
        compatible = "axis,artpec6-clkctrl";
        reg = <0xf8000000 0x48>;
        #clock-cells = <1>;
        clocks = <&ext_clk>;
        clock-names = "sys_refclk";
    };
```

## Documentation/devicetree/bindings/clock/axis,artpec8-clock.yaml
```yaml
# SPDX-License-Identifier: (GPL-2.0-only OR BSD-2-Clause)
%YAML 1.2
---
$id: http://devicetree.org/schemas/clock/axis,artpec8-clock.yaml#
$schema: http://devicetree.org/meta-schemas/core.yaml#

title: Axis ARTPEC-8 SoC clock controller

maintainers:
  - Jesper Nilsson <jesper.nilsson@axis.com>

description: |
  ARTPEC-8 clock controller is comprised of several CMU (Clock Management Unit)
  units, generating clocks for different domains. Those CMU units are modeled
  as separate device tree nodes, and might depend on each other.
  The root clock in that root tree is an external clock: OSCCLK (25 MHz).
  This external clock must be defined as a fixed-rate clock in dts.

  CMU_CMU is a top-level CMU, where all base clocks are prepared using PLLs and
  dividers; all other clocks of function blocks (other CMUs) are usually
  derived from CMU_CMU.

  Each clock is assigned an identifier and client nodes can use this identifier
  to specify the clock which they consume. All clocks available for usage
  in clock consumer nodes are defined as preprocessor macros in
  'include/dt-bindings/clock/axis,artpec8-clk.h' header.

properties:
  compatible:
    enum:
      - axis,artpec8-cmu-cmu
      - axis,artpec8-cmu-bus
      - axis,artpec8-cmu-core
      - axis,artpec8-cmu-cpucl
      - axis,artpec8-cmu-fsys
      - axis,artpec8-cmu-imem
      - axis,artpec8-cmu-peri

  reg:
    maxItems: 1

  clocks:
    minItems: 1
    maxItems: 5

  clock-names:
    minItems: 1
    maxItems: 5

  "#clock-cells":
    const: 1

required:
  - compatible
  - reg
  - clocks
  - clock-names
  - "#clock-cells"

allOf:
  - if:
      properties:
        compatible:
          const: axis,artpec8-cmu-cmu

    then:
      properties:
        clocks:
          items:
            - description: External reference clock (25 MHz)

        clock-names:
          items:
            - const: fin_pll

  - if:
      properties:
        compatible:
          const: axis,artpec8-cmu-bus

    then:
      properties:
        clocks:
          items:
            - description: External reference clock (25 MHz)
            - description: CMU_BUS BUS clock (from CMU_CMU)
            - description: CMU_BUS DLP clock (from CMU_CMU)

        clock-names:
          items:
            - const: fin_pll
            - const: bus
            - const: dlp

  - if:
      properties:
        compatible:
          const: axis,artpec8-cmu-core

    then:
      properties:
        clocks:
          items:
            - description: External reference clock (25 MHz)
            - description: CMU_CORE main clock (from CMU_CMU)
            - description: CMU_CORE DLP clock (from CMU_CMU)

        clock-names:
          items:
            - const: fin_pll
            - const: main
            - const: dlp

  - if:
      properties:
        compatible:
          const: axis,artpec8-cmu-cpucl

    then:
      properties:
        clocks:
          items:
            - description: External reference clock (25 MHz)
            - description: CMU_CPUCL switch clock (from CMU_CMU)

        clock-names:
          items:
            - const: fin_pll
            - const: switch

  - if:
      properties:
        compatible:
          const: axis,artpec8-cmu-fsys

    then:
      properties:
        clocks:
          items:
            - description: External reference clock (25 MHz)
            - description: CMU_FSYS SCAN0 clock (from CMU_CMU)
            - description: CMU_FSYS SCAN1 clock (from CMU_CMU)
            - description: CMU_FSYS BUS clock (from CMU_CMU)
            - description: CMU_FSYS IP clock (from CMU_CMU)

        clock-names:
          items:
            - const: fin_pll
            - const: scan0
            - const: scan1
            - const: bus
            - const: ip

  - if:
      properties:
        compatible:
          const: axis,artpec8-cmu-imem

    then:
      properties:
        clocks:
          items:
            - description: External reference clock (25 MHz)
            - description: CMU_IMEM ACLK clock (from CMU_CMU)
            - description: CMU_IMEM JPEG clock (from CMU_CMU)

        clock-names:
          items:
            - const: fin_pll
            - const: aclk
            - const: jpeg

  - if:
      properties:
        compatible:
          const: axis,artpec8-cmu-peri

    then:
      properties:
        clocks:
          items:
            - description: External reference clock (25 MHz)
            - description: CMU_PERI IP clock (from CMU_CMU)
            - description: CMU_PERI AUDIO clock (from CMU_CMU)
            - description: CMU_PERI DISP clock (from CMU_CMU)

        clock-names:
          items:
            - const: fin_pll
            - const: ip
            - const: audio
            - const: disp

additionalProperties: false

examples:
  # Clock controller node for CMU_FSYS
  - |
    #include <dt-bindings/clock/axis,artpec8-clk.h>

    cmu_fsys: clock-controller@16c10000 {
        compatible = "axis,artpec8-cmu-fsys";
        reg = <0x16c10000 0x4000>;
        #clock-cells = <1>;
        clocks = <&fin_pll>,
                 <&cmu_cmu CLK_DOUT_CMU_FSYS_SCAN0>,
                 <&cmu_cmu CLK_DOUT_CMU_FSYS_SCAN1>,
                 <&cmu_cmu CLK_DOUT_CMU_FSYS_BUS>,
                 <&cmu_cmu CLK_DOUT_CMU_FSYS_IP>;
        clock-names = "fin_pll", "scan0", "scan1", "bus", "ip";
    };

...
```

## Documentation/devicetree/bindings/clock/axis,artpec9-clock.yaml
```yaml
# SPDX-License-Identifier: (GPL-2.0-only OR BSD-2-Clause)
%YAML 1.2
---
$id: http://devicetree.org/schemas/clock/axis,artpec9-clock.yaml#
$schema: http://devicetree.org/meta-schemas/core.yaml#

title: Axis ARTPEC-9 SoC clock controller

maintainers:
  - Jesper Nilsson <jesper.nilsson@axis.com>

description: |
  ARTPEC-9 clock controller is comprised of several CMU (Clock Management Unit)
  units, generating clocks for different domains. Those CMU units are modeled
  as separate device tree nodes, and might depend on each other.
  The root clock in that root tree is an external clock: OSCCLK (25 MHz).
  This external clock must be defined as a fixed-rate clock in dts.

  CMU_CMU is a top-level CMU, where all base clocks are prepared using PLLs and
  dividers, all other clocks of function blocks (other CMUs) are usually
  derived from CMU_CMU.

  Each clock is assigned an identifier and client nodes can use this identifier
  to specify the clock which they consume. All clocks available for usage
  in clock consumer nodes are defined as preprocessor macros in
  'include/dt-bindings/clock/axis,artpec9-clk.h' header.

properties:
  compatible:
    enum:
      - axis,artpec9-cmu-cmu
      - axis,artpec9-cmu-bus
      - axis,artpec9-cmu-core
      - axis,artpec9-cmu-cpucl
      - axis,artpec9-cmu-fsys0
      - axis,artpec9-cmu-fsys1
      - axis,artpec9-cmu-imem
      - axis,artpec9-cmu-peri

  reg:
    maxItems: 1

  clocks:
    minItems: 1
    maxItems: 5

  clock-names:
    minItems: 1
    maxItems: 5

  "#clock-cells":
    const: 1

required:
  - compatible
  - reg
  - clocks
  - clock-names
  - "#clock-cells"

allOf:
  - if:
      properties:
        compatible:
          const: axis,artpec9-cmu-cmu

    then:
      properties:
        clocks:
          items:
            - description: External reference clock (25 MHz)

        clock-names:
          items:
            - const: fin_pll

  - if:
      properties:
        compatible:
          const: axis,artpec9-cmu-bus

    then:
      properties:
        clocks:
          items:
            - description: External reference clock (25 MHz)
            - description: CMU_BUS bus clock (from CMU_CMU)

        clock-names:
          items:
            - const: fin_pll
            - const: bus

  - if:
      properties:
        compatible:
          const: axis,artpec9-cmu-core

    then:
      properties:
        clocks:
          items:
            - description: External reference clock (25 MHz)
            - description: CMU_CORE main clock (from CMU_CMU)

        clock-names:
          items:
            - const: fin_pll
            - const: main

  - if:
      properties:
        compatible:
          const: axis,artpec9-cmu-cpucl

    then:
      properties:
        clocks:
          items:
            - description: External reference clock (25 MHz)
            - description: CMU_CPUCL switch clock (from CMU_CMU)

        clock-names:
          items:
            - const: fin_pll
            - const: switch

  - if:
      properties:
        compatible:
          const: axis,artpec9-cmu-fsys0

    then:
      properties:
        clocks:
          items:
            - description: External reference clock (25 MHz)
            - description: CMU_FSYS0 bus clock (from CMU_CMU)
            - description: CMU_FSYS0 IP clock (from CMU_CMU)

        clock-names:
          items:
            - const: fin_pll
            - const: bus
            - const: ip

  - if:
      properties:
        compatible:
          const: axis,artpec9-cmu-fsys1

    then:
      properties:
        clocks:
          items:
            - description: External reference clock (25 MHz)
            - description: CMU_FSYS1 scan0 clock (from CMU_CMU)
            - description: CMU_FSYS1 scan1 clock (from CMU_CMU)
            - description: CMU_FSYS1 bus clock (from CMU_CMU)

        clock-names:
          items:
            - const: fin_pll
            - const: scan0
            - const: scan1
            - const: bus

  - if:
      properties:
        compatible:
          const: axis,artpec9-cmu-imem

    then:
      properties:
        clocks:
          items:
            - description: External reference clock (25 MHz)
            - description: CMU_IMEM ACLK clock (from CMU_CMU)
            - description: CMU_IMEM CA5 clock (from CMU_CMU)
            - description: CMU_IMEM JPEG clock (from CMU_CMU)
            - description: CMU_IMEM SSS clock (from CMU_CMU)

        clock-names:
          items:
            - const: fin_pll
            - const: aclk
            - const: ca5
            - const: jpeg
            - const: sss

  - if:
      properties:
        compatible:
          const: axis,artpec9-cmu-peri

    then:
      properties:
        clocks:
          items:
            - description: External reference clock (25 MHz)
            - description: CMU_PERI IP clock (from CMU_CMU)
            - description: CMU_PERI DISP clock (from CMU_CMU)

        clock-names:
          items:
            - const: fin_pll
            - const: ip
            - const: disp

additionalProperties: false

examples:
  # Clock controller node for CMU_FSYS1
  - |
    #include <dt-bindings/clock/axis,artpec9-clk.h>

    soc {
        #address-cells = <2>;
        #size-cells = <2>;

        cmu_fsys1: clock-controller@14c10000 {
            compatible = "axis,artpec9-cmu-fsys1";
            reg = <0x0 0x14c10000 0x0 0x4000>;
            #clock-cells = <1>;
            clocks = <&fin_pll>,
                     <&cmu_cmu CLK_DOUT_CMU_FSYS1_SCAN0>,
                     <&cmu_cmu CLK_DOUT_CMU_FSYS1_SCAN1>,
                     <&cmu_cmu CLK_DOUT_CMU_FSYS1_BUS>;
            clock-names = "fin_pll", "scan0", "scan1", "bus";
        };
    };
...
```

## Documentation/devicetree/bindings/clock/axs10x-i2s-pll-clock.txt
```
Binding for the AXS10X I2S PLL clock

This binding uses the common clock binding[1].

[1] Documentation/devicetree/bindings/clock/clock-bindings.txt

Required properties:
- compatible: shall be "snps,axs10x-i2s-pll-clock"
- reg : address and length of the I2S PLL register set.
- clocks: shall be the input parent clock phandle for the PLL.
- #clock-cells: from common clock binding; Should always be set to 0.

Example:
	pll_clock: pll_clock {
		compatible = "fixed-clock";
		clock-frequency = <27000000>;
		#clock-cells = <0>;
	};

	i2s_clock@100a0 {
		compatible = "snps,axs10x-i2s-pll-clock";
		reg = <0x100a0 0x10>;
		clocks = <&pll_clock>;
		#clock-cells = <0>;
	};
```
