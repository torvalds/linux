## Documentation/devicetree/bindings/clock/riscv,rpmi-clock.yaml
```yaml
# SPDX-License-Identifier: (GPL-2.0-only OR BSD-2-Clause)
%YAML 1.2
---
$id: http://devicetree.org/schemas/clock/riscv,rpmi-clock.yaml#
$schema: http://devicetree.org/meta-schemas/core.yaml#

title: RISC-V RPMI clock service group based clock controller

maintainers:
  - Anup Patel <anup@brainfault.org>

description: |
  The RISC-V Platform Management Interface (RPMI) [1] defines a
  messaging protocol which is modular and extensible. The supervisor
  software can send/receive RPMI messages via SBI MPXY extension [2]
  or some dedicated supervisor-mode RPMI transport.

  The RPMI specification [1] defines clock service group for accessing
  system clocks managed by a platform microcontroller. The supervisor
  software can access RPMI clock service group via SBI MPXY channel or
  some dedicated supervisor-mode RPMI transport.

  ===========================================
  References
  ===========================================

  [1] RISC-V Platform Management Interface (RPMI) v1.0 (or higher)
      https://github.com/riscv-non-isa/riscv-rpmi/releases

  [2] RISC-V Supervisor Binary Interface (SBI) v3.0 (or higher)
      https://github.com/riscv-non-isa/riscv-sbi-doc/releases

properties:
  compatible:
    description:
      Intended for use by the supervisor software.
    const: riscv,rpmi-clock

  mboxes:
    maxItems: 1
    description:
      Mailbox channel of the underlying RPMI transport or SBI message proxy channel.

  "#clock-cells":
    const: 1
    description:
      Platform specific CLOCK_ID as defined by the RISC-V Platform Management
      Interface (RPMI) specification.

required:
  - compatible
  - mboxes
  - "#clock-cells"

additionalProperties: false

examples:
  - |
    clock-controller {
        compatible = "riscv,rpmi-clock";
        mboxes = <&mpxy_mbox 0x1000 0x0>;
        #clock-cells = <1>;
    };
...
```

## Documentation/devicetree/bindings/clock/riscv,rpmi-mpxy-clock.yaml
```yaml
# SPDX-License-Identifier: (GPL-2.0-only OR BSD-2-Clause)
%YAML 1.2
---
$id: http://devicetree.org/schemas/clock/riscv,rpmi-mpxy-clock.yaml#
$schema: http://devicetree.org/meta-schemas/core.yaml#

title: RISC-V RPMI clock service group based message proxy

maintainers:
  - Anup Patel <anup@brainfault.org>

description: |
  The RISC-V Platform Management Interface (RPMI) [1] defines a
  messaging protocol which is modular and extensible. The supervisor
  software can send/receive RPMI messages via SBI MPXY extension [2]
  or some dedicated supervisor-mode RPMI transport.

  The RPMI specification [1] defines clock service group for accessing
  system clocks managed by a platform microcontroller. The SBI implementation
  (machine mode firmware or hypervisor) can implement an SBI MPXY channel
  to allow RPMI clock service group access to the supervisor software.

  ===========================================
  References
  ===========================================

  [1] RISC-V Platform Management Interface (RPMI) v1.0 (or higher)
      https://github.com/riscv-non-isa/riscv-rpmi/releases

  [2] RISC-V Supervisor Binary Interface (SBI) v3.0 (or higher)
      https://github.com/riscv-non-isa/riscv-sbi-doc/releases

properties:
  compatible:
    description:
      Intended for use by the SBI implementation.
    const: riscv,rpmi-mpxy-clock

  mboxes:
    maxItems: 1
    description:
      Mailbox channel of the underlying RPMI transport.

  riscv,sbi-mpxy-channel-id:
    $ref: /schemas/types.yaml#/definitions/uint32
    description:
      The SBI MPXY channel id to be used for providing RPMI access to
      the supervisor software.

required:
  - compatible
  - mboxes
  - riscv,sbi-mpxy-channel-id

additionalProperties: false

examples:
  - |
    clock-service {
        compatible = "riscv,rpmi-mpxy-clock";
        mboxes = <&rpmi_shmem_mbox 0x8>;
        riscv,sbi-mpxy-channel-id = <0x1000>;
    };
...
```

## Documentation/devicetree/bindings/clock/rockchip,clk-out.yaml
```yaml
# SPDX-License-Identifier: GPL-2.0-only OR BSD-2-Clause
%YAML 1.2
---
$id: http://devicetree.org/schemas/clock/rockchip,clk-out.yaml#
$schema: http://devicetree.org/meta-schemas/core.yaml#

title: Rockchip Clock Out Control Module Binding

maintainers:
  - Sugar Zhang <sugar.zhang@rock-chips.com>

description: |
  This add support switch for clk-bidirection which located
  at GRF, such as SAIx_MCLK_{IN OUT} which share the same pin.
  and these config maybe located in many pieces of GRF,
  which hard to addressed in one single clk driver. so, we add
  this simple helper driver to address this situation.

  In order to simplify implement and usage, and also for safety
  clk usage (avoid high freq glitch), we set all clk out as disabled
  (which means Input default for clk-bidrection) in the pre-stage,
  such boot-loader or init by HW default. And then set a safety freq
  before enable clk-out, such as "assign-clock-rates" or clk_set_rate
  in drivers.

properties:
  compatible:
    enum:
      - rockchip,clk-out

  reg:
    maxItems: 1

  "#clock-cells":
    const: 1

  clocks:
    maxItems: 1
    description: parent clocks.

  power-domains:
    maxItems: 1

  clock-output-names:
    maxItems: 1

  rockchip,bit-shift:
    $ref: /schemas/types.yaml#/definitions/uint32
    description: Defines the bit shift of clk out enable.

  rockchip,bit-set-to-disable:
    type: boolean
    description: |
      By default this clock sets the bit at bit-shift to enable the clock.
      Setting this property does the opposite: setting the bit disable
      the clock and clearing it enables the clock.

required:
  - compatible
  - reg
  - clocks
  - "#clock-cells"
  - clock-output-names
  - rockchip,bit-shift

additionalProperties: false

examples:
  # Clock Provider node:
  - |
    mclkin_sai0: mclkin-sai0 {
        compatible = "fixed-clock";
        #clock-cells = <0>;
        clock-frequency = <12288000>;
        clock-output-names = "mclk_sai0_from_io";
    };

    mclkout_sai0: mclkout-sai0@ff040070 {
        compatible = "rockchip,clk-out";
        reg = <0 0xff040070 0 0x4>;
        clocks = <&cru MCLK_SAI0_OUT2IO>;
        #clock-cells = <0>;
        clock-output-names = "mclk_sai0_to_io";
        rockchip,bit-shift = <4>;
    };

  # Clock mclkout Consumer node:
  - |
    ext_codec {
        clocks = <&mclkout_sai0>;
        clock-names = "mclk";
        assigned-clocks = <&mclkout_sai0>;
        assigned-clock-rates = <12288000>;
        pinctrl-names = "default";
        pinctrl-0 = <&i2s0m0_mclk>;
    };

  # Clock mclkin Consumer node:
  - |
    ext_codec {
        clocks = <&mclkin_sai0>;
        clock-names = "mclk";
        assigned-clocks = <&cru CLK_SAI0>;
        assigned-clock-parents = <&mclkin_sai0>;
        pinctrl-names = "default";
        pinctrl-0 = <&i2s0m0_mclk>;
    };
```

## Documentation/devicetree/bindings/clock/rockchip,px30-cru.txt
```
* Rockchip PX30 Clock and Reset Unit

The PX30 clock controller generates and supplies clock to various
controllers within the SoC and also implements a reset controller for SoC
peripherals.

Required Properties:

- compatible: PMU for CRU should be "rockchip,px30-pmu-cru"
- compatible: CRU should be "rockchip,px30-cru"
- reg: physical base address of the controller and length of memory mapped
  region.
- clocks: A list of phandle + clock-specifier pairs for the clocks listed
          in clock-names
- clock-names: Should contain the following:
  - "xin24m" for both PMUCRU and CRU
  - "gpll" for CRU (sourced from PMUCRU)
- #clock-cells: should be 1.
- #reset-cells: should be 1.

Optional Properties:

- rockchip,grf: phandle to the syscon managing the "general register files"
  If missing, pll rates are not changeable, due to the missing pll lock status.

Each clock is assigned an identifier and client nodes can use this identifier
to specify the clock which they consume. All available clocks are defined as
preprocessor macros in the dt-bindings/clock/px30-cru.h headers and can be
used in device tree sources. Similar macros exist for the reset sources in
these files.

External clocks:

There are several clocks that are generated outside the SoC. It is expected
that they are defined using standard clock bindings with following
clock-output-names:
 - "xin24m" - crystal input - required,
 - "xin32k" - rtc clock - optional,
 - "i2sx_clkin" - external I2S clock - optional,
 - "gmac_clkin" - external GMAC clock - optional

Example: Clock controller node:

	pmucru: clock-controller@ff2bc000 {
		compatible = "rockchip,px30-pmucru";
		reg = <0x0 0xff2bc000 0x0 0x1000>;
		#clock-cells = <1>;
		#reset-cells = <1>;
	};

	cru: clock-controller@ff2b0000 {
		compatible = "rockchip,px30-cru";
		reg = <0x0 0xff2b0000 0x0 0x1000>;
		rockchip,grf = <&grf>;
		#clock-cells = <1>;
		#reset-cells = <1>;
	};

Example: UART controller node that consumes the clock generated by the clock
  controller:

	uart0: serial@ff030000 {
		compatible = "rockchip,px30-uart", "snps,dw-apb-uart";
		reg = <0x0 0xff030000 0x0 0x100>;
		interrupts = <GIC_SPI 15 IRQ_TYPE_LEVEL_HIGH>;
		clocks = <&pmucru SCLK_UART0_PMU>, <&pmucru PCLK_UART0_PMU>;
		clock-names = "baudclk", "apb_pclk";
		reg-shift = <2>;
		reg-io-width = <4>;
	};
```

## Documentation/devicetree/bindings/clock/rockchip,px30-cru.yaml
```yaml
# SPDX-License-Identifier: GPL-2.0
%YAML 1.2
---
$id: http://devicetree.org/schemas/clock/rockchip,px30-cru.yaml#
$schema: http://devicetree.org/meta-schemas/core.yaml#

title: Rockchip PX30 Clock and Reset Unit (CRU)

maintainers:
  - Elaine Zhang <zhangqing@rock-chips.com>
  - Heiko Stuebner <heiko@sntech.de>

description: |
  The PX30 clock controller generates and supplies clocks to various
  controllers within the SoC and also implements a reset controller for SoC
  peripherals.
  Each clock is assigned an identifier and client nodes can use this identifier
  to specify the clock which they consume. All available clocks are defined as
  preprocessor macros in the dt-bindings/clock/px30-cru.h headers and can be
  used in device tree sources. Similar macros exist for the reset sources in
  these files.
  There are several clocks that are generated outside the SoC. It is expected
  that they are defined using standard clock bindings with following
  clock-output-names:
    - "xin24m"     - crystal input       - required
    - "xin32k"     - rtc clock           - optional
    - "i2sx_clkin" - external I2S clock  - optional
    - "gmac_clkin" - external GMAC clock - optional

properties:
  compatible:
    enum:
      - rockchip,px30-cru
      - rockchip,px30-pmucru

  reg:
    maxItems: 1

  "#clock-cells":
    const: 1

  "#reset-cells":
    const: 1

  clocks:
    minItems: 1
    items:
      - description: Clock for both PMUCRU and CRU
      - description: Clock for CRU (sourced from PMUCRU)

  clock-names:
    minItems: 1
    items:
      - const: xin24m
      - const: gpll

  rockchip,grf:
    $ref: /schemas/types.yaml#/definitions/phandle
    description:
      Phandle to the syscon managing the "general register files" (GRF),
      if missing pll rates are not changeable, due to the missing pll
      lock status.

required:
  - compatible
  - reg
  - clocks
  - clock-names
  - "#clock-cells"
  - "#reset-cells"

allOf:
  - if:
      properties:
        compatible:
          contains:
            const: rockchip,px30-cru

    then:
      properties:
        clocks:
          minItems: 2

        clock-names:
          minItems: 2

    else:
      properties:
        clocks:
          maxItems: 1

        clock-names:
          maxItems: 1

additionalProperties: false

examples:
  - |
    #include <dt-bindings/clock/px30-cru.h>

    pmucru: clock-controller@ff2bc000 {
      compatible = "rockchip,px30-pmucru";
      reg = <0xff2bc000 0x1000>;
      clocks = <&xin24m>;
      clock-names = "xin24m";
      rockchip,grf = <&grf>;
      #clock-cells = <1>;
      #reset-cells = <1>;
    };

    cru: clock-controller@ff2b0000 {
      compatible = "rockchip,px30-cru";
      reg = <0xff2b0000 0x1000>;
      clocks = <&xin24m>, <&pmucru PLL_GPLL>;
      clock-names = "xin24m", "gpll";
      rockchip,grf = <&grf>;
      #clock-cells = <1>;
      #reset-cells = <1>;
    };
```

## Documentation/devicetree/bindings/clock/rockchip,rk1108-cru.txt
```
* Rockchip RK1108 Clock and Reset Unit

The RK1108 clock controller generates and supplies clock to various
controllers within the SoC and also implements a reset controller for SoC
peripherals.

Required Properties:

- compatible: should be "rockchip,rk1108-cru"
- reg: physical base address of the controller and length of memory mapped
  region.
- #clock-cells: should be 1.
- #reset-cells: should be 1.

Optional Properties:

- rockchip,grf: phandle to the syscon managing the "general register files"
  If missing pll rates are not changeable, due to the missing pll lock status.

Each clock is assigned an identifier and client nodes can use this identifier
to specify the clock which they consume. All available clocks are defined as
preprocessor macros in the dt-bindings/clock/rk1108-cru.h headers and can be
used in device tree sources. Similar macros exist for the reset sources in
these files.

External clocks:

There are several clocks that are generated outside the SoC. It is expected
that they are defined using standard clock bindings with following
clock-output-names:
 - "xin24m" - crystal input - required,
 - "ext_vip" - external VIP clock - optional
 - "ext_i2s" - external I2S clock - optional
 - "ext_gmac" - external GMAC clock - optional
 - "hdmiphy" - external clock input derived from HDMI PHY - optional
 - "usbphy" - external clock input derived from USB PHY - optional

Example: Clock controller node:

	cru: cru@20200000 {
		compatible = "rockchip,rk1108-cru";
		reg = <0x20200000 0x1000>;
		rockchip,grf = <&grf>;

		#clock-cells = <1>;
		#reset-cells = <1>;
	};

Example: UART controller node that consumes the clock generated by the clock
  controller:

	uart0: serial@10230000 {
		compatible = "rockchip,rk1108-uart", "snps,dw-apb-uart";
		reg = <0x10230000 0x100>;
		interrupts = <GIC_SPI 44 IRQ_TYPE_LEVEL_HIGH>;
		reg-shift = <2>;
		reg-io-width = <4>;
		clocks = <&cru SCLK_UART0>;
	};
```
