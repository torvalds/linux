## Documentation/devicetree/bindings/clock/tango4-clock.txt
```
* Sigma Designs Tango4 Clock Generator

The Tango4 clock generator outputs cpu_clk and sys_clk (the latter is used
for RAM and various peripheral devices). The clock binding described here
is applicable to all Tango4 SoCs.

Required Properties:

- compatible: should be "sigma,tango4-clkgen".
- reg: physical base address of the device and length of memory mapped region.
- clocks: phandle of the input clock (crystal oscillator).
- clock-output-names: should be "cpuclk" and "sysclk".
- #clock-cells: should be set to 1.

Example:

	clkgen: clkgen@10000 {
		compatible = "sigma,tango4-clkgen";
		reg = <0x10000 0x40>;
		clocks = <&xtal>;
		clock-output-names = "cpuclk", "sysclk";
		#clock-cells = <1>;
	};
```

## Documentation/devicetree/bindings/clock/tesla,fsd-clock.yaml
```yaml
# SPDX-License-Identifier: (GPL-2.0-only OR BSD-2-Clause)
%YAML 1.2
---
$id: http://devicetree.org/schemas/clock/tesla,fsd-clock.yaml#
$schema: http://devicetree.org/meta-schemas/core.yaml#

title: Tesla FSD (Full Self-Driving) SoC clock controller

maintainers:
  - Alim Akhtar <alim.akhtar@samsung.com>
  - linux-fsd@tesla.com

description: |
  FSD clock controller consist of several clock management unit
  (CMU), which generates clocks for various internal SoC blocks.
  The root clock comes from external OSC clock (24 MHz).

  All available clocks are defined as preprocessor macros in
  'dt-bindings/clock/fsd-clk.h' header.

properties:
  compatible:
    enum:
      - tesla,fsd-clock-cmu
      - tesla,fsd-clock-imem
      - tesla,fsd-clock-peric
      - tesla,fsd-clock-fsys0
      - tesla,fsd-clock-fsys1
      - tesla,fsd-clock-mfc
      - tesla,fsd-clock-cam_csi

  clocks:
    minItems: 1
    maxItems: 6

  clock-names:
    minItems: 1
    maxItems: 6

  "#clock-cells":
    const: 1

  reg:
    maxItems: 1

allOf:
  - if:
      properties:
        compatible:
          contains:
            const: tesla,fsd-clock-cmu
    then:
      properties:
        clocks:
          items:
            - description: External reference clock (24 MHz)
        clock-names:
          items:
            - const: fin_pll

  - if:
      properties:
        compatible:
          contains:
            const: tesla,fsd-clock-imem
    then:
      properties:
        clocks:
          items:
            - description: External reference clock (24 MHz)
            - description: IMEM TCU clock (from CMU_CMU)
            - description: IMEM bus clock (from CMU_CMU)
            - description: IMEM DMA clock (from CMU_CMU)
        clock-names:
          items:
            - const: fin_pll
            - const: dout_cmu_imem_tcuclk
            - const: dout_cmu_imem_aclk
            - const: dout_cmu_imem_dmaclk

  - if:
      properties:
        compatible:
          contains:
            const: tesla,fsd-clock-peric
    then:
      properties:
        clocks:
          items:
            - description: External reference clock (24 MHz)
            - description: Shared0 PLL div4 clock (from CMU_CMU)
            - description: PERIC shared1 div36 clock (from CMU_CMU)
            - description: PERIC shared0 div3 TBU clock (from CMU_CMU)
            - description: PERIC shared0 div20 clock (from CMU_CMU)
            - description: PERIC shared1 div4 DMAclock (from CMU_CMU)
        clock-names:
          items:
            - const: fin_pll
            - const: dout_cmu_pll_shared0_div4
            - const: dout_cmu_peric_shared1div36
            - const: dout_cmu_peric_shared0div3_tbuclk
            - const: dout_cmu_peric_shared0div20
            - const: dout_cmu_peric_shared1div4_dmaclk

  - if:
      properties:
        compatible:
          contains:
            const: tesla,fsd-clock-fsys0
    then:
      properties:
        clocks:
          items:
            - description: External reference clock (24 MHz)
            - description: Shared0 PLL div6 clock (from CMU_CMU)
            - description: FSYS0 shared1 div4 clock (from CMU_CMU)
            - description: FSYS0 shared0 div4 clock (from CMU_CMU)
        clock-names:
          items:
            - const: fin_pll
            - const: dout_cmu_pll_shared0_div6
            - const: dout_cmu_fsys0_shared1div4
            - const: dout_cmu_fsys0_shared0div4

  - if:
      properties:
        compatible:
          contains:
            const: tesla,fsd-clock-fsys1
    then:
      properties:
        clocks:
          items:
            - description: External reference clock (24 MHz)
            - description: FSYS1 shared0 div8 clock (from CMU_CMU)
            - description: FSYS1 shared0 div4 clock (from CMU_CMU)
        clock-names:
          items:
            - const: fin_pll
            - const: dout_cmu_fsys1_shared0div8
            - const: dout_cmu_fsys1_shared0div4

  - if:
      properties:
        compatible:
          contains:
            const: tesla,fsd-clock-mfc
    then:
      properties:
        clocks:
          items:
            - description: External reference clock (24 MHz)
        clock-names:
          items:
            - const: fin_pll

  - if:
      properties:
        compatible:
          contains:
            const: tesla,fsd-clock-cam_csi
    then:
      properties:
        clocks:
          items:
            - description: External reference clock (24 MHz)
        clock-names:
          items:
            - const: fin_pll

required:
  - compatible
  - "#clock-cells"
  - clocks
  - clock-names
  - reg

additionalProperties: false

examples:
  # Clock controller node for CMU_FSYS1
  - |
    #include <dt-bindings/clock/fsd-clk.h>

    clock_fsys1: clock-controller@16810000 {
          compatible = "tesla,fsd-clock-fsys1";
          reg = <0x16810000 0x3000>;
          #clock-cells = <1>;

          clocks = <&fin_pll>,
                   <&clock_cmu DOUT_CMU_FSYS1_SHARED0DIV8>,
                   <&clock_cmu DOUT_CMU_FSYS1_SHARED0DIV4>;
          clock-names = "fin_pll",
                        "dout_cmu_fsys1_shared0div8",
                        "dout_cmu_fsys1_shared0div4";
    };

...
```

## Documentation/devicetree/bindings/clock/thead,th1520-clk-ap.yaml
```yaml
# SPDX-License-Identifier: GPL-2.0-only OR BSD-2-Clause
%YAML 1.2
---
$id: http://devicetree.org/schemas/clock/thead,th1520-clk-ap.yaml#
$schema: http://devicetree.org/meta-schemas/core.yaml#

title: T-HEAD TH1520 AP sub-system clock controller

description: |
  The T-HEAD TH1520 AP sub-system clock controller configures the
  CPU, DPU, GMAC and TEE PLLs. Additionally the VO subsystem configures
  the clock gates for the HDMI, MIPI and the GPU.

  SoC reference manual
  https://openbeagle.org/beaglev-ahead/beaglev-ahead/-/blob/main/docs/TH1520%20System%20User%20Manual.pdf

maintainers:
  - Jisheng Zhang <jszhang@kernel.org>
  - Wei Fu <wefu@redhat.com>
  - Drew Fustini <dfustini@tenstorrent.com>

properties:
  compatible:
    enum:
      - thead,th1520-clk-ap
      - thead,th1520-clk-vo

  reg:
    maxItems: 1

  clocks:
    items:
      - description: |
          One input clock:
          - For "thead,th1520-clk-ap": the clock input must be the 24 MHz
            main oscillator.
          - For "thead,th1520-clk-vo": the clock input must be the VIDEO_PLL,
            which is configured by the AP clock controller. According to the
            TH1520 manual, VIDEO_PLL is a Silicon Creations Sigma-Delta PLL
            (integer PLL) typically running at 792 MHz (FOUTPOSTDIV), with
            a maximum FOUTVCO of 2376 MHz.

  "#clock-cells":
    const: 1
    description:
      See <dt-bindings/clock/thead,th1520-clk-ap.h> for valid indices.

required:
  - compatible
  - reg
  - clocks
  - "#clock-cells"

additionalProperties: false

examples:
  - |
    #include <dt-bindings/clock/thead,th1520-clk-ap.h>
    clock-controller@ef010000 {
        compatible = "thead,th1520-clk-ap";
        reg = <0xef010000 0x1000>;
        clocks = <&osc>;
        #clock-cells = <1>;
    };
```

## Documentation/devicetree/bindings/clock/ti,am62-audio-refclk.yaml
```yaml
# SPDX-License-Identifier: (GPL-2.0-only OR BSD-2-Clause)
%YAML 1.2
---
$id: http://devicetree.org/schemas/clock/ti,am62-audio-refclk.yaml#
$schema: http://devicetree.org/meta-schemas/core.yaml#

title: TI Audio Reference Clock

maintainers:
  - Jai Luthra <j-luthra@ti.com>

properties:
  compatible:
    items:
      - const: ti,am62-audio-refclk

  reg:
    maxItems: 1

  "#clock-cells":
    const: 0

  clocks:
    maxItems: 1

required:
  - compatible
  - reg
  - "#clock-cells"
  - clocks

additionalProperties: false

examples:
  - |
    audio_refclk0: clock@82e0 {
        compatible = "ti,am62-audio-refclk";
        reg = <0x82e0 0x4>;
        clocks = <&k3_clks 157 0>;
        assigned-clocks = <&k3_clks 157 0>;
        assigned-clock-parents = <&k3_clks 157 8>;
        #clock-cells = <0>;
    };
```

## Documentation/devicetree/bindings/clock/ti,am654-ehrpwm-tbclk.yaml
```yaml
# SPDX-License-Identifier: (GPL-2.0-only OR BSD-2-Clause)
%YAML 1.2
---
$id: http://devicetree.org/schemas/clock/ti,am654-ehrpwm-tbclk.yaml#
$schema: http://devicetree.org/meta-schemas/core.yaml#

title: TI EHRPWM Time Base Clock

maintainers:
  - Vignesh Raghavendra <vigneshr@ti.com>

properties:
  compatible:
    items:
      - enum:
          - ti,am654-ehrpwm-tbclk
          - ti,am64-epwm-tbclk
      - const: syscon

  "#clock-cells":
    const: 1

  reg:
    maxItems: 1

required:
  - compatible
  - "#clock-cells"
  - reg

additionalProperties: false

examples:
  - |
    ehrpwm_tbclk: syscon@4140 {
        compatible = "ti,am654-ehrpwm-tbclk", "syscon";
        reg = <0x4140 0x18>;
        #clock-cells = <1>;
    };
```

## Documentation/devicetree/bindings/clock/ti,cdce706.txt
```
Bindings for Texas Instruments CDCE706 programmable 3-PLL clock
synthesizer/multiplier/divider.

Reference: http://www.ti.com/lit/ds/symlink/cdce706.pdf

I2C device node required properties:
- compatible: shall be "ti,cdce706".
- reg: i2c device address, shall be in range [0x68...0x6b].
- #clock-cells: from common clock binding; shall be set to 1.
- clocks: from common clock binding; list of parent clock
  handles, shall be reference clock(s) connected to CLK_IN0
  and CLK_IN1 pins.
- clock-names: shall be clk_in0 and/or clk_in1. Use clk_in0
  in case of crystal oscillator or differential signal input
  configuration. Use clk_in0 and clk_in1 in case of independent
  single-ended LVCMOS inputs configuration.

Example:

	clocks {
		clk54: clk54 {
			#clock-cells = <0>;
			compatible = "fixed-clock";
			clock-frequency = <54000000>;
		};
	};
	...
	i2c0: i2c-master@0d090000 {
		...
		cdce706: clock-synth@69 {
			compatible = "ti,cdce706";
			#clock-cells = <1>;
			reg = <0x69>;
			clocks = <&clk54>;
			clock-names = "clk_in0";
		};
	};
	...
	simple-audio-card,codec {
		...
		clocks = <&cdce706 4>;
	};
```

## Documentation/devicetree/bindings/clock/ti,cdce925.txt
```
Binding for TI CDCE913/925/937/949 programmable I2C clock synthesizers.

Reference
This binding uses the common clock binding[1].

[1] Documentation/devicetree/bindings/clock/clock-bindings.txt
[2] https://www.ti.com/product/cdce913
[3] https://www.ti.com/product/cdce925
[4] https://www.ti.com/product/cdce937
[5] https://www.ti.com/product/cdce949

The driver provides clock sources for each output Y1 through Y5.

Required properties:
 - compatible: Shall be one of the following:
	- "ti,cdce913": 1-PLL, 3 Outputs
	- "ti,cdce925": 2-PLL, 5 Outputs
	- "ti,cdce937": 3-PLL, 7 Outputs
	- "ti,cdce949": 4-PLL, 9 Outputs
 - reg: I2C device address.
 - clocks: Points to a fixed parent clock that provides the input frequency.
 - #clock-cells: From common clock bindings: Shall be 1.

Optional properties:
 - xtal-load-pf: Crystal load-capacitor value to fine-tune performance on a
                 board, or to compensate for external influences.
- vdd-supply: A regulator node for Vdd
- vddout-supply: A regulator node for Vddout

For all PLL1, PLL2, ... an optional child node can be used to specify spread
spectrum clocking parameters for a board.
  - spread-spectrum: SSC mode as defined in the data sheet.
  - spread-spectrum-center: Use "centered" mode instead of "max" mode. When
    present, the clock runs at the requested frequency on average. Otherwise
    the requested frequency is the maximum value of the SCC range.


Example:

	clockgen: cdce925pw@64 {
		compatible = "cdce925";
		reg = <0x64>;
		clocks = <&xtal_27Mhz>;
		#clock-cells = <1>;
		xtal-load-pf = <5>;
		vdd-supply = <&1v8-reg>;
		vddout-supply = <&3v3-reg>;
		/* PLL options to get SSC 1% centered */
		PLL2 {
			spread-spectrum = <4>;
			spread-spectrum-center;
		};
	};
```

## Documentation/devicetree/bindings/clock/ti,cdce925.yaml
```yaml
# SPDX-License-Identifier: (GPL-2.0-only OR BSD-2-Clause)
%YAML 1.2
---
$id: http://devicetree.org/schemas/clock/ti,cdce925.yaml#
$schema: http://devicetree.org/meta-schemas/core.yaml#

title: TI CDCE913/925/937/949 programmable I2C clock synthesizers

maintainers:
  - Alexander Stein <alexander.stein@ew.tq-group.com>

description: |
  Flexible Low Power LVCMOS Clock Generator with SSC Support for EMI Reduction

  - CDCE(L)913: 1-PLL, 3 Outputs https://www.ti.com/product/cdce913
  - CDCE(L)925: 2-PLL, 5 Outputs https://www.ti.com/product/cdce925
  - CDCE(L)937: 3-PLL, 7 Outputs https://www.ti.com/product/cdce937
  - CDCE(L)949: 4-PLL, 9 Outputs https://www.ti.com/product/cdce949

properties:
  compatible:
    enum:
      - ti,cdce913
      - ti,cdce925
      - ti,cdce937
      - ti,cdce949

  reg:
    maxItems: 1

  clocks:
    items:
      - description: fixed parent clock

  "#clock-cells":
    const: 1

  vdd-supply:
    description: Regulator that provides 1.8V Vdd power supply

  vddout-supply:
    description: |
      Regulator that provides Vddout power supply.
      non-L variant: 2.5V or 3.3V for
      L variant: 1.8V for

  xtal-load-pf:
    $ref: /schemas/types.yaml#/definitions/uint32
    description: |
      Crystal load-capacitor value to fine-tune performance on a
      board, or to compensate for external influences.

patternProperties:
  "^PLL[1-4]$":
    type: object
    description: |
      optional child node can be used to specify spread
      spectrum clocking parameters for a board

    additionalProperties: false

    properties:
      spread-spectrum:
        $ref: /schemas/types.yaml#/definitions/uint32
        description: SSC mode as defined in the data sheet

      spread-spectrum-center:
        type: boolean
        description: |
          Use "centered" mode instead of "max" mode. When
          present, the clock runs at the requested frequency on average.
          Otherwise the requested frequency is the maximum value of the
          SCC range.

required:
  - compatible
  - reg
  - clocks
  - "#clock-cells"

additionalProperties: false

examples:
  - |
    i2c {
        #address-cells = <1>;
        #size-cells = <0>;

        cdce925: clock-controller@64 {
            compatible = "ti,cdce925";
            reg = <0x64>;
            clocks = <&xtal_27Mhz>;
            #clock-cells = <1>;
            xtal-load-pf = <5>;
            vdd-supply = <&reg_1v8>;
            vddout-supply = <&reg_3v3>;
            /* PLL options to get SSC 1% centered */
            PLL2 {
                spread-spectrum = <4>;
                spread-spectrum-center;
            };
        };
    };
```
