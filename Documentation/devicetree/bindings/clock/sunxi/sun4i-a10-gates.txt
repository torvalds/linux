## Documentation/devicetree/bindings/clock/ti/autoidle.txt
```
Binding for Texas Instruments autoidle clock.

Binding status: Unstable - ABI compatibility may be broken in the future

This binding uses the common clock binding[1]. It assumes a register mapped
clock which can be put to idle automatically by hardware based on the usage
and a configuration bit setting. Autoidle clock is never an individual
clock, it is always a derivative of some basic clock like a gate, divider,
or fixed-factor.

[1] Documentation/devicetree/bindings/clock/clock-bindings.txt

Required properties:
- reg : offset for the register controlling the autoidle
- ti,autoidle-shift : bit shift of the autoidle enable bit
- ti,invert-autoidle-bit : autoidle is enabled by setting the bit to 0

Examples:
	dpll_core_m4_ck: dpll_core_m4_ck {
		#clock-cells = <0>;
		compatible = "ti,divider-clock";
		clocks = <&dpll_core_x2_ck>;
		ti,max-div = <31>;
		ti,autoidle-shift = <8>;
		reg = <0x2d38>;
		ti,index-starts-at-one;
		ti,invert-autoidle-bit;
	};

	dpll_usb_clkdcoldo_ck: dpll_usb_clkdcoldo_ck {
		#clock-cells = <0>;
		compatible = "ti,fixed-factor-clock";
		clocks = <&dpll_usb_ck>;
		ti,clock-div = <1>;
		ti,autoidle-shift = <8>;
		reg = <0x01b4>;
		ti,clock-mult = <1>;
		ti,invert-autoidle-bit;
	};
```

## Documentation/devicetree/bindings/clock/ti/clockdomain.txt
```
Binding for Texas Instruments clockdomain.

Binding status: Unstable - ABI compatibility may be broken in the future

This binding uses the common clock binding[1] in consumer role.
Every clock on TI SoC belongs to one clockdomain, but software
only needs this information for specific clocks which require
their parent clockdomain to be controlled when the clock is
enabled/disabled. This binding doesn't define a new clock
binding type, it is used to group existing clock nodes under
hardware hierarchy.

[1] Documentation/devicetree/bindings/clock/clock-bindings.txt

Required properties:
- compatible : shall be "ti,clockdomain"
- #clock-cells : from common clock binding; shall be set to 0.
- clocks : link phandles of clocks within this domain

Optional properties:
- clock-output-names : from common clock binding.

Examples:
	dss_clkdm: dss_clkdm {
		compatible = "ti,clockdomain";
		clocks = <&dss1_alwon_fck_3430es2>, <&dss_ick_3430es2>;
	};
```

## Documentation/devicetree/bindings/clock/ti/composite.txt
```
Binding for TI composite clock.

Binding status: Unstable - ABI compatibility may be broken in the future

This binding uses the common clock binding[1]. It assumes a
register-mapped composite clock with multiple different sub-types;

a multiplexer clock with multiple input clock signals or parents, one
of which can be selected as output, this behaves exactly as [2]

an adjustable clock rate divider, this behaves exactly as [3]

a gating function which can be used to enable and disable the output
clock, this behaves exactly as [4]

The binding must provide a list of the component clocks that shall be
merged to this clock. The component clocks shall be of one of the
"ti,*composite*-clock" types.

[1] Documentation/devicetree/bindings/clock/clock-bindings.txt
[2] Documentation/devicetree/bindings/clock/ti/mux.txt
[3] Documentation/devicetree/bindings/clock/ti/divider.txt
[4] Documentation/devicetree/bindings/clock/ti/gate.txt

Required properties:
- compatible : shall be: "ti,composite-clock"
- clocks : link phandles of component clocks
- #clock-cells : from common clock binding; shall be set to 0.

Examples:

usb_l4_gate_ick: usb_l4_gate_ick {
	#clock-cells = <0>;
	compatible = "ti,composite-interface-clock";
	clocks = <&l4_ick>;
	ti,bit-shift = <5>;
	reg = <0x0a10>;
};

usb_l4_div_ick: usb_l4_div_ick {
	#clock-cells = <0>;
	compatible = "ti,composite-divider-clock";
	clocks = <&l4_ick>;
	ti,bit-shift = <4>;
	ti,max-div = <1>;
	reg = <0x0a40>;
	ti,index-starts-at-one;
};

usb_l4_ick: usb_l4_ick {
	#clock-cells = <0>;
	compatible = "ti,composite-clock";
	clocks = <&usb_l4_gate_ick>, <&usb_l4_div_ick>;
};
```

## Documentation/devicetree/bindings/clock/ti/davinci/da8xx-cfgchip.txt
```
Binding for TI DA8XX/OMAP-L13X/AM17XX/AM18XX CFGCHIP clocks

TI DA8XX/OMAP-L13X/AM17XX/AM18XX SoCs contain a general purpose set of
registers call CFGCHIPn. Some of these registers function as clock
gates. This document describes the bindings for those clocks.

All of the clock nodes described below must be child nodes of a CFGCHIP node
(compatible = "ti,da830-cfgchip").

USB PHY clocks
--------------
Required properties:
- compatible: shall be "ti,da830-usb-phy-clocks".
- #clock-cells: from common clock binding; shall be set to 1.
- clocks: phandles to the parent clocks corresponding to clock-names
- clock-names: shall be "fck", "usb_refclkin", "auxclk"

This node provides two clocks. The clock at index 0 is the USB 2.0 PHY 48MHz
clock and the clock at index 1 is the USB 1.1 PHY 48MHz clock.

eHRPWM Time Base Clock (TBCLK)
------------------------------
Required properties:
- compatible: shall be "ti,da830-tbclksync".
- #clock-cells: from common clock binding; shall be set to 0.
- clocks: phandle to the parent clock
- clock-names: shall be "fck"

PLL DIV4.5 divider
------------------
Required properties:
- compatible: shall be "ti,da830-div4p5ena".
- #clock-cells: from common clock binding; shall be set to 0.
- clocks: phandle to the parent clock
- clock-names: shall be "pll0_pllout"

EMIFA clock source (ASYNC1)
---------------------------
Required properties:
- compatible: shall be "ti,da850-async1-clksrc".
- #clock-cells: from common clock binding; shall be set to 0.
- clocks: phandles to the parent clocks corresponding to clock-names
- clock-names: shall be "pll0_sysclk3", "div4.5"

ASYNC3 clock source
-------------------
Required properties:
- compatible: shall be "ti,da850-async3-clksrc".
- #clock-cells: from common clock binding; shall be set to 0.
- clocks: phandles to the parent clocks corresponding to clock-names
- clock-names: shall be "pll0_sysclk2", "pll1_sysclk2"

Examples:

	cfgchip: syscon@1417c {
		compatible = "ti,da830-cfgchip", "syscon", "simple-mfd";
		reg = <0x1417c 0x14>;

		usb_phy_clk: usb-phy-clocks {
			compatible = "ti,da830-usb-phy-clocks";
			#clock-cells = <1>;
			clocks = <&psc1 1>, <&usb_refclkin>, <&pll0_auxclk>;
			clock-names = "fck", "usb_refclkin", "auxclk";
		};
		ehrpwm_tbclk: ehrpwm_tbclk {
			compatible = "ti,da830-tbclksync";
			#clock-cells = <0>;
			clocks = <&psc1 17>;
			clock-names = "fck";
		};
		div4p5_clk: div4.5 {
			compatible = "ti,da830-div4p5ena";
			#clock-cells = <0>;
			clocks = <&pll0_pllout>;
			clock-names = "pll0_pllout";
		};
		async1_clk: async1 {
			compatible = "ti,da850-async1-clksrc";
			#clock-cells = <0>;
			clocks = <&pll0_sysclk 3>, <&div4p5_clk>;
			clock-names = "pll0_sysclk3", "div4.5";
		};
		async3_clk: async3 {
			compatible = "ti,da850-async3-clksrc";
			#clock-cells = <0>;
			clocks = <&pll0_sysclk 2>, <&pll1_sysclk 2>;
			clock-names = "pll0_sysclk2", "pll1_sysclk2";
		};
	};

Also see:
- Documentation/devicetree/bindings/clock/clock-bindings.txt
```
