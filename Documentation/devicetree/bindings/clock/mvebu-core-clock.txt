## Documentation/devicetree/bindings/clock/nvidia,tegra20-car.txt
```
NVIDIA Tegra20 Clock And Reset Controller

This binding uses the common clock binding:
Documentation/devicetree/bindings/clock/clock-bindings.txt

The CAR (Clock And Reset) Controller on Tegra is the HW module responsible
for muxing and gating Tegra's clocks, and setting their rates.

Required properties :
- compatible : Should be "nvidia,tegra20-car"
- reg : Should contain CAR registers location and length
- clocks : Should contain phandle and clock specifiers for two clocks:
  the 32 KHz "32k_in", and the board-specific oscillator "osc".
- #clock-cells : Should be 1.
  In clock consumers, this cell represents the clock ID exposed by the
  CAR. The assignments may be found in header file
  <dt-bindings/clock/tegra20-car.h>.

Example SoC include file:

/ {
	tegra_car: clock {
		compatible = "nvidia,tegra20-car";
		reg = <0x60006000 0x1000>;
		#clock-cells = <1>;
	};

	usb@c5004000 {
		clocks = <&tegra_car TEGRA20_CLK_USB2>;
	};
};

Example board file:

/ {
	clocks {
		compatible = "simple-bus";
		#address-cells = <1>;
		#size-cells = <0>;

		osc: clock@0 {
			compatible = "fixed-clock";
			reg = <0>;
			#clock-cells = <0>;
			clock-frequency = <12000000>;
		};

		clk_32k: clock@1 {
			compatible = "fixed-clock";
			reg = <1>;
			#clock-cells = <0>;
			clock-frequency = <32768>;
		};
	};

	&tegra_car {
		clocks = <&clk_32k> <&osc>;
	};
};
```

## Documentation/devicetree/bindings/clock/nvidia,tegra20-car.yaml
```yaml
# SPDX-License-Identifier: (GPL-2.0+ OR BSD-2-Clause)
%YAML 1.2
---
$id: http://devicetree.org/schemas/clock/nvidia,tegra20-car.yaml#
$schema: http://devicetree.org/meta-schemas/core.yaml#

title: NVIDIA Tegra Clock and Reset Controller

maintainers:
  - Jon Hunter <jonathanh@nvidia.com>
  - Thierry Reding <thierry.reding@gmail.com>

description: |
  The Clock and Reset (CAR) is the HW module responsible for muxing and gating
  Tegra's clocks, and setting their rates. It comprises CLKGEN and RSTGEN units.

  CLKGEN provides the registers to program the PLLs. It controls most of
  the clock source programming and most of the clock dividers.

  CLKGEN input signals include the external clock for the reference frequency
  (12 MHz, 26 MHz) and the external clock for the Real Time Clock (32.768 KHz).

  Outputs from CLKGEN are inputs clock of the h/w blocks in the Tegra system.

  RSTGEN provides the registers needed to control resetting of each block in
  the Tegra system.

properties:
  compatible:
    enum:
      - nvidia,tegra20-car
      - nvidia,tegra30-car
      - nvidia,tegra114-car
      - nvidia,tegra210-car

  reg:
    maxItems: 1

  '#clock-cells':
    const: 1

  "#reset-cells":
    const: 1

patternProperties:
  "^(sclk)|(pll-[cem])$":
    type: object
    properties:
      compatible:
        enum:
          - nvidia,tegra20-sclk
          - nvidia,tegra30-sclk
          - nvidia,tegra30-pllc
          - nvidia,tegra30-plle
          - nvidia,tegra30-pllm

      operating-points-v2: true

      clocks:
        items:
          - description: node's clock

      power-domains:
        maxItems: 1
        description: phandle to the core SoC power domain

    required:
      - compatible
      - operating-points-v2
      - clocks
      - power-domains

    additionalProperties: false

required:
  - compatible
  - reg
  - '#clock-cells'
  - "#reset-cells"

additionalProperties: false

examples:
  - |
    #include <dt-bindings/clock/tegra20-car.h>

    car: clock-controller@60006000 {
        compatible = "nvidia,tegra20-car";
        reg = <0x60006000 0x1000>;
        #clock-cells = <1>;
        #reset-cells = <1>;

        sclk {
            compatible = "nvidia,tegra20-sclk";
            operating-points-v2 = <&opp_table>;
            clocks = <&tegra_car TEGRA20_CLK_SCLK>;
            power-domains = <&domain>;
        };
    };
```

## Documentation/devicetree/bindings/clock/nvidia,tegra210-car.txt
```
NVIDIA Tegra210 Clock And Reset Controller

This binding uses the common clock binding:
Documentation/devicetree/bindings/clock/clock-bindings.txt

The CAR (Clock And Reset) Controller on Tegra is the HW module responsible
for muxing and gating Tegra's clocks, and setting their rates.

Required properties :
- compatible : Should be "nvidia,tegra210-car"
- reg : Should contain CAR registers location and length
- clocks : Should contain phandle and clock specifiers for two clocks:
  the 32 KHz "32k_in".
- #clock-cells : Should be 1.
  In clock consumers, this cell represents the clock ID exposed by the
  CAR. The assignments may be found in header file
  <dt-bindings/clock/tegra210-car.h>.
- #reset-cells : Should be 1.
  In clock consumers, this cell represents the bit number in the CAR's
  array of CLK_RST_CONTROLLER_RST_DEVICES_* registers.

Example SoC include file:

/ {
	tegra_car: clock {
		compatible = "nvidia,tegra210-car";
		reg = <0x60006000 0x1000>;
		#clock-cells = <1>;
		#reset-cells = <1>;
	};

	usb@c5004000 {
		clocks = <&tegra_car TEGRA210_CLK_USB2>;
	};
};

Example board file:

/ {
	clocks {
		compatible = "simple-bus";
		#address-cells = <1>;
		#size-cells = <0>;

		clk_32k: clock@1 {
			compatible = "fixed-clock";
			reg = <1>;
			#clock-cells = <0>;
			clock-frequency = <32768>;
		};
	};

	&tegra_car {
		clocks = <&clk_32k>;
	};
};
```

## Documentation/devicetree/bindings/clock/nvidia,tegra30-car.txt
```
NVIDIA Tegra30 Clock And Reset Controller

This binding uses the common clock binding:
Documentation/devicetree/bindings/clock/clock-bindings.txt

The CAR (Clock And Reset) Controller on Tegra is the HW module responsible
for muxing and gating Tegra's clocks, and setting their rates.

Required properties :
- compatible : Should be "nvidia,tegra30-car"
- reg : Should contain CAR registers location and length
- clocks : Should contain phandle and clock specifiers for two clocks:
  the 32 KHz "32k_in", and the board-specific oscillator "osc".
- #clock-cells : Should be 1.
  In clock consumers, this cell represents the clock ID exposed by the CAR.

  The first 130 clocks are numbered to match the bits in the CAR's CLK_OUT_ENB
  registers. These IDs often match those in the CAR's RST_DEVICES registers,
  but not in all cases. Some bits in CLK_OUT_ENB affect multiple clocks. In
  this case, those clocks are assigned IDs above 160 in order to highlight
  this issue. Implementations that interpret these clock IDs as bit values
  within the CLK_OUT_ENB or RST_DEVICES registers should be careful to
  explicitly handle these special cases.

  The balance of the clocks controlled by the CAR are assigned IDs of 160 and
  above.

  0	cpu
  1	unassigned
  2	unassigned
  3	unassigned
  4	rtc
  5	timer
  6	uarta
  7	unassigned	(register bit affects uartb and vfir)
  8	gpio
  9	sdmmc2
  10	unassigned	(register bit affects spdif_in and spdif_out)
  11	i2s1
  12	i2c1
  13	ndflash
  14	sdmmc1
  15	sdmmc4
  16	unassigned
  17	pwm
  18	i2s2
  19	epp
  20	unassigned	(register bit affects vi and vi_sensor)
  21	2d
  22	usbd
  23	isp
  24	3d
  25	unassigned
  26	disp2
  27	disp1
  28	host1x
  29	vcp
  30	i2s0
  31	cop_cache

  32	mc
  33	ahbdma
  34	apbdma
  35	unassigned
  36	kbc
  37	statmon
  38	pmc
  39	unassigned	(register bit affects fuse and fuse_burn)
  40	kfuse
  41	sbc1
  42	nor
  43	unassigned
  44	sbc2
  45	unassigned
  46	sbc3
  47	i2c5
  48	dsia
  49	unassigned	(register bit affects cve and tvo)
  50	mipi
  51	hdmi
  52	csi
  53	tvdac
  54	i2c2
  55	uartc
  56	unassigned
  57	emc
  58	usb2
  59	usb3
  60	mpe
  61	vde
  62	bsea
  63	bsev

  64	speedo
  65	uartd
  66	uarte
  67	i2c3
  68	sbc4
  69	sdmmc3
  70	pcie
  71	owr
  72	afi
  73	csite
  74	pciex
  75	avpucq
  76	la
  77	unassigned
  78	unassigned
  79	dtv
  80	ndspeed
  81	i2cslow
  82	dsib
  83	unassigned
  84	irama
  85	iramb
  86	iramc
  87	iramd
  88	cram2
  89	unassigned
  90	audio_2x	a/k/a audio_2x_sync_clk
  91	unassigned
  92	csus
  93	cdev2
  94	cdev1
  95	unassigned

  96	cpu_g
  97	cpu_lp
  98	3d2
  99	mselect
  100	tsensor
  101	i2s3
  102	i2s4
  103	i2c4
  104	sbc5
  105	sbc6
  106	d_audio
  107	apbif
  108	dam0
  109	dam1
  110	dam2
  111	hda2codec_2x
  112	atomics
  113	audio0_2x
  114	audio1_2x
  115	audio2_2x
  116	audio3_2x
  117	audio4_2x
  118	audio5_2x
  119	actmon
  120	extern1
  121	extern2
  122	extern3
  123	sata_oob
  124	sata
  125	hda
  127	se
  128	hda2hdmi
  129	sata_cold

  160	uartb
  161	vfir
  162	spdif_in
  163	spdif_out
  164	vi
  165	vi_sensor
  166	fuse
  167	fuse_burn
  168	cve
  169	tvo

  170	clk_32k
  171	clk_m
  172	clk_m_div2
  173	clk_m_div4
  174	pll_ref
  175	pll_c
  176	pll_c_out1
  177	pll_m
  178	pll_m_out1
  179	pll_p
  180	pll_p_out1
  181	pll_p_out2
  182	pll_p_out3
  183	pll_p_out4
  184	pll_a
  185	pll_a_out0
  186	pll_d
  187	pll_d_out0
  188	pll_d2
  189	pll_d2_out0
  190	pll_u
  191	pll_x
  192	pll_x_out0
  193	pll_e
  194	spdif_in_sync
  195	i2s0_sync
  196	i2s1_sync
  197	i2s2_sync
  198	i2s3_sync
  199	i2s4_sync
  200	vimclk
  201	audio0
  202	audio1
  203	audio2
  204	audio3
  205	audio4
  206	audio5
  207	clk_out_1 (extern1)
  208	clk_out_2 (extern2)
  209	clk_out_3 (extern3)
  210	sclk
  211	blink
  212	cclk_g
  213	cclk_lp
  214	twd
  215	cml0
  216	cml1
  217	hclk
  218	pclk

Example SoC include file:

/ {
	tegra_car: clock {
		compatible = "nvidia,tegra30-car";
		reg = <0x60006000 0x1000>;
		#clock-cells = <1>;
	};

	usb@c5004000 {
		clocks = <&tegra_car 58>; /* usb2 */
	};
};

Example board file:

/ {
	clocks {
		compatible = "simple-bus";
		#address-cells = <1>;
		#size-cells = <0>;

		osc: clock@0 {
			compatible = "fixed-clock";
			reg = <0>;
			#clock-cells = <0>;
			clock-frequency = <12000000>;
		};

		clk_32k: clock@1 {
			compatible = "fixed-clock";
			reg = <1>;
			#clock-cells = <0>;
			clock-frequency = <32768>;
		};
	};

	&tegra_car {
		clocks = <&clk_32k> <&osc>;
	};
};
```

## Documentation/devicetree/bindings/clock/nxp,imx95-display-master-csr.yaml
```yaml
# SPDX-License-Identifier: (GPL-2.0-only OR BSD-2-Clause)
%YAML 1.2
---
$id: http://devicetree.org/schemas/clock/nxp,imx95-display-master-csr.yaml#
$schema: http://devicetree.org/meta-schemas/core.yaml#

title: NXP i.MX95 Display Master Block Control

maintainers:
  - Peng Fan <peng.fan@nxp.com>

properties:
  compatible:
    items:
      - const: nxp,imx95-display-master-csr
      - const: syscon

  reg:
    maxItems: 1

  power-domains:
    maxItems: 1

  clocks:
    maxItems: 1

  '#clock-cells':
    const: 1
    description:
      The clock consumer should specify the desired clock by having the clock
      ID in its "clocks" phandle cell. See
      include/dt-bindings/clock/nxp,imx95-clock.h

  mux-controller:
    type: object
    $ref: /schemas/mux/reg-mux.yaml

required:
  - compatible
  - reg
  - '#clock-cells'
  - mux-controller
  - power-domains
  - clocks

additionalProperties: false

examples:
  - |
    syscon@4c410000 {
      compatible = "nxp,imx95-display-master-csr", "syscon";
      reg = <0x4c410000 0x10000>;
      #clock-cells = <1>;
      clocks = <&scmi_clk 62>;
      power-domains = <&scmi_devpd 3>;

      mux: mux-controller {
        compatible = "mmio-mux";
        #mux-control-cells = <1>;
        mux-reg-masks = <0x4 0x00000001>; /* Pixel_link_sel */
        idle-states = <0>;
      };
    };
...
```

## Documentation/devicetree/bindings/clock/nxp,lpc1850-ccu.yaml
```yaml
# SPDX-License-Identifier: (GPL-2.0-only OR BSD-2-Clause)
%YAML 1.2
---
$id: http://devicetree.org/schemas/clock/nxp,lpc1850-ccu.yaml#
$schema: http://devicetree.org/meta-schemas/core.yaml#

title: NXP LPC1850 Clock Control Unit (CCU)

description:
  Each CGU base clock has several clock branches which can be turned on
  or off independently by the Clock Control Units CCU1 or CCU2. The
  branch clocks are distributed between CCU1 and CCU2.

  Above text taken from NXP LPC1850 User Manual

maintainers:
  - Frank Li <Frank.Li@nxp.com>

properties:
  compatible:
    const: nxp,lpc1850-ccu

  reg:
    maxItems: 1

  '#clock-cells':
    const: 1

  clocks:
    minItems: 1
    maxItems: 8

  clock-names:
    minItems: 1
    maxItems: 8
    items:
      enum:
        - base_usb0_clk
        - base_periph_clk
        - base_usb1_clk
        - base_cpu_clk
        - base_spifi_clk
        - base_spi_clk
        - base_apb1_clk
        - base_apb3_clk
        - base_adchs_clk
        - base_sdio_clk
        - base_ssp0_clk
        - base_ssp1_clk
        - base_uart0_clk
        - base_uart1_clk
        - base_uart2_clk
        - base_uart3_clk
        - base_audio_clk
    description:
      Which branch clocks that are available on the CCU depends on the
      specific LPC part. Check the user manual for your specific part.

      A list of CCU clocks can be found in dt-bindings/clock/lpc18xx-ccu.h.

required:
  - compatible
  - reg
  - '#clock-cells'
  - clocks
  - clock-names

additionalProperties: false

examples:
  - |
    #include <dt-bindings/clock/lpc18xx-cgu.h>

    clock-controller@40051000 {
        compatible = "nxp,lpc1850-ccu";
        reg = <0x40051000 0x1000>;
        #clock-cells = <1>;
        clocks = <&cgu BASE_APB3_CLK>, <&cgu BASE_APB1_CLK>,
                 <&cgu BASE_SPIFI_CLK>, <&cgu BASE_CPU_CLK>,
                 <&cgu BASE_PERIPH_CLK>, <&cgu BASE_USB0_CLK>,
                 <&cgu BASE_USB1_CLK>, <&cgu BASE_SPI_CLK>;
        clock-names = "base_apb3_clk",   "base_apb1_clk",
                      "base_spifi_clk",  "base_cpu_clk",
                      "base_periph_clk", "base_usb0_clk",
                      "base_usb1_clk",   "base_spi_clk";
    };

  - |
    #include <dt-bindings/clock/lpc18xx-cgu.h>

    clock-controller@40052000 {
        compatible = "nxp,lpc1850-ccu";
        reg = <0x40052000 0x1000>;
        #clock-cells = <1>;
        clocks = <&cgu BASE_AUDIO_CLK>, <&cgu BASE_UART3_CLK>,
                 <&cgu BASE_UART2_CLK>, <&cgu BASE_UART1_CLK>,
                 <&cgu BASE_UART0_CLK>, <&cgu BASE_SSP1_CLK>,
                 <&cgu BASE_SSP0_CLK>,  <&cgu BASE_SDIO_CLK>;
        clock-names = "base_audio_clk", "base_uart3_clk",
                      "base_uart2_clk", "base_uart1_clk",
                      "base_uart0_clk", "base_ssp1_clk",
                      "base_ssp0_clk",  "base_sdio_clk";
    };
```
