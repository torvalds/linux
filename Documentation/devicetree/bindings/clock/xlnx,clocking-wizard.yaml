## Documentation/devicetree/bindings/clock/xlnx,clocking-wizard.yaml
```yaml
# SPDX-License-Identifier: (GPL-2.0-only OR BSD-2-Clause)
%YAML 1.2
---
$id: http://devicetree.org/schemas/clock/xlnx,clocking-wizard.yaml#
$schema: http://devicetree.org/meta-schemas/core.yaml#

title: Xilinx clocking wizard

maintainers:
  - Shubhrajyoti Datta <shubhrajyoti.datta@xilinx.com>

description:
  The clocking wizard is a soft ip clocking block of Xilinx versal. It
  reads required input clock frequencies from the devicetree and acts as clock
  clock output.

properties:
  compatible:
    enum:
      - xlnx,clocking-wizard
      - xlnx,clocking-wizard-v5.2
      - xlnx,clocking-wizard-v6.0


  reg:
    maxItems: 1

  "#clock-cells":
    const: 1

  clocks:
    items:
      - description: clock input
      - description: axi clock

  clock-names:
    items:
      - const: clk_in1
      - const: s_axi_aclk


  xlnx,speed-grade:
    $ref: /schemas/types.yaml#/definitions/uint32
    enum: [1, 2, 3]
    description:
      Speed grade of the device. Higher the speed grade faster is the FPGA device.

  xlnx,nr-outputs:
    $ref: /schemas/types.yaml#/definitions/uint32
    minimum: 1
    maximum: 8
    description:
      Number of outputs.

required:
  - compatible
  - reg
  - "#clock-cells"
  - clocks
  - clock-names
  - xlnx,speed-grade
  - xlnx,nr-outputs

additionalProperties: false

examples:
  - |
    clock-controller@b0000000  {
        compatible = "xlnx,clocking-wizard";
        reg = <0xb0000000 0x10000>;
        #clock-cells = <1>;
        xlnx,speed-grade = <1>;
        xlnx,nr-outputs = <6>;
        clock-names = "clk_in1", "s_axi_aclk";
        clocks = <&clkc 15>, <&clkc 15>;
    };
...
```

## Documentation/devicetree/bindings/clock/xlnx,vcu.yaml
```yaml
# SPDX-License-Identifier: (GPL-2.0 OR BSD-2-Clause)
%YAML 1.2
---
$id: http://devicetree.org/schemas/clock/xlnx,vcu.yaml#
$schema: http://devicetree.org/meta-schemas/core.yaml#
title: LogicoreIP designed compatible with Xilinx ZYNQ family.

maintainers:
  - Rohit Visavalia <rohit.visavalia@amd.com>

description:
  LogicoreIP design to provide the isolation between processing system
  and programmable logic. Also provides the list of register set to configure
  the frequency.

properties:
  compatible:
    items:
      - enum:
          - xlnx,vcu
          - xlnx,vcu-logicoreip-1.0

  reg:
    maxItems: 1

  clocks:
    items:
      - description: pll ref clocksource
      - description: aclk

  clock-names:
    items:
      - const: pll_ref
      - const: aclk

  reset-gpios:
    maxItems: 1

required:
  - reg
  - clocks
  - clock-names

additionalProperties: false

examples:
  - |
    #include <dt-bindings/gpio/gpio.h>
    fpga {
        #address-cells = <2>;
        #size-cells = <2>;
        xlnx_vcu: vcu@a0040000 {
            compatible = "xlnx,vcu-logicoreip-1.0";
            reg = <0x0 0xa0040000 0x0 0x1000>;
            reset-gpios = <&gpio 78 GPIO_ACTIVE_HIGH>;
            clocks = <&si570_1>, <&clkc 71>;
            clock-names = "pll_ref", "aclk";
        };
    };
```

## Documentation/devicetree/bindings/clock/xlnx,zynqmp-clk.txt
```
--------------------------------------------------------------------------
Device Tree Clock bindings for the Zynq Ultrascale+ MPSoC controlled using
Zynq MPSoC firmware interface
--------------------------------------------------------------------------
The clock controller is a h/w block of Zynq Ultrascale+ MPSoC clock
tree. It reads required input clock frequencies from the devicetree and acts
as clock provider for all clock consumers of PS clocks.

See clock_bindings.txt for more information on the generic clock bindings.

Required properties:
 - #clock-cells:	Must be 1
 - compatible:		Must contain:	"xlnx,zynqmp-clk"
 - clocks:		List of clock specifiers which are external input
			clocks to the given clock controller. Please refer
			the next section to find the input clocks for a
			given controller.
 - clock-names:		List of clock names which are exteral input clocks
			to the given clock controller. Please refer to the
			clock bindings for more details.

Input clocks for zynqmp Ultrascale+ clock controller:

The Zynq UltraScale+ MPSoC has one primary and four alternative reference clock
inputs. These required clock inputs are:
 - pss_ref_clk (PS reference clock)
 - video_clk (reference clock for video system )
 - pss_alt_ref_clk (alternative PS reference clock)
 - aux_ref_clk
 - gt_crx_ref_clk (transceiver reference clock)

The following strings are optional parameters to the 'clock-names' property in
order to provide an optional (E)MIO clock source:
 - swdt0_ext_clk
 - swdt1_ext_clk
 - gem0_emio_clk
 - gem1_emio_clk
 - gem2_emio_clk
 - gem3_emio_clk
 - mio_clk_XX		# with XX = 00..77
 - mio_clk_50_or_51	#for the mux clock to gem tsu from 50 or 51


Output clocks are registered based on clock information received
from firmware. Output clocks indexes are mentioned in
include/dt-bindings/clock/xlnx-zynqmp-clk.h.

-------
Example
-------

firmware {
	zynqmp_firmware: zynqmp-firmware {
		compatible = "xlnx,zynqmp-firmware";
		method = "smc";
		zynqmp_clk: clock-controller {
			#clock-cells = <1>;
			compatible = "xlnx,zynqmp-clk";
			clocks = <&pss_ref_clk>, <&video_clk>, <&pss_alt_ref_clk>, <&aux_ref_clk>, <&gt_crx_ref_clk>;
			clock-names = "pss_ref_clk", "video_clk", "pss_alt_ref_clk","aux_ref_clk", "gt_crx_ref_clk";
		};
	};
};
```

## Documentation/devicetree/bindings/clock/zx296702-clk.txt
```
Device Tree Clock bindings for ZTE zx296702

This binding uses the common clock binding[1].

[1] Documentation/devicetree/bindings/clock/clock-bindings.txt

Required properties:
- compatible : shall be one of the following:
	"zte,zx296702-topcrm-clk":
		zx296702 top clock selection, divider and gating

	"zte,zx296702-lsp0crpm-clk" and
	"zte,zx296702-lsp1crpm-clk":
		zx296702 device level clock selection and gating

- reg: Address and length of the register set

The clock consumer should specify the desired clock by having the clock
ID in its "clocks" phandle cell. See include/dt-bindings/clock/zx296702-clock.h
for the full list of zx296702 clock IDs.


topclk: topcrm@0x09800000 {
        compatible = "zte,zx296702-topcrm-clk";
        reg = <0x09800000 0x1000>;
        #clock-cells = <1>;
};

uart0: serial@0x09405000 {
        compatible = "zte,zx296702-uart";
        reg = <0x09405000 0x1000>;
        interrupts = <GIC_SPI 37 IRQ_TYPE_LEVEL_HIGH>;
        clocks = <&lsp1clk ZX296702_UART0_PCLK>;
};
```

## Documentation/devicetree/bindings/clock/zx296718-clk.txt
```
Device Tree Clock bindings for ZTE zx296718

This binding uses the common clock binding[1].

[1] Documentation/devicetree/bindings/clock/clock-bindings.txt

Required properties:
- compatible : shall be one of the following:
	"zte,zx296718-topcrm":
		zx296718 top clock selection, divider and gating

	"zte,zx296718-lsp0crm" and
	"zte,zx296718-lsp1crm":
		zx296718 device level clock selection and gating

	"zte,zx296718-audiocrm":
		zx296718 audio clock selection, divider and gating

- reg: Address and length of the register set

The clock consumer should specify the desired clock by having the clock
ID in its "clocks" phandle cell. See include/dt-bindings/clock/zx296718-clock.h
for the full list of zx296718 clock IDs.


topclk: topcrm@1461000 {
        compatible = "zte,zx296718-topcrm-clk";
        reg = <0x01461000 0x1000>;
        #clock-cells = <1>;
};

usbphy0:usb-phy0 {
	compatible = "zte,zx296718-usb-phy";
	#phy-cells = <0>;
	clocks = <&topclk USB20_PHY_CLK>;
	clock-names = "phyclk";
	status = "okay";
};
```

## Documentation/devicetree/bindings/clock/zynq-7000.txt
```
Device Tree Clock bindings for the Zynq 7000 EPP

The Zynq EPP has several different clk providers, each with there own bindings.
The purpose of this document is to document their usage.

See clock_bindings.txt for more information on the generic clock bindings.
See Chapter 25 of Zynq TRM for more information about Zynq clocks.

== Clock Controller ==
The clock controller is a logical abstraction of Zynq's clock tree. It reads
required input clock frequencies from the devicetree and acts as clock provider
for all clock consumers of PS clocks.

Required properties:
 - #clock-cells : Must be 1
 - compatible : "xlnx,ps7-clkc"
 - ps-clk-frequency : Frequency of the oscillator providing ps_clk in HZ
		      (usually 33 MHz oscillators are used for Zynq platforms)
 - clock-output-names : List of strings used to name the clock outputs. Shall be
			a list of the outputs given below.

Optional properties:
 - clocks : as described in the clock bindings
 - clock-names : as described in the clock bindings
 - fclk-enable : Bit mask to enable FCLKs statically at boot time.
		 Bit [0..3] correspond to FCLK0..FCLK3. The corresponding
		 FCLK will only be enabled if it is actually running at
		 boot time.

Clock inputs:
The following strings are optional parameters to the 'clock-names' property in
order to provide an optional (E)MIO clock source.
 - swdt_ext_clk
 - gem0_emio_clk
 - gem1_emio_clk
 - mio_clk_XX		# with XX = 00..53
...

Clock outputs:
 0:  armpll
 1:  ddrpll
 2:  iopll
 3:  cpu_6or4x
 4:  cpu_3or2x
 5:  cpu_2x
 6:  cpu_1x
 7:  ddr2x
 8:  ddr3x
 9:  dci
 10: lqspi
 11: smc
 12: pcap
 13: gem0
 14: gem1
 15: fclk0
 16: fclk1
 17: fclk2
 18: fclk3
 19: can0
 20: can1
 21: sdio0
 22: sdio1
 23: uart0
 24: uart1
 25: spi0
 26: spi1
 27: dma
 28: usb0_aper
 29: usb1_aper
 30: gem0_aper
 31: gem1_aper
 32: sdio0_aper
 33: sdio1_aper
 34: spi0_aper
 35: spi1_aper
 36: can0_aper
 37: can1_aper
 38: i2c0_aper
 39: i2c1_aper
 40: uart0_aper
 41: uart1_aper
 42: gpio_aper
 43: lqspi_aper
 44: smc_aper
 45: swdt
 46: dbg_trc
 47: dbg_apb

Example:
	clkc: clkc {
		#clock-cells = <1>;
		compatible = "xlnx,ps7-clkc";
		ps-clk-frequency = <33333333>;
		clock-output-names = "armpll", "ddrpll", "iopll", "cpu_6or4x",
				"cpu_3or2x", "cpu_2x", "cpu_1x", "ddr2x", "ddr3x",
				"dci", "lqspi", "smc", "pcap", "gem0", "gem1",
				"fclk0", "fclk1", "fclk2", "fclk3", "can0", "can1",
				"sdio0", "sdio1", "uart0", "uart1", "spi0", "spi1",
				"dma", "usb0_aper", "usb1_aper", "gem0_aper",
				"gem1_aper", "sdio0_aper", "sdio1_aper",
				"spi0_aper", "spi1_aper", "can0_aper", "can1_aper",
				"i2c0_aper", "i2c1_aper", "uart0_aper", "uart1_aper",
				"gpio_aper", "lqspi_aper", "smc_aper", "swdt",
				"dbg_trc", "dbg_apb";
		# optional props
		clocks = <&clkc 16>, <&clk_foo>;
		clock-names = "gem1_emio_clk", "can_mio_clk_23";
	};
```

## Documentation/devicetree/bindings/common-properties.txt
```
Common properties
=================

Endianness
----------

The Devicetree Specification does not define any properties related to hardware
byte swapping, but endianness issues show up frequently in porting drivers to
different machine types.  This document attempts to provide a consistent
way of handling byte swapping across drivers.

Optional properties:
 - big-endian: Boolean; force big endian register accesses
   unconditionally (e.g. ioread32be/iowrite32be).  Use this if you
   know the peripheral always needs to be accessed in big endian (BE) mode.
 - little-endian: Boolean; force little endian register accesses
   unconditionally (e.g. readl/writel).  Use this if you know the
   peripheral always needs to be accessed in little endian (LE) mode.
 - native-endian: Boolean; always use register accesses matched to the
   endianness of the kernel binary (e.g. LE vmlinux -> readl/writel,
   BE vmlinux -> ioread32be/iowrite32be).  In this case no byte swaps
   will ever be performed.  Use this if the hardware "self-adjusts"
   register endianness based on the CPU's configured endianness.

If a binding supports these properties, then the binding should also
specify the default behavior if none of these properties are present.
In such cases, little-endian is the preferred default, but it is not
a requirement.  Some implementations assume that little-endian is
the default, because most existing (PCI-based) drivers implicitly
default to LE for their MMIO accesses.

Examples:
Scenario 1 : CPU in LE mode & device in LE mode.
dev: dev@40031000 {
	      compatible = "name";
	      reg = <0x40031000 0x1000>;
	      ...
	      native-endian;
};

Scenario 2 : CPU in LE mode & device in BE mode.
dev: dev@40031000 {
	      compatible = "name";
	      reg = <0x40031000 0x1000>;
	      ...
	      big-endian;
};

Scenario 3 : CPU in BE mode & device in BE mode.
dev: dev@40031000 {
	      compatible = "name";
	      reg = <0x40031000 0x1000>;
	      ...
	      native-endian;
};

Scenario 4 : CPU in BE mode & device in LE mode.
dev: dev@40031000 {
	      compatible = "name";
	      reg = <0x40031000 0x1000>;
	      ...
	      little-endian;
};

Daisy-chained devices
---------------------

Many serially-attached GPIO and IIO devices are daisy-chainable.  To the
host controller, a daisy-chain appears as a single device, but the number
of inputs and outputs it provides is the sum of inputs and outputs provided
by all of its devices.  The driver needs to know how many devices the
daisy-chain comprises to determine the amount of data exchanged, how many
inputs and outputs to register and so on.

Optional properties:
 - #daisy-chained-devices: Number of devices in the daisy-chain (default is 1).

Example:
gpio@0 {
	      compatible = "name";
	      reg = <0>;
	      gpio-controller;
	      #gpio-cells = <2>;
	      #daisy-chained-devices = <3>;
};
```

## Documentation/devicetree/bindings/connector/gocontroll,moduline-module-slot.yaml
```yaml
# SPDX-License-Identifier: (GPL-2.0-only OR BSD-2-Clause)
%YAML 1.2
---
$id: http://devicetree.org/schemas/connector/gocontroll,moduline-module-slot.yaml#
$schema: http://devicetree.org/meta-schemas/core.yaml#

title: GOcontroll Moduline Module slot

maintainers:
  - Maud Spierings <maudspierings@gocontroll.com>

description:
  The GOcontroll Moduline module slot represents a connector that fullfills the
  Moduline slot specification, and can thus house any IO module that is also
  built to this spec.

properties:
  compatible:
    const: gocontroll,moduline-module-slot

  reg:
    maxItems: 1

  interrupts:
    description: indicates readiness, high means busy.
    maxItems: 1
  reset-gpios:
    description: resets the module, active low.
    maxItems: 1
  sync-gpios:
    description: sync line between all module slots.
    maxItems: 1

  vdd-supply:
    description: low power 3v3 supply generally for the microcontroller.
  vddp-supply:
    description: medium power 5v0 supply for on module low power peripherals.
  vddhpp-supply:
    description: high power 6v-8v supply for on module high power peripherals.
  power-supply:
    description: high power 6v-30v supply for high power module circuits.

  i2c-bus:
    description: i2c bus shared between module slots and the SoC
    $ref: /schemas/types.yaml#/definitions/phandle

  slot-number:
    description:
      The number of the module slot representing the location of on the pcb.
      This enables access to the modules based on slot location.
    $ref: /schemas/types.yaml#/definitions/uint32

  spi-max-frequency: true

required:
  - compatible
  - reg
  - reset-gpios
  - interrupts
  - sync-gpios
  - i2c-bus
  - slot-number

additionalProperties: false

examples:
  - |
    #include <dt-bindings/gpio/gpio.h>
    #include <dt-bindings/interrupt-controller/irq.h>

    spi {
        #address-cells = <1>;
        #size-cells = <0>;

        connector@0 {
            reg = <0>;
            compatible = "gocontroll,moduline-module-slot";
            reset-gpios = <&gpio5 10 GPIO_ACTIVE_LOW>;
            sync-gpios = <&gpio4 16 GPIO_ACTIVE_HIGH>;
            interrupt-parent = <&gpio4>;
            interrupts = <5 IRQ_TYPE_EDGE_FALLING>;
            vdd-supply = <&reg_3v3_per>;
            vddp-supply = <&reg_5v0>;
            vddhpp-supply = <&reg_6v4>;
            i2c-bus = <&i2c2>;
            slot-number = <1>;
        };
    };
```
