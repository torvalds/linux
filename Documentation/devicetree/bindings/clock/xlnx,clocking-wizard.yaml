## Documentation/devicetree/bindings/counter/fsl,ftm-quaddec.yaml
```yaml
# SPDX-License-Identifier: (GPL-2.0-only OR BSD-2-Clause)
%YAML 1.2
---
$id: http://devicetree.org/schemas/counter/fsl,ftm-quaddec.yaml#
$schema: http://devicetree.org/meta-schemas/core.yaml#

title: FlexTimer Quadrature decoder counter

description:
  Exposes a simple counter for the quadrature decoder mode.

maintainers:
  - Frank Li <Frank.li@nxp.com>

properties:
  compatible:
    const: fsl,ftm-quaddec

  reg:
    maxItems: 1

  big-endian: true

required:
  - compatible
  - reg

additionalProperties: false

examples:
  - |
    counter@29d0000 {
       compatible = "fsl,ftm-quaddec";
       reg = <0x29d0000 0x10000>;
       big-endian;
    };
```

## Documentation/devicetree/bindings/counter/ftm-quaddec.txt
```
FlexTimer Quadrature decoder counter

This driver exposes a simple counter for the quadrature decoder mode.

Required properties:
- compatible:		Must be "fsl,ftm-quaddec".
- reg:			Must be set to the memory region of the flextimer.

Optional property:
- big-endian:		Access the device registers in big-endian mode.

Example:
		counter0: counter@29d0000 {
			compatible = "fsl,ftm-quaddec";
			reg = <0x0 0x29d0000 0x0 0x10000>;
			big-endian;
			status = "disabled";
		};
```

## Documentation/devicetree/bindings/counter/interrupt-counter.yaml
```yaml
# SPDX-License-Identifier: GPL-2.0
%YAML 1.2
---
$id: http://devicetree.org/schemas/counter/interrupt-counter.yaml#
$schema: http://devicetree.org/meta-schemas/core.yaml#

title: Interrupt counter

maintainers:
  - Oleksij Rempel <o.rempel@pengutronix.de>

description: |
  A generic interrupt counter to measure interrupt frequency. It was developed
  and used for agricultural devices to measure rotation speed of wheels or
  other tools. Since the direction of rotation is not important, only one
  signal line is needed.
  Interrupts or gpios are required. If both are defined, the interrupt will
  take precedence for counting interrupts.

properties:
  compatible:
    const: interrupt-counter

  interrupts:
    maxItems: 1

  gpios:
    maxItems: 1

required:
  - compatible

anyOf:
  - required: [ interrupts-extended ]
  - required: [ interrupts ]
  - required: [ gpios ]

additionalProperties: false

examples:
  - |

    #include <dt-bindings/interrupt-controller/irq.h>
    #include <dt-bindings/gpio/gpio.h>

    counter-0 {
        compatible = "interrupt-counter";
        interrupts-extended = <&gpio 0 IRQ_TYPE_EDGE_RISING>;
    };

    counter-1 {
        compatible = "interrupt-counter";
        gpios = <&gpio 2 GPIO_ACTIVE_HIGH>;
    };

    counter-2 {
        compatible = "interrupt-counter";
        interrupts-extended = <&gpio 2 IRQ_TYPE_EDGE_RISING>;
        gpios = <&gpio 2 GPIO_ACTIVE_HIGH>;
    };

...
```

## Documentation/devicetree/bindings/counter/stm32-lptimer-cnt.txt
```
STMicroelectronics STM32 Low-Power Timer quadrature encoder and counter

STM32 Low-Power Timer provides several counter modes. It can be used as:
- quadrature encoder to detect angular position and direction of rotary
  elements, from IN1 and IN2 input signals.
- simple counter from IN1 input signal.

Must be a sub-node of an STM32 Low-Power Timer device tree node.
See ../mfd/stm32-lptimer.txt for details about the parent node.

Required properties:
- compatible:		Must be "st,stm32-lptimer-counter".
- pinctrl-names: 	Set to "default". An additional "sleep" state can be
			defined to set pins in sleep state.
- pinctrl-n: 		List of phandles pointing to pin configuration nodes,
			to set IN1/IN2 pins in mode of operation for Low-Power
			Timer input on external pin.

Example:
	timer@40002400 {
		compatible = "st,stm32-lptimer";
		...
		counter {
			compatible = "st,stm32-lptimer-counter";
			pinctrl-names = "default", "sleep";
			pinctrl-0 = <&lptim1_in_pins>;
			pinctrl-1 = <&lptim1_sleep_in_pins>;
		};
	};
```

## Documentation/devicetree/bindings/counter/stm32-timer-cnt.txt
```
STMicroelectronics STM32 Timer quadrature encoder

STM32 Timer provides quadrature encoder to detect
angular position and direction of rotary elements,
from IN1 and IN2 input signals.

Must be a sub-node of an STM32 Timer device tree node.
See ../mfd/stm32-timers.txt for details about the parent node.

Required properties:
- compatible:		Must be "st,stm32-timer-counter".
- pinctrl-names: 	Set to "default".
- pinctrl-0: 		List of phandles pointing to pin configuration nodes,
			to set CH1/CH2 pins in mode of operation for STM32
			Timer input on external pin.

Example:
	timers@40010000 {
		#address-cells = <1>;
		#size-cells = <0>;
		compatible = "st,stm32-timers";
		reg = <0x40010000 0x400>;
		clocks = <&rcc 0 160>;
		clock-names = "int";

		counter {
			compatible = "st,stm32-timer-counter";
			pinctrl-names = "default";
			pinctrl-0 = <&tim1_in_pins>;
		};
	};
```

## Documentation/devicetree/bindings/counter/ti,am62-ecap-capture.yaml
```yaml
# SPDX-License-Identifier: (GPL-2.0-only OR BSD-2-Clause)
%YAML 1.2
---
$id: http://devicetree.org/schemas/counter/ti,am62-ecap-capture.yaml#
$schema: http://devicetree.org/meta-schemas/core.yaml#

title: Texas Instruments Enhanced Capture (eCAP) Module

maintainers:
  - Julien Panis <jpanis@baylibre.com>

description: |
  The eCAP module resources can be used to capture timestamps
  on input signal events (falling/rising edges).

properties:
  compatible:
    const: ti,am62-ecap-capture

  reg:
    maxItems: 1

  interrupts:
    maxItems: 1

  clocks:
    maxItems: 1

  clock-names:
    const: fck

  power-domains:
    maxItems: 1

required:
  - compatible
  - reg
  - interrupts
  - clocks
  - clock-names

additionalProperties: false

examples:
  - |
    #include <dt-bindings/interrupt-controller/arm-gic.h>
    #include <dt-bindings/soc/ti,sci_pm_domain.h>

    soc {
        #address-cells = <2>;
        #size-cells = <2>;

        capture@23100000 { /* eCAP in capture mode on am62x */
            compatible = "ti,am62-ecap-capture";
            reg = <0x00 0x23100000 0x00 0x100>;
            interrupts = <GIC_SPI 113 IRQ_TYPE_EDGE_RISING>;
            power-domains = <&k3_pds 51 TI_SCI_PD_EXCLUSIVE>;
            clocks = <&k3_clks 51 0>;
            clock-names = "fck";
        };
    };
```

## Documentation/devicetree/bindings/counter/ti-eqep.yaml
```yaml
# SPDX-License-Identifier: GPL-2.0
%YAML 1.2
---
$id: http://devicetree.org/schemas/counter/ti-eqep.yaml#
$schema: http://devicetree.org/meta-schemas/core.yaml#

title: Texas Instruments Enhanced Quadrature Encoder Pulse (eQEP) Module

maintainers:
  - David Lechner <david@lechnology.com>

properties:
  compatible:
    enum:
      - ti,am3352-eqep
      - ti,am62-eqep

  reg:
    maxItems: 1

  interrupts:
    description: The eQEP event interrupt
    maxItems: 1

  clocks:
    description: The functional and interface clock that determines the clock
      rate for the eQEP peripheral.
    maxItems: 1

  clock-names:
    const: sysclkout

  power-domains:
    maxItems: 1

allOf:
  - if:
      properties:
        compatible:
          contains:
            enum:
              - ti,am62-eqep
    then:
      properties:
        clock-names: false

      required:
        - power-domains

required:
  - compatible
  - reg
  - interrupts
  - clocks

additionalProperties: false

examples:
  - |
    eqep0: counter@180 {
        compatible = "ti,am3352-eqep";
        reg = <0x180 0x80>;
        clocks = <&l4ls_gclk>;
        interrupts = <79>;
    };

...
```
