## Documentation/devicetree/bindings/clock/qcom,sm4450-gcc.yaml
```yaml
# SPDX-License-Identifier: (GPL-2.0-only OR BSD-2-Clause)
%YAML 1.2
---
$id: http://devicetree.org/schemas/clock/qcom,sm4450-gcc.yaml#
$schema: http://devicetree.org/meta-schemas/core.yaml#

title: Qualcomm Global Clock & Reset Controller on SM4450

maintainers:
  - Ajit Pandey <quic_ajipan@quicinc.com>
  - Taniya Das <quic_tdas@quicinc.com>

description: |
  Qualcomm global clock control module provides the clocks, resets and power
  domains on SM4450

  See also:: include/dt-bindings/clock/qcom,sm4450-gcc.h

properties:
  compatible:
    const: qcom,sm4450-gcc

  clocks:
    items:
      - description: Board XO source
      - description: Sleep clock source
      - description: UFS Phy Rx symbol 0 clock source
      - description: UFS Phy Rx symbol 1 clock source
      - description: UFS Phy Tx symbol 0 clock source
      - description: USB3 Phy wrapper pipe clock source

required:
  - compatible
  - clocks

allOf:
  - $ref: qcom,gcc.yaml#

unevaluatedProperties: false

examples:
  - |
    #include <dt-bindings/clock/qcom,rpmh.h>
    clock-controller@100000 {
      compatible = "qcom,sm4450-gcc";
      reg = <0x00100000 0x001f4200>;
      clocks = <&rpmhcc RPMH_CXO_CLK>, <&sleep_clk>,
               <&ufs_mem_phy 0>, <&ufs_mem_phy 1>,
               <&ufs_mem_phy 2>, <&usb_1_qmpphy>;
      #clock-cells = <1>;
      #reset-cells = <1>;
      #power-domain-cells = <1>;
    };

...
```

## Documentation/devicetree/bindings/clock/qcom,sm6115-dispcc.yaml
```yaml
# SPDX-License-Identifier: (GPL-2.0-only OR BSD-2-Clause)
%YAML 1.2
---
$id: http://devicetree.org/schemas/clock/qcom,sm6115-dispcc.yaml#
$schema: http://devicetree.org/meta-schemas/core.yaml#

title: Qualcomm Display Clock Controller for SM6115

maintainers:
  - Bjorn Andersson <andersson@kernel.org>

description: |
  Qualcomm display clock control module provides the clocks and power domains
  on SM6115.

  See also:: include/dt-bindings/clock/qcom,sm6115-dispcc.h

properties:
  compatible:
    enum:
      - qcom,sm6115-dispcc

  clocks:
    items:
      - description: Board XO source
      - description: Board sleep clock
      - description: Byte clock from DSI PHY0
      - description: Pixel clock from DSI PHY0
      - description: GPLL0 DISP DIV clock from GCC

  '#clock-cells':
    const: 1

  '#reset-cells':
    const: 1

  '#power-domain-cells':
    const: 1

  reg:
    maxItems: 1

required:
  - compatible
  - reg
  - clocks
  - '#clock-cells'
  - '#reset-cells'
  - '#power-domain-cells'

additionalProperties: false

examples:
  - |
    #include <dt-bindings/clock/qcom,rpmcc.h>
    #include <dt-bindings/clock/qcom,gcc-sm6115.h>
    clock-controller@5f00000 {
      compatible = "qcom,sm6115-dispcc";
      reg = <0x5f00000 0x20000>;
      clocks = <&rpmcc RPM_SMD_XO_CLK_SRC>,
               <&sleep_clk>,
               <&dsi0_phy 0>,
               <&dsi0_phy 1>,
               <&gcc GCC_DISP_GPLL0_DIV_CLK_SRC>;
      #clock-cells = <1>;
      #reset-cells = <1>;
      #power-domain-cells = <1>;
    };
...
```

## Documentation/devicetree/bindings/clock/qcom,sm6115-gpucc.yaml
```yaml
# SPDX-License-Identifier: (GPL-2.0-only OR BSD-2-Clause)
%YAML 1.2
---
$id: http://devicetree.org/schemas/clock/qcom,sm6115-gpucc.yaml#
$schema: http://devicetree.org/meta-schemas/core.yaml#

title: Qualcomm Graphics Clock & Reset Controller on SM6115

maintainers:
  - Konrad Dybcio <konradybcio@kernel.org>

description: |
  Qualcomm graphics clock control module provides clocks, resets and power
  domains on Qualcomm SoCs.

  See also: include/dt-bindings/clock/qcom,sm6115-gpucc.h

properties:
  compatible:
    enum:
      - qcom,sm6115-gpucc

  clocks:
    items:
      - description: Board XO source
      - description: GPLL0 main branch source
      - description: GPLL0 main div source

required:
  - compatible
  - clocks

allOf:
  - $ref: qcom,gcc.yaml#

unevaluatedProperties: false

examples:
  - |
    #include <dt-bindings/clock/qcom,gcc-sm6115.h>
    #include <dt-bindings/clock/qcom,rpmcc.h>

    soc {
        #address-cells = <1>;
        #size-cells = <1>;

        clock-controller@5990000 {
            compatible = "qcom,sm6115-gpucc";
            reg = <0x05990000 0x9000>;
            clocks = <&rpmcc RPM_SMD_XO_CLK_SRC>,
                     <&gcc GCC_GPU_GPLL0_CLK_SRC>,
                     <&gcc GCC_GPU_GPLL0_DIV_CLK_SRC>;
            #clock-cells = <1>;
            #reset-cells = <1>;
            #power-domain-cells = <1>;
        };
    };
...
```

## Documentation/devicetree/bindings/clock/qcom,sm6115-lpasscc.yaml
```yaml
# SPDX-License-Identifier: (GPL-2.0-only OR BSD-2-Clause)
%YAML 1.2
---
$id: http://devicetree.org/schemas/clock/qcom,sm6115-lpasscc.yaml#
$schema: http://devicetree.org/meta-schemas/core.yaml#

title: Qualcomm LPASS Core & Audio Clock Controller on SM6115

maintainers:
  - Konrad Dybcio <konradybcio@kernel.org>
  - Srinivas Kandagatla <srinivas.kandagatla@linaro.org>

description: |
  Qualcomm LPASS core and audio clock controllers provide audio-related resets
  on SM6115 and its derivatives.

  See also::
    include/dt-bindings/clock/qcom,sm6115-lpasscc.h

properties:
  compatible:
    enum:
      - qcom,sm6115-lpassaudiocc
      - qcom,sm6115-lpasscc

  reg:
    maxItems: 1

  '#reset-cells':
    const: 1

required:
  - compatible
  - reg
  - '#reset-cells'

additionalProperties: false

examples:
  - |
    lpass_audiocc: clock-controller@a6a9000 {
        compatible = "qcom,sm6115-lpassaudiocc";
        reg = <0x0a6a9000 0x1000>;
        #reset-cells = <1>;
    };
...
```

## Documentation/devicetree/bindings/clock/qcom,sm6125-gpucc.yaml
```yaml
# SPDX-License-Identifier: (GPL-2.0-only OR BSD-2-Clause)
%YAML 1.2
---
$id: http://devicetree.org/schemas/clock/qcom,sm6125-gpucc.yaml#
$schema: http://devicetree.org/meta-schemas/core.yaml#

title: Qualcomm Graphics Clock & Reset Controller on SM6125

maintainers:
  - Konrad Dybcio <konradybcio@kernel.org>

description: |
  Qualcomm graphics clock control module provides clocks and power domains on
  Qualcomm SoCs.

  See also:: include/dt-bindings/clock/qcom,sm6125-gpucc.h

properties:
  compatible:
    enum:
      - qcom,sm6125-gpucc

  clocks:
    items:
      - description: Board XO source
      - description: GPLL0 main branch source

  '#clock-cells':
    const: 1

  '#power-domain-cells':
    const: 1

  reg:
    maxItems: 1

required:
  - compatible
  - reg
  - clocks
  - '#clock-cells'
  - '#power-domain-cells'

additionalProperties: false

examples:
  - |
    #include <dt-bindings/clock/qcom,gcc-sm6125.h>
    #include <dt-bindings/clock/qcom,rpmcc.h>

    soc {
        #address-cells = <1>;
        #size-cells = <1>;

        clock-controller@5990000 {
            compatible = "qcom,sm6125-gpucc";
            reg = <0x05990000 0x9000>;
            clocks = <&rpmcc RPM_SMD_XO_CLK_SRC>,
                     <&gcc GCC_GPU_GPLL0_CLK_SRC>;
            #clock-cells = <1>;
            #power-domain-cells = <1>;
        };
    };
...
```

## Documentation/devicetree/bindings/clock/qcom,sm6350-camcc.yaml
```yaml
# SPDX-License-Identifier: (GPL-2.0-only OR BSD-2-Clause)
%YAML 1.2
---
$id: http://devicetree.org/schemas/clock/qcom,sm6350-camcc.yaml#
$schema: http://devicetree.org/meta-schemas/core.yaml#

title: Qualcomm Camera Clock & Reset Controller on SM6350

maintainers:
  - Konrad Dybcio <konradybcio@kernel.org>
  - Taniya Das <quic_tdas@quicinc.com>

description: |
  Qualcomm camera clock control module provides the clocks, resets and  power
  domains on SM6350 and QCS615 SoC.

  See also:
    include/dt-bindings/clock/qcom,qcs615-camcc.h
    include/dt-bindings/clock/qcom,sm6350-camcc.h

properties:
  compatible:
    enum:
      - qcom,qcs615-camcc
      - qcom,sm6350-camcc

  clocks:
    items:
      - description: Board XO source

  reg:
    maxItems: 1

required:
  - compatible
  - clocks

allOf:
  - $ref: qcom,gcc.yaml#

unevaluatedProperties: false

examples:
  - |
    #include <dt-bindings/clock/qcom,rpmh.h>
    clock-controller@ad00000 {
      compatible = "qcom,sm6350-camcc";
      reg = <0x0ad00000 0x16000>;
      clocks = <&rpmhcc RPMH_CXO_CLK>;
      #clock-cells = <1>;
      #reset-cells = <1>;
      #power-domain-cells = <1>;
    };
...
```

## Documentation/devicetree/bindings/clock/qcom,sm6375-dispcc.yaml
```yaml
# SPDX-License-Identifier: (GPL-2.0-only OR BSD-2-Clause)
%YAML 1.2
---
$id: http://devicetree.org/schemas/clock/qcom,sm6375-dispcc.yaml#
$schema: http://devicetree.org/meta-schemas/core.yaml#

title: Qualcomm Display Clock & Reset Controller on SM6375

maintainers:
  - Konrad Dybcio <konradybcio@kernel.org>

description: |
  Qualcomm display clock control module provides the clocks, resets and power
  domains on SM6375.

  See also: include/dt-bindings/clock/qcom,dispcc-sm6375.h

allOf:
  - $ref: qcom,gcc.yaml#

properties:
  compatible:
    const: qcom,sm6375-dispcc

  clocks:
    items:
      - description: Board XO source
      - description: GPLL0 source from GCC
      - description: Byte clock from DSI PHY
      - description: Pixel clock from DSI PHY

required:
  - compatible
  - clocks

unevaluatedProperties: false

examples:
  - |
    #include <dt-bindings/clock/qcom,sm6375-gcc.h>
    #include <dt-bindings/clock/qcom,rpmh.h>

    clock-controller@5f00000 {
      compatible = "qcom,sm6375-dispcc";
      reg = <0x05f00000 0x20000>;
      clocks = <&rpmhcc RPMH_CXO_CLK>,
               <&gcc GCC_DISP_GPLL0_CLK_SRC>,
               <&dsi_phy 0>,
               <&dsi_phy 1>;
      #clock-cells = <1>;
      #reset-cells = <1>;
      #power-domain-cells = <1>;
    };
...
```

## Documentation/devicetree/bindings/clock/qcom,sm6375-gpucc.yaml
```yaml
# SPDX-License-Identifier: (GPL-2.0-only OR BSD-2-Clause)
%YAML 1.2
---
$id: http://devicetree.org/schemas/clock/qcom,sm6375-gpucc.yaml#
$schema: http://devicetree.org/meta-schemas/core.yaml#

title: Qualcomm Graphics Clock & Reset Controller on SM6375

maintainers:
  - Konrad Dybcio <konrad.dybcio@linaro.org>

description: |
  Qualcomm graphics clock control module provides clocks, resets and power
  domains on Qualcomm SoCs.

  See also:: include/dt-bindings/clock/qcom,sm6375-gpucc.h

properties:
  compatible:
    enum:
      - qcom,sm6375-gpucc

  clocks:
    items:
      - description: Board XO source
      - description: GPLL0 main branch source
      - description: GPLL0 div branch source
      - description: SNoC DVM GFX source

required:
  - compatible
  - clocks

allOf:
  - $ref: qcom,gcc.yaml#

unevaluatedProperties: false

examples:
  - |
    #include <dt-bindings/clock/qcom,sm6375-gcc.h>
    #include <dt-bindings/clock/qcom,rpmcc.h>

    soc {
        #address-cells = <2>;
        #size-cells = <2>;

        clock-controller@5990000 {
            compatible = "qcom,sm6375-gpucc";
            reg = <0 0x05990000 0 0x9000>;
            clocks = <&rpmcc RPM_SMD_XO_CLK_SRC>,
                     <&gcc GCC_GPU_GPLL0_CLK_SRC>,
                     <&gcc GCC_GPU_GPLL0_DIV_CLK_SRC>,
                     <&gcc GCC_GPU_SNOC_DVM_GFX_CLK>;
            #clock-cells = <1>;
            #reset-cells = <1>;
            #power-domain-cells = <1>;
        };
    };
...
```

## Documentation/devicetree/bindings/clock/qcom,sm7150-camcc.yaml
```yaml
# SPDX-License-Identifier: (GPL-2.0-only OR BSD-2-Clause)
%YAML 1.2
---
$id: http://devicetree.org/schemas/clock/qcom,sm7150-camcc.yaml#
$schema: http://devicetree.org/meta-schemas/core.yaml#

title: Qualcomm Camera Clock & Reset Controller on SM7150

maintainers:
  - Danila Tikhonov <danila@jiaxyga.com>
  - David Wronek <david@mainlining.org>
  - Jens Reidel <adrian@travitia.xyz>

description: |
  Qualcomm camera clock control module provides the clocks, resets and power
  domains on SM7150.

  See also:: include/dt-bindings/clock/qcom,sm7150-camcc.h

properties:
  compatible:
    const: qcom,sm7150-camcc

  clocks:
    items:
      - description: Board XO source
      - description: Board XO Active-Only source
      - description: Sleep clock source

  power-domains:
    maxItems: 1
    description:
      CX power domain.

required:
  - compatible
  - clocks
  - power-domains

allOf:
  - $ref: qcom,gcc.yaml#

unevaluatedProperties: false

examples:
  - |
    #include <dt-bindings/clock/qcom,rpmh.h>
    #include <dt-bindings/power/qcom,rpmhpd.h>
    clock-controller@ad00000 {
      compatible = "qcom,sm7150-camcc";
      reg = <0xad00000 0x10000>;
      clocks = <&rpmhcc RPMH_CXO_CLK>,
               <&rpmhcc RPMH_CXO_CLK_A>,
               <&sleep_clk>;
      power-domains = <&rpmhpd RPMHPD_CX>;
      #clock-cells = <1>;
      #reset-cells = <1>;
      #power-domain-cells = <1>;
    };
...
```

## Documentation/devicetree/bindings/clock/qcom,sm7150-dispcc.yaml
```yaml
# SPDX-License-Identifier: (GPL-2.0-only OR BSD-2-Clause)
%YAML 1.2
---
$id: http://devicetree.org/schemas/clock/qcom,sm7150-dispcc.yaml#
$schema: http://devicetree.org/meta-schemas/core.yaml#

title: Qualcomm Display Clock & Reset Controller for SM7150

maintainers:
  - Danila Tikhonov <danila@jiaxyga.com>
  - David Wronek <david@mainlining.org>
  - Jens Reidel <adrian@travitia.xyz>

description: |
  Qualcomm display clock control module provides the clocks, resets and power
  domains on SM7150.

  See also:: include/dt-bindings/clock/qcom,sm7150-dispcc.h

properties:
  compatible:
    const: qcom,sm7150-dispcc

  clocks:
    items:
      - description: Board XO source
      - description: Board Always On XO source
      - description: GPLL0 source from GCC
      - description: Sleep clock source
      - description: Byte clock from MDSS DSI PHY0
      - description: Pixel clock from MDSS DSI PHY0
      - description: Byte clock from MDSS DSI PHY1
      - description: Pixel clock from MDSS DSI PHY1
      - description: Link clock from DP PHY
      - description: VCO DIV clock from DP PHY

  power-domains:
    maxItems: 1
    description:
      CX power domain.

required:
  - compatible
  - clocks
  - power-domains

allOf:
  - $ref: qcom,gcc.yaml#

unevaluatedProperties: false

examples:
  - |
    #include <dt-bindings/clock/qcom,sm7150-gcc.h>
    #include <dt-bindings/clock/qcom,rpmh.h>
    #include <dt-bindings/power/qcom,rpmhpd.h>
    clock-controller@af00000 {
      compatible = "qcom,sm7150-dispcc";
      reg = <0x0af00000 0x200000>;
      clocks = <&rpmhcc RPMH_CXO_CLK>,
               <&rpmhcc RPMH_CXO_CLK_A>,
               <&gcc GCC_DISP_GPLL0_CLK_SRC>,
               <&sleep_clk>,
               <&mdss_dsi0_phy 0>,
               <&mdss_dsi0_phy 1>,
               <&mdss_dsi1_phy 0>,
               <&mdss_dsi1_phy 1>,
               <&dp_phy 0>,
               <&dp_phy 1>;
      power-domains = <&rpmhpd RPMHPD_CX>;
      #clock-cells = <1>;
      #reset-cells = <1>;
      #power-domain-cells = <1>;
    };
...
```
