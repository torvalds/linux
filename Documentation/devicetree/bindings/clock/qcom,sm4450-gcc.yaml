## Documentation/devicetree/bindings/clock/qcom,sm7150-gcc.yaml
```yaml
# SPDX-License-Identifier: (GPL-2.0-only OR BSD-2-Clause)
%YAML 1.2
---
$id: http://devicetree.org/schemas/clock/qcom,sm7150-gcc.yaml#
$schema: http://devicetree.org/meta-schemas/core.yaml#

title: Qualcomm Global Clock & Reset Controller on SM7150

maintainers:
  - Bjorn Andersson <andersson@kernel.org>
  - Danila Tikhonov <danila@jiaxyga.com>
  - David Wronek <davidwronek@gmail.com>

description: |
  Qualcomm global clock control module provides the clocks, resets and power
  domains on SM7150

  See also: include/dt-bindings/clock/qcom,sm7150-gcc.h

properties:
  compatible:
    const: qcom,sm7150-gcc

  clocks:
    items:
      - description: Board XO source
      - description: Board XO Active-Only source
      - description: Sleep clock source

required:
  - compatible
  - clocks
  - '#power-domain-cells'

allOf:
  - $ref: qcom,gcc.yaml#

unevaluatedProperties: false

examples:
  - |
    #include <dt-bindings/clock/qcom,rpmh.h>
    clock-controller@100000 {
      compatible = "qcom,sm7150-gcc";
      reg = <0x00100000 0x001f0000>;
      clocks = <&rpmhcc RPMH_CXO_CLK>,
               <&rpmhcc RPMH_CXO_CLK_A>,
               <&sleep_clk>;
      #clock-cells = <1>;
      #reset-cells = <1>;
      #power-domain-cells = <1>;
    };
...
```

## Documentation/devicetree/bindings/clock/qcom,sm7150-videocc.yaml
```yaml
# SPDX-License-Identifier: (GPL-2.0-only OR BSD-2-Clause)
%YAML 1.2
---
$id: http://devicetree.org/schemas/clock/qcom,sm7150-videocc.yaml#
$schema: http://devicetree.org/meta-schemas/core.yaml#

title: Qualcomm Video Clock & Reset Controller on SM7150

maintainers:
  - Danila Tikhonov <danila@jiaxyga.com>
  - David Wronek <david@mainlining.org>
  - Jens Reidel <adrian@travitia.xyz>

description: |
  Qualcomm video clock control module provides the clocks, resets and power
  domains on SM7150.

  See also: include/dt-bindings/clock/qcom,videocc-sm7150.h

properties:
  compatible:
    const: qcom,sm7150-videocc

  clocks:
    items:
      - description: Board XO source
      - description: Board Always On XO source

  power-domains:
    maxItems: 1
    description:
      CX power domain.

required:
  - compatible
  - clocks
  - power-domains

allOf:
  - $ref: qcom,gcc.yaml#

unevaluatedProperties: false

examples:
  - |
    #include <dt-bindings/clock/qcom,rpmh.h>
    #include <dt-bindings/power/qcom,rpmhpd.h>
    videocc: clock-controller@ab00000 {
      compatible = "qcom,sm7150-videocc";
      reg = <0x0ab00000 0x10000>;
      clocks = <&rpmhcc RPMH_CXO_CLK>,
               <&rpmhcc RPMH_CXO_CLK_A>;
      power-domains = <&rpmhpd RPMHPD_CX>;
      #clock-cells = <1>;
      #reset-cells = <1>;
      #power-domain-cells = <1>;
    };
...
```

## Documentation/devicetree/bindings/clock/qcom,sm8150-camcc.yaml
```yaml
# SPDX-License-Identifier: (GPL-2.0-only OR BSD-2-Clause)
%YAML 1.2
---
$id: http://devicetree.org/schemas/clock/qcom,sm8150-camcc.yaml#
$schema: http://devicetree.org/meta-schemas/core.yaml#

title: Qualcomm Camera Clock & Reset Controller on SM8150

maintainers:
  - Satya Priya Kakitapalli <quic_skakitap@quicinc.com>

description: |
  Qualcomm camera clock control module provides the clocks, resets and
  power domains on SM8150.

  See also:: include/dt-bindings/clock/qcom,sm8150-camcc.h

properties:
  compatible:
    const: qcom,sm8150-camcc

  reg:
    maxItems: 1

  clocks:
    items:
      - description: Board XO source
      - description: Camera AHB clock from GCC

  power-domains:
    maxItems: 1
    description:
      A phandle and PM domain specifier for the MMCX power domain.

  required-opps:
    maxItems: 1
    description:
      A phandle to an OPP node describing required MMCX performance point.

  '#clock-cells':
    const: 1

  '#reset-cells':
    const: 1

  '#power-domain-cells':
    const: 1

required:
  - compatible
  - reg
  - clocks
  - power-domains
  - required-opps
  - '#clock-cells'
  - '#reset-cells'
  - '#power-domain-cells'

additionalProperties: false

examples:
  - |
    #include <dt-bindings/clock/qcom,gcc-sm8150.h>
    #include <dt-bindings/clock/qcom,rpmh.h>
    #include <dt-bindings/power/qcom-rpmpd.h>
    clock-controller@ad00000 {
      compatible = "qcom,sm8150-camcc";
      reg = <0x0ad00000 0x10000>;
      clocks = <&rpmhcc RPMH_CXO_CLK>,
               <&gcc GCC_CAMERA_AHB_CLK>;
      power-domains = <&rpmhpd SM8150_MMCX>;
      required-opps = <&rpmhpd_opp_low_svs>;
      #clock-cells = <1>;
      #reset-cells = <1>;
      #power-domain-cells = <1>;
    };
...
```

## Documentation/devicetree/bindings/clock/qcom,sm8350-videocc.yaml
```yaml
# SPDX-License-Identifier: (GPL-2.0-only OR BSD-2-Clause)
%YAML 1.2
---
$id: http://devicetree.org/schemas/clock/qcom,sm8350-videocc.yaml#
$schema: http://devicetree.org/meta-schemas/core.yaml#

title: Qualcomm SM8350 Video Clock & Reset Controller

maintainers:
  - Konrad Dybcio <konrad.dybcio@linaro.org>

description: |
  Qualcomm video clock control module provides the clocks, resets and power
  domains on Qualcomm SoCs.

  See also::
    include/dt-bindings/clock/qcom,videocc-sm8350.h
    include/dt-bindings/reset/qcom,videocc-sm8350.h

properties:
  compatible:
    enum:
      - qcom,sc8280xp-videocc
      - qcom,sm8350-videocc

  clocks:
    items:
      - description: Board XO source
      - description: Board active XO source
      - description: Board sleep clock

  power-domains:
    description:
      A phandle and PM domain specifier for the MMCX power domain.
    maxItems: 1

  required-opps:
    description:
      A phandle to an OPP node describing required MMCX performance point.
    maxItems: 1

required:
  - compatible
  - clocks
  - power-domains
  - required-opps

allOf:
  - $ref: qcom,gcc.yaml#

unevaluatedProperties: false

examples:
  - |
    #include <dt-bindings/clock/qcom,rpmh.h>
    #include <dt-bindings/power/qcom,rpmhpd.h>

    clock-controller@abf0000 {
      compatible = "qcom,sm8350-videocc";
      reg = <0x0abf0000 0x10000>;
      clocks = <&rpmhcc RPMH_CXO_CLK>,
               <&rpmhcc RPMH_CXO_CLK_A>,
               <&sleep_clk>;
      power-domains = <&rpmhpd RPMHPD_MMCX>;
      required-opps = <&rpmhpd_opp_low_svs>;
      #clock-cells = <1>;
      #reset-cells = <1>;
      #power-domain-cells = <1>;
    };
...
```

## Documentation/devicetree/bindings/clock/qcom,sm8450-dispcc.yaml
```yaml
# SPDX-License-Identifier: (GPL-2.0-only OR BSD-2-Clause)
%YAML 1.2
---
$id: http://devicetree.org/schemas/clock/qcom,sm8450-dispcc.yaml#
$schema: http://devicetree.org/meta-schemas/core.yaml#

title: Qualcomm Display Clock & Reset Controller for SM8450

maintainers:
  - Dmitry Baryshkov <dmitry.baryshkov@linaro.org>

description: |
  Qualcomm display clock control module provides the clocks, resets and power
  domains on SM8450.

  See also: include/dt-bindings/clock/qcom,sm8450-dispcc.h

properties:
  compatible:
    enum:
      - qcom,sm8450-dispcc
      - qcom,sm8475-dispcc

  clocks:
    minItems: 3
    items:
      - description: Board XO source
      - description: Board Always On XO source
      - description: Display's AHB clock
      - description: sleep clock
      - description: Byte clock from DSI PHY0
      - description: Pixel clock from DSI PHY0
      - description: Byte clock from DSI PHY1
      - description: Pixel clock from DSI PHY1
      - description: Link clock from DP PHY0
      - description: VCO DIV clock from DP PHY0
      - description: Link clock from DP PHY1
      - description: VCO DIV clock from DP PHY1
      - description: Link clock from DP PHY2
      - description: VCO DIV clock from DP PHY2
      - description: Link clock from DP PHY3
      - description: VCO DIV clock from DP PHY3

  power-domains:
    description:
      A phandle and PM domain specifier for the MMCX power domain.
    maxItems: 1

  required-opps:
    description:
      A phandle to an OPP node describing required MMCX performance point.
    maxItems: 1

required:
  - compatible
  - clocks
  - '#power-domain-cells'

allOf:
  - $ref: qcom,gcc.yaml#

unevaluatedProperties: false

examples:
  - |
    #include <dt-bindings/clock/qcom,gcc-sm8450.h>
    #include <dt-bindings/clock/qcom,rpmh.h>
    #include <dt-bindings/power/qcom,rpmhpd.h>
    clock-controller@af00000 {
      compatible = "qcom,sm8450-dispcc";
      reg = <0x0af00000 0x10000>;
      clocks = <&rpmhcc RPMH_CXO_CLK>,
               <&rpmhcc RPMH_CXO_CLK_A>,
               <&gcc GCC_DISP_AHB_CLK>,
               <&sleep_clk>,
               <&dsi0_phy 0>,
               <&dsi0_phy 1>,
               <&dsi1_phy 0>,
               <&dsi1_phy 1>;
      #clock-cells = <1>;
      #reset-cells = <1>;
      #power-domain-cells = <1>;
      power-domains = <&rpmhpd RPMHPD_MMCX>;
      required-opps = <&rpmhpd_opp_low_svs>;
    };
...
```

## Documentation/devicetree/bindings/clock/qcom,sm8450-gpucc.yaml
```yaml
# SPDX-License-Identifier: (GPL-2.0-only OR BSD-2-Clause)
%YAML 1.2
---
$id: http://devicetree.org/schemas/clock/qcom,sm8450-gpucc.yaml#
$schema: http://devicetree.org/meta-schemas/core.yaml#

title: Qualcomm Graphics Clock & Reset Controller on SM8450

maintainers:
  - Konrad Dybcio <konradybcio@kernel.org>

description: |
  Qualcomm graphics clock control module provides the clocks, resets and power
  domains on Qualcomm SoCs.

  See also::
    include/dt-bindings/clock/qcom,sm8450-gpucc.h
    include/dt-bindings/clock/qcom,sm8550-gpucc.h
    include/dt-bindings/reset/qcom,sm8450-gpucc.h
    include/dt-bindings/reset/qcom,sm8650-gpucc.h
    include/dt-bindings/reset/qcom,x1e80100-gpucc.h

properties:
  compatible:
    enum:
      - qcom,sm8450-gpucc
      - qcom,sm8550-gpucc
      - qcom,sm8650-gpucc
      - qcom,x1e80100-gpucc

  clocks:
    items:
      - description: Board XO source
      - description: GPLL0 main branch source
      - description: GPLL0 div branch source

required:
  - compatible
  - clocks
  - '#power-domain-cells'

allOf:
  - $ref: qcom,gcc.yaml#

unevaluatedProperties: false

examples:
  - |
    #include <dt-bindings/clock/qcom,gcc-sm8450.h>
    #include <dt-bindings/clock/qcom,rpmh.h>

    soc {
        #address-cells = <2>;
        #size-cells = <2>;

        clock-controller@3d90000 {
            compatible = "qcom,sm8450-gpucc";
            reg = <0 0x03d90000 0 0xa000>;
            clocks = <&rpmhcc RPMH_CXO_CLK>,
                     <&gcc GCC_GPU_GPLL0_CLK_SRC>,
                     <&gcc GCC_GPU_GPLL0_DIV_CLK_SRC>;
            #clock-cells = <1>;
            #reset-cells = <1>;
            #power-domain-cells = <1>;
        };
    };
...
```

## Documentation/devicetree/bindings/clock/qcom,sm8450-videocc.yaml
```yaml
# SPDX-License-Identifier: (GPL-2.0-only OR BSD-2-Clause)
%YAML 1.2
---
$id: http://devicetree.org/schemas/clock/qcom,sm8450-videocc.yaml#
$schema: http://devicetree.org/meta-schemas/core.yaml#

title: Qualcomm Video Clock & Reset Controller on SM8450

maintainers:
  - Taniya Das <quic_tdas@quicinc.com>
  - Jagadeesh Kona <quic_jkona@quicinc.com>

description: |
  Qualcomm video clock control module provides the clocks, resets and power
  domains on SM8450.

  See also:
    include/dt-bindings/clock/qcom,sm8450-videocc.h
    include/dt-bindings/clock/qcom,sm8650-videocc.h

properties:
  compatible:
    enum:
      - qcom,sm8450-videocc
      - qcom,sm8475-videocc
      - qcom,sm8550-videocc
      - qcom,sm8650-videocc
      - qcom,x1e80100-videocc

  clocks:
    items:
      - description: Board XO source
      - description: Video AHB clock from GCC

  power-domains:
    description:
      Power domains required for the clock controller to operate
    items:
      - description: MMCX power domain
      - description: MXC power domain

  required-opps:
    description:
      OPP nodes that describe required performance points on power domains
    items:
      - description: MMCX performance point
      - description: MXC performance point

required:
  - compatible
  - clocks
  - power-domains
  - '#power-domain-cells'

allOf:
  - $ref: qcom,gcc.yaml#
  - if:
      properties:
        compatible:
          contains:
            enum:
              - qcom,sm8450-videocc
              - qcom,sm8550-videocc
    then:
      required:
        - required-opps

unevaluatedProperties: false

examples:
  - |
    #include <dt-bindings/clock/qcom,gcc-sm8450.h>
    #include <dt-bindings/clock/qcom,rpmh.h>
    #include <dt-bindings/power/qcom,rpmhpd.h>
    videocc: clock-controller@aaf0000 {
      compatible = "qcom,sm8450-videocc";
      reg = <0x0aaf0000 0x10000>;
      clocks = <&rpmhcc RPMH_CXO_CLK>,
               <&gcc GCC_VIDEO_AHB_CLK>;
      power-domains = <&rpmhpd RPMHPD_MMCX>,
                      <&rpmhpd RPMHPD_MXC>;
      required-opps = <&rpmhpd_opp_low_svs>,
                      <&rpmhpd_opp_low_svs>;
      #clock-cells = <1>;
      #reset-cells = <1>;
      #power-domain-cells = <1>;
    };
...
```

## Documentation/devicetree/bindings/clock/qcom,sm8550-dispcc.yaml
```yaml
# SPDX-License-Identifier: (GPL-2.0-only OR BSD-2-Clause)
%YAML 1.2
---
$id: http://devicetree.org/schemas/clock/qcom,sm8550-dispcc.yaml#
$schema: http://devicetree.org/meta-schemas/core.yaml#

title: Qualcomm Display Clock & Reset Controller for SM8550

maintainers:
  - Bjorn Andersson <andersson@kernel.org>
  - Neil Armstrong <neil.armstrong@linaro.org>

description: |
  Qualcomm display clock control module provides the clocks, resets and power
  domains on SM8550, SM8650, SM8750 and few other platforms.

  See also:
  - include/dt-bindings/clock/qcom,sm8550-dispcc.h
  - include/dt-bindings/clock/qcom,sm8650-dispcc.h
  - include/dt-bindings/clock/qcom,sm8750-dispcc.h
  - include/dt-bindings/clock/qcom,x1e80100-dispcc.h

properties:
  compatible:
    enum:
      - qcom,sar2130p-dispcc
      - qcom,sm8550-dispcc
      - qcom,sm8650-dispcc
      - qcom,sm8750-dispcc
      - qcom,x1e80100-dispcc

  clocks:
    items:
      - description: Board XO source
      - description: Board Always On XO source
      - description: Display's AHB clock
      - description: sleep clock
      - description: Byte clock from DSI PHY0
      - description: Pixel clock from DSI PHY0
      - description: Byte clock from DSI PHY1
      - description: Pixel clock from DSI PHY1
      - description: Link clock from DP PHY0
      - description: VCO DIV clock from DP PHY0
      - description: Link clock from DP PHY1
      - description: VCO DIV clock from DP PHY1
      - description: Link clock from DP PHY2
      - description: VCO DIV clock from DP PHY2
      - description: Link clock from DP PHY3
      - description: VCO DIV clock from DP PHY3

  power-domains:
    description:
      A phandle and PM domain specifier for the MMCX power domain.
    maxItems: 1

  required-opps:
    description:
      A phandle to an OPP node describing required MMCX performance point.
    maxItems: 1

required:
  - compatible
  - clocks
  - '#power-domain-cells'

allOf:
  - $ref: qcom,gcc.yaml#

unevaluatedProperties: false

examples:
  - |
    #include <dt-bindings/clock/qcom,sm8550-gcc.h>
    #include <dt-bindings/clock/qcom,rpmh.h>
    #include <dt-bindings/power/qcom,rpmhpd.h>
    clock-controller@af00000 {
      compatible = "qcom,sm8550-dispcc";
      reg = <0x0af00000 0x10000>;
      clocks = <&rpmhcc RPMH_CXO_CLK>,
               <&rpmhcc RPMH_CXO_CLK_A>,
               <&gcc GCC_DISP_AHB_CLK>,
               <&sleep_clk>,
               <&dsi0_phy 0>,
               <&dsi0_phy 1>,
               <&dsi1_phy 0>,
               <&dsi1_phy 1>,
               <&dp0_phy 0>,
               <&dp0_phy 1>,
               <&dp1_phy 0>,
               <&dp1_phy 1>,
               <&dp2_phy 0>,
               <&dp2_phy 1>,
               <&dp3_phy 0>,
               <&dp3_phy 1>;
      #clock-cells = <1>;
      #reset-cells = <1>;
      #power-domain-cells = <1>;
      power-domains = <&rpmhpd RPMHPD_MMCX>;
      required-opps = <&rpmhpd_opp_low_svs>;
    };
...
```
