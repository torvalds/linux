## Documentation/devicetree/bindings/clock/qcom,sm8550-gcc.yaml
```yaml
# SPDX-License-Identifier: (GPL-2.0-only OR BSD-2-Clause)
%YAML 1.2
---
$id: http://devicetree.org/schemas/clock/qcom,sm8550-gcc.yaml#
$schema: http://devicetree.org/meta-schemas/core.yaml#

title: Qualcomm Global Clock & Reset Controller on SM8550

maintainers:
  - Bjorn Andersson <andersson@kernel.org>

description: |
  Qualcomm global clock control module provides the clocks, resets and power
  domains on SM8550

  See also: include/dt-bindings/clock/qcom,sm8550-gcc.h

properties:
  compatible:
    const: qcom,sm8550-gcc

  clocks:
    items:
      - description: Board XO source
      - description: Sleep clock source
      - description: PCIE 0 Pipe clock source
      - description: PCIE 1 Pipe clock source
      - description: PCIE 1 Phy Auxiliary clock source
      - description: UFS Phy Rx symbol 0 clock source
      - description: UFS Phy Rx symbol 1 clock source
      - description: UFS Phy Tx symbol 0 clock source
      - description: USB3 Phy wrapper pipe clock source

required:
  - compatible
  - clocks
  - '#power-domain-cells'

allOf:
  - $ref: qcom,gcc.yaml#

unevaluatedProperties: false

examples:
  - |
    #include <dt-bindings/clock/qcom,rpmh.h>
    clock-controller@100000 {
      compatible = "qcom,sm8550-gcc";
      reg = <0x00100000 0x001f4200>;
      clocks = <&rpmhcc RPMH_CXO_CLK>, <&sleep_clk>,
               <&pcie0_phy>,
               <&pcie1_phy>,
               <&pcie_1_phy_aux_clk>,
               <&ufs_mem_phy 0>,
               <&ufs_mem_phy 1>,
               <&ufs_mem_phy 2>,
               <&usb_1_qmpphy>;
      #clock-cells = <1>;
      #reset-cells = <1>;
      #power-domain-cells = <1>;
    };

...
```

## Documentation/devicetree/bindings/clock/qcom,sm8550-tcsr.yaml
```yaml
# SPDX-License-Identifier: (GPL-2.0-only OR BSD-2-Clause)
%YAML 1.2
---
$id: http://devicetree.org/schemas/clock/qcom,sm8550-tcsr.yaml#
$schema: http://devicetree.org/meta-schemas/core.yaml#

title: Qualcomm TCSR Clock Controller on SM8550

maintainers:
  - Bjorn Andersson <andersson@kernel.org>

description: |
  Qualcomm TCSR clock control module provides the clocks, resets and
  power domains on SM8550

  See also:
  - include/dt-bindings/clock/qcom,sm8550-tcsr.h
  - include/dt-bindings/clock/qcom,sm8650-tcsr.h

properties:
  compatible:
    items:
      - enum:
          - qcom,sar2130p-tcsr
          - qcom,sm8550-tcsr
          - qcom,sm8650-tcsr
          - qcom,x1e80100-tcsr
      - const: syscon

  clocks:
    items:
      - description: TCXO pad clock

  reg:
    maxItems: 1

  '#clock-cells':
    const: 1

  '#reset-cells':
    const: 1

required:
  - compatible
  - clocks

additionalProperties: false

examples:
  - |
    #include <dt-bindings/clock/qcom,rpmh.h>

    clock-controller@1fc0000 {
      compatible = "qcom,sm8550-tcsr", "syscon";
      reg = <0x1fc0000 0x30000>;
      clocks = <&rpmhcc RPMH_CXO_CLK>;
      #clock-cells = <1>;
      #reset-cells = <1>;
    };

...
```

## Documentation/devicetree/bindings/clock/qcom,spmi-clkdiv.txt
```
Qualcomm Technologies, Inc. SPMI PMIC clock divider (clkdiv)

clkdiv configures the clock frequency of a set of outputs on the PMIC.
These clocks are typically wired through alternate functions on
gpio pins.

=======================
Properties
=======================

- compatible
	Usage:      required
	Value type: <string>
	Definition: must be "qcom,spmi-clkdiv".

- reg
	Usage:      required
	Value type: <prop-encoded-array>
	Definition: base address of CLKDIV peripherals.

- qcom,num-clkdivs
	Usage:      required
	Value type: <u32>
	Definition: number of CLKDIV peripherals.

- clocks:
	Usage: required
	Value type: <prop-encoded-array>
	Definition: reference to the xo clock.

- clock-names:
	Usage: required
	Value type: <stringlist>
	Definition: must be "xo".

- #clock-cells:
	Usage: required
	Value type: <u32>
	Definition: shall contain 1.

=======
Example
=======

pm8998_clk_divs: clock-controller@5b00 {
	compatible = "qcom,spmi-clkdiv";
	reg = <0x5b00>;
	#clock-cells = <1>;
	qcom,num-clkdivs = <3>;
	clocks = <&xo_board>;
	clock-names = "xo";

	assigned-clocks = <&pm8998_clk_divs 1>,
			  <&pm8998_clk_divs 2>,
			  <&pm8998_clk_divs 3>;
	assigned-clock-rates = <9600000>,
			       <9600000>,
			       <9600000>;
};
```

## Documentation/devicetree/bindings/clock/qcom,spmi-clkdiv.yaml
```yaml
# SPDX-License-Identifier: (GPL-2.0-only OR BSD-2-Clause)
%YAML 1.2
---
$id: http://devicetree.org/schemas/clock/qcom,spmi-clkdiv.yaml#
$schema: http://devicetree.org/meta-schemas/core.yaml#

title: Qualcomm SPMI PMIC clock divider

maintainers:
  - Bjorn Andersson <andersson@kernel.org>
  - Stephen Boyd <sboyd@kernel.org>

description: |
  Qualcomm SPMI PMIC clock divider configures the clock frequency of a set of
  outputs on the PMIC.  These clocks are typically wired through alternate
  functions on GPIO pins.

properties:
  compatible:
    const: qcom,spmi-clkdiv

  reg:
    maxItems: 1

  clocks:
    items:
      - description: Board XO source

  clock-names:
    items:
      - const: xo

  "#clock-cells":
    const: 1

  qcom,num-clkdivs:
    $ref: /schemas/types.yaml#/definitions/uint32
    description: Number of CLKDIV peripherals.

required:
  - compatible
  - reg
  - clocks
  - clock-names
  - "#clock-cells"
  - qcom,num-clkdivs

additionalProperties: false

examples:
  - |
    pmic {
        #address-cells = <1>;
        #size-cells = <0>;

        clock-controller@5b00 {
            compatible = "qcom,spmi-clkdiv";
            reg = <0x5b00>;
            clocks = <&xo_board>;
            clock-names = "xo";
            #clock-cells = <1>;
            qcom,num-clkdivs = <3>;

            assigned-clocks = <&pm8998_clk_divs 1>,
                              <&pm8998_clk_divs 2>,
                              <&pm8998_clk_divs 3>;
            assigned-clock-rates = <9600000>,
                                   <9600000>,
                                   <9600000>;
        };
    };
```

## Documentation/devicetree/bindings/clock/qcom,turingcc.txt
```
Qualcomm Turing Clock & Reset Controller Binding
------------------------------------------------

Required properties :
- compatible: shall contain "qcom,qcs404-turingcc".
- reg: shall contain base register location and length.
- clocks: ahb clock for the TuringCC
- #clock-cells: from common clock binding, shall contain 1.
- #reset-cells: from common reset binding, shall contain 1.

Example:
	turingcc: clock-controller@800000 {
		compatible = "qcom,qcs404-turingcc";
		reg = <0x00800000 0x30000>;
		clocks = <&gcc GCC_CDSP_CFG_AHB_CLK>;

		#clock-cells = <1>;
		#reset-cells = <1>;
	};
```

## Documentation/devicetree/bindings/clock/qcom,videocc.txt
```
Qualcomm Video Clock & Reset Controller Binding
-----------------------------------------------

Required properties :
- compatible : shall contain "qcom,sdm845-videocc"
- reg : shall contain base register location and length
- #clock-cells : from common clock binding, shall contain 1.
- #power-domain-cells : from generic power domain binding, shall contain 1.
- #reset-cells : from common reset binding, shall contain 1.

Example:
	videocc: clock-controller@ab00000 {
		compatible = "qcom,sdm845-videocc";
		reg = <0xab00000 0x10000>;
		#clock-cells = <1>;
		#power-domain-cells = <1>;
		#reset-cells = <1>;
	};
```

## Documentation/devicetree/bindings/clock/qcom,videocc.yaml
```yaml
# SPDX-License-Identifier: (GPL-2.0-only OR BSD-2-Clause)
%YAML 1.2
---
$id: http://devicetree.org/schemas/clock/qcom,videocc.yaml#
$schema: http://devicetree.org/meta-schemas/core.yaml#

title: Qualcomm Video Clock & Reset Controller

maintainers:
  - Taniya Das <quic_tdas@quicinc.com>

description: |
  Qualcomm video clock control module provides the clocks, resets and power
  domains on Qualcomm SoCs.

  See also::
    include/dt-bindings/clock/qcom,videocc-sc7180.h
    include/dt-bindings/clock/qcom,videocc-sc7280.h
    include/dt-bindings/clock/qcom,videocc-sdm845.h
    include/dt-bindings/clock/qcom,videocc-sm8150.h
    include/dt-bindings/clock/qcom,videocc-sm8250.h

properties:
  compatible:
    enum:
      - qcom,sc7180-videocc
      - qcom,sc7280-videocc
      - qcom,sdm845-videocc
      - qcom,sm8150-videocc
      - qcom,sm8250-videocc

  clocks:
    minItems: 1
    maxItems: 3

  clock-names:
    minItems: 1
    maxItems: 3

  power-domains:
    description:
      A phandle and PM domain specifier for the MMCX power domain.
    maxItems: 1

  required-opps:
    description:
      A phandle to an OPP node describing required MMCX performance point.
    maxItems: 1

required:
  - compatible
  - clocks
  - clock-names
  - '#power-domain-cells'

allOf:
  - $ref: qcom,gcc.yaml#

  - if:
      properties:
        compatible:
          enum:
            - qcom,sc7180-videocc
            - qcom,sdm845-videocc
    then:
      properties:
        clocks:
          items:
            - description: Board XO source
        clock-names:
          items:
            - const: bi_tcxo

  - if:
      properties:
        compatible:
          enum:
            - qcom,sc7280-videocc
    then:
      properties:
        clocks:
          items:
            - description: Board XO source
            - description: Board active XO source
        clock-names:
          items:
            - const: bi_tcxo
            - const: bi_tcxo_ao

  - if:
      properties:
        compatible:
          enum:
            - qcom,sm8150-videocc
    then:
      properties:
        clocks:
          items:
            - description: AHB
            - description: Board XO source
        clock-names:
          items:
            - const: iface
            - const: bi_tcxo

  - if:
      properties:
        compatible:
          enum:
            - qcom,sm8250-videocc
    then:
      properties:
        clocks:
          items:
            - description: AHB
            - description: Board XO source
            - description: Board active XO source
        clock-names:
          items:
            - const: iface
            - const: bi_tcxo
            - const: bi_tcxo_ao

unevaluatedProperties: false

examples:
  - |
    #include <dt-bindings/clock/qcom,rpmh.h>
    #include <dt-bindings/power/qcom,rpmhpd.h>
    clock-controller@ab00000 {
      compatible = "qcom,sdm845-videocc";
      reg = <0x0ab00000 0x10000>;
      clocks = <&rpmhcc RPMH_CXO_CLK>;
      clock-names = "bi_tcxo";
      #clock-cells = <1>;
      #reset-cells = <1>;
      #power-domain-cells = <1>;
      power-domains = <&rpmhpd RPMHPD_MMCX>;
      required-opps = <&rpmhpd_opp_low_svs>;
    };
...
```
