## Documentation/devicetree/bindings/clock/ti/ti,divider-clock.yaml
```yaml
# SPDX-License-Identifier: GPL-2.0-only
%YAML 1.2
---
$id: http://devicetree.org/schemas/clock/ti/ti,divider-clock.yaml#
$schema: http://devicetree.org/meta-schemas/core.yaml#

title: Texas Instruments divider clock

maintainers:
  - Tero Kristo <kristo@kernel.org>

description: |
  This clock It assumes a register-mapped adjustable clock rate divider
  that does not gate and has only one input clock or parent.  By default the
  value programmed into the register is one less than the actual divisor value.
  E.g:

  register value    actual divisor value
  0                 1
  1                 2
  2                 3

  This assumption may be modified by the following optional properties:

  ti,index-starts-at-one - valid divisor values start at 1, not the default
  of 0.  E.g:
  register value    actual divisor value
  1                 1
  2                 2
  3                 3

  ti,index-power-of-two - valid divisor values are powers of two.  E.g:
  register value    actual divisor value
  0                 1
  1                 2
  2                 4

  Additionally an array of valid dividers may be supplied like so:

  ti,dividers = <4>, <8>, <0>, <16>;

  Which will map the resulting values to a divisor table by their index:
  register value    actual divisor value
  0                 4
  1                 8
  2                 <invalid divisor, skipped>
  3                 16

  Any zero value in this array means the corresponding bit-value is invalid
  and must not be used.

  The binding must also provide the register to control the divider and
  unless the divider array is provided, min and max dividers. Optionally
  the number of bits to shift that mask, if necessary. If the shift value
  is missing it is the same as supplying a zero shift.

  This binding can also optionally provide support to the hardware autoidle
  feature, see [1].

  [1] Documentation/devicetree/bindings/clock/ti/autoidle.txt

properties:
  compatible:
    enum:
      - ti,divider-clock
      - ti,composite-divider-clock

  "#clock-cells":
    const: 0

  clocks:
    maxItems: 1

  clock-output-names:
    maxItems: 1

  reg:
    maxItems: 1

  ti,dividers:
    $ref: /schemas/types.yaml#/definitions/uint32-array
    description:
      array of integers defining divisors

  ti,bit-shift:
    $ref: /schemas/types.yaml#/definitions/uint32
    description:
      number of bits to shift the divider value
    maximum: 31
    default: 0

  ti,min-div:
    $ref: /schemas/types.yaml#/definitions/uint32
    description:
      min divisor for dividing the input clock rate, only
      needed if the first divisor is offset from the default value (1)
    minimum: 1
    default: 1


  ti,max-div:
    $ref: /schemas/types.yaml#/definitions/uint32
    description:
      max divisor for dividing the input clock rate, only needed
      if ti,dividers is not defined.

  ti,index-starts-at-one:
    type: boolean
    description:
      valid divisor programming starts at 1, not zero,
      only valid if ti,dividers is not defined

  ti,index-power-of-two:
    type: boolean
    description:
      valid divisor programming must be a power of two,
      only valid if ti,dividers is not defined.

  ti,autoidle-shift:
    $ref: /schemas/types.yaml#/definitions/uint32
    description:
      bit shift of the autoidle enable bit for the clock,
      see [1].
    maximum: 31
    default: 0

  ti,invert-autoidle-bit:
    type: boolean
    description:
      autoidle is enabled by setting the bit to 0,
      see [1]

  ti,set-rate-parent:
    type: boolean
    description:
      clk_set_rate is propagated to parent            |

  ti,latch-bit:
    $ref: /schemas/types.yaml#/definitions/uint32
    description:
      latch the divider value to HW, only needed if the register
      compatible access requires this. As an example dra76x DPLL_GMAC
      H14 divider implements such behavior.

dependentSchemas:
  ti,dividers:
    properties:
      ti,min-div: false
      ti,max-div: false
      ti,index-power-of-two: false
      ti,index-starts-at-one: false

required:
  - compatible
  - "#clock-cells"
  - clocks
  - reg

additionalProperties: false

examples:
  - |
    bus {
      #address-cells = <1>;
      #size-cells = <0>;

      clock-controller@190 {
        #clock-cells = <0>;
        compatible = "ti,divider-clock";
        clocks = <&dpll_usb_ck>;
        ti,max-div = <127>;
        reg = <0x190>;
        ti,index-starts-at-one;
      };

      clock-controller@528 {
        #clock-cells = <0>;
        compatible = "ti,divider-clock";
        clocks = <&abe_clk>;
        ti,bit-shift = <24>;
        reg = <0x528>;
        ti,max-div = <2>;
      };

      clock-controller@a40 {
        #clock-cells = <0>;
        compatible = "ti,composite-divider-clock";
        clocks = <&corex2_fck>;
        ti,bit-shift = <8>;
        reg = <0x0a40>;
        ti,dividers = <0>, <1>, <2>, <3>, <4>, <0>, <6>, <0>, <8>;
      };
    };
```

## Documentation/devicetree/bindings/clock/ti/ti,fixed-factor-clock.yaml
```yaml
# SPDX-License-Identifier: (GPL-2.0-only OR BSD-2-Clause)
%YAML 1.2
---
$id: http://devicetree.org/schemas/clock/ti/ti,fixed-factor-clock.yaml#
$schema: http://devicetree.org/meta-schemas/core.yaml#

title: TI fixed factor rate clock sources

maintainers:
  - Tero Kristo <kristo@kernel.org>
  - Sukrut Bellary <sbellary@baylibre.com>

description:
  This consists of a divider and a multiplier used to generate a fixed rate
  clock. This also uses the autoidle support from TI autoidle clock.

allOf:
  - $ref: ti,autoidle.yaml#

properties:
  compatible:
    const: ti,fixed-factor-clock

  "#clock-cells":
    const: 0

  reg:
    maxItems: 1

  ti,clock-div:
    $ref: /schemas/types.yaml#/definitions/uint32
    description: Fixed divider
    minimum: 1

  ti,clock-mult:
    $ref: /schemas/types.yaml#/definitions/uint32
    description: Fixed multiplier
    minimum: 1

  clocks:
    maxItems: 1

  clock-output-names:
    maxItems: 1

  ti,set-rate-parent:
    description:
      Propagate to parent clock
    type: boolean

required:
  - compatible
  - clocks
  - "#clock-cells"
  - ti,clock-mult
  - ti,clock-div

unevaluatedProperties: false

examples:
  - |
    bus{
        #address-cells = <1>;
        #size-cells = <0>;

        clock@1b4 {
            compatible = "ti,fixed-factor-clock";
            reg = <0x1b4>;
            clocks = <&dpll_usb_ck>;
            #clock-cells = <0>;
            ti,clock-mult = <1>;
            ti,clock-div = <1>;
            ti,autoidle-shift = <8>;
            ti,invert-autoidle-bit;
        };
    };
```

## Documentation/devicetree/bindings/clock/ti/ti,gate-clock.yaml
```yaml
# SPDX-License-Identifier: GPL-2.0-only
%YAML 1.2
---
$id: http://devicetree.org/schemas/clock/ti/ti,gate-clock.yaml#
$schema: http://devicetree.org/meta-schemas/core.yaml#

title: Texas Instruments gate clock

maintainers:
  - Tero Kristo <kristo@kernel.org>

description: |
  *Deprecated design pattern: one node per clock*

  This clock is quite much similar to the basic gate-clock [1], however,
  it supports a number of additional features. If no register
  is provided for this clock, the code assumes that a clockdomain
  will be controlled instead and the corresponding hw-ops for
  that is used.

  [1] Documentation/devicetree/bindings/clock/gpio-gate-clock.yaml
  [2] Documentation/devicetree/bindings/clock/ti/clockdomain.txt

properties:
  compatible:
    enum:
      - ti,gate-clock           # basic gate clock
      - ti,wait-gate-clock      # gate clock which waits until clock is
                                # active before returning from clk_enable()
      - ti,dss-gate-clock       # gate clock with DSS specific hardware
                                # handling
      - ti,am35xx-gate-clock    # gate clock with AM35xx specific hardware
                                # handling
      - ti,clkdm-gate-clock     # clockdomain gate clock, which derives its
                                # functional clock directly from a
                                # clockdomain, see [2] how to map
                                # clockdomains properly
      - ti,hsdiv-gate-clock     # gate clock with OMAP36xx specific hardware
                                # handling, required for a hardware errata
      - ti,composite-gate-clock # composite gate clock, to be part of
                                # composite clock
      - ti,composite-no-wait-gate-clock # composite gate clock that does not
                                        # wait for clock to be active before
                                        # returning from clk_enable()
  "#clock-cells":
    const: 0

  clocks: true

  clock-output-names:
    maxItems: 1

  reg:
    maxItems: 1

  ti,bit-shift:
    $ref: /schemas/types.yaml#/definitions/uint32
    description:
      Number of bits to shift the bit-mask
    maximum: 31
    default: 0

  ti,set-bit-to-disable:
    type: boolean
    description:
      Inverts default gate programming. Setting the bit
      gates the clock and clearing the bit ungates the clock.

  ti,set-rate-parent:
    type: boolean
    description:
      clk_set_rate is propagated to parent clock,

if:
  properties:
    compatible:
      contains:
        const: ti,clkdm-gate-clock
then:
  properties:
    reg: false
  required:
    - compatible
    - "#clock-cells"
    - clocks
else:
  required:
    - compatible
    - "#clock-cells"
    - clocks
    - reg

additionalProperties: false

examples:
  - |
    bus {
      #address-cells = <1>;
      #size-cells = <0>;

      clock-controller@a00 {
        #clock-cells = <0>;
        compatible = "ti,gate-clock";
        clocks = <&core_96m_fck>;
        reg = <0x0a00>;
        ti,bit-shift = <25>;
      };

      clock-controller@d00 {
        compatible = "ti,hsdiv-gate-clock";
        reg = <0x0d00>;
        #clock-cells = <0>;
        clocks = <&dpll4_m2x2_mul_ck>;
        ti,bit-shift = <0x1b>;
        ti,set-bit-to-disable;
      };
    };

  - |
    clock-controller {
      #clock-cells = <0>;
      compatible = "ti,clkdm-gate-clock";
      clocks = <&emu_src_mux_ck>;
    };
```

## Documentation/devicetree/bindings/clock/ti/ti,interface-clock.yaml
```yaml
# SPDX-License-Identifier: GPL-2.0-only
%YAML 1.2
---
$id: http://devicetree.org/schemas/clock/ti/ti,interface-clock.yaml#
$schema: http://devicetree.org/meta-schemas/core.yaml#

title: Texas Instruments interface clock.

maintainers:
  - Tero Kristo <kristo@kernel.org>

description: |
  This clock is quite much similar to the basic gate-clock[1], however,
  it supports a number of additional features, including
  companion clock finding (match corresponding functional gate
  clock) and hardware autoidle enable / disable.

  [1] Documentation/devicetree/bindings/clock/gpio-gate-clock.yaml

properties:
  compatible:
    enum:
      - ti,omap3-interface-clock           # basic OMAP3 interface clock
      - ti,omap3-no-wait-interface-clock   # interface clock which has no hardware
                                           # capability for waiting clock to be ready
      - ti,omap3-hsotgusb-interface-clock  # interface clock with USB specific HW handling
      - ti,omap3-dss-interface-clock       # interface clock with DSS specific HW handling
      - ti,omap3-ssi-interface-clock       # interface clock with SSI specific HW handling
      - ti,am35xx-interface-clock          # interface clock with AM35xx specific HW handling
      - ti,omap2430-interface-clock        # interface clock with OMAP2430 specific HW handling

  "#clock-cells":
    const: 0

  clocks:
    maxItems: 1

  clock-output-names:
    maxItems: 1

  reg:
    maxItems: 1

  ti,bit-shift:
    description:
      bit shift for the bit enabling/disabling the clock
    $ref: /schemas/types.yaml#/definitions/uint32
    default: 0
    maximum: 31

required:
  - compatible
  - clocks
  - '#clock-cells'
  - reg

additionalProperties: false

examples:
  - |
    bus {
      #address-cells = <1>;
      #size-cells = <0>;

      aes1_ick: clock-controller@3 {
        #clock-cells = <0>;
        compatible = "ti,omap3-interface-clock";
        clocks = <&security_l4_ick2>;
        reg = <3>;
      };
    };
```

## Documentation/devicetree/bindings/clock/ti/ti,mux-clock.yaml
```yaml
# SPDX-License-Identifier: GPL-2.0-only
%YAML 1.2
---
$id: http://devicetree.org/schemas/clock/ti/ti,mux-clock.yaml#
$schema: http://devicetree.org/meta-schemas/core.yaml#

title: Texas Instruments mux clock

maintainers:
  - Tero Kristo <kristo@kernel.org>

description: |
  This clock assumes a register-mapped multiplexer with multiple inpt clock
  signals or parents, one of which can be selected as output. This clock does
  not gate or adjust the parent rate via a divider or multiplier.

  By default the "clocks" property lists the parents in the same order
  as they are programmed into the register.  E.g:

    clocks = <&foo_clock>, <&bar_clock>, <&baz_clock>;

  Results in programming the register as follows:

  register value   selected parent clock
  0                foo_clock
  1                bar_clock
  2                baz_clock

  Some clock controller IPs do not allow a value of zero to be programmed
  into the register, instead indexing begins at 1.  The optional property
  "index-starts-at-one" modified the scheme as follows:

  register value   selected clock parent
  1                foo_clock
  2                bar_clock
  3                baz_clock

  The binding must provide the register to control the mux. Optionally
  the number of bits to shift the control field in the register can be
  supplied. If the shift value is missing it is the same as supplying
  a zero shift.

properties:
  compatible:
    enum:
      - ti,mux-clock
      - ti,composite-mux-clock

  "#clock-cells":
    const: 0

  clocks: true

  clock-output-names:
    maxItems: 1

  reg:
    maxItems: 1

  ti,bit-shift:
    $ref: /schemas/types.yaml#/definitions/uint32
    description:
      Number of bits to shift the bit-mask
    maximum: 31
    default: 0

  ti,index-starts-at-one:
    type: boolean
    description:
      Valid input select programming starts at 1, not zero

  ti,set-rate-parent:
    type: boolean
    description:
      clk_set_rate is propagated to parent clock,
      not supported by the composite-mux-clock subtype.

  ti,latch-bit:
    $ref: /schemas/types.yaml#/definitions/uint32
    description:
      Latch the mux value to HW, only needed if the register
      access requires this. As an example, dra7x DPLL_GMAC H14 muxing
      implements such behavior.
    maximum: 31

if:
  properties:
    compatible:
      contains:
        const: ti,composite-mux-clock
then:
  properties:
    ti,set-rate-parent: false

required:
  - compatible
  - "#clock-cells"
  - clocks
  - reg

additionalProperties: false

examples:
  - |
    bus {
      #address-cells = <1>;
      #size-cells = <0>;

      clock-controller@110 {
        compatible = "ti,mux-clock";
        reg = <0x0110>;
        #clock-cells = <0>;
        clocks = <&virt_12000000_ck>, <&virt_13000000_ck>, <&virt_16800000_ck>;
        ti,index-starts-at-one;
        ti,set-rate-parent;
      };

      clock-controller@120 {
        compatible = "ti,composite-mux-clock";
        reg = <0x0120>;
        #clock-cells = <0>;
        clocks = <&core_96m_fck>, <&mcbsp_clks>;
        ti,bit-shift = <4>;
      };
    };
```
