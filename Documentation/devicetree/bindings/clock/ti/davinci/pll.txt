## Documentation/devicetree/bindings/clock/ti/fapll.txt
```
Binding for Texas Instruments FAPLL clock.

Binding status: Unstable - ABI compatibility may be broken in the future

This binding uses the common clock binding[1]. It assumes a
register-mapped FAPLL with usually two selectable input clocks
(reference clock and bypass clock), and one or more child
syntesizers.

[1] Documentation/devicetree/bindings/clock/clock-bindings.txt

Required properties:
- compatible : shall be "ti,dm816-fapll-clock"
- #clock-cells : from common clock binding; shall be set to 0.
- clocks : link phandles of parent clocks (clk-ref and clk-bypass)
- reg : address and length of the register set for controlling the FAPLL.

Examples:
	main_fapll: main_fapll {
		#clock-cells = <1>;
		compatible = "ti,dm816-fapll-clock";
		reg = <0x400 0x40>;
		clocks = <&sys_clkin_ck &sys_clkin_ck>;
		clock-indices = <1>, <2>, <3>, <4>, <5>,
				<6>, <7>;
		clock-output-names = "main_pll_clk1",
				     "main_pll_clk2",
				     "main_pll_clk3",
				     "main_pll_clk4",
				     "main_pll_clk5",
				     "main_pll_clk6",
				     "main_pll_clk7";
	};
```

## Documentation/devicetree/bindings/clock/ti/fixed-factor-clock.txt
```
Binding for TI fixed factor rate clock sources.

This binding uses the common clock binding[1], and also uses the autoidle
support from TI autoidle clock [2].

[1] Documentation/devicetree/bindings/clock/clock-bindings.txt
[2] Documentation/devicetree/bindings/clock/ti/autoidle.txt

Required properties:
- compatible : shall be "ti,fixed-factor-clock".
- #clock-cells : from common clock binding; shall be set to 0.
- ti,clock-div: fixed divider.
- ti,clock-mult: fixed multiplier.
- clocks: parent clock.

Optional properties:
- clock-output-names : from common clock binding.
- ti,autoidle-shift: bit shift of the autoidle enable bit for the clock,
  see [2]
- reg: offset for the autoidle register of this clock, see [2]
- ti,invert-autoidle-bit: autoidle is enabled by setting the bit to 0, see [2]
- ti,set-rate-parent: clk_set_rate is propagated to parent

Example:
	clock {
		compatible = "ti,fixed-factor-clock";
		clocks = <&parentclk>;
		#clock-cells = <0>;
		ti,clock-div = <2>;
		ti,clock-mult = <1>;
	};

	dpll_usb_clkdcoldo_ck: dpll_usb_clkdcoldo_ck {
		#clock-cells = <0>;
		compatible = "ti,fixed-factor-clock";
		clocks = <&dpll_usb_ck>;
		ti,clock-div = <1>;
		ti,autoidle-shift = <8>;
		reg = <0x01b4>;
		ti,clock-mult = <1>;
		ti,invert-autoidle-bit;
	};
```

## Documentation/devicetree/bindings/clock/ti/gate.txt
```
Binding for Texas Instruments gate clock.

Binding status: Unstable - ABI compatibility may be broken in the future

This binding uses the common clock binding[1]. This clock is
quite much similar to the basic gate-clock [2], however,
it supports a number of additional features. If no register
is provided for this clock, the code assumes that a clockdomain
will be controlled instead and the corresponding hw-ops for
that is used.

[1] Documentation/devicetree/bindings/clock/clock-bindings.txt
[2] Documentation/devicetree/bindings/clock/gpio-gate-clock.txt
[3] Documentation/devicetree/bindings/clock/ti/clockdomain.txt

Required properties:
- compatible : shall be one of:
  "ti,gate-clock" - basic gate clock
  "ti,wait-gate-clock" - gate clock which waits until clock is active before
			 returning from clk_enable()
  "ti,dss-gate-clock" - gate clock with DSS specific hardware handling
  "ti,am35xx-gate-clock" - gate clock with AM35xx specific hardware handling
  "ti,clkdm-gate-clock" - clockdomain gate clock, which derives its functional
			  clock directly from a clockdomain, see [3] how
			  to map clockdomains properly
  "ti,hsdiv-gate-clock" - gate clock with OMAP36xx specific hardware handling,
			  required for a hardware errata
  "ti,composite-gate-clock" - composite gate clock, to be part of composite
			      clock
  "ti,composite-no-wait-gate-clock" - composite gate clock that does not wait
				      for clock to be active before returning
				      from clk_enable()
- #clock-cells : from common clock binding; shall be set to 0
- clocks : link to phandle of parent clock
- reg : offset for register controlling adjustable gate, not needed for
	ti,clkdm-gate-clock type

Optional properties:
- ti,bit-shift : bit shift for programming the clock gate, invalid for
		 ti,clkdm-gate-clock type
- ti,set-bit-to-disable : inverts default gate programming. Setting the bit
  gates the clock and clearing the bit ungates the clock.

Examples:
	mmchs2_fck: mmchs2_fck@48004a00 {
		#clock-cells = <0>;
		compatible = "ti,gate-clock";
		clocks = <&core_96m_fck>;
		reg = <0x0a00>;
		ti,bit-shift = <25>;
	};

	uart4_fck_am35xx: uart4_fck_am35xx {
		#clock-cells = <0>;
		compatible = "ti,wait-gate-clock";
		clocks = <&core_48m_fck>;
		reg = <0x0a00>;
		ti,bit-shift = <23>;
	};

	dss1_alwon_fck_3430es2: dss1_alwon_fck_3430es2@48004e00 {
		#clock-cells = <0>;
		compatible = "ti,dss-gate-clock";
		clocks = <&dpll4_m4x2_ck>;
		reg = <0x0e00>;
		ti,bit-shift = <0>;
	};

	emac_ick: emac_ick@4800259c {
		#clock-cells = <0>;
		compatible = "ti,am35xx-gate-clock";
		clocks = <&ipss_ick>;
		reg = <0x059c>;
		ti,bit-shift = <1>;
	};

	emu_src_ck: emu_src_ck {
		#clock-cells = <0>;
		compatible = "ti,clkdm-gate-clock";
		clocks = <&emu_src_mux_ck>;
	};

	dpll4_m2x2_ck: dpll4_m2x2_ck@48004d00 {
		#clock-cells = <0>;
		compatible = "ti,hsdiv-gate-clock";
		clocks = <&dpll4_m2x2_mul_ck>;
		ti,bit-shift = <0x1b>;
		reg = <0x0d00>;
		ti,set-bit-to-disable;
	};

	vlynq_gate_fck: vlynq_gate_fck {
		#clock-cells = <0>;
		compatible = "ti,composite-gate-clock";
		clocks = <&core_ck>;
		ti,bit-shift = <3>;
		reg = <0x0200>;
	};

	sys_clkout2_src_gate: sys_clkout2_src_gate {
		#clock-cells = <0>;
		compatible = "ti,composite-no-wait-gate-clock";
		clocks = <&core_ck>;
		ti,bit-shift = <15>;
		reg = <0x0070>;
	};
```

## Documentation/devicetree/bindings/clock/ti/interface.txt
```
Binding for Texas Instruments interface clock.

Binding status: Unstable - ABI compatibility may be broken in the future

This binding uses the common clock binding[1]. This clock is
quite much similar to the basic gate-clock [2], however,
it supports a number of additional features, including
companion clock finding (match corresponding functional gate
clock) and hardware autoidle enable / disable.

[1] Documentation/devicetree/bindings/clock/clock-bindings.txt
[2] Documentation/devicetree/bindings/clock/gate-clock.txt

Required properties:
- compatible : shall be one of:
  "ti,omap3-interface-clock" - basic OMAP3 interface clock
  "ti,omap3-no-wait-interface-clock" - interface clock which has no hardware
				       capability for waiting clock to be ready
  "ti,omap3-hsotgusb-interface-clock" - interface clock with USB specific HW
					handling
  "ti,omap3-dss-interface-clock" - interface clock with DSS specific HW handling
  "ti,omap3-ssi-interface-clock" - interface clock with SSI specific HW handling
  "ti,am35xx-interface-clock" - interface clock with AM35xx specific HW handling
  "ti,omap2430-interface-clock" - interface clock with OMAP2430 specific HW
				  handling
- #clock-cells : from common clock binding; shall be set to 0
- clocks : link to phandle of parent clock
- reg : base address for the control register

Optional properties:
- ti,bit-shift : bit shift for the bit enabling/disabling the clock (default 0)

Examples:
	aes1_ick: aes1_ick@48004a14 {
		#clock-cells = <0>;
		compatible = "ti,omap3-interface-clock";
		clocks = <&security_l4_ick2>;
		reg = <0x48004a14 0x4>;
		ti,bit-shift = <3>;
	};

	cam_ick: cam_ick@48004f10 {
		#clock-cells = <0>;
		compatible = "ti,omap3-no-wait-interface-clock";
		clocks = <&l4_ick>;
		reg = <0x48004f10 0x4>;
		ti,bit-shift = <0>;
	};

	ssi_ick_3430es2: ssi_ick_3430es2@48004a10 {
		#clock-cells = <0>;
		compatible = "ti,omap3-ssi-interface-clock";
		clocks = <&ssi_l4_ick>;
		reg = <0x48004a10 0x4>;
		ti,bit-shift = <0>;
	};
```

## Documentation/devicetree/bindings/clock/ti/mux.txt
```
Binding for TI mux clock.

Binding status: Unstable - ABI compatibility may be broken in the future

This binding uses the common clock binding[1].  It assumes a
register-mapped multiplexer with multiple input clock signals or
parents, one of which can be selected as output.  This clock does not
gate or adjust the parent rate via a divider or multiplier.

By default the "clocks" property lists the parents in the same order
as they are programmed into the regster.  E.g:

	clocks = <&foo_clock>, <&bar_clock>, <&baz_clock>;

results in programming the register as follows:

register value		selected parent clock
0			foo_clock
1			bar_clock
2			baz_clock

Some clock controller IPs do not allow a value of zero to be programmed
into the register, instead indexing begins at 1.  The optional property
"index-starts-at-one" modified the scheme as follows:

register value		selected clock parent
1			foo_clock
2			bar_clock
3			baz_clock

The binding must provide the register to control the mux. Optionally
the number of bits to shift the control field in the register can be
supplied. If the shift value is missing it is the same as supplying
a zero shift.

[1] Documentation/devicetree/bindings/clock/clock-bindings.txt

Required properties:
- compatible : shall be "ti,mux-clock" or "ti,composite-mux-clock".
- #clock-cells : from common clock binding; shall be set to 0.
- clocks : link phandles of parent clocks
- reg : register offset for register controlling adjustable mux

Optional properties:
- ti,bit-shift : number of bits to shift the bit-mask, defaults to
  0 if not present
- ti,index-starts-at-one : valid input select programming starts at 1, not
  zero
- ti,set-rate-parent : clk_set_rate is propagated to parent clock,
  not supported by the composite-mux-clock subtype
- ti,latch-bit : latch the mux value to HW, only needed if the register
  access requires this. As an example, dra7x DPLL_GMAC H14 muxing
  implements such behavior.

Examples:

sys_clkin_ck: sys_clkin_ck@4a306110 {
	#clock-cells = <0>;
	compatible = "ti,mux-clock";
	clocks = <&virt_12000000_ck>, <&virt_13000000_ck>, <&virt_16800000_ck>, <&virt_19200000_ck>, <&virt_26000000_ck>, <&virt_27000000_ck>, <&virt_38400000_ck>;
	reg = <0x0110>;
	ti,index-starts-at-one;
};

abe_dpll_bypass_clk_mux_ck: abe_dpll_bypass_clk_mux_ck@4a306108 {
	#clock-cells = <0>;
	compatible = "ti,mux-clock";
	clocks = <&sys_clkin_ck>, <&sys_32k_ck>;
	ti,bit-shift = <24>;
	reg = <0x0108>;
};

mcbsp5_mux_fck: mcbsp5_mux_fck {
	#clock-cells = <0>;
	compatible = "ti,composite-mux-clock";
	clocks = <&core_96m_fck>, <&mcbsp_clks>;
	ti,bit-shift = <4>;
	reg = <0x02d8>;
};
```

## Documentation/devicetree/bindings/clock/ti/ti,autoidle.yaml
```yaml
# SPDX-License-Identifier: (GPL-2.0-only OR BSD-2-Clause)
%YAML 1.2
---
$id: http://devicetree.org/schemas/clock/ti/ti,autoidle.yaml#
$schema: http://devicetree.org/meta-schemas/core.yaml#

title: TI autoidle clock

maintainers:
  - Tero Kristo <kristo@kernel.org>
  - Sukrut Bellary <sbellary@baylibre.com>

description:
  Some clocks in TI SoC support the autoidle feature. These properties are
  applicable only if the clock supports autoidle feature. It assumes a register
  mapped clock which can be put to idle automatically by hardware based on
  usage and configuration bit setting. Autoidle clock is never an individual
  clock, it is always a derivative of some basic clock like a gate, divider, or
  fixed-factor.

properties:
  ti,autoidle-shift:
    $ref: /schemas/types.yaml#/definitions/uint32
    description:
      bit shift of the autoidle enable bit for the clock
    maximum: 31
    default: 0

  ti,invert-autoidle-bit:
    type: boolean
    description:
      autoidle is enabled by setting the bit to 0

additionalProperties: true
```

## Documentation/devicetree/bindings/clock/ti/ti,clksel.yaml
```yaml
# SPDX-License-Identifier: (GPL-2.0-only OR BSD-2-Clause)
%YAML 1.2
---
$id: http://devicetree.org/schemas/clock/ti/ti,clksel.yaml#
$schema: http://devicetree.org/meta-schemas/core.yaml#

title: TI clksel clock

maintainers:
  - Tony Lindgren <tony@atomide.com>

description: |
  The TI CLKSEL clocks consist of consist of input clock mux bits, and in some
  cases also has divider, multiplier and gate bits.

properties:
  compatible:
    const: ti,clksel

  reg:
    maxItems: 1
    description: The CLKSEL register range

  '#address-cells':
    enum: [ 0, 1, 2 ]

  '#size-cells':
    enum: [ 0, 1, 2 ]

  ranges: true

  "#clock-cells":
    const: 2
    description: The CLKSEL register and bit offset

required:
  - compatible
  - reg
  - "#clock-cells"

additionalProperties:
  type: object

examples:
  - |
    clksel_gfx_fclk: clock@52c {
      compatible = "ti,clksel";
      reg = <0x25c 0x4>;
      #clock-cells = <2>;
    };
...
```

## Documentation/devicetree/bindings/clock/ti/ti,composite-clock.yaml
```yaml
# SPDX-License-Identifier: GPL-2.0-only
%YAML 1.2
---
$id: http://devicetree.org/schemas/clock/ti/ti,composite-clock.yaml#
$schema: http://devicetree.org/meta-schemas/core.yaml#

title: Texas Instruments composite clock

maintainers:
  - Tero Kristo <kristo@kernel.org>

description: |
  *Deprecated design pattern: one node per clock*

  This binding assumes a register-mapped composite clock with multiple
  different sub-types:

    a multiplexer clock with multiple input clock signals or parents, one
    of which can be selected as output, this behaves exactly as [1].

    an adjustable clock rate divider, this behaves exactly as [2].

    a gating function which can be used to enable and disable the output
    clock, this behaves exactly as [3].

  The binding must provide a list of the component clocks that shall be
  merged to this clock. The component clocks shall be of one of the
  "ti,*composite*-clock" types.

  [1] Documentation/devicetree/bindings/clock/ti/ti,mux-clock.yaml
  [2] Documentation/devicetree/bindings/clock/ti/ti,divider-clock.yaml
  [3] Documentation/devicetree/bindings/clock/ti/ti,gate-clock.yaml

properties:
  compatible:
    const: ti,composite-clock

  "#clock-cells":
    const: 0

  clocks: true

  clock-output-names:
    maxItems: 1

required:
  - compatible
  - "#clock-cells"
  - clocks

additionalProperties: false

examples:
  - |
    bus {
      #address-cells = <1>;
      #size-cells = <0>;

      usb_l4_gate_ick: clock-controller@a10 {
        #clock-cells = <0>;
        compatible = "ti,composite-gate-clock";
        clocks = <&l4_ick>;
        ti,bit-shift = <5>;
        reg = <0x0a10>;
      };

      usb_l4_div_ick: clock-controller@a40 {
        #clock-cells = <0>;
        compatible = "ti,composite-divider-clock";
        clocks = <&l4_ick>;
        ti,bit-shift = <4>;
        ti,max-div = <1>;
        reg = <0x0a40>;
        ti,index-starts-at-one;
      };
    };

    clock-controller {
      #clock-cells = <0>;
      compatible = "ti,composite-clock";
      clocks = <&usb_l4_gate_ick>, <&usb_l4_div_ick>;
    };
```
