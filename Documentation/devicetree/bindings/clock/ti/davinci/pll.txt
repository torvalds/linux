## Documentation/devicetree/bindings/clock/toshiba,tmpv770x-pipllct.yaml
```yaml
# SPDX-License-Identifier: (GPL-2.0-only OR BSD-2-Clause)
%YAML 1.2
---
$id: http://devicetree.org/schemas/clock/toshiba,tmpv770x-pipllct.yaml#
$schema: http://devicetree.org/meta-schemas/core.yaml#

title: Toshiba Visconti5 TMPV770X PLL Controller

maintainers:
  - Nobuhiro Iwamatsu <nobuhiro1.iwamatsu@toshiba.co.jp>

description:
  Toshia Visconti5 PLL controller which supports the PLLs on TMPV770X.

properties:
  compatible:
    const: toshiba,tmpv7708-pipllct

  reg:
    maxItems: 1

  '#clock-cells':
    const: 1

  clocks:
    description: External reference clock (OSC2)
    maxItems: 1

required:
  - compatible
  - reg
  - "#clock-cells"
  - clocks

additionalProperties: false

examples:
  - |

    osc2_clk: osc2-clk {
      compatible = "fixed-clock";
      clock-frequency = <20000000>;
      #clock-cells = <0>;
    };

    soc {
        #address-cells = <2>;
        #size-cells = <2>;

        pipllct: clock-controller@24220000 {
            compatible = "toshiba,tmpv7708-pipllct";
            reg = <0 0x24220000 0 0x820>;
            #clock-cells = <1>;
            clocks = <&osc2_clk>;
        };
    };
...
```

## Documentation/devicetree/bindings/clock/toshiba,tmpv770x-pismu.yaml
```yaml
# SPDX-License-Identifier: (GPL-2.0-only OR BSD-2-Clause)
%YAML 1.2
---
$id: http://devicetree.org/schemas/clock/toshiba,tmpv770x-pismu.yaml#
$schema: http://devicetree.org/meta-schemas/core.yaml#

title: Toshiba Visconti5 TMPV770x SMU controller Device Tree Bindings

maintainers:
  - Nobuhiro Iwamatsu <nobuhiro1.iwamatsu@toshiba.co.jp>

description:
  Toshia Visconti5 SMU (System Management Unit) which supports the clock
  and resets on TMPV770x.

properties:
  compatible:
    items:
      - const: toshiba,tmpv7708-pismu
      - const: syscon

  reg:
    maxItems: 1

  '#clock-cells':
    const: 1

  '#reset-cells':
    const: 1

required:
  - compatible
  - reg
  - "#clock-cells"
  - "#reset-cells"

additionalProperties: false

examples:
  - |
    soc {
        #address-cells = <2>;
        #size-cells = <2>;

        pismu: syscon@24200000 {
            compatible = "toshiba,tmpv7708-pismu", "syscon";
            reg = <0 0x24200000 0 0x2140>;
            #clock-cells = <1>;
            #reset-cells = <1>;
        };
    };
...
```

## Documentation/devicetree/bindings/clock/uniphier-clock.txt
```
UniPhier clock controller


System clock
------------

Required properties:
- compatible: should be one of the following:
    "socionext,uniphier-sld3-clock" - for sLD3 SoC.
    "socionext,uniphier-ld4-clock"  - for LD4 SoC.
    "socionext,uniphier-pro4-clock" - for Pro4 SoC.
    "socionext,uniphier-sld8-clock" - for sLD8 SoC.
    "socionext,uniphier-pro5-clock" - for Pro5 SoC.
    "socionext,uniphier-pxs2-clock" - for PXs2/LD6b SoC.
    "socionext,uniphier-ld11-clock" - for LD11 SoC.
    "socionext,uniphier-ld20-clock" - for LD20 SoC.
- #clock-cells: should be 1.

Example:

	sysctrl@61840000 {
		compatible = "socionext,uniphier-sysctrl",
			     "simple-mfd", "syscon";
		reg = <0x61840000 0x4000>;

		clock {
			compatible = "socionext,uniphier-ld20-clock";
			#clock-cells = <1>;
		};

		other nodes ...
	};

Provided clocks:

 8: ST DMAC
12: GIO (Giga bit stream I/O)
14: USB3 ch0 host
15: USB3 ch1 host
16: USB3 ch0 PHY0
17: USB3 ch0 PHY1
20: USB3 ch1 PHY0
21: USB3 ch1 PHY1


Media I/O (MIO) clock
---------------------

Required properties:
- compatible: should be one of the following:
    "socionext,uniphier-sld3-mio-clock" - for sLD3 SoC.
    "socionext,uniphier-ld4-mio-clock"  - for LD4 SoC.
    "socionext,uniphier-pro4-mio-clock" - for Pro4 SoC.
    "socionext,uniphier-sld8-mio-clock" - for sLD8 SoC.
    "socionext,uniphier-pro5-mio-clock" - for Pro5 SoC.
    "socionext,uniphier-pxs2-mio-clock" - for PXs2/LD6b SoC.
    "socionext,uniphier-ld11-mio-clock" - for LD11 SoC.
    "socionext,uniphier-ld20-mio-clock" - for LD20 SoC.
- #clock-cells: should be 1.

Example:

	mioctrl@59810000 {
		compatible = "socionext,uniphier-mioctrl",
			     "simple-mfd", "syscon";
		reg = <0x59810000 0x800>;

		clock {
			compatible = "socionext,uniphier-ld20-mio-clock";
			#clock-cells = <1>;
		};

		other nodes ...
	};

Provided clocks:

 0: SD ch0 host
 1: eMMC host
 2: SD ch1 host
 7: MIO DMAC
 8: USB2 ch0 host
 9: USB2 ch1 host
10: USB2 ch2 host
11: USB2 ch3 host
12: USB2 ch0 PHY
13: USB2 ch1 PHY
14: USB2 ch2 PHY
15: USB2 ch3 PHY


Peripheral clock
----------------

Required properties:
- compatible: should be one of the following:
    "socionext,uniphier-sld3-peri-clock" - for sLD3 SoC.
    "socionext,uniphier-ld4-peri-clock"  - for LD4 SoC.
    "socionext,uniphier-pro4-peri-clock" - for Pro4 SoC.
    "socionext,uniphier-sld8-peri-clock" - for sLD8 SoC.
    "socionext,uniphier-pro5-peri-clock" - for Pro5 SoC.
    "socionext,uniphier-pxs2-peri-clock" - for PXs2/LD6b SoC.
    "socionext,uniphier-ld11-peri-clock" - for LD11 SoC.
    "socionext,uniphier-ld20-peri-clock" - for LD20 SoC.
- #clock-cells: should be 1.

Example:

	perictrl@59820000 {
		compatible = "socionext,uniphier-perictrl",
			     "simple-mfd", "syscon";
		reg = <0x59820000 0x200>;

		clock {
			compatible = "socionext,uniphier-ld20-peri-clock";
			#clock-cells = <1>;
		};

		other nodes ...
	};

Provided clocks:

 0: UART ch0
 1: UART ch1
 2: UART ch2
 3: UART ch3
 4: I2C ch0
 5: I2C ch1
 6: I2C ch2
 7: I2C ch3
 8: I2C ch4
 9: I2C ch5
10: I2C ch6
```

## Documentation/devicetree/bindings/clock/ux500.txt
```
Clock bindings for ST-Ericsson Ux500 clocks

Required properties :
- compatible : shall contain only one of the following:
  "stericsson,u8500-clks"
  "stericsson,u8540-clks"
  "stericsson,u9540-clks"
- reg : shall contain base register location and length for
  CLKRST1, 2, 3, 5, and 6 in an array. Note the absence of
  CLKRST4, which does not exist.

Required subnodes:
- prcmu-clock: a subnode with one clock cell for PRCMU (power,
  reset, control unit) clocks. The cell indicates which PRCMU
  clock in the prcmu-clock node the consumer wants to use.
- prcc-periph-clock: a subnode with two clock cells for
  PRCC (programmable reset- and clock controller) peripheral clocks.
  The first cell indicates which PRCC block the consumer
  wants to use, possible values are 1, 2, 3, 5, 6. The second
  cell indicates which clock inside the PRCC block it wants,
  possible values are 0 thru 31.
- prcc-kernel-clock: a subnode with two clock cells for
  PRCC (programmable reset- and clock controller) kernel clocks
  The first cell indicates which PRCC block the consumer
  wants to use, possible values are 1, 2, 3, 5, 6. The second
  cell indicates which clock inside the PRCC block it wants,
  possible values are 0 thru 31.
- rtc32k-clock: a subnode with zero clock cells for the 32kHz
  RTC clock.
- smp-twd-clock: a subnode for the ARM SMP Timer Watchdog cluster
  with zero clock cells.

Example:

clocks {
	compatible = "stericsson,u8500-clks";
	/*
	 * Registers for the CLKRST block on peripheral
	 * groups 1, 2, 3, 5, 6,
	 */
	reg = <0x8012f000 0x1000>, <0x8011f000 0x1000>,
	    <0x8000f000 0x1000>, <0xa03ff000 0x1000>,
	    <0xa03cf000 0x1000>;

	prcmu_clk: prcmu-clock {
		#clock-cells = <1>;
	};

	prcc_pclk: prcc-periph-clock {
		#clock-cells = <2>;
	};

	prcc_kclk: prcc-kernel-clock {
		#clock-cells = <2>;
	};

	rtc_clk: rtc32k-clock {
		#clock-cells = <0>;
	};

	smp_twd_clk: smp-twd-clock {
		#clock-cells = <0>;
	};
};
```

## Documentation/devicetree/bindings/clock/vf610-clock.txt
```
* Clock bindings for Freescale Vybrid VF610 SOC

Required properties:
- compatible: Should be "fsl,vf610-ccm"
- reg: Address and length of the register set
- #clock-cells: Should be <1>

Optional properties:
- clocks: list of clock identifiers which are external input clocks to the
	given clock controller. Please refer the next section to find
	the input clocks for a given controller.
- clock-names: list of names of clocks which are exteral input clocks to the
	given clock controller.

Input clocks for top clock controller:
	- sxosc (external crystal oscillator 32KHz, recommended)
	- fxosc (external crystal oscillator 24MHz, recommended)
	- audio_ext
	- enet_ext

The clock consumer should specify the desired clock by having the clock
ID in its "clocks" phandle cell. See include/dt-bindings/clock/vf610-clock.h
for the full list of VF610 clock IDs.

Examples:

clks: ccm@4006b000 {
	compatible = "fsl,vf610-ccm";
	reg = <0x4006b000 0x1000>;
	#clock-cells = <1>;
	clocks = <&sxosc>, <&fxosc>;
	clock-names = "sxosc", "fxosc";
};

uart1: serial@40028000 {
	compatible = "fsl,vf610-uart";
	reg = <0x40028000 0x1000>;
	interrupts = <0 62 0x04>;
	clocks = <&clks VF610_CLK_UART1>;
	clock-names = "ipg";
};
```

## Documentation/devicetree/bindings/clock/vt8500.txt
```
Device Tree Clock bindings for arch-vt8500

This binding uses the common clock binding[1].

[1] Documentation/devicetree/bindings/clock/clock-bindings.txt

Required properties:
- compatible : shall be one of the following:
	"via,vt8500-pll-clock" - for a VT8500/WM8505 PLL clock
	"wm,wm8650-pll-clock" - for a WM8650 PLL clock
	"wm,wm8750-pll-clock" - for a WM8750 PLL clock
	"wm,wm8850-pll-clock" - for a WM8850 PLL clock
	"via,vt8500-device-clock" - for a VT/WM device clock

Required properties for PLL clocks:
- reg : shall be the control register offset from PMC base for the pll clock.
- clocks : shall be the input parent clock phandle for the clock. This should
	be the reference clock.
- #clock-cells : from common clock binding; shall be set to 0.

Required properties for device clocks:
- clocks : shall be the input parent clock phandle for the clock. This should
	be a pll output.
- #clock-cells : from common clock binding; shall be set to 0.


Device Clocks

Device clocks are required to have one or both of the following sets of
properties:


Gated device clocks:

Required properties:
- enable-reg : shall be the register offset from PMC base for the enable
	register.
- enable-bit : shall be the bit within enable-reg to enable/disable the clock.


Divisor device clocks:

Required property:
- divisor-reg : shall be the register offset from PMC base for the divisor
	register.
Optional property:
- divisor-mask : shall be the mask for the divisor register. Defaults to 0x1f
	if not specified.


For example:

ref25: ref25M {
	#clock-cells = <0>;
	compatible = "fixed-clock";
	clock-frequency = <25000000>;
};

plla: plla {
	#clock-cells = <0>;
	compatible = "wm,wm8650-pll-clock";
	clocks = <&ref25>;
	reg = <0x200>;
};

sdhc: sdhc {
	#clock-cells = <0>;
	compatible = "via,vt8500-device-clock";
	clocks = <&pllb>;
	divisor-reg = <0x328>;
	divisor-mask = <0x3f>;
	enable-reg = <0x254>;
	enable-bit = <18>;
};
```

## Documentation/devicetree/bindings/clock/xgene.txt
```
Device Tree Clock bindings for APM X-Gene

This binding uses the common clock binding[1].

[1] Documentation/devicetree/bindings/clock/clock-bindings.txt

Required properties:
- compatible : shall be one of the following:
	"apm,xgene-socpll-clock" - for a X-Gene SoC PLL clock
	"apm,xgene-pcppll-clock" - for a X-Gene PCP PLL clock
	"apm,xgene-device-clock" - for a X-Gene device clock

Required properties for SoC or PCP PLL clocks:
- reg : shall be the physical PLL register address for the pll clock.
- clocks : shall be the input parent clock phandle for the clock. This should
	be the reference clock.
- #clock-cells : shall be set to 1.
- clock-output-names : shall be the name of the PLL referenced by derive
  clock.
Optional properties for PLL clocks:
- clock-names : shall be the name of the PLL. If missing, use the device name.

Required properties for device clocks:
- reg : shall be a list of address and length pairs describing the CSR
         reset and/or the divider. Either may be omitted, but at least
         one must be present.
 - reg-names : shall be a string list describing the reg resource. This
               may include "csr-reg" and/or "div-reg". If this property
               is not present, the reg property is assumed to describe
               only "csr-reg".
- clocks : shall be the input parent clock phandle for the clock.
- #clock-cells : shall be set to 1.
- clock-output-names : shall be the name of the device referenced.
Optional properties for device clocks:
- clock-names : shall be the name of the device clock. If missing, use the
                device name.
- csr-offset : Offset to the CSR reset register from the reset address base.
               Default is 0.
- csr-mask : CSR reset mask bit. Default is 0xF.
- enable-offset : Offset to the enable register from the reset address base.
                  Default is 0x8.
- enable-mask : CSR enable mask bit. Default is 0xF.
- divider-offset : Offset to the divider CSR register from the divider base.
                   Default is 0x0.
- divider-width : Width of the divider register. Default is 0.
- divider-shift : Bit shift of the divider register. Default is 0.

For example:

	pcppll: pcppll@17000100 {
		compatible = "apm,xgene-pcppll-clock";
		#clock-cells = <1>;
		clocks = <&refclk 0>;
		clock-names = "pcppll";
		reg = <0x0 0x17000100 0x0 0x1000>;
		clock-output-names = "pcppll";
		type = <0>;
	};

	socpll: socpll@17000120 {
		compatible = "apm,xgene-socpll-clock";
		#clock-cells = <1>;
		clocks = <&refclk 0>;
		clock-names = "socpll";
		reg = <0x0 0x17000120 0x0 0x1000>;
		clock-output-names = "socpll";
		type = <1>;
	};

	qmlclk: qmlclk {
		compatible = "apm,xgene-device-clock";
		#clock-cells = <1>;
		clocks = <&socplldiv2 0>;
		clock-names = "qmlclk";
		reg = <0x0 0x1703C000 0x0 0x1000>;
		reg-name = "csr-reg";
		clock-output-names = "qmlclk";
	};

	ethclk: ethclk {
		compatible = "apm,xgene-device-clock";
		#clock-cells = <1>;
		clocks = <&socplldiv2 0>;
		clock-names = "ethclk";
		reg = <0x0 0x17000000 0x0 0x1000>;
		reg-names = "div-reg";
		divider-offset = <0x238>;
		divider-width = <0x9>;
		divider-shift = <0x0>;
		clock-output-names = "ethclk";
	};

	apbclk: apbclk {
		compatible = "apm,xgene-device-clock";
		#clock-cells = <1>;
		clocks = <&ahbclk 0>;
		clock-names = "apbclk";
		reg = <0x0 0x1F2AC000 0x0 0x1000
			0x0 0x1F2AC000 0x0 0x1000>;
		reg-names = "csr-reg", "div-reg";
		csr-offset = <0x0>;
		csr-mask = <0x200>;
		enable-offset = <0x8>;
		enable-mask = <0x200>;
		divider-offset = <0x10>;
		divider-width = <0x2>;
		divider-shift = <0x0>;
		flags = <0x8>;
		clock-output-names = "apbclk";
	};
```
