## Documentation/devicetree/bindings/clock/silabs,si570.yaml
```yaml
# SPDX-License-Identifier: (GPL-2.0-only OR BSD-2-Clause)
%YAML 1.2
---
$id: http://devicetree.org/schemas/clock/silabs,si570.yaml#
$schema: http://devicetree.org/meta-schemas/core.yaml#

title: Silicon Labs Si570/Si571/Si598/Si599 programmable I2C clock generator

maintainers:
  - Soren Brinkmann <soren.brinkmann@xilinx.com>

description: >
  Silicon Labs 570, 571, 598 and 599 programmable I2C clock generators. Details
  about the devices can be found in the data sheets[1][2].

  [1] Si570/571 Data Sheet
      https://www.silabs.com/Support%20Documents/TechnicalDocs/si570.pdf
  [2] Si598/599 Data Sheet
      https://www.silabs.com/Support%20Documents/TechnicalDocs/si598-99.pdf

properties:
  compatible:
    enum:
      - silabs,si570
      - silabs,si571
      - silabs,si598
      - silabs,si599

  reg:
    maxItems: 1

  '#clock-cells':
    const: 0

  factory-fout:
    description: Factory-set default frequency in Hz.
    $ref: /schemas/types.yaml#/definitions/uint32

  temperature-stability:
    description: Temperature stability of the device in PPM.
    $ref: /schemas/types.yaml#/definitions/uint32
    enum:
      - 7
      - 20
      - 50
      - 100

  clock-output-names:
    maxItems: 1

  clock-frequency:
    description: Output frequency to generate at boot; can be reprogrammed at runtime.

  silabs,skip-recall:
    description: Skip the NVM-to-RAM recall operation during boot.
    type: boolean

required:
  - compatible
  - reg
  - '#clock-cells'
  - factory-fout
  - temperature-stability

additionalProperties: false

examples:
  - |
    i2c {
        #address-cells = <1>;
        #size-cells = <0>;

        clock-generator@5d {
            compatible = "silabs,si570";
            reg = <0x5d>;
            #clock-cells = <0>;
            temperature-stability = <50>;
            factory-fout = <156250000>;
        };
    };
```

## Documentation/devicetree/bindings/clock/skyworks,si521xx.yaml
```yaml
# SPDX-License-Identifier: (GPL-2.0-only OR BSD-2-Clause)
%YAML 1.2
---
$id: http://devicetree.org/schemas/clock/skyworks,si521xx.yaml#
$schema: http://devicetree.org/meta-schemas/core.yaml#

title: Skyworks Si521xx I2C PCIe clock generators

description: |
  The Skyworks Si521xx are I2C PCIe clock generators providing
  from 4 to 9 output clocks.

maintainers:
  - Marek Vasut <marex@denx.de>

properties:
  compatible:
    enum:
      - skyworks,si52144
      - skyworks,si52146
      - skyworks,si52147

  reg:
    const: 0x6b

  '#clock-cells':
    const: 1

  clocks:
    items:
      - description: XTal input clock

  skyworks,out-amplitude-microvolt:
    enum: [ 300000, 400000, 500000, 600000, 700000, 800000, 900000, 1000000 ]
    description: Output clock signal amplitude

required:
  - compatible
  - reg
  - clocks
  - '#clock-cells'

additionalProperties: false

examples:
  - |
    i2c {
        #address-cells = <1>;
        #size-cells = <0>;

        clock-generator@6b {
            compatible = "skyworks,si52144";
            reg = <0x6b>;
            #clock-cells = <1>;
            clocks = <&ref25m>;
        };
    };

...
```

## Documentation/devicetree/bindings/clock/snps,hsdk-pll-clock.txt
```
Binding for the HSDK Generic PLL clock

This binding uses the common clock binding[1].

[1] Documentation/devicetree/bindings/clock/clock-bindings.txt

Required properties:
- compatible: should be "snps,hsdk-<name>-pll-clock"
  "snps,hsdk-core-pll-clock"
  "snps,hsdk-gp-pll-clock"
  "snps,hsdk-hdmi-pll-clock"
- reg : should contain base register location and length.
- clocks: shall be the input parent clock phandle for the PLL.
- #clock-cells: from common clock binding; Should always be set to 0.

Example:
	input_clk: input-clk {
		clock-frequency = <33333333>;
		compatible = "fixed-clock";
		#clock-cells = <0>;
	};

	cpu_clk: cpu-clk@0 {
		compatible = "snps,hsdk-core-pll-clock";
		reg = <0x00 0x10>;
		#clock-cells = <0>;
		clocks = <&input_clk>;
	};
```

## Documentation/devicetree/bindings/clock/snps,pll-clock.txt
```
Binding for the AXS10X Generic PLL clock

This binding uses the common clock binding[1].

[1] Documentation/devicetree/bindings/clock/clock-bindings.txt

Required properties:
- compatible: should be "snps,axs10x-<name>-pll-clock"
  "snps,axs10x-arc-pll-clock"
  "snps,axs10x-pgu-pll-clock"
- reg: should always contain 2 pairs address - length: first for PLL config
registers and second for corresponding LOCK CGU register.
- clocks: shall be the input parent clock phandle for the PLL.
- #clock-cells: from common clock binding; Should always be set to 0.

Example:
	input-clk: input-clk {
		clock-frequency = <33333333>;
		compatible = "fixed-clock";
		#clock-cells = <0>;
	};

	core-clk: core-clk@80 {
		compatible = "snps,axs10x-arc-pll-clock";
		reg = <0x80 0x10>, <0x100 0x10>;
		#clock-cells = <0>;
		clocks = <&input-clk>;
	};
```

## Documentation/devicetree/bindings/clock/socionext,uniphier-clock.yaml
```yaml
# SPDX-License-Identifier: GPL-2.0-only OR BSD-2-Clause
%YAML 1.2
---
$id: http://devicetree.org/schemas/clock/socionext,uniphier-clock.yaml#
$schema: http://devicetree.org/meta-schemas/core.yaml#

title: UniPhier clock controller

maintainers:
  - Masahiro Yamada <yamada.masahiro@socionext.com>

properties:
  compatible:
    oneOf:
      - description: System clock
        enum:
          - socionext,uniphier-ld4-clock
          - socionext,uniphier-pro4-clock
          - socionext,uniphier-sld8-clock
          - socionext,uniphier-pro5-clock
          - socionext,uniphier-pxs2-clock
          - socionext,uniphier-ld6b-clock
          - socionext,uniphier-ld11-clock
          - socionext,uniphier-ld20-clock
          - socionext,uniphier-pxs3-clock
          - socionext,uniphier-nx1-clock
      - description: Media I/O (MIO) clock, SD clock
        enum:
          - socionext,uniphier-ld4-mio-clock
          - socionext,uniphier-pro4-mio-clock
          - socionext,uniphier-sld8-mio-clock
          - socionext,uniphier-pro5-sd-clock
          - socionext,uniphier-pxs2-sd-clock
          - socionext,uniphier-ld11-mio-clock
          - socionext,uniphier-ld20-sd-clock
          - socionext,uniphier-pxs3-sd-clock
          - socionext,uniphier-nx1-sd-clock
      - description: Peripheral clock
        enum:
          - socionext,uniphier-ld4-peri-clock
          - socionext,uniphier-pro4-peri-clock
          - socionext,uniphier-sld8-peri-clock
          - socionext,uniphier-pro5-peri-clock
          - socionext,uniphier-pxs2-peri-clock
          - socionext,uniphier-ld11-peri-clock
          - socionext,uniphier-ld20-peri-clock
          - socionext,uniphier-pxs3-peri-clock
          - socionext,uniphier-nx1-peri-clock
      - description: SoC-glue clock
        enum:
          - socionext,uniphier-pro4-sg-clock

  "#clock-cells":
    const: 1

additionalProperties: false

required:
  - compatible
  - "#clock-cells"

examples:
  - |
    clock-controller {
        compatible = "socionext,uniphier-ld11-clock";
        #clock-cells = <1>;
    };
```

## Documentation/devicetree/bindings/clock/sophgo,cv1800-clk.yaml
```yaml
# SPDX-License-Identifier: GPL-2.0-only OR BSD-2-Clause
%YAML 1.2
---
$id: http://devicetree.org/schemas/clock/sophgo,cv1800-clk.yaml#
$schema: http://devicetree.org/meta-schemas/core.yaml#

title: Sophgo CV1800/SG2000 Series Clock Controller

maintainers:
  - Inochi Amaoto <inochiama@outlook.com>

properties:
  compatible:
    oneOf:
      - enum:
          - sophgo,cv1800b-clk
          - sophgo,cv1812h-clk
          - sophgo,sg2000-clk
      - items:
          - const: sophgo,sg2002-clk
          - const: sophgo,sg2000-clk
      - const: sophgo,cv1800-clk
        deprecated: true
      - const: sophgo,cv1810-clk
        deprecated: true

  reg:
    maxItems: 1

  clocks:
    maxItems: 1

  "#clock-cells":
    const: 1
    description:
      See <dt-bindings/clock/sophgo,cv1800.h> for valid indices.

required:
  - compatible
  - reg
  - clocks
  - "#clock-cells"

additionalProperties: false

examples:
  - |
    clock-controller@3002000 {
        compatible = "sophgo,cv1800-clk";
        reg = <0x03002000 0x1000>;
        clocks = <&osc>;
        #clock-cells = <1>;
    };

...
```

## Documentation/devicetree/bindings/clock/sophgo,sg2042-clkgen.yaml
```yaml
# SPDX-License-Identifier: (GPL-2.0 OR BSD-2-Clause)
%YAML 1.2
---
$id: http://devicetree.org/schemas/clock/sophgo,sg2042-clkgen.yaml#
$schema: http://devicetree.org/meta-schemas/core.yaml#

title: Sophgo SG2042 Clock Generator for divider/mux/gate

maintainers:
  - Chen Wang <unicorn_wang@outlook.com>

properties:
  compatible:
    const: sophgo,sg2042-clkgen

  reg:
    maxItems: 1

  clocks:
    items:
      - description: Main PLL
      - description: Fixed PLL
      - description: DDR PLL 0
      - description: DDR PLL 1

  clock-names:
    items:
      - const: mpll
      - const: fpll
      - const: dpll0
      - const: dpll1

  '#clock-cells':
    const: 1
    description:
      See <dt-bindings/clock/sophgo,sg2042-clkgen.h> for valid indices.

required:
  - compatible
  - reg
  - clocks
  - clock-names
  - '#clock-cells'

additionalProperties: false

examples:
  - |
    clock-controller@30012000 {
      compatible = "sophgo,sg2042-clkgen";
      reg = <0x30012000 0x1000>;
      clocks = <&pllclk 0>,
               <&pllclk 1>,
               <&pllclk 2>,
               <&pllclk 3>;
      clock-names = "mpll",
                    "fpll",
                    "dpll0",
                    "dpll1";
      #clock-cells = <1>;
    };
```

## Documentation/devicetree/bindings/clock/sophgo,sg2042-pll.yaml
```yaml
# SPDX-License-Identifier: (GPL-2.0 OR BSD-2-Clause)
%YAML 1.2
---
$id: http://devicetree.org/schemas/clock/sophgo,sg2042-pll.yaml#
$schema: http://devicetree.org/meta-schemas/core.yaml#

title: Sophgo SG2042 PLL Clock Generator

maintainers:
  - Chen Wang <unicorn_wang@outlook.com>

properties:
  compatible:
    const: sophgo,sg2042-pll

  reg:
    maxItems: 1

  clocks:
    items:
      - description: Oscillator(Clock Generation IC) for Main/Fixed PLL (25 MHz)
      - description: Oscillator(Clock Generation IC) for DDR PLL 0 (25 MHz)
      - description: Oscillator(Clock Generation IC) for DDR PLL 1 (25 MHz)

  clock-names:
    items:
      - const: cgi_main
      - const: cgi_dpll0
      - const: cgi_dpll1

  '#clock-cells':
    const: 1
    description:
      See <dt-bindings/clock/sophgo,sg2042-pll.h> for valid indices.

required:
  - compatible
  - reg
  - clocks
  - clock-names
  - '#clock-cells'

additionalProperties: false

examples:
  - |
    clock-controller@10000000 {
      compatible = "sophgo,sg2042-pll";
      reg = <0x10000000 0x10000>;
      clocks = <&cgi_main>, <&cgi_dpll0>, <&cgi_dpll1>;
      clock-names = "cgi_main", "cgi_dpll0", "cgi_dpll1";
      #clock-cells = <1>;
    };
```

## Documentation/devicetree/bindings/clock/sophgo,sg2042-rpgate.yaml
```yaml
# SPDX-License-Identifier: (GPL-2.0 OR BSD-2-Clause)
%YAML 1.2
---
$id: http://devicetree.org/schemas/clock/sophgo,sg2042-rpgate.yaml#
$schema: http://devicetree.org/meta-schemas/core.yaml#

title: Sophgo SG2042 Gate Clock Generator for RP(riscv processors) subsystem

maintainers:
  - Chen Wang <unicorn_wang@outlook.com>

properties:
  compatible:
    const: sophgo,sg2042-rpgate

  reg:
    maxItems: 1

  clocks:
    items:
      - description: Gate clock for RP subsystem

  clock-names:
    items:
      - const: rpgate

  '#clock-cells':
    const: 1
    description:
      See <dt-bindings/clock/sophgo,sg2042-rpgate.h> for valid indices.

required:
  - compatible
  - reg
  - clocks
  - clock-names
  - '#clock-cells'

additionalProperties: false

examples:
  - |
    clock-controller@20000000 {
      compatible = "sophgo,sg2042-rpgate";
      reg = <0x20000000 0x10000>;
      clocks = <&clkgen 85>;
      clock-names = "rpgate";
      #clock-cells = <1>;
    };
```

## Documentation/devicetree/bindings/clock/sophgo,sg2044-clk.yaml
```yaml
# SPDX-License-Identifier: (GPL-2.0 OR BSD-2-Clause)
%YAML 1.2
---
$id: http://devicetree.org/schemas/clock/sophgo,sg2044-clk.yaml#
$schema: http://devicetree.org/meta-schemas/core.yaml#

title: Sophgo SG2044 Clock Controller

maintainers:
  - Inochi Amaoto <inochiama@gmail.com>

description: |
  The Sophgo SG2044 clock controller requires an external oscillator
  as input clock.

  All available clocks are defined as preprocessor macros in
  include/dt-bindings/clock/sophgo,sg2044-clk.h

properties:
  compatible:
    const: sophgo,sg2044-clk

  reg:
    maxItems: 1

  clocks:
    items:
      - description: fpll0
      - description: fpll1
      - description: fpll2
      - description: dpll0
      - description: dpll1
      - description: dpll2
      - description: dpll3
      - description: dpll4
      - description: dpll5
      - description: dpll6
      - description: dpll7
      - description: mpll0
      - description: mpll1
      - description: mpll2
      - description: mpll3
      - description: mpll4
      - description: mpll5

  clock-names:
    items:
      - const: fpll0
      - const: fpll1
      - const: fpll2
      - const: dpll0
      - const: dpll1
      - const: dpll2
      - const: dpll3
      - const: dpll4
      - const: dpll5
      - const: dpll6
      - const: dpll7
      - const: mpll0
      - const: mpll1
      - const: mpll2
      - const: mpll3
      - const: mpll4
      - const: mpll5

  '#clock-cells':
    const: 1

required:
  - compatible
  - reg
  - clocks
  - '#clock-cells'

additionalProperties: false

examples:
  - |
    #include <dt-bindings/clock/sophgo,sg2044-pll.h>

    clock-controller@50002000 {
      compatible = "sophgo,sg2044-clk";
      reg = <0x50002000 0x1000>;
      #clock-cells = <1>;
      clocks = <&syscon CLK_FPLL0>, <&syscon CLK_FPLL1>,
               <&syscon CLK_FPLL2>, <&syscon CLK_DPLL0>,
               <&syscon CLK_DPLL1>, <&syscon CLK_DPLL2>,
               <&syscon CLK_DPLL3>, <&syscon CLK_DPLL4>,
               <&syscon CLK_DPLL5>, <&syscon CLK_DPLL6>,
               <&syscon CLK_DPLL7>, <&syscon CLK_MPLL0>,
               <&syscon CLK_MPLL1>, <&syscon CLK_MPLL2>,
               <&syscon CLK_MPLL3>, <&syscon CLK_MPLL4>,
               <&syscon CLK_MPLL5>;
      clock-names = "fpll0", "fpll1", "fpll2", "dpll0",
                    "dpll1", "dpll2", "dpll3", "dpll4",
                    "dpll5", "dpll6", "dpll7", "mpll0",
                    "mpll1", "mpll2", "mpll3", "mpll4",
                    "mpll5";
    };
```

## Documentation/devicetree/bindings/clock/spacemit,k1-pll.yaml
```yaml
# SPDX-License-Identifier: GPL-2.0-only OR BSD-2-Clause
%YAML 1.2
---
$id: http://devicetree.org/schemas/clock/spacemit,k1-pll.yaml#
$schema: http://devicetree.org/meta-schemas/core.yaml#

title: SpacemiT K1 PLL

maintainers:
  - Haylen Chu <heylenay@4d2.org>

properties:
  compatible:
    const: spacemit,k1-pll

  reg:
    maxItems: 1

  clocks:
    description: External 24MHz oscillator

  spacemit,mpmu:
    $ref: /schemas/types.yaml#/definitions/phandle
    description:
      Phandle to the "Main PMU (MPMU)" syscon. It is used to check PLL
      lock status.

  "#clock-cells":
    const: 1
    description:
      See <dt-bindings/clock/spacemit,k1-syscon.h> for valid indices.

required:
  - compatible
  - reg
  - clocks
  - spacemit,mpmu
  - "#clock-cells"

additionalProperties: false

examples:
  - |
    clock-controller@d4090000 {
        compatible = "spacemit,k1-pll";
        reg = <0xd4090000 0x1000>;
        clocks = <&vctcxo_24m>;
        spacemit,mpmu = <&sysctl_mpmu>;
        #clock-cells = <1>;
    };
```
