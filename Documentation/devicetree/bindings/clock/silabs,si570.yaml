## Documentation/devicetree/bindings/clock/sprd,sc9860-clk.txt
```
Spreadtrum SC9860 Clock Binding
------------------------

Required properties:
- compatible: should contain the following compatible strings:
	- "sprd,sc9860-pmu-gate"
	- "sprd,sc9860-pll"
	- "sprd,sc9860-ap-clk"
	- "sprd,sc9860-aon-prediv"
	- "sprd,sc9860-apahb-gate"
	- "sprd,sc9860-aon-gate"
	- "sprd,sc9860-aonsecure-clk"
	- "sprd,sc9860-agcp-gate"
	- "sprd,sc9860-gpu-clk"
	- "sprd,sc9860-vsp-clk"
	- "sprd,sc9860-vsp-gate"
	- "sprd,sc9860-cam-clk"
	- "sprd,sc9860-cam-gate"
	- "sprd,sc9860-disp-clk"
	- "sprd,sc9860-disp-gate"
	- "sprd,sc9860-apapb-gate"

- #clock-cells: must be 1

- clocks : Should be the input parent clock(s) phandle for the clock, this
	   property here just simply shows which clock group the clocks'
	   parents are in, since each clk node would represent many clocks
	   which are defined in the driver.  The detailed dependency
	   relationship (i.e. how many parents and which are the parents)
	   are implemented in driver code.

Optional properties:

- reg:	Contain the registers base address and length. It must be configured
	only if no 'sprd,syscon' under the node.

- sprd,syscon: phandle to the syscon which is in the same address area with
	       the clock, and so we can get regmap for the clocks from the
	       syscon device.

Example:

	pmu_gate: pmu-gate {
		compatible = "sprd,sc9860-pmu-gate";
		sprd,syscon = <&pmu_regs>;
		clocks = <&ext_26m>;
		#clock-cells = <1>;
	};

	pll: pll {
		compatible = "sprd,sc9860-pll";
		sprd,syscon = <&ana_regs>;
		clocks = <&pmu_gate 0>;
		#clock-cells = <1>;
	};

	ap_clk: clock-controller@20000000 {
		compatible = "sprd,sc9860-ap-clk";
		reg = <0 0x20000000 0 0x400>;
		clocks = <&ext_26m>, <&pll 0>,
			 <&pmu_gate 0>;
		#clock-cells = <1>;
	};
```

## Documentation/devicetree/bindings/clock/sprd,sc9860-clk.yaml
```yaml
# SPDX-License-Identifier: GPL-2.0-only OR BSD-2-Clause
%YAML 1.2
---
$id: http://devicetree.org/schemas/clock/sprd,sc9860-clk.yaml#
$schema: http://devicetree.org/meta-schemas/core.yaml#

title: Spreadtrum SC9860 clock

maintainers:
  - Orson Zhai <orsonzhai@gmail.com>
  - Baolin Wang <baolin.wang7@gmail.com>
  - Chunyan Zhang <zhang.lyra@gmail.com>

properties:
  compatible:
    enum:
      - sprd,sc9860-agcp-gate
      - sprd,sc9860-aonsecure-clk
      - sprd,sc9860-aon-gate
      - sprd,sc9860-aon-prediv
      - sprd,sc9860-apahb-gate
      - sprd,sc9860-apapb-gate
      - sprd,sc9860-ap-clk
      - sprd,sc9860-cam-clk
      - sprd,sc9860-cam-gate
      - sprd,sc9860-disp-clk
      - sprd,sc9860-disp-gate
      - sprd,sc9860-gpu-clk
      - sprd,sc9860-pll
      - sprd,sc9860-pmu-gate
      - sprd,sc9860-vsp-clk
      - sprd,sc9860-vsp-gate

  reg:
    maxItems: 1

  clocks:
    minItems: 1
    maxItems: 3

  '#clock-cells':
    const: 1

  sprd,syscon:
    $ref: /schemas/types.yaml#/definitions/phandle
    description:
      phandle to the syscon which is in the same address area with the
      clock, and so we can get regmap for the clocks from the syscon device

required:
  - compatible
  - clocks
  - '#clock-cells'

allOf:
  - if:
      properties:
        compatible:
          contains:
            enum:
              - sprd,sc9860-agcp-gate
              - sprd,sc9860-aon-gate
              - sprd,sc9860-apahb-gate
              - sprd,sc9860-apapb-gate
              - sprd,sc9860-cam-gate
              - sprd,sc9860-disp-gate
              - sprd,sc9860-gpu-clk
              - sprd,sc9860-pll
              - sprd,sc9860-pmu-gate
              - sprd,sc9860-vsp-gate
    then:
      properties:
        clocks:
          maxItems: 1
  - if:
      properties:
        compatible:
          contains:
            enum:
              - sprd,sc9860-aonsecure-clk
              - sprd,sc9860-cam-clk
              - sprd,sc9860-disp-clk
              - sprd,sc9860-vsp-clk
    then:
      properties:
        clocks:
          minItems: 2
          maxItems: 2
  - if:
      properties:
        compatible:
          contains:
            enum:
              - sprd,sc9860-aon-prediv
              - sprd,sc9860-ap-clk
    then:
      properties:
        clocks:
          minItems: 3
  - if:
      properties:
        compatible:
          contains:
            enum:
              - sprd,sc9860-aonsecure-clk
              - sprd,sc9860-aon-prediv
              - sprd,sc9860-ap-clk
              - sprd,sc9860-cam-clk
              - sprd,sc9860-disp-clk
              - sprd,sc9860-gpu-clk
              - sprd,sc9860-vsp-clk
    then:
      required:
        - reg
      properties:
        sprd,syscon: false
  - if:
      properties:
        compatible:
          contains:
            enum:
              - sprd,sc9860-agcp-gate
              - sprd,sc9860-aon-gate
              - sprd,sc9860-apahb-gate
              - sprd,sc9860-apapb-gate
              - sprd,sc9860-cam-gate
              - sprd,sc9860-disp-gate
              - sprd,sc9860-pll
              - sprd,sc9860-pmu-gate
              - sprd,sc9860-vsp-gate
    then:
      required:
        - sprd,syscon
      properties:
        reg: false

additionalProperties: false

examples:
  - |
    soc {
      #address-cells = <2>;
      #size-cells = <2>;

      pmu-gate {
        compatible = "sprd,sc9860-pmu-gate";
        clocks = <&ext_26m>;
        #clock-cells = <1>;
        sprd,syscon = <&pmu_regs>;
      };

      clock-controller@20000000 {
        compatible = "sprd,sc9860-ap-clk";
        reg = <0 0x20000000 0 0x400>;
        clocks = <&ext_26m>, <&pll 0>, <&pmu_gate 0>;
        #clock-cells = <1>;
      };
    };
...
```

## Documentation/devicetree/bindings/clock/sprd,sc9863a-clk.yaml
```yaml
# SPDX-License-Identifier: (GPL-2.0-only OR BSD-2-Clause)
# Copyright 2019 Unisoc Inc.
%YAML 1.2
---
$id: "http://devicetree.org/schemas/clock/sprd,sc9863a-clk.yaml#"
$schema: "http://devicetree.org/meta-schemas/core.yaml#"

title: SC9863A Clock Control Unit Device Tree Bindings

maintainers:
  - Orson Zhai <orsonzhai@gmail.com>
  - Baolin Wang <baolin.wang7@gmail.com>
  - Chunyan Zhang <zhang.lyra@gmail.com>

properties:
  "#clock-cells":
    const: 1

  compatible :
    enum:
      - sprd,sc9863a-ap-clk
      - sprd,sc9863a-aon-clk
      - sprd,sc9863a-apahb-gate
      - sprd,sc9863a-pmu-gate
      - sprd,sc9863a-aonapb-gate
      - sprd,sc9863a-pll
      - sprd,sc9863a-mpll
      - sprd,sc9863a-rpll
      - sprd,sc9863a-dpll
      - sprd,sc9863a-mm-gate
      - sprd,sc9863a-apapb-gate

  clocks:
    minItems: 1
    maxItems: 4
    description: |
      The input parent clock(s) phandle for this clock, only list fixed
      clocks which are declared in devicetree.

  clock-names:
    minItems: 1
    maxItems: 4
    items:
      - const: ext-26m
      - const: ext-32k
      - const: ext-4m
      - const: rco-100m

  reg:
    maxItems: 1

required:
  - compatible
  - '#clock-cells'

if:
  properties:
    compatible:
      enum:
        - sprd,sc9863a-ap-clk
        - sprd,sc9863a-aon-clk
then:
  required:
    - reg

else:
  description: |
    Other SC9863a clock nodes should be the child of a syscon node in
    which compatible string shoule be:
            "sprd,sc9863a-glbregs", "syscon", "simple-mfd"

    The 'reg' property for the clock node is also required if there is a sub
    range of registers for the clocks.

examples:
  - |
    ap_clk: clock-controller@21500000 {
      compatible = "sprd,sc9863a-ap-clk";
      reg = <0 0x21500000 0 0x1000>;
      clocks = <&ext_26m>, <&ext_32k>;
      clock-names = "ext-26m", "ext-32k";
      #clock-cells = <1>;
    };

  - |
    soc {
      #address-cells = <2>;
      #size-cells = <2>;

      ap_ahb_regs: syscon@20e00000 {
        compatible = "sprd,sc9863a-glbregs", "syscon", "simple-mfd";
        reg = <0 0x20e00000 0 0x4000>;
        #address-cells = <1>;
        #size-cells = <1>;
        ranges = <0 0 0x20e00000 0x4000>;

        apahb_gate: apahb-gate@0 {
          compatible = "sprd,sc9863a-apahb-gate";
          reg = <0x0 0x1020>;
          #clock-cells = <1>;
        };
      };
    };

...
```

## Documentation/devicetree/bindings/clock/sprd,ums512-clk.yaml
```yaml
# SPDX-License-Identifier: (GPL-2.0-only OR BSD-2-Clause)
# Copyright 2022 Unisoc Inc.
%YAML 1.2
---
$id: http://devicetree.org/schemas/clock/sprd,ums512-clk.yaml#
$schema: http://devicetree.org/meta-schemas/core.yaml#

title: UMS512 Soc clock controller

maintainers:
  - Orson Zhai <orsonzhai@gmail.com>
  - Baolin Wang <baolin.wang7@gmail.com>
  - Chunyan Zhang <zhang.lyra@gmail.com>

properties:
  compatible:
    enum:
      - sprd,ums512-apahb-gate
      - sprd,ums512-ap-clk
      - sprd,ums512-aonapb-clk
      - sprd,ums512-pmu-gate
      - sprd,ums512-g0-pll
      - sprd,ums512-g2-pll
      - sprd,ums512-g3-pll
      - sprd,ums512-gc-pll
      - sprd,ums512-aon-gate
      - sprd,ums512-audcpapb-gate
      - sprd,ums512-audcpahb-gate
      - sprd,ums512-gpu-clk
      - sprd,ums512-mm-clk
      - sprd,ums512-mm-gate-clk
      - sprd,ums512-apapb-gate

  "#clock-cells":
    const: 1

  clocks:
    minItems: 1
    maxItems: 4
    description: |
      The input parent clock(s) phandle for the clock, only list
      fixed clocks which are declared in devicetree.

  clock-names:
    minItems: 1
    items:
      - const: ext-26m
      - const: ext-32k
      - const: ext-4m
      - const: rco-100m

  reg:
    maxItems: 1

required:
  - compatible
  - '#clock-cells'
  - reg

additionalProperties: false

examples:
  - |
    ap_clk: clock-controller@20200000 {
      compatible = "sprd,ums512-ap-clk";
      reg = <0x20200000 0x1000>;
      clocks = <&ext_26m>;
      clock-names = "ext-26m";
      #clock-cells = <1>;
    };
...
```

## Documentation/devicetree/bindings/clock/st,nomadik.txt
```
ST Microelectronics Nomadik SRC System Reset and Control

This binding uses the common clock binding:
Documentation/devicetree/bindings/clock/clock-bindings.txt

The Nomadik SRC controller is responsible of controlling chrystals,
PLLs and clock gates.

Required properties for the SRC node:
- compatible: must be "stericsson,nomadik-src"
- reg: must contain the SRC register base and size

Optional properties for the SRC node:
- disable-sxtalo: if present this will disable the SXTALO
  i.e. the driver output for the slow 32kHz chrystal, if the
  board has its own circuitry for providing this oscillator
- disable-mxtal: if present this will disable the MXTALO,
  i.e. the driver output for the main (~19.2 MHz) chrystal,
  if the board has its own circuitry for providing this
  osciallator


PLL nodes: these nodes represent the two PLLs on the system,
which should both have the main chrystal, represented as a
fixed frequency clock, as parent.

Required properties for the two PLL nodes:
- compatible: must be "st,nomadik-pll-clock"
- clock-cells: must be 0
- clock-id: must be 1 or 2 for PLL1 and PLL2 respectively
- clocks: this clock will have main chrystal as parent


HCLK nodes: these represent the clock gates on individual
lines from the HCLK clock tree and the gate for individual
lines from the PCLK clock tree.

Requires properties for the HCLK nodes:
- compatible: must be "st,nomadik-hclk-clock"
- clock-cells: must be 0
- clock-id: must be the clock ID from 0 to 63 according to
  this table:

	0:  HCLKDMA0
	1:  HCLKSMC
	2:  HCLKSDRAM
	3:  HCLKDMA1
	4:  HCLKCLCD
	5:  PCLKIRDA
	6:  PCLKSSP
	7:  PCLKUART0
	8:  PCLKSDI
	9:  PCLKI2C0
	10: PCLKI2C1
	11: PCLKUART1
	12: PCLMSP0
	13: HCLKUSB
	14: HCLKDIF
	15: HCLKSAA
	16: HCLKSVA
	17: PCLKHSI
	18: PCLKXTI
	19: PCLKUART2
	20: PCLKMSP1
	21: PCLKMSP2
	22: PCLKOWM
	23: HCLKHPI
	24: PCLKSKE
	25: PCLKHSEM
	26: HCLK3D
	27: HCLKHASH
	28: HCLKCRYP
	29: PCLKMSHC
	30: HCLKUSBM
	31: HCLKRNG
	(32, 33, 34, 35 RESERVED)
	36: CLDCLK
	37: IRDACLK
	38: SSPICLK
	39: UART0CLK
	40: SDICLK
	41: I2C0CLK
	42: I2C1CLK
	43: UART1CLK
	44: MSPCLK0
	45: USBCLK
	46: DIFCLK
	47: IPI2CCLK
	48: IPBMCCLK
	49: HSICLKRX
	50: HSICLKTX
	51: UART2CLK
	52: MSPCLK1
	53: MSPCLK2
	54: OWMCLK
	(55 RESERVED)
	56: SKECLK
	(57 RESERVED)
	58: 3DCLK
	59: PCLKMSP3
	60: MSPCLK3
	61: MSHCCLK
	62: USBMCLK
	63: RNGCCLK
```

## Documentation/devicetree/bindings/clock/st,stm32-rcc.txt
```
STMicroelectronics STM32 Reset and Clock Controller
===================================================

The RCC IP is both a reset and a clock controller.

Please refer to clock-bindings.txt for common clock controller binding usage.
Please also refer to reset.txt for common reset controller binding usage.

Required properties:
- compatible: Should be:
  "st,stm32f42xx-rcc"
  "st,stm32f469-rcc"
- reg: should be register base and length as documented in the
  datasheet
- #reset-cells: 1, see below
- #clock-cells: 2, device nodes should specify the clock in their "clocks"
  property, containing a phandle to the clock device node, an index selecting
  between gated clocks and other clocks and an index specifying the clock to
  use.
- clocks: External oscillator clock phandle
  - high speed external clock signal (HSE)
  - external I2S clock (I2S_CKIN)

Example:

	rcc: rcc@40023800 {
		#reset-cells = <1>;
		#clock-cells = <2>
		compatible = "st,stm32f42xx-rcc", "st,stm32-rcc";
		reg = <0x40023800 0x400>;
		clocks = <&clk_hse>, <&clk_i2s_ckin>;
	};

Specifying gated clocks
=======================

The primary index must be set to 0.

The secondary index is the bit number within the RCC register bank, starting
from the first RCC clock enable register (RCC_AHB1ENR, address offset 0x30).

It is calculated as: index = register_offset / 4 * 32 + bit_offset.
Where bit_offset is the bit offset within the register (LSB is 0, MSB is 31).

To simplify the usage and to share bit definition with the reset and clock
drivers of the RCC IP, macros are available to generate the index in
human-readble format.

For STM32F4 series, the macro are available here:
 - include/dt-bindings/mfd/stm32f4-rcc.h

Example:

	/* Gated clock, AHB1 bit 0 (GPIOA) */
	... {
		clocks = <&rcc 0 STM32F4_AHB1_CLOCK(GPIOA)>
	};

	/* Gated clock, AHB2 bit 4 (CRYP) */
	... {
		clocks = <&rcc 0 STM32F4_AHB2_CLOCK(CRYP)>
	};

Specifying other clocks
=======================

The primary index must be set to 1.

The secondary index is bound with the following magic numbers:

	0	SYSTICK
	1	FCLK
	2	CLK_LSI		(low-power clock source)
	3	CLK_LSE		(generated from a 32.768 kHz low-speed external
				 crystal or ceramic resonator)
	4	CLK_HSE_RTC	(HSE division factor for RTC clock)
	5	CLK_RTC		(real-time clock)
	6	PLL_VCO_I2S	(vco frequency of I2S pll)
	7	PLL_VCO_SAI	(vco frequency of SAI pll)
	8	CLK_LCD		(LCD-TFT)
	9	CLK_I2S		(I2S clocks)
	10	CLK_SAI1	(audio clocks)
	11	CLK_SAI2
	12	CLK_I2SQ_PDIV	(post divisor of pll i2s q divisor)
	13	CLK_SAIQ_PDIV	(post divisor of pll sai q divisor)

Example:

	/* Misc clock, FCLK */
	... {
		clocks = <&rcc 1 STM32F4_APB1_CLOCK(TIM2)>
	};


Specifying softreset control of devices
=======================================

Device nodes should specify the reset channel required in their "resets"
property, containing a phandle to the reset device node and an index specifying
which channel to use.
The index is the bit number within the RCC registers bank, starting from RCC
base address.
It is calculated as: index = register_offset / 4 * 32 + bit_offset.
Where bit_offset is the bit offset within the register.
For example, for CRC reset:
  crc = AHB1RSTR_offset / 4 * 32 + CRCRST_bit_offset = 0x10 / 4 * 32 + 12 = 140

example:

	timer2 {
		resets	= <&rcc STM32F4_APB1_RESET(TIM2)>;
	};
```
