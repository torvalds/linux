## Documentation/devicetree/bindings/clock/marvell,berlin2-clk.yaml
```yaml
# SPDX-License-Identifier: (GPL-2.0-only OR BSD-2-Clause)
%YAML 1.2
---
$id: http://devicetree.org/schemas/clock/marvell,berlin2-clk.yaml#
$schema: http://devicetree.org/meta-schemas/core.yaml#

title: Marvell Berlin Clock Controller

maintainers:
  - Jisheng Zhang <jszhang@kernel.org>

description:
  Clock related registers are spread among the chip control registers. Berlin
  clock node should be a sub-node of the chip controller node. Marvell Berlin2
  (BG2, BG2CD, BG2Q) SoCs share the same IP for PLLs and clocks, with some minor
  differences in features and register layout.

properties:
  compatible:
    enum:
      - marvell,berlin2-clk
      - marvell,berlin2q-clk

  '#clock-cells':
    const: 1

  clocks:
    maxItems: 1

  clock-names:
    items:
      - enum:
          - refclk
          - video_ext0

required:
  - compatible
  - '#clock-cells'
  - clocks
  - clock-names

additionalProperties: false

examples:
  - |
    clock-controller {
        compatible = "marvell,berlin2q-clk";
        #clock-cells = <1>;
        clocks = <&refclk>;
        clock-names = "refclk";
    };
```

## Documentation/devicetree/bindings/clock/marvell,cp110-clock.yaml
```yaml
# SPDX-License-Identifier: (GPL-2.0-only OR BSD-2-Clause)
%YAML 1.2
---
$id: http://devicetree.org/schemas/clock/marvell,cp110-clock.yaml#
$schema: http://devicetree.org/meta-schemas/core.yaml#

title: Marvell Armada CP110 System Controller Clocks

maintainers:
  - Gregory Clement <gregory.clement@bootlin.com>
  - Miquel Raynal <miquel.raynal@bootlin.com>

description: >
  The CP110 is one of the two core HW blocks of the Marvell Armada 7K/8K/931x
  SoCs. It contains system controllers, which provide several registers giving
  access to numerous features: clocks, pin-muxing and many other SoC
  configuration items.

properties:
  compatible:
    const: marvell,cp110-clock

  "#clock-cells":
    const: 2
    description: >
      The first cell must be 0 or 1. 0 for the core clocks and 1 for the
      gateable clocks. The second cell identifies the particular core clock or
      gateable clocks.

      The following clocks are available:

        - Core clocks
          - 0 0       APLL
          - 0 1       PPv2 core
          - 0 2       EIP
          - 0 3       Core
          - 0 4       NAND core
          - 0 5       SDIO core

        - Gateable clocks
          - 1 0       Audio
          - 1 1       Comm Unit
          - 1 2       NAND
          - 1 3       PPv2
          - 1 4       SDIO
          - 1 5       MG Domain
          - 1 6       MG Core
          - 1 7       XOR1
          - 1 8       XOR0
          - 1 9       GOP DP
          - 1 11      PCIe x1 0
          - 1 12      PCIe x1 1
          - 1 13      PCIe x4
          - 1 14      PCIe / XOR
          - 1 15      SATA
          - 1 16      SATA USB
          - 1 17      Main
          - 1 18      SD/MMC/GOP
          - 1 21      Slow IO (SPI, NOR, BootROM, I2C, UART)
          - 1 22      USB3H0
          - 1 23      USB3H1
          - 1 24      USB3 Device
          - 1 25      EIP150
          - 1 26      EIP197

required:
  - compatible
  - "#clock-cells"

additionalProperties: false
```

## Documentation/devicetree/bindings/clock/marvell,dove-divider-clock.yaml
```yaml
# SPDX-License-Identifier: (GPL-2.0-only OR BSD-2-Clause)
%YAML 1.2
---
$id: http://devicetree.org/schemas/marvell,dove-divider-clock.yaml#
$schema: http://devicetree.org/meta-schemas/core.yaml#

title: Marvell Dove PLL Divider Clock

maintainers:
  - Andrew Lunn <andrew@lunn.ch>
  - Gregory Clement <gregory.clement@bootlin.com>

description: >
  Marvell Dove has a 2GHz PLL, which feeds into a set of dividers to provide
  high speed clocks for a number of peripherals.  These dividers are part of the
  PMU, and thus this node should be a child of the PMU node.

  The following clocks are provided:

    ID	Clock
    -------------
    0	AXI bus clock
    1	GPU clock
    2	VMeta clock
    3	LCD clock

properties:
  compatible:
    const: marvell,dove-divider-clock

  reg:
    maxItems: 1

  '#clock-cells':
    const: 1

required:
  - compatible
  - reg
  - '#clock-cells'

additionalProperties: false

examples:
  - |
    clock-controller@64 {
        compatible = "marvell,dove-divider-clock";
        reg = <0x0064 0x8>;
        #clock-cells = <1>;
    };
```

## Documentation/devicetree/bindings/clock/marvell,mmp2-audio-clock.yaml
```yaml
# SPDX-License-Identifier: (GPL-2.0+ OR BSD-2-Clause)
%YAML 1.2
---
$id: http://devicetree.org/schemas/clock/marvell,mmp2-audio-clock.yaml#
$schema: http://devicetree.org/meta-schemas/core.yaml#

title: Marvell MMP2 Audio Clock Controller

maintainers:
  - Lubomir Rintel <lkundrak@v3.sk>

description: |
  The audio clock controller generates and supplies the clocks to the audio
  codec.

  Each clock is assigned an identifier and client nodes use this identifier
  to specify the clock which they consume.

  All these identifiers could be found in
  <dt-bindings/clock/marvell,mmp2-audio.h>.

properties:
  compatible:
    enum:
      - marvell,mmp2-audio-clock

  reg:
    maxItems: 1

  clocks:
    items:
      - description: Audio subsystem clock
      - description: The crystal oscillator clock
      - description: First I2S clock
      - description: Second I2S clock

  clock-names:
    items:
      - const: audio
      - const: vctcxo
      - const: i2s0
      - const: i2s1

  '#clock-cells':
    const: 1

  power-domains:
    maxItems: 1

required:
  - compatible
  - reg
  - clocks
  - clock-names
  - '#clock-cells'

additionalProperties: false

examples:
  - |
    #include <dt-bindings/clock/marvell,mmp2-audio.h>
    #include <dt-bindings/clock/marvell,mmp2.h>
    #include <dt-bindings/power/marvell,mmp2.h>

    clock-controller@d42a0c30 {
      compatible = "marvell,mmp2-audio-clock";
      reg = <0xd42a0c30 0x10>;
      clock-names = "audio", "vctcxo", "i2s0", "i2s1";
      clocks = <&soc_clocks MMP2_CLK_AUDIO>,
               <&soc_clocks MMP2_CLK_VCTCXO>,
               <&soc_clocks MMP2_CLK_I2S0>,
               <&soc_clocks MMP2_CLK_I2S1>;
      power-domains = <&soc_clocks MMP2_POWER_DOMAIN_AUDIO>;
      #clock-cells = <1>;
    };
```

## Documentation/devicetree/bindings/clock/marvell,mmp2-clock.yaml
```yaml
# SPDX-License-Identifier: GPL-2.0
%YAML 1.2
---
$id: http://devicetree.org/schemas/clock/marvell,mmp2-clock.yaml#
$schema: http://devicetree.org/meta-schemas/core.yaml#

title: Marvell MMP2 and MMP3 Clock Controller

maintainers:
  - Lubomir Rintel <lkundrak@v3.sk>

description: |
  The clock subsystem on MMP2 or MMP3 generates and supplies clock to various
  controllers within the SoC.

  Each clock is assigned an identifier and client nodes use this identifier
  to specify the clock which they consume.

  All these identifiers could be found in <dt-bindings/clock/marvell,mmp2.h>.

properties:
  compatible:
    enum:
      - marvell,mmp2-clock # controller compatible with MMP2 SoC
      - marvell,mmp3-clock # controller compatible with MMP3 SoC

  reg:
    items:
      - description: MPMU register region
      - description: APMU register region
      - description: APBC register region

  reg-names:
    items:
      - const: mpmu
      - const: apmu
      - const: apbc

  '#clock-cells':
    const: 1

  '#reset-cells':
    const: 1

  '#power-domain-cells':
    const: 1

required:
  - compatible
  - reg
  - reg-names
  - '#clock-cells'
  - '#reset-cells'
  - '#power-domain-cells'

additionalProperties: false

examples:
  - |
    clock-controller@d4050000 {
      compatible = "marvell,mmp2-clock";
      reg = <0xd4050000 0x1000>,
            <0xd4282800 0x400>,
            <0xd4015000 0x1000>;
      reg-names = "mpmu", "apmu", "apbc";
      #clock-cells = <1>;
      #reset-cells = <1>;
      #power-domain-cells = <1>;
    };
```

## Documentation/devicetree/bindings/clock/marvell,mmp2.txt
```
* Marvell MMP2 Clock Controller

The MMP2 clock subsystem generates and supplies clock to various
controllers within the MMP2 SoC.

Required Properties:

- compatible: should be one of the following.
  - "marvell,mmp2-clock" - controller compatible with MMP2 SoC.

- reg: physical base address of the clock subsystem and length of memory mapped
  region. There are 3 places in SOC has clock control logic:
  "mpmu", "apmu", "apbc". So three reg spaces need to be defined.

- #clock-cells: should be 1.
- #reset-cells: should be 1.

Each clock is assigned an identifier and client nodes use this identifier
to specify the clock which they consume.

All these identifier could be found in <dt-bindings/clock/marvell-mmp2.h>.
```

## Documentation/devicetree/bindings/clock/marvell,mvebu-core-clock.yaml
```yaml
# SPDX-License-Identifier: (GPL-2.0-only OR BSD-2-Clause)
%YAML 1.2
---
$id: http://devicetree.org/schemas/clock/marvell,mvebu-core-clock.yaml#
$schema: http://devicetree.org/meta-schemas/core.yaml#

title: Marvell MVEBU SoC core clock

maintainers:
  - Andrew Lunn <andrew@lunn.ch>
  - Gregory Clement <gregory.clement@bootlin.com>

description: >
  Marvell MVEBU SoCs usually allow to determine core clock frequencies by
  reading the Sample-At-Reset (SAR) register. The core clock consumer should
  specify the desired clock by having the clock ID in its "clocks" phandle cell.

  The following is a list of provided IDs and clock names on Armada 370/XP:
   0 = tclk    (Internal Bus clock)
   1 = cpuclk  (CPU clock)
   2 = nbclk   (L2 Cache clock)
   3 = hclk    (DRAM control clock)
   4 = dramclk (DDR clock)

  The following is a list of provided IDs and clock names on Armada 375:
   0 = tclk    (Internal Bus clock)
   1 = cpuclk  (CPU clock)
   2 = l2clk   (L2 Cache clock)
   3 = ddrclk  (DDR clock)

  The following is a list of provided IDs and clock names on Armada 380/385:
   0 = tclk    (Internal Bus clock)
   1 = cpuclk  (CPU clock)
   2 = l2clk   (L2 Cache clock)
   3 = ddrclk  (DDR clock)

  The following is a list of provided IDs and clock names on Armada 39x:
   0 = tclk    (Internal Bus clock)
   1 = cpuclk  (CPU clock)
   2 = nbclk   (Coherent Fabric clock)
   3 = hclk    (SDRAM Controller Internal Clock)
   4 = dclk    (SDRAM Interface Clock)
   5 = refclk  (Reference Clock)

  The following is a list of provided IDs and clock names on 98dx3236:
   0 = tclk    (Internal Bus clock)
   1 = cpuclk  (CPU clock)
   2 = ddrclk  (DDR clock)
   3 = mpll    (MPLL Clock)

  The following is a list of provided IDs and clock names on Kirkwood and Dove:
   0 = tclk   (Internal Bus clock)
   1 = cpuclk (CPU0 clock)
   2 = l2clk  (L2 Cache clock derived from CPU0 clock)
   3 = ddrclk (DDR controller clock derived from CPU0 clock)

  The following is a list of provided IDs and clock names on Orion5x:
   0 = tclk   (Internal Bus clock)
   1 = cpuclk (CPU0 clock)
   2 = ddrclk (DDR controller clock derived from CPU0 clock)

properties:
  compatible:
    enum:
      - marvell,armada-370-core-clock
      - marvell,armada-375-core-clock
      - marvell,armada-380-core-clock
      - marvell,armada-390-core-clock
      - marvell,armada-xp-core-clock
      - marvell,dove-core-clock
      - marvell,kirkwood-core-clock
      - marvell,mv88f5181-core-clock
      - marvell,mv88f5182-core-clock
      - marvell,mv88f5281-core-clock
      - marvell,mv88f6180-core-clock
      - marvell,mv88f6183-core-clock
      - marvell,mv98dx1135-core-clock
      - marvell,mv98dx3236-core-clock

  reg:
    maxItems: 1

  '#clock-cells':
    const: 1

  clock-output-names:
    description: Overwrite default clock output names.

required:
  - compatible
  - reg
  - '#clock-cells'

additionalProperties: false
```

## Documentation/devicetree/bindings/clock/marvell,pxa168.txt
```
* Marvell PXA168 Clock Controller

The PXA168 clock subsystem generates and supplies clock to various
controllers within the PXA168 SoC.

Required Properties:

- compatible: should be one of the following.
  - "marvell,pxa168-clock" - controller compatible with PXA168 SoC.

- reg: physical base address of the clock subsystem and length of memory mapped
  region. There are 3 places in SOC has clock control logic:
  "mpmu", "apmu", "apbc". So three reg spaces need to be defined.

- #clock-cells: should be 1.
- #reset-cells: should be 1.

Each clock is assigned an identifier and client nodes use this identifier
to specify the clock which they consume.

All these identifier could be found in <dt-bindings/clock/marvell,pxa168.h>.
```

## Documentation/devicetree/bindings/clock/marvell,pxa1908.yaml
```yaml
# SPDX-License-Identifier: GPL-2.0-only OR BSD-2-Clause
%YAML 1.2
---
$id: http://devicetree.org/schemas/clock/marvell,pxa1908.yaml#
$schema: http://devicetree.org/meta-schemas/core.yaml#

title: Marvell PXA1908 Clock Controllers

maintainers:
  - Duje Mihanović <duje.mihanovic@skole.hr>

description: |
  The PXA1908 clock subsystem generates and supplies clock to various
  controllers within the PXA1908 SoC. The PXA1908 contains numerous clock
  controller blocks, with the ones currently supported being APBC, APBCP, MPMU
  and APMU roughly corresponding to internal buses.

  All these clock identifiers could be found in <include/dt-bindings/marvell,pxa1908.h>.

properties:
  compatible:
    enum:
      - marvell,pxa1908-apbc
      - marvell,pxa1908-apbcp
      - marvell,pxa1908-mpmu
      - marvell,pxa1908-apmu

  reg:
    maxItems: 1

  '#clock-cells':
    const: 1

required:
  - compatible
  - reg
  - '#clock-cells'

additionalProperties: false

examples:
  # APMU block:
  - |
    clock-controller@d4282800 {
      compatible = "marvell,pxa1908-apmu";
      reg = <0xd4282800 0x400>;
      #clock-cells = <1>;
    };
```

## Documentation/devicetree/bindings/clock/marvell,pxa1928.txt
```
* Marvell PXA1928 Clock Controllers

The PXA1928 clock subsystem generates and supplies clock to various
controllers within the PXA1928 SoC. The PXA1928 contains 3 clock controller
blocks called APMU, MPMU, and APBC roughly corresponding to internal buses.

Required Properties:

- compatible: should be one of the following.
  - "marvell,pxa1928-apmu" - APMU controller compatible
  - "marvell,pxa1928-mpmu" - MPMU controller compatible
  - "marvell,pxa1928-apbc" - APBC controller compatible
- reg: physical base address of the clock controller and length of memory mapped
  region.
- #clock-cells: should be 1.
- #reset-cells: should be 1.

Each clock is assigned an identifier and client nodes use the clock controller
phandle and this identifier to specify the clock which they consume.

All these identifiers can be found in <dt-bindings/clock/marvell,pxa1928.h>.
```

## Documentation/devicetree/bindings/clock/marvell,pxa910.txt
```
* Marvell PXA910 Clock Controller

The PXA910 clock subsystem generates and supplies clock to various
controllers within the PXA910 SoC.

Required Properties:

- compatible: should be one of the following.
  - "marvell,pxa910-clock" - controller compatible with PXA910 SoC.

- reg: physical base address of the clock subsystem and length of memory mapped
  region. There are 4 places in SOC has clock control logic:
  "mpmu", "apmu", "apbc", "apbcp". So four reg spaces need to be defined.

- #clock-cells: should be 1.
- #reset-cells: should be 1.

Each clock is assigned an identifier and client nodes use this identifier
to specify the clock which they consume.

All these identifier could be found in <dt-bindings/clock/marvell-pxa910.h>.
```
