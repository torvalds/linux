## Documentation/devicetree/bindings/clock/maxim,max77686.txt
```
Binding for Maxim MAX77686/MAX77802/MAX77620 32k clock generator block

This is a part of device tree bindings of MAX77686/MAX77802/MAX77620
multi-function device. More information can be found in MFD DT binding
doc as follows:
	bindings/mfd/max77686.txt for MAX77686 and
	bindings/mfd/max77802.txt for MAX77802 and
	bindings/mfd/max77620.txt for MAX77620.

The MAX77686 contains three 32.768khz clock outputs that can be controlled
(gated/ungated) over I2C. Clocks are defined as preprocessor macros in
dt-bindings/clock/maxim,max77686.h.


The MAX77802 contains two 32.768khz clock outputs that can be controlled
(gated/ungated) over I2C. Clocks are defined as preprocessor macros in
dt-bindings/clock/maxim,max77802.h.

The MAX77686 contains one 32.768khz clock outputs that can be controlled
(gated/ungated) over I2C. Clocks are defined as preprocessor macros in
dt-bindings/clock/maxim,max77620.h.

Following properties should be presend in main device node of the MFD chip.

Required properties:

- #clock-cells: from common clock binding; shall be set to 1.

Optional properties:
- clock-output-names: From common clock binding.

Each clock is assigned an identifier and client nodes can use this identifier
to specify the clock which they consume. Following indices are allowed:
    - 0: 32khz_ap clock (max77686, max77802), 32khz_out0 (max77620)
    - 1: 32khz_cp clock (max77686, max77802),
    - 2: 32khz_pmic clock (max77686).

Clocks are defined as preprocessor macros in above dt-binding header for
respective chips.

Example:

1. With MAX77686:

#include <dt-bindings/clock/maxim,max77686.h>
/* ... */

	Node of the MFD chip
		max77686: max77686@9 {
			compatible = "maxim,max77686";
			interrupt-parent = <&wakeup_eint>;
			interrupts = <26 IRQ_TYPE_LEVEL_LOW>;
			reg = <0x09>;
			#clock-cells = <1>;

			/* ... */
		};

	Clock consumer node

		foo@0 {
			compatible = "bar,foo";
			/* ... */
			clock-names = "my-clock";
			clocks = <&max77686 MAX77686_CLK_PMIC>;
		};

2. With MAX77802:

#include <dt-bindings/clock/maxim,max77802.h>
/* ... */

	Node of the MFD chip
		max77802: max77802@9 {
			compatible = "maxim,max77802";
			interrupt-parent = <&wakeup_eint>;
			interrupts = <26 IRQ_TYPE_LEVEL_LOW>;
			reg = <0x09>;
			#clock-cells = <1>;

			/* ... */
		};

	Clock consumer node

		foo@0 {
			compatible = "bar,foo";
			/* ... */
			clock-names = "my-clock";
			clocks = <&max77802 MAX77802_CLK_32K_AP>;
		};


3. With MAX77620:

#include <dt-bindings/clock/maxim,max77620.h>
/* ... */

	Node of the MFD chip
		max77620: max77620@3c {
			compatible = "maxim,max77620";
			reg = <0x3c>;
			#clock-cells = <1>;
			/* ... */
		};

	Clock consumer node

		foo@0 {
			compatible = "bar,foo";
			/* ... */
			clock-names = "my-clock";
			clocks = <&max77620 MAX77620_CLK_32K_OUT0>;
		};
```

## Documentation/devicetree/bindings/clock/maxim,max77802.txt
```
Binding for Maxim MAX77802 32k clock generator block

This is a part of device tree bindings of MAX77802 multi-function device.
More information can be found in bindings/mfd/max77802.txt file.

The MAX77802 contains two 32.768khz clock outputs that can be controlled
(gated/ungated) over I2C.

Following properties should be present in main device node of the MFD chip.

Required properties:
- #clock-cells: From common clock binding; shall be set to 1.

Optional properties:
- clock-output-names: From common clock binding.

Each clock is assigned an identifier and client nodes can use this identifier
to specify the clock which they consume. Following indices are allowed:
     - 0: 32khz_ap clock,
     - 1: 32khz_cp clock.

Clocks are defined as preprocessor macros in dt-bindings/clock/maxim,max77802.h
header and can be used in device tree sources.

Example: Node of the MFD chip

	max77802: max77802@09 {
		compatible = "maxim,max77802";
		interrupt-parent = <&wakeup_eint>;
		interrupts = <26 0>;
		reg = <0x09>;
		#clock-cells = <1>;

		/* ... */
	};

Example: Clock consumer node

	foo@0 {
		compatible = "bar,foo";
		/* ... */
		clock-names = "my-clock";
		clocks = <&max77802 MAX77802_CLK_32K_AP>;
	};
```

## Documentation/devicetree/bindings/clock/maxim,max9485.txt
```
Devicetree bindings for Maxim MAX9485 Programmable Audio Clock Generator

This device exposes 4 clocks in total:

- MAX9485_MCLKOUT: 	A gated, buffered output of the input clock of 27 MHz
- MAX9485_CLKOUT:	A PLL that can be configured to 16 different discrete
			frequencies
- MAX9485_CLKOUT[1,2]:	Two gated outputs for MAX9485_CLKOUT

MAX9485_CLKOUT[1,2] are children of MAX9485_CLKOUT which upchain all rate set
requests.

Required properties:
- compatible:	"maxim,max9485"
- clocks:	Input clock, must provice 27.000 MHz
- clock-names:	Must be set to "xclk"
- #clock-cells: From common clock binding; shall be set to 1

Optional properties:
- reset-gpios:		GPIO descriptor connected to the #RESET input pin
- vdd-supply:		A regulator node for Vdd
- clock-output-names:	Name of output clocks, as defined in common clock
			bindings

If not explicitly set, the output names are "mclkout", "clkout", "clkout1"
and "clkout2".

Clocks are defined as preprocessor macros in the dt-binding header.

Example:

	#include <dt-bindings/clock/maxim,max9485.h>

	xo-27mhz: xo-27mhz {
		compatible = "fixed-clock";
		#clock-cells = <0>;
		clock-frequency = <27000000>;
	};

	&i2c0 {
		max9485: audio-clock@63 {
			reg = <0x63>;
			compatible = "maxim,max9485";
			clock-names = "xclk";
			clocks = <&xo-27mhz>;
			reset-gpios = <&gpio 1 GPIO_ACTIVE_HIGH>;
			vdd-supply = <&3v3-reg>;
			#clock-cells = <1>;
		};
	};

	// Clock consumer node

	foo@0 {
		compatible = "bar,foo";
		/* ... */
		clock-names = "foo-input-clk";
		clocks = <&max9485 MAX9485_CLKOUT1>;
	};
```

## Documentation/devicetree/bindings/clock/maxim,max9485.yaml
```yaml
# SPDX-License-Identifier: (GPL-2.0-only OR BSD-2-Clause)
%YAML 1.2
---
$id: http://devicetree.org/schemas/clock/maxim,max9485.yaml#
$schema: http://devicetree.org/meta-schemas/core.yaml#

title: Maxim MAX9485 Programmable Audio Clock Generator

maintainers:
  - Daniel Mack <daniel@zonque.org>

description: >
  Maxim MAX9485 Programmable Audio Clock Generator exposes 4 clocks in total:

    - MAX9485_MCLKOUT:  A gated, buffered output of the input clock of 27 MHz
    - MAX9485_CLKOUT:   A PLL that can be configured to 16 different discrete
                        frequencies
    - MAX9485_CLKOUT[1,2]:  Two gated outputs for MAX9485_CLKOUT

  MAX9485_CLKOUT[1,2] are children of MAX9485_CLKOUT which upchain all rate set
  requests.

properties:
  compatible:
    const: maxim,max9485

  reg:
    maxItems: 1

  clocks:
    description: Input clock. Must provide 27 MHz
    maxItems: 1

  clock-names:
    items:
      - const: xclk

  '#clock-cells':
    const: 1

  reset-gpios:
    description: >
      GPIO descriptor connected to the #RESET input pin

  vdd-supply:
    description: A regulator node for Vdd

  clock-output-names:
    description: Name of output clocks, as defined in common clock bindings
    items:
      - const: mclkout
      - const: clkout
      - const: clkout1
      - const: clkout2

required:
  - compatible
  - reg
  - clocks
  - clock-names
  - '#clock-cells'

additionalProperties: false

examples:
  - |
    #include <dt-bindings/gpio/gpio.h>

    i2c {
        #address-cells = <1>;
        #size-cells = <0>;

        clock-controller@63 {
            compatible = "maxim,max9485";
            reg = <0x63>;
            #clock-cells = <1>;
            clock-names = "xclk";
            clocks = <&xo_27mhz>;
            reset-gpios = <&gpio 1 GPIO_ACTIVE_HIGH>;
            vdd-supply = <&reg_3v3>;
        };
    };
```

## Documentation/devicetree/bindings/clock/mediatek,apmixedsys.yaml
```yaml
# SPDX-License-Identifier: (GPL-2.0 OR BSD-2-Clause)
%YAML 1.2
---
$id: http://devicetree.org/schemas/clock/mediatek,apmixedsys.yaml#
$schema: http://devicetree.org/meta-schemas/core.yaml#

title: MediaTek AP Mixedsys Controller

maintainers:
  - Michael Turquette <mturquette@baylibre.com>
  - Stephen Boyd <sboyd@kernel.org>

description:
  The Mediatek apmixedsys controller provides PLLs to the system.
  The clock values can be found in <dt-bindings/clock/mt*-clk.h>.

properties:
  compatible:
    oneOf:
      - enum:
          - mediatek,mt6797-apmixedsys
          - mediatek,mt7622-apmixedsys
          - mediatek,mt7981-apmixedsys
          - mediatek,mt7986-apmixedsys
          - mediatek,mt7988-apmixedsys
          - mediatek,mt8135-apmixedsys
          - mediatek,mt8173-apmixedsys
          - mediatek,mt8516-apmixedsys
      - items:
          - const: mediatek,mt7623-apmixedsys
          - const: mediatek,mt2701-apmixedsys
          - const: syscon
      - items:
          - enum:
              - mediatek,mt2701-apmixedsys
              - mediatek,mt2712-apmixedsys
              - mediatek,mt6765-apmixedsys
              - mediatek,mt6779-apmixed
              - mediatek,mt6795-apmixedsys
              - mediatek,mt7629-apmixedsys
              - mediatek,mt8167-apmixedsys
              - mediatek,mt8183-apmixedsys
          - const: syscon

  reg:
    maxItems: 1

  '#clock-cells':
    const: 1

required:
  - compatible
  - reg
  - '#clock-cells'

additionalProperties: false

examples:
  - |
    apmixedsys: clock-controller@10209000 {
        compatible = "mediatek,mt8173-apmixedsys";
        reg = <0x10209000 0x1000>;
        #clock-cells = <1>;
    };
```

## Documentation/devicetree/bindings/clock/mediatek,ethsys.yaml
```yaml
# SPDX-License-Identifier: GPL-2.0-only OR BSD-2-Clause
%YAML 1.2
---
$id: http://devicetree.org/schemas/clock/mediatek,ethsys.yaml#
$schema: http://devicetree.org/meta-schemas/core.yaml#

title: Mediatek ethsys controller

description:
  The available clocks are defined in dt-bindings/clock/mt*-clk.h.

maintainers:
  - James Liao <jamesjj.liao@mediatek.com>

properties:
  compatible:
    oneOf:
      - items:
          - enum:
              - mediatek,mt2701-ethsys
              - mediatek,mt7622-ethsys
              - mediatek,mt7629-ethsys
              - mediatek,mt7981-ethsys
              - mediatek,mt7986-ethsys
          - const: syscon
      - items:
          - const: mediatek,mt7623-ethsys
          - const: mediatek,mt2701-ethsys
          - const: syscon

  reg:
    maxItems: 1

  "#clock-cells":
    const: 1

  "#reset-cells":
    const: 1

required:
  - reg
  - "#clock-cells"
  - "#reset-cells"

additionalProperties: false

examples:
  - |
    clock-controller@1b000000 {
        compatible = "mediatek,mt2701-ethsys", "syscon";
        reg = <0x1b000000 0x1000>;
        #clock-cells = <1>;
        #reset-cells = <1>;
    };
```

## Documentation/devicetree/bindings/clock/mediatek,mt2701-hifsys.yaml
```yaml
# SPDX-License-Identifier: GPL-2.0-only OR BSD-2-Clause
%YAML 1.2
---
$id: http://devicetree.org/schemas/clock/mediatek,mt2701-hifsys.yaml#
$schema: http://devicetree.org/meta-schemas/core.yaml#

title: MediaTek HIFSYS clock and reset controller

description:
  The MediaTek HIFSYS controller provides various clocks and reset outputs to
  the system.

maintainers:
  - Matthias Brugger <matthias.bgg@gmail.com>

properties:
  compatible:
    oneOf:
      - enum:
          - mediatek,mt2701-hifsys
          - mediatek,mt7622-hifsys
      - items:
          - enum:
              - mediatek,mt7623-hifsys
          - const: mediatek,mt2701-hifsys

  reg:
    maxItems: 1

  "#clock-cells":
    const: 1
    description: The available clocks are defined in dt-bindings/clock/mt*-clk.h

  "#reset-cells":
    const: 1

required:
  - reg
  - "#clock-cells"

additionalProperties: false

examples:
  - |
    clock-controller@1a000000 {
        compatible = "mediatek,mt2701-hifsys";
        reg = <0x1a000000 0x1000>;
        #clock-cells = <1>;
        #reset-cells = <1>;
    };
```

## Documentation/devicetree/bindings/clock/mediatek,mt6795-clock.yaml
```yaml
# SPDX-License-Identifier: (GPL-2.0 OR BSD-2-Clause)
%YAML 1.2
---
$id: http://devicetree.org/schemas/clock/mediatek,mt6795-clock.yaml#
$schema: http://devicetree.org/meta-schemas/core.yaml#

title: MediaTek Functional Clock Controller for MT6795

maintainers:
  - AngeloGioacchino Del Regno <angelogioacchino.delregno@collabora.com>
  - Chun-Jie Chen <chun-jie.chen@mediatek.com>

description: |
  The clock architecture in MediaTek like below
  PLLs -->
          dividers -->
                      muxes
                           -->
                              clock gate

  The devices provide clock gate control in different IP blocks.

properties:
  compatible:
    enum:
      - mediatek,mt6795-mfgcfg
      - mediatek,mt6795-vdecsys
      - mediatek,mt6795-vencsys

  reg:
    maxItems: 1

  '#clock-cells':
    const: 1

required:
  - compatible
  - reg
  - '#clock-cells'

additionalProperties: false

examples:
  - |
    soc {
        #address-cells = <2>;
        #size-cells = <2>;

        mfgcfg: clock-controller@13000000 {
            compatible = "mediatek,mt6795-mfgcfg";
            reg = <0 0x13000000 0 0x1000>;
            #clock-cells = <1>;
        };

        vdecsys: clock-controller@16000000 {
            compatible = "mediatek,mt6795-vdecsys";
            reg = <0 0x16000000 0 0x1000>;
            #clock-cells = <1>;
        };

        vencsys: clock-controller@18000000 {
            compatible = "mediatek,mt6795-vencsys";
            reg = <0 0x18000000 0 0x1000>;
            #clock-cells = <1>;
        };
    };
```

## Documentation/devicetree/bindings/clock/mediatek,mt6795-sys-clock.yaml
```yaml
# SPDX-License-Identifier: (GPL-2.0 OR BSD-2-Clause)
%YAML 1.2
---
$id: http://devicetree.org/schemas/clock/mediatek,mt6795-sys-clock.yaml#
$schema: http://devicetree.org/meta-schemas/core.yaml#

title: MediaTek System Clock Controller for MT6795

maintainers:
  - AngeloGioacchino Del Regno <angelogioacchino.delregno@collabora.com>
  - Chun-Jie Chen <chun-jie.chen@mediatek.com>

description:
  The Mediatek system clock controller provides various clocks and system
  configuration like reset and bus protection on MT6795.

properties:
  compatible:
    items:
      - enum:
          - mediatek,mt6795-apmixedsys
          - mediatek,mt6795-infracfg
          - mediatek,mt6795-pericfg
          - mediatek,mt6795-topckgen
      - const: syscon

  reg:
    maxItems: 1

  '#clock-cells':
    const: 1

  '#reset-cells':
    const: 1

required:
  - compatible
  - reg
  - '#clock-cells'

additionalProperties: false

examples:
  - |
    soc {
        #address-cells = <2>;
        #size-cells = <2>;

        topckgen: clock-controller@10000000 {
            compatible = "mediatek,mt6795-topckgen", "syscon";
            reg = <0 0x10000000 0 0x1000>;
            #clock-cells = <1>;
        };
    };
```
