## Documentation/devicetree/bindings/clock/mediatek,mt7621-sysc.yaml
```yaml
# SPDX-License-Identifier: (GPL-2.0-only OR BSD-2-Clause)
%YAML 1.2
---
$id: http://devicetree.org/schemas/clock/mediatek,mt7621-sysc.yaml#
$schema: http://devicetree.org/meta-schemas/core.yaml#

title: MT7621 Clock Device Tree Bindings

maintainers:
  - Sergio Paracuellos <sergio.paracuellos@gmail.com>

description: |
  The MT7621 has a PLL controller from where the cpu clock is provided
  as well as derived clocks for the bus and the peripherals. It also
  can gate SoC device clocks.

  Each clock is assigned an identifier and client nodes use this identifier
  to specify the clock which they consume.

  All these identifiers could be found in:
  [1]: <include/dt-bindings/clock/mt7621-clk.h>.

  The clocks are provided inside a system controller node.

properties:
  compatible:
    items:
      - const: mediatek,mt7621-sysc
      - const: syscon

  reg:
    maxItems: 1

  "#clock-cells":
    description:
      The first cell indicates the clock number, see [1] for available
      clocks.
    const: 1

  ralink,memctl:
    $ref: /schemas/types.yaml#/definitions/phandle
    description:
      phandle of syscon used to control memory registers

  clock-output-names:
    maxItems: 8

required:
  - compatible
  - reg
  - '#clock-cells'
  - ralink,memctl

additionalProperties: false

examples:
  - |
    #include <dt-bindings/clock/mt7621-clk.h>

    sysc: sysc@0 {
      compatible = "mediatek,mt7621-sysc", "syscon";
      reg = <0x0 0x100>;
      #clock-cells = <1>;
      ralink,memctl = <&memc>;
      clock-output-names = "xtal", "cpu", "bus",
                           "50m", "125m", "150m",
                           "250m", "270m";
    };
```

## Documentation/devicetree/bindings/clock/mediatek,mt7622-pciesys.yaml
```yaml
# SPDX-License-Identifier: GPL-2.0-only OR BSD-2-Clause
%YAML 1.2
---
$id: http://devicetree.org/schemas/clock/mediatek,mt7622-pciesys.yaml#
$schema: http://devicetree.org/meta-schemas/core.yaml#

title: MediaTek PCIESYS clock and reset controller

description:
  The MediaTek PCIESYS controller provides various clocks to the system.

maintainers:
  - Matthias Brugger <matthias.bgg@gmail.com>

properties:
  compatible:
    oneOf:
      - items:
          - const: mediatek,mt7622-pciesys
          - const: syscon
      - const: mediatek,mt7629-pciesys

  reg:
    maxItems: 1

  "#clock-cells":
    const: 1
    description: The available clocks are defined in dt-bindings/clock/mt*-clk.h

  "#reset-cells":
    const: 1

required:
  - reg
  - "#clock-cells"
  - "#reset-cells"

additionalProperties: false

examples:
  - |
    clock-controller@1a100800 {
        compatible = "mediatek,mt7622-pciesys", "syscon";
        reg = <0x1a100800 0x1000>;
        #clock-cells = <1>;
        #reset-cells = <1>;
    };
```

## Documentation/devicetree/bindings/clock/mediatek,mt7622-ssusbsys.yaml
```yaml
# SPDX-License-Identifier: GPL-2.0-only OR BSD-2-Clause
%YAML 1.2
---
$id: http://devicetree.org/schemas/clock/mediatek,mt7622-ssusbsys.yaml#
$schema: http://devicetree.org/meta-schemas/core.yaml#

title: MediaTek SSUSBSYS clock and reset controller

description:
  The MediaTek SSUSBSYS controller provides various clocks to the system.

maintainers:
  - Matthias Brugger <matthias.bgg@gmail.com>

properties:
  compatible:
    enum:
      - mediatek,mt7622-ssusbsys
      - mediatek,mt7629-ssusbsys

  reg:
    maxItems: 1

  "#clock-cells":
    const: 1
    description: The available clocks are defined in dt-bindings/clock/mt*-clk.h

  "#reset-cells":
    const: 1

required:
  - reg
  - "#clock-cells"
  - "#reset-cells"

additionalProperties: false

examples:
  - |
    clock-controller@1a000000 {
        compatible = "mediatek,mt7622-ssusbsys";
        reg = <0x1a000000 0x1000>;
        #clock-cells = <1>;
        #reset-cells = <1>;
    };
```

## Documentation/devicetree/bindings/clock/mediatek,mt7988-ethwarp.yaml
```yaml
# SPDX-License-Identifier: (GPL-2.0 OR BSD-2-Clause)
%YAML 1.2
---
$id: http://devicetree.org/schemas/clock/mediatek,mt7988-ethwarp.yaml#
$schema: http://devicetree.org/meta-schemas/core.yaml#

title: MediaTek MT7988 ethwarp Controller

maintainers:
  - Daniel Golle <daniel@makrotopia.org>

description:
  The Mediatek MT7988 ethwarp controller provides clocks and resets for the
  Ethernet related subsystems found the MT7988 SoC.
  The clock values can be found in <dt-bindings/clock/mt*-clk.h>.

properties:
  compatible:
    items:
      - const: mediatek,mt7988-ethwarp

  reg:
    maxItems: 1

  '#clock-cells':
    const: 1

  '#reset-cells':
    const: 1

required:
  - compatible
  - reg
  - '#clock-cells'
  - '#reset-cells'

additionalProperties: false

examples:
  - |
    #include <dt-bindings/reset/ti-syscon.h>
    soc {
        #address-cells = <2>;
        #size-cells = <2>;

        clock-controller@15031000 {
            compatible = "mediatek,mt7988-ethwarp";
            reg = <0 0x15031000 0 0x1000>;
            #clock-cells = <1>;
            #reset-cells = <1>;
        };
    };
```

## Documentation/devicetree/bindings/clock/mediatek,mt7988-xfi-pll.yaml
```yaml
# SPDX-License-Identifier: (GPL-2.0 OR BSD-2-Clause)
%YAML 1.2
---
$id: http://devicetree.org/schemas/clock/mediatek,mt7988-xfi-pll.yaml#
$schema: http://devicetree.org/meta-schemas/core.yaml#

title: MediaTek MT7988 XFI PLL Clock Controller

maintainers:
  - Daniel Golle <daniel@makrotopia.org>

description:
  The MediaTek XFI PLL controller provides the 156.25MHz clock for the
  Ethernet SerDes PHY from the 40MHz top_xtal clock.

properties:
  compatible:
    const: mediatek,mt7988-xfi-pll

  reg:
    maxItems: 1

  resets:
    maxItems: 1

  '#clock-cells':
    const: 1

required:
  - compatible
  - reg
  - resets
  - '#clock-cells'

additionalProperties: false

examples:
  - |
    soc {
        #address-cells = <2>;
        #size-cells = <2>;
        clock-controller@11f40000 {
            compatible = "mediatek,mt7988-xfi-pll";
            reg = <0 0x11f40000 0 0x1000>;
            resets = <&watchdog 16>;
            #clock-cells = <1>;
        };
    };
```
