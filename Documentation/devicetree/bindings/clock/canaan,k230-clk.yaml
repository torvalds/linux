## Documentation/devicetree/bindings/clock/clk-s5pv210-audss.txt
```
* Samsung Audio Subsystem Clock Controller

The Samsung Audio Subsystem clock controller generates and supplies clocks
to Audio Subsystem block available in the S5PV210 and compatible SoCs.

Required Properties:

- compatible: should be "samsung,s5pv210-audss-clock".
- reg: physical base address and length of the controller's register set.

- #clock-cells: should be 1.

- clocks:
  - hclk: AHB bus clock of the Audio Subsystem.
  - xxti: Optional fixed rate PLL reference clock, parent of mout_audss. If
    not specified (i.e. xusbxti is used for PLL reference), it is fixed to
    a clock named "xxti".
  - fout_epll: Input PLL to the AudioSS block, parent of mout_audss.
  - iiscdclk0: Optional external i2s clock, parent of mout_i2s. If not
    specified, it is fixed to a clock named "iiscdclk0".
  - sclk_audio0: Audio bus clock, parent of mout_i2s.

- clock-names: Aliases for the above clocks. They should be "hclk",
  "xxti", "fout_epll", "iiscdclk0", and "sclk_audio0" respectively.

All available clocks are defined as preprocessor macros in
dt-bindings/clock/s5pv210-audss-clk.h header and can be used in device
tree sources.

Example: Clock controller node.

	clk_audss: clock-controller@c0900000 {
		compatible = "samsung,s5pv210-audss-clock";
		reg = <0xc0900000 0x1000>;
		#clock-cells = <1>;
		clock-names = "hclk", "xxti",
				"fout_epll", "sclk_audio0";
		clocks = <&clocks DOUT_HCLKP>, <&xxti>,
				<&clocks FOUT_EPLL>, <&clocks SCLK_AUDIO0>;
	};

Example: I2S controller node that consumes the clock generated by the clock
	 controller. Refer to the standard clock bindings for information
         about 'clocks' and 'clock-names' property.

	i2s0: i2s@03830000 {
		/* ... */
		clock-names = "iis", "i2s_opclk0",
				"i2s_opclk1";
		clocks = <&clk_audss CLK_I2S>, <&clk_audss CLK_I2S>,
				<&clk_audss CLK_DOUT_AUD_BUS>;
		/* ... */
	};
```

## Documentation/devicetree/bindings/clock/clps711x-clock.txt
```
* Clock bindings for the Cirrus Logic CLPS711X CPUs

Required properties:
- compatible       : Shall contain "cirrus,clps711x-clk".
- reg              : Address of the internal register set.
- startup-frequency: Factory set CPU startup frequency in HZ.
- #clock-cells     : Should be <1>.

The clock consumer should specify the desired clock by having the clock
ID in its "clocks" phandle cell. See include/dt-bindings/clock/clps711x-clock.h
for the full list of CLPS711X clock IDs.

Example:
	clks: clks@80000000 {
		#clock-cells = <1>;
		compatible = "cirrus,ep7312-clk", "cirrus,clps711x-clk";
		reg = <0x80000000 0xc000>;
		startup-frequency = <73728000>;
	};
```

## Documentation/devicetree/bindings/clock/cs2000-cp.txt
```
CIRRUS LOGIC Fractional-N Clock Synthesizer & Clock Multiplier

Required properties:

- compatible:		"cirrus,cs2000-cp"
- reg:			The chip select number on the I2C bus
- clocks:		common clock binding for CLK_IN, XTI/REF_CLK
- clock-names:		CLK_IN : clk_in, XTI/REF_CLK : ref_clk
- #clock-cells:		must be <0>

Example:

&i2c2 {
	...
	cs2000: clk_multiplier@4f {
		#clock-cells = <0>;
		compatible = "cirrus,cs2000-cp";
		reg = <0x4f>;
		clocks = <&rcar_sound 0>, <&x12_clk>;
		clock-names = "clk_in", "ref_clk";
	};
};
```

## Documentation/devicetree/bindings/clock/csr,atlas7-car.txt
```
* Clock and reset bindings for CSR atlas7

Required properties:
- compatible: Should be "sirf,atlas7-car"
- reg: Address and length of the register set
- #clock-cells: Should be <1>
- #reset-cells: Should be <1>

The clock consumer should specify the desired clock by having the clock
ID in its "clocks" phandle cell.
The ID list atlas7_clks defined in drivers/clk/sirf/clk-atlas7.c

The reset consumer should specify the desired reset by having the reset
ID in its "reset" phandle cell.
The ID list atlas7_reset_unit defined in drivers/clk/sirf/clk-atlas7.c

Examples: Clock and reset controller node:

car: clock-controller@18620000 {
	compatible = "sirf,atlas7-car";
	reg = <0x18620000 0x1000>;
	#clock-cells = <1>;
	#reset-cells = <1>;
};

Examples: Consumers using clock or reset:

timer@10dc0000 {
	compatible = "sirf,macro-tick";
	reg = <0x10dc0000 0x1000>;
	clocks = <&car 54>;
	interrupts = <0 0 0>,
		   <0 1 0>,
		   <0 2 0>,
		   <0 49 0>,
		   <0 50 0>,
		   <0 51 0>;
};

uart1: uart@18020000 {
	cell-index = <1>;
	compatible = "sirf,macro-uart";
	reg = <0x18020000 0x1000>;
	clocks = <&clks 95>;
	interrupts = <0 18 0>;
	fifosize = <32>;
};

vpp@13110000 {
	compatible = "sirf,prima2-vpp";
	reg = <0x13110000 0x10000>;
	interrupts = <0 31 0>;
	clocks = <&car 85>;
	resets = <&car 29>;
};
```

## Documentation/devicetree/bindings/clock/dove-divider-clock.txt
```
PLL divider based Dove clocks

Marvell Dove has a 2GHz PLL, which feeds into a set of dividers to provide
high speed clocks for a number of peripherals.  These dividers are part of
the PMU, and thus this node should be a child of the PMU node.

The following clocks are provided:

ID	Clock
-------------
0	AXI bus clock
1	GPU clock
2	VMeta clock
3	LCD clock

Required properties:
- compatible : shall be "marvell,dove-divider-clock"
- reg : shall be the register address of the Core PLL and Clock Divider
   Control 0 register.  This will cover that register, as well as the
   Core PLL and Clock Divider Control 1 register.  Thus, it will have
   a size of 8.
- #clock-cells : from common clock binding; shall be set to 1

divider_clk: core-clock@64 {
	compatible = "marvell,dove-divider-clock";
	reg = <0x0064 0x8>;
	#clock-cells = <1>;
};
```

## Documentation/devicetree/bindings/clock/efm32-clock.txt
```
* Clock bindings for Energy Micro efm32 Giant Gecko's Clock Management Unit

Required properties:
- compatible: Should be "efm32gg,cmu"
- reg: Base address and length of the register set
- interrupts: Interrupt used by the CMU
- #clock-cells: Should be <1>

The clock consumer should specify the desired clock by having the clock ID in
its "clocks" phandle cell. The header efm32-clk.h contains a list of available
IDs.
```

## Documentation/devicetree/bindings/clock/exynos3250-clock.txt
```
* Samsung Exyyess3250 Clock Controller

The Exyyess3250 clock controller generates and supplies clock to various
controllers within the Exyyess3250 SoC.

Required Properties:

- compatible: should be one of the following.
  - "samsung,exyyess3250-cmu" - controller compatible with Exyyess3250 SoC.
  - "samsung,exyyess3250-cmu-dmc" - controller compatible with
    Exyyess3250 SoC for Dynamic Memory Controller domain.
  - "samsung,exyyess3250-cmu-isp" - ISP block clock controller compatible
     with Exyyess3250 SOC

- reg: physical base address of the controller and length of memory mapped
  region.

- #clock-cells: should be 1.

Each clock is assigned an identifier and client yesdes can use this identifier
to specify the clock which they consume.

All available clocks are defined as preprocessor macros in
dt-bindings/clock/exyyess3250.h header and can be used in device
tree sources.

Example 1: Examples of clock controller yesdes are listed below.

	cmu: clock-controller@10030000 {
		compatible = "samsung,exyyess3250-cmu";
		reg = <0x10030000 0x20000>;
		#clock-cells = <1>;
	};

	cmu_dmc: clock-controller@105c0000 {
		compatible = "samsung,exyyess3250-cmu-dmc";
		reg = <0x105C0000 0x2000>;
		#clock-cells = <1>;
	};

	cmu_isp: clock-controller@10048000 {
		compatible = "samsung,exyyess3250-cmu-isp";
		reg = <0x10048000 0x1000>;
		#clock-cells = <1>;
	};

Example 2: UART controller yesde that consumes the clock generated by the clock
	   controller. Refer to the standard clock bindings for information
	   about 'clocks' and 'clock-names' property.

	serial@13800000 {
		compatible = "samsung,exyyess4210-uart";
		reg = <0x13800000 0x100>;
		interrupts = <0 109 0>;
		clocks = <&cmu CLK_UART0>, <&cmu CLK_SCLK_UART0>;
		clock-names = "uart", "clk_uart_baud0";
	};
```

## Documentation/devicetree/bindings/clock/exynos4-clock.txt
```
* Samsung Exyyess4 Clock Controller

The Exyyess4 clock controller generates and supplies clock to various controllers
within the Exyyess4 SoC. The clock binding described here is applicable to all
SoC's in the Exyyess4 family.

Required Properties:

- compatible: should be one of the following.
  - "samsung,exyyess4210-clock" - controller compatible with Exyyess4210 SoC.
  - "samsung,exyyess4412-clock" - controller compatible with Exyyess4412 SoC.

- reg: physical base address of the controller and length of memory mapped
  region.

- #clock-cells: should be 1.

Each clock is assigned an identifier and client yesdes can use this identifier
to specify the clock which they consume.

All available clocks are defined as preprocessor macros in
dt-bindings/clock/exyyess4.h header and can be used in device
tree sources.

Example 1: An example of a clock controller yesde is listed below.

	clock: clock-controller@10030000 {
		compatible = "samsung,exyyess4210-clock";
		reg = <0x10030000 0x20000>;
		#clock-cells = <1>;
	};

Example 2: UART controller yesde that consumes the clock generated by the clock
	   controller. Refer to the standard clock bindings for information
	   about 'clocks' and 'clock-names' property.

	serial@13820000 {
		compatible = "samsung,exyyess4210-uart";
		reg = <0x13820000 0x100>;
		interrupts = <0 54 0>;
		clocks = <&clock CLK_UART2>, <&clock CLK_SCLK_UART2>;
		clock-names = "uart", "clk_uart_baud0";
	};

Exyyess4412 SoC contains some additional clocks for FIMC-ISP (Camera ISP)
subsystem. Registers for those clocks are located in the ISP power domain.
Because those registers are also located in a different memory region than
the main clock controller, a separate clock controller has to be defined for
handling them.

Required Properties:

- compatible: should be "samsung,exyyess4412-isp-clock".

- reg: physical base address of the ISP clock controller and length of memory
  mapped region.

- #clock-cells: should be 1.

- clocks: list of the clock controller input clock identifiers,
  from common clock bindings, should point to CLK_ACLK200 and
  CLK_ACLK400_MCUISP clocks from the main clock controller.

- clock-names: list of the clock controller input clock names,
  as described in clock-bindings.txt, should be "aclk200" and
  "aclk400_mcuisp".

- power-domains: a phandle to ISP power domain yesde as described by
  generic PM domain bindings.

Example 3: The clock controllers bindings for Exyyess4412 SoCs.

	clock: clock-controller@10030000 {
		compatible = "samsung,exyyess4412-clock";
		reg = <0x10030000 0x18000>;
		#clock-cells = <1>;
	};

	isp_clock: clock-controller@10048000 {
		compatible = "samsung,exyyess4412-isp-clock";
		reg = <0x10048000 0x1000>;
		#clock-cells = <1>;
		power-domains = <&pd_isp>;
		clocks = <&clock CLK_ACLK200>, <&clock CLK_ACLK400_MCUISP>;
		clock-names = "aclk200", "aclk400_mcuisp";
	};
```

## Documentation/devicetree/bindings/clock/exynos4415-clock.txt
```
* Samsung Exynos4415 Clock Controller

The Exynos4415 clock controller generates and supplies clock to various
consumer devices within the Exynos4415 SoC.

Required properties:

- compatible: should be one of the following:
  - "samsung,exynos4415-cmu" - for the main system clocks controller
    (CMU_LEFTBUS, CMU_RIGHTBUS, CMU_TOP, CMU_CPU clock domains).
  - "samsung,exynos4415-cmu-dmc" - for the Exynos4415 SoC DRAM Memory
    Controller (DMC) domain clock controller.

- reg: physical base address of the controller and length of memory mapped
  region.

- #clock-cells: should be 1.

Each clock is assigned an identifier and client nodes can use this identifier
to specify the clock which they consume.

All available clocks are defined as preprocessor macros in
dt-bindings/clock/exynos4415.h header and can be used in device
tree sources.

Example 1: An example of a clock controller node is listed below.

	cmu: clock-controller@10030000 {
		compatible = "samsung,exynos4415-cmu";
		reg = <0x10030000 0x18000>;
		#clock-cells = <1>;
	};

	cmu-dmc: clock-controller@105C0000 {
		compatible = "samsung,exynos4415-cmu-dmc";
		reg = <0x105C0000 0x3000>;
		#clock-cells = <1>;
	};
```

## Documentation/devicetree/bindings/clock/exynos5250-clock.txt
```
* Samsung Exyyess5250 Clock Controller

The Exyyess5250 clock controller generates and supplies clock to various
controllers within the Exyyess5250 SoC.

Required Properties:

- compatible: should be one of the following.
  - "samsung,exyyess5250-clock" - controller compatible with Exyyess5250 SoC.

- reg: physical base address of the controller and length of memory mapped
  region.

- #clock-cells: should be 1.

Each clock is assigned an identifier and client yesdes can use this identifier
to specify the clock which they consume.

All available clocks are defined as preprocessor macros in
dt-bindings/clock/exyyess5250.h header and can be used in device
tree sources.

Example 1: An example of a clock controller yesde is listed below.

	clock: clock-controller@10010000 {
		compatible = "samsung,exyyess5250-clock";
		reg = <0x10010000 0x30000>;
		#clock-cells = <1>;
	};

Example 2: UART controller yesde that consumes the clock generated by the clock
	   controller. Refer to the standard clock bindings for information
	   about 'clocks' and 'clock-names' property.

	serial@13820000 {
		compatible = "samsung,exyyess4210-uart";
		reg = <0x13820000 0x100>;
		interrupts = <0 54 0>;
		clocks = <&clock CLK_UART2>, <&clock CLK_SCLK_UART2>;
		clock-names = "uart", "clk_uart_baud0";
	};
```
