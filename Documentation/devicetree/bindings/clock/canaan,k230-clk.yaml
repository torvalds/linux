## Documentation/devicetree/bindings/clock/canaan,k230-clk.yaml
```yaml
# SPDX-License-Identifier: (GPL-2.0-only OR BSD-2-Clause)
%YAML 1.2
---
$id: http://devicetree.org/schemas/clock/canaan,k230-clk.yaml#
$schema: http://devicetree.org/meta-schemas/core.yaml#

title: Canaan Kendryte K230 Clock

maintainers:
  - Xukai Wang <kingxukai@zohomail.com>

description:
  The Canaan K230 clock controller generates various clocks for SoC
  peripherals. See include/dt-bindings/clock/canaan,k230-clk.h for
  valid clock IDs.

properties:
  compatible:
    const: canaan,k230-clk

  reg:
    items:
      - description: PLL control registers
      - description: Sysclk control registers

  clocks:
    items:
      - description: Main external reference clock
      - description:
          External clock which used as the pulse input
          for the timer to provide timing signals.

  clock-names:
    items:
      - const: osc24m
      - const: timer-pulse-in

  '#clock-cells':
    const: 1

required:
  - compatible
  - reg
  - clocks
  - clock-names
  - '#clock-cells'

additionalProperties: false

examples:
  - |
    clock-controller@91102000 {
        compatible = "canaan,k230-clk";
        reg = <0x91102000 0x40>,
              <0x91100000 0x108>;
        clocks = <&osc24m>, <&timerx_pulse_in>;
        clock-names = "osc24m", "timer-pulse-in";
        #clock-cells = <1>;
    };
```

## Documentation/devicetree/bindings/clock/cirrus,cs2000-cp.yaml
```yaml
# SPDX-License-Identifier: (GPL-2.0-only OR BSD-2-Clause)
%YAML 1.2
---
$id: http://devicetree.org/schemas/clock/cirrus,cs2000-cp.yaml#
$schema: http://devicetree.org/meta-schemas/core.yaml#

title: Binding CIRRUS LOGIC Fractional-N Clock Synthesizer & Clock Multiplier

maintainers:
  - Kuninori Morimoto <kuninori.morimoto.gx@renesas.com>

description: |
  The CS2000-CP is an extremely versatile system clocking device that
  utilizes a programmable phase lock loop.

  Link: https://www.cirrus.com/products/cs2000/

properties:
  compatible:
    enum:
      - cirrus,cs2000-cp

  clocks:
    description:
      Common clock binding for CLK_IN, XTI/REF_CLK
    minItems: 2
    maxItems: 2

  clock-names:
    items:
      - const: clk_in
      - const: ref_clk

  '#clock-cells':
    const: 0

  reg:
    maxItems: 1

required:
  - compatible
  - reg
  - clocks
  - clock-names
  - '#clock-cells'

additionalProperties: false

examples:
  - |
    i2c@0 {
      reg = <0x0 0x100>;
      #address-cells = <1>;
      #size-cells = <0>;

      clock-controller@4f {
        #clock-cells = <0>;
        compatible = "cirrus,cs2000-cp";
        reg = <0x4f>;
        clocks = <&rcar_sound 0>, <&x12_clk>;
        clock-names = "clk_in", "ref_clk";
      };
    };
```

## Documentation/devicetree/bindings/clock/cirrus,ep7209-clk.yaml
```yaml
# SPDX-License-Identifier: (GPL-2.0-only OR BSD-2-Clause)
%YAML 1.2
---
$id: http://devicetree.org/schemas/clock/cirrus,ep7209-clk.yaml#
$schema: http://devicetree.org/meta-schemas/core.yaml#

title: Cirrus Logic CLPS711X Clock Controller

maintainers:
  - Alexander Shiyan <shc_work@mail.ru>

description:
  See include/dt-bindings/clock/clps711x-clock.h for the full list of CLPS711X
  clock IDs.

properties:
  compatible:
    items:
      - const: cirrus,ep7312-clk
      - const: cirrus,ep7209-clk

  reg:
    maxItems: 1

  startup-frequency:
    description: Factory set CPU startup frequency in HZ.
    $ref: /schemas/types.yaml#/definitions/uint32

  "#clock-cells":
    const: 1

required:
  - compatible
  - reg
  - startup-frequency
  - "#clock-cells"

additionalProperties: false

examples:
  - |
    clock-controller@80000000 {
        compatible = "cirrus,ep7312-clk", "cirrus,ep7209-clk";
        reg = <0x80000000 0xc000>;
        #clock-cells = <1>;
        startup-frequency = <73728000>;
    };
```

## Documentation/devicetree/bindings/clock/cirrus,lochnagar.txt
```
Cirrus Logic Lochnagar Audio Development Board

Lochnagar is an evaluation and development board for Cirrus Logic
Smart CODEC and Amp devices. It allows the connection of most Cirrus
Logic devices on mini-cards, as well as allowing connection of
various application processor systems to provide a full evaluation
platform.  Audio system topology, clocking and power can all be
controlled through the Lochnagar, allowing the device under test
to be used in a variety of possible use cases.

This binding document describes the binding for the clock portion of
the driver.

Also see these documents for generic binding information:
  [1] Clock : ../clock/clock-bindings.txt

And these for relevant defines:
  [2] include/dt-bindings/clock/lochnagar.h

This binding must be part of the Lochnagar MFD binding:
  [3] ../mfd/cirrus,lochnagar.txt

Required properties:

  - compatible : One of the following strings:
                 "cirrus,lochnagar1-clk"
                 "cirrus,lochnagar2-clk"

  - #clock-cells : Must be 1. The first cell indicates the clock
    number, see [2] for available clocks and [1].

Optional properties:

  - clocks : Must contain an entry for each clock in clock-names.
  - clock-names : May contain entries for each of the following
    clocks:
     - ln-cdc-clkout : Output clock from CODEC card.
     - ln-dsp-clkout : Output clock from DSP card.
     - ln-gf-mclk1,ln-gf-mclk2,ln-gf-mclk3,ln-gf-mclk4 : Optional
       input audio clocks from host system.
     - ln-psia1-mclk, ln-psia2-mclk : Optional input audio clocks from
       external connector.
     - ln-spdif-clkout : Optional input audio clock from SPDIF.
     - ln-adat-mclk : Optional input audio clock from ADAT.
     - ln-pmic-32k : On board fixed clock.
     - ln-clk-12m : On board fixed clock.
     - ln-clk-11m : On board fixed clock.
     - ln-clk-24m : On board fixed clock.
     - ln-clk-22m : On board fixed clock.
     - ln-clk-8m : On board fixed clock.
     - ln-usb-clk-24m : On board fixed clock.
     - ln-usb-clk-12m : On board fixed clock.

  - assigned-clocks : A list of Lochnagar clocks to be reparented, see
    [2] for available clocks.
  - assigned-clock-parents : Parents to be assigned to the clocks
    listed in "assigned-clocks".

Optional nodes:

  - fixed-clock nodes may be registered for the following on board clocks:
     - ln-pmic-32k : 32768 Hz
     - ln-clk-12m : 12288000 Hz
     - ln-clk-11m : 11298600 Hz
     - ln-clk-24m : 24576000 Hz
     - ln-clk-22m : 22579200 Hz
     - ln-clk-8m : 8192000 Hz
     - ln-usb-clk-24m : 24576000 Hz
     - ln-usb-clk-12m : 12288000 Hz

Example:

lochnagar {
	lochnagar-clk {
		compatible = "cirrus,lochnagar2-clk";

		#clock-cells = <1>;

		clocks = <&clk-audio>, <&clk_pmic>;
		clock-names = "ln-gf-mclk2", "ln-pmic-32k";

		assigned-clocks = <&lochnagar-clk LOCHNAGAR_CDC_MCLK1>,
				  <&lochnagar-clk LOCHNAGAR_CDC_MCLK2>;
		assigned-clock-parents = <&clk-audio>,
					 <&clk-pmic>;
	};

	clk-pmic: clk-pmic {
		compatible = "fixed-clock";
		clock-cells = <0>;
		clock-frequency = <32768>;
	};
};
```

## Documentation/devicetree/bindings/clock/cirrus,lochnagar.yaml
```yaml
# SPDX-License-Identifier: GPL-2.0-only OR BSD-2-Clause
%YAML 1.2
---
$id: http://devicetree.org/schemas/clock/cirrus,lochnagar.yaml#
$schema: http://devicetree.org/meta-schemas/core.yaml#

title: Cirrus Logic Lochnagar Audio Development Board

maintainers:
  - patches@opensource.cirrus.com

description: |
  Lochnagar is an evaluation and development board for Cirrus Logic
  Smart CODEC and Amp devices. It allows the connection of most Cirrus
  Logic devices on mini-cards, as well as allowing connection of various
  application processor systems to provide a full evaluation platform.
  Audio system topology, clocking and power can all be controlled through
  the Lochnagar, allowing the device under test to be used in a variety of
  possible use cases.

  This binding document describes the binding for the clock portion of the
  driver.

  Also see these documents for generic binding information:
    [1] Clock : ../clock/clock-bindings.txt

  And these for relevant defines:
    [2] include/dt-bindings/clock/lochnagar.h

  This binding must be part of the Lochnagar MFD binding:
    [3] ../mfd/cirrus,lochnagar.yaml

properties:
  compatible:
    enum:
      - cirrus,lochnagar1-clk
      - cirrus,lochnagar2-clk

  '#clock-cells':
    description:
      The first cell indicates the clock number, see [2] for available
      clocks and [1].
    const: 1

  clock-names:
    items:
      enum:
        - ln-cdc-clkout # Output clock from CODEC card.
        - ln-dsp-clkout # Output clock from DSP card.
        - ln-gf-mclk1 # Optional input clock from host system.
        - ln-gf-mclk2 # Optional input clock from host system.
        - ln-gf-mclk3 # Optional input clock from host system.
        - ln-gf-mclk4 # Optional input clock from host system.
        - ln-psia1-mclk # Optional input clock from external connector.
        - ln-psia2-mclk # Optional input clock from external connector.
        - ln-spdif-mclk # Optional input clock from SPDIF.
        - ln-spdif-clkout # Optional input clock from SPDIF.
        - ln-adat-mclk # Optional input clock from ADAT.
        - ln-pmic-32k # On board fixed clock.
        - ln-clk-12m # On board fixed clock.
        - ln-clk-11m # On board fixed clock.
        - ln-clk-24m # On board fixed clock.
        - ln-clk-22m # On board fixed clock.
        - ln-clk-8m # On board fixed clock.
        - ln-usb-clk-24m # On board fixed clock.
        - ln-usb-clk-12m # On board fixed clock.
    minItems: 1
    maxItems: 19

  clocks: true
  assigned-clocks: true
  assigned-clock-parents: true

additionalProperties: false

required:
  - compatible
  - '#clock-cells'
```

## Documentation/devicetree/bindings/clock/clk-exynos-audss.txt
```
* Samsung Audio Subsystem Clock Controller

The Samsung Audio Subsystem clock controller generates and supplies clocks
to Audio Subsystem block available in the S5PV210 and Exynos SoCs. The clock
binding described here is applicable to all SoCs in Exynos family.

Required Properties:

- compatible: should be one of the following:
  - "samsung,exynos4210-audss-clock" - controller compatible with all Exynos4 SoCs.
  - "samsung,exynos5250-audss-clock" - controller compatible with Exynos5250
    SoCs.
  - "samsung,exynos5410-audss-clock" - controller compatible with Exynos5410
    SoCs.
  - "samsung,exynos5420-audss-clock" - controller compatible with Exynos5420
    SoCs.
- reg: physical base address and length of the controller's register set.

- #clock-cells: should be 1.

- clocks:
  - pll_ref: Fixed rate PLL reference clock, parent of mout_audss. "fin_pll"
    is used if not specified.
  - pll_in: Input PLL to the AudioSS block, parent of mout_audss. "fout_epll"
    is used if not specified.
  - cdclk: External i2s clock, parent of mout_i2s. "cdclk0" is used if not
    specified.
  - sclk_audio: Audio bus clock, parent of mout_i2s. "sclk_audio0" is used if
    not specified.
  - sclk_pcm_in: PCM clock, parent of sclk_pcm.  "sclk_pcm0" is used if not
    specified.

- clock-names: Aliases for the above clocks. They should be "pll_ref",
  "pll_in", "cdclk", "sclk_audio", and "sclk_pcm_in" respectively.

The following is the list of clocks generated by the controller. Each clock is
assigned an identifier and client nodes use this identifier to specify the
clock which they consume. Some of the clocks are available only on a particular
Exynos4 SoC and this is specified where applicable.

Provided clocks:

Clock           ID      SoC (if specific)
-----------------------------------------------

mout_audss      0
mout_i2s        1
dout_srp        2
dout_aud_bus    3
dout_i2s        4
srp_clk         5
i2s_bus         6
sclk_i2s        7
pcm_bus         8
sclk_pcm        9
adma            10      Exynos5420

Example 1: An example of a clock controller node using the default input
	   clock names is listed below.

clock_audss: audss-clock-controller@3810000 {
	compatible = "samsung,exynos5250-audss-clock";
	reg = <0x03810000 0x0C>;
	#clock-cells = <1>;
};

Example 2: An example of a clock controller node with the input clocks
           specified.

clock_audss: audss-clock-controller@3810000 {
	compatible = "samsung,exynos5250-audss-clock";
	reg = <0x03810000 0x0C>;
	#clock-cells = <1>;
	clocks = <&clock 1>, <&clock 7>, <&clock 138>, <&clock 160>,
		<&ext_i2s_clk>;
	clock-names = "pll_ref", "pll_in", "sclk_audio", "sclk_pcm_in", "cdclk";
};

Example 3: I2S controller node that consumes the clock generated by the clock
           controller. Refer to the standard clock bindings for information
           about 'clocks' and 'clock-names' property.

i2s0: i2s@3830000 {
	compatible = "samsung,i2s-v5";
	reg = <0x03830000 0x100>;
	dmas = <&pdma0 10
		&pdma0 9
		&pdma0 8>;
	dma-names = "tx", "rx", "tx-sec";
	clocks = <&clock_audss EXYNOS_I2S_BUS>,
		<&clock_audss EXYNOS_I2S_BUS>,
		<&clock_audss EXYNOS_SCLK_I2S>,
		<&clock_audss EXYNOS_MOUT_AUDSS>,
		<&clock_audss EXYNOS_MOUT_I2S>;
	clock-names = "iis", "i2s_opclk0", "i2s_opclk1",
		      "mout_audss", "mout_i2s";
};
```

## Documentation/devicetree/bindings/clock/clk-palmas-clk32kg-clocks.txt
```
* Palmas 32KHz clocks *

Palmas device has two clock output pins for 32KHz, KG and KG_AUDIO.

This binding uses the common clock binding ./clock-bindings.txt.

Required properties:
- compatible :	"ti,palmas-clk32kg" for clk32kg clock
		"ti,palmas-clk32kgaudio" for clk32kgaudio clock
- #clock-cells : shall be set to 0.

Optional property:
- ti,external-sleep-control: The external enable input pins controlled the
	enable/disable of clocks.  The external enable input pins ENABLE1,
	ENABLE2 and NSLEEP. The valid values for the external pins are:
		PALMAS_EXT_CONTROL_PIN_ENABLE1 for ENABLE1 pin
		PALMAS_EXT_CONTROL_PIN_ENABLE2 for ENABLE2 pin
		PALMAS_EXT_CONTROL_PIN_NSLEEP for NSLEEP pin
	Option 0 or missing this property means the clock is enabled/disabled
	via register access and these pins do not have any control.
	The macros of external control pins for DTS is defined at
	dt-bindings/mfd/palmas.h

Example:
	#include <dt-bindings/mfd/palmas.h>
	...
	palmas: tps65913@58 {
		...
		clk32kg: palmas_clk32k@0 {
			compatible = "ti,palmas-clk32kg";
			#clock-cells = <0>;
			ti,external-sleep-control = <PALMAS_EXT_CONTROL_PIN_NSLEEP>;
		};
		...
	};
```

## Documentation/devicetree/bindings/clock/clk-pvtm.txt
```
ROCKCHIP PVTM 32KHz clocks *

ROCKCHIP device has two clock sources for 32KHz, external 32k osc and internal pvtm 32k.

This binding uses the common clock binding[1].

[1] Documentation/devicetree/bindings/clock/clock-bindings.txt

Required properties:
- compatible :	"rockchip,rk3368-pvtm-clock" for rk3368 soc pvtm 32k clock
- #clock-cells : shall be set to 0.

Optional property:
- clock-output-names : From common clock binding.

Example:
	pvtm_clock: pvtm-clock {
		compatible = "rockchip,rk3368-pvtm-clock";
		#clock-cells = <0>;
		clocks = <&cru SCLK_PVTM_PMU>;
		clock-names = "pvtm_pmu_clk";
		clock-output-names = "xin32k_pvtm";
		status = "okay";
	};
```
