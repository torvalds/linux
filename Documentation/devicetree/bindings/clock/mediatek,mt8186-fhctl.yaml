## Documentation/devicetree/bindings/clock/microchip,mpfs-ccc.yaml
```yaml
# SPDX-License-Identifier: (GPL-2.0-only OR BSD-2-Clause)
%YAML 1.2
---
$id: http://devicetree.org/schemas/clock/microchip,mpfs-ccc.yaml#
$schema: http://devicetree.org/meta-schemas/core.yaml#

title: Microchip PolarFire SoC Fabric Clock Conditioning Circuitry

maintainers:
  - Conor Dooley <conor.dooley@microchip.com>

description: |
  Microchip PolarFire SoC has 4 Clock Conditioning Circuitry blocks. Each of
  these blocks contains two PLLs and 2 DLLs & are located in the four corners of
  the FPGA. For more information see "PolarFire SoC FPGA Clocking Resources" at:
  https://onlinedocs.microchip.com/pr/GUID-8F0CC4C0-0317-4262-89CA-CE7773ED1931-en-US-1/index.html

properties:
  compatible:
    const: microchip,mpfs-ccc

  reg:
    items:
      - description: PLL0's control registers
      - description: PLL1's control registers
      - description: DLL0's control registers
      - description: DLL1's control registers

  clocks:
    description:
      The CCC PLL's have two input clocks. It is required that even if the input
      clocks are identical that both are provided.
    minItems: 2
    items:
      - description: PLL0's refclk0
      - description: PLL0's refclk1
      - description: PLL1's refclk0
      - description: PLL1's refclk1
      - description: DLL0's refclk
      - description: DLL1's refclk

  clock-names:
    minItems: 2
    items:
      - const: pll0_ref0
      - const: pll0_ref1
      - const: pll1_ref0
      - const: pll1_ref1
      - const: dll0_ref
      - const: dll1_ref

  '#clock-cells':
    const: 1
    description: |
      The clock consumer should specify the desired clock by having the clock
      ID in its "clocks" phandle cell.
      See include/dt-bindings/clock/microchip,mpfs-clock.h for the full list of
      PolarFire clock IDs.

required:
  - compatible
  - reg
  - clocks
  - clock-names
  - '#clock-cells'

additionalProperties: false

examples:
  - |
    clock-controller@38100000 {
        compatible = "microchip,mpfs-ccc";
        reg = <0x38010000 0x1000>, <0x38020000 0x1000>,
              <0x39010000 0x1000>, <0x39020000 0x1000>;
        #clock-cells = <1>;
        clocks = <&refclk_ccc>, <&refclk_ccc>, <&refclk_ccc>, <&refclk_ccc>,
                  <&refclk_ccc>, <&refclk_ccc>;
        clock-names = "pll0_ref0", "pll0_ref1", "pll1_ref0", "pll1_ref1",
                      "dll0_ref", "dll1_ref";
    };
```

## Documentation/devicetree/bindings/clock/microchip,mpfs-clkcfg.yaml
```yaml
# SPDX-License-Identifier: (GPL-2.0-only OR BSD-2-Clause)
%YAML 1.2
---
$id: http://devicetree.org/schemas/clock/microchip,mpfs-clkcfg.yaml#
$schema: http://devicetree.org/meta-schemas/core.yaml#

title: Microchip PolarFire Clock Control Module

maintainers:
  - Daire McNamara <daire.mcnamara@microchip.com>

description: |
  Microchip PolarFire clock control (CLKCFG) is an integrated clock controller,
  which gates and enables all peripheral clocks.

  This device tree binding describes 33 gate clocks.  Clocks are referenced by
  user nodes by the CLKCFG node phandle and the clock index in the group, from
  0 to 32.

properties:
  compatible:
    const: microchip,mpfs-clkcfg

  reg:
    items:
      - description: |
          clock config registers:
          These registers contain enable, reset & divider tables for the, cpu,
          axi, ahb and rtc/mtimer reference clocks as well as enable and reset
          for the peripheral clocks.
      - description: |
          mss pll dri registers:
          Block of registers responsible for dynamic reconfiguration of the mss
          pll

  clocks:
    maxItems: 1

  '#clock-cells':
    const: 1
    description: |
      The clock consumer should specify the desired clock by having the clock
      ID in its "clocks" phandle cell.
      See include/dt-bindings/clock/microchip,mpfs-clock.h for the full list of
      PolarFire clock IDs.

  resets:
    maxItems: 1

  '#reset-cells':
    description:
      The AHB/AXI peripherals on the PolarFire SoC have reset support, so from
      CLK_ENVM to CLK_CFM. The reset consumer should specify the desired
      peripheral via the clock ID in its "resets" phandle cell.
      See include/dt-bindings/clock/microchip,mpfs-clock.h for the full list of
      PolarFire clock IDs.
    const: 1

required:
  - compatible
  - reg
  - clocks
  - '#clock-cells'

additionalProperties: false

examples:
  # Clock Config node:
  - |
    #include <dt-bindings/clock/microchip,mpfs-clock.h>
    soc {
            #address-cells = <2>;
            #size-cells = <2>;
            clkcfg: clock-controller@20002000 {
                compatible = "microchip,mpfs-clkcfg";
                reg = <0x0 0x20002000 0x0 0x1000>, <0x0 0x3E001000 0x0 0x1000>;
                clocks = <&ref>;
                #clock-cells = <1>;
        };
    };
```

## Documentation/devicetree/bindings/clock/microchip,pic32.txt
```
Microchip PIC32 Clock Controller Binding
----------------------------------------
Microchip clock controller is consists of few oscillators, PLL, multiplexer
and few divider modules.

This binding uses common clock bindings.
[1] Documentation/devicetree/bindings/clock/clock-bindings.txt

Required properties:
- compatible: shall be "microchip,pic32mzda-clk".
- reg: shall contain base address and length of clock registers.
- #clock-cells: shall be 1.

Optional properties:
- microchip,pic32mzda-sosc: shall be added only if platform has
  secondary oscillator connected.

Example:
	rootclk: clock-controller@1f801200 {
		compatible = "microchip,pic32mzda-clk";
		reg = <0x1f801200 0x200>;
		#clock-cells = <1>;
		/* optional */
		microchip,pic32mzda-sosc;
	};


The clock consumer shall specify the desired clock-output of the clock
controller (as defined in [2]) by specifying output-id in its "clock"
phandle cell.
[2] include/dt-bindings/clock/microchip,pic32-clock.h

For example for UART2:
uart2: serial@2 {
	compatible = "microchip,pic32mzda-uart";
	reg = <>;
	interrupts = <>;
	clocks = <&rootclk PB2CLK>;
};
```

## Documentation/devicetree/bindings/clock/microchip,pic32mzda-clk.yaml
```yaml
# SPDX-License-Identifier: (GPL-2.0-only OR BSD-2-Clause)
%YAML 1.2
---
$id: http://devicetree.org/schemas/clock/microchip,pic32mzda-clk.yaml#
$schema: http://devicetree.org/meta-schemas/core.yaml#

title: Microchip PIC32MZDA Clock Controller

maintainers:
  - Purna Chandra Mandal <purna.mandal@microchip.com>

description:
  Microchip clock controller consists of a few oscillators, PLL, multiplexer
  and divider modules.

properties:
  compatible:
    const: microchip,pic32mzda-clk

  reg:
    maxItems: 1

  '#clock-cells':
    const: 1

  microchip,pic32mzda-sosc:
    description: Presence of secondary oscillator.
    type: boolean

required:
  - compatible
  - reg
  - "#clock-cells"

additionalProperties: false

examples:
  - |
    clock-controller@1f801200 {
        compatible = "microchip,pic32mzda-clk";
        reg = <0x1f801200 0x200>;
        #clock-cells = <1>;
        /* optional */
        microchip,pic32mzda-sosc;
    };
```

## Documentation/devicetree/bindings/clock/microchip,sparx5-dpll.yaml
```yaml
# SPDX-License-Identifier: (GPL-2.0-only OR BSD-2-Clause)
%YAML 1.2
---
$id: http://devicetree.org/schemas/clock/microchip,sparx5-dpll.yaml#
$schema: http://devicetree.org/meta-schemas/core.yaml#

title: Microchip Sparx5 DPLL Clock

maintainers:
  - Lars Povlsen <lars.povlsen@microchip.com>

description: |
  The Sparx5 DPLL clock controller generates and supplies clock to
  various peripherals within the SoC.

properties:
  compatible:
    const: microchip,sparx5-dpll

  reg:
    maxItems: 1

  clocks:
    maxItems: 1

  '#clock-cells':
    const: 1

required:
  - compatible
  - reg
  - clocks
  - '#clock-cells'

additionalProperties: false

examples:
  # Clock provider for eMMC:
  - |
    lcpll_clk: lcpll-clk {
        compatible = "fixed-clock";
        #clock-cells = <0>;
        clock-frequency = <2500000000>;
    };
    clks: clock-controller@61110000c {
        compatible = "microchip,sparx5-dpll";
        #clock-cells = <1>;
        clocks = <&lcpll_clk>;
        reg = <0x1110000c 0x24>;
    };

...
```

## Documentation/devicetree/bindings/clock/milbeaut-clock.yaml
```yaml
# SPDX-License-Identifier: GPL-2.0
%YAML 1.2
---
$id: http://devicetree.org/schemas/clock/milbeaut-clock.yaml#
$schema: http://devicetree.org/meta-schemas/core.yaml#

title: Milbeaut SoCs Clock Controller

maintainers:
  - Taichi Sugaya <sugaya.taichi@socionext.com>

description: |
  Milbeaut SoCs Clock controller is an integrated clock controller, which
  generates and supplies to all modules.

  This binding uses common clock bindings
  [1] Documentation/devicetree/bindings/clock/clock-bindings.txt

properties:
  compatible:
    enum:
      - socionext,milbeaut-m10v-ccu

  reg:
    maxItems: 1

  clocks:
    maxItems: 1
    description: external clock

  '#clock-cells':
    const: 1

required:
  - compatible
  - reg
  - clocks
  - '#clock-cells'

additionalProperties: false

examples:
  - |
    clock-controller@1d021000 {
        compatible = "socionext,milbeaut-m10v-ccu";
        reg = <0x1d021000 0x4000>;
        #clock-cells = <1>;
        clocks = <&clki40mhz>;
    };
...
```

## Documentation/devicetree/bindings/clock/mobileye,eyeq5-clk.yaml
```yaml
# SPDX-License-Identifier: (GPL-2.0-only OR BSD-2-Clause)
%YAML 1.2
---
$id: http://devicetree.org/schemas/clock/mobileye,eyeq5-clk.yaml#
$schema: http://devicetree.org/meta-schemas/core.yaml#

title: Mobileye EyeQ5 clock controller

description:
  The EyeQ5 clock controller handles 10 read-only PLLs derived from the main
  crystal clock. It also exposes one divider clock, a child of one of the PLLs.
  Its registers live in a shared region called OLB.

maintainers:
  - Grégory Clement <gregory.clement@bootlin.com>
  - Théo Lebrun <theo.lebrun@bootlin.com>
  - Vladimir Kondratiev <vladimir.kondratiev@mobileye.com>

properties:
  compatible:
    const: mobileye,eyeq5-clk

  reg:
    maxItems: 2

  reg-names:
    items:
      - const: plls
      - const: ospi

  "#clock-cells":
    const: 1

  clocks:
    maxItems: 1
    description:
      Input parent clock to all PLLs. Expected to be the main crystal.

  clock-names:
    items:
      - const: ref

required:
  - compatible
  - reg
  - reg-names
  - "#clock-cells"
  - clocks
  - clock-names

additionalProperties: false
```

## Documentation/devicetree/bindings/clock/moxa,moxart-clock.txt
```
Device Tree Clock bindings for arch-moxart

This binding uses the common clock binding[1].

[1] Documentation/devicetree/bindings/clock/clock-bindings.txt

MOXA ART SoCs allow to determine PLL output and APB frequencies
by reading registers holding multiplier and divisor information.


PLL:

Required properties:
- compatible : Must be "moxa,moxart-pll-clock"
- #clock-cells : Should be 0
- reg : Should contain registers location and length
- clocks : Should contain phandle + clock-specifier for the parent clock

Optional properties:
- clock-output-names : Should contain clock name


APB:

Required properties:
- compatible : Must be "moxa,moxart-apb-clock"
- #clock-cells : Should be 0
- reg : Should contain registers location and length
- clocks : Should contain phandle + clock-specifier for the parent clock

Optional properties:
- clock-output-names : Should contain clock name


For example:

	clk_pll: clk_pll@98100000 {
		compatible = "moxa,moxart-pll-clock";
		#clock-cells = <0>;
		reg = <0x98100000 0x34>;
	};

	clk_apb: clk_apb@98100000 {
		compatible = "moxa,moxart-apb-clock";
		#clock-cells = <0>;
		reg = <0x98100000 0x34>;
		clocks = <&clk_pll>;
	};
```

## Documentation/devicetree/bindings/clock/moxa,moxart-clock.yaml
```yaml
# SPDX-License-Identifier: (GPL-2.0-only OR BSD-2-Clause)
%YAML 1.2
---
$id: http://devicetree.org/schemas/clock/moxa,moxart-clock.yaml#
$schema: http://devicetree.org/meta-schemas/core.yaml#

title: MOXA ART Clock Controllers

maintainers:
  - Krzysztof Kozlowski <krzk@kernel.org>

description:
  MOXA ART SoCs allow to determine PLL output and APB frequencies by reading
  registers holding multiplier and divisor information.

properties:
  compatible:
    enum:
      - moxa,moxart-apb-clock
      - moxa,moxart-pll-clock

  "#clock-cells":
    const: 0

  reg:
    maxItems: 1

  clocks:
    maxItems: 1

  clock-output-names: true

additionalProperties: false

required:
  - compatible
  - "#clock-cells"
  - reg
```

## Documentation/devicetree/bindings/clock/mstar,msc313-cpupll.yaml
```yaml
# SPDX-License-Identifier: (GPL-2.0 OR BSD-2-Clause)
%YAML 1.2
---
$id: http://devicetree.org/schemas/clock/mstar,msc313-cpupll.yaml#
$schema: http://devicetree.org/meta-schemas/core.yaml#

title: MStar/Sigmastar MSC313 CPU PLL

maintainers:
  - Daniel Palmer <daniel@thingy.jp>

description: |
  The MStar/SigmaStar MSC313 and later ARMv7 chips have a scalable
  PLL that can be used as the clock source for the CPU(s).

properties:
  compatible:
    const: mstar,msc313-cpupll

  "#clock-cells":
    const: 1

  clocks:
    maxItems: 1

  reg:
    maxItems: 1

required:
  - compatible
  - "#clock-cells"
  - clocks
  - reg

additionalProperties: false

examples:
  - |
    #include <dt-bindings/clock/mstar-msc313-mpll.h>
    cpupll: cpupll@206400 {
        compatible = "mstar,msc313-cpupll";
        reg = <0x206400 0x200>;
        #clock-cells = <1>;
        clocks = <&mpll MSTAR_MSC313_MPLL_DIV2>;
    };
```

## Documentation/devicetree/bindings/clock/mstar,msc313-mpll.yaml
```yaml
# SPDX-License-Identifier: (GPL-2.0 OR BSD-2-Clause)
%YAML 1.2
---
$id: http://devicetree.org/schemas/clock/mstar,msc313-mpll.yaml#
$schema: http://devicetree.org/meta-schemas/core.yaml#

title: MStar/Sigmastar MSC313 MPLL

maintainers:
  - Daniel Palmer <daniel@thingy.jp>

description: |
  The MStar/SigmaStar MSC313 and later ARMv7 chips have an MPLL block that
  takes the external xtal input and multiplies it to create a high
  frequency clock and divides that down into a number of clocks that
  peripherals use.

properties:
  compatible:
    const: mstar,msc313-mpll

  "#clock-cells":
    const: 1

  clocks:
    maxItems: 1

  reg:
    maxItems: 1

required:
  - compatible
  - "#clock-cells"
  - clocks
  - reg

additionalProperties: false

examples:
  - |
    mpll@206000 {
        compatible = "mstar,msc313-mpll";
        reg = <0x206000 0x200>;
        #clock-cells = <1>;
        clocks = <&xtal>;
    };
```
