## Documentation/devicetree/bindings/clock/mediatek,mt8196-sys-clock.yaml
```yaml
# SPDX-License-Identifier: (GPL-2.0 OR BSD-2-Clause)
%YAML 1.2
---
$id: http://devicetree.org/schemas/clock/mediatek,mt8196-sys-clock.yaml#
$schema: http://devicetree.org/meta-schemas/core.yaml#

title: MediaTek System Clock Controller for MT8196

maintainers:
  - Guangjie Song <guangjie.song@mediatek.com>
  - Laura Nao <laura.nao@collabora.com>

description: |
  The clock architecture in MediaTek SoCs is structured like below:
  PLLs -->
          dividers -->
                      muxes
                           -->
                              clock gate

  The apmixedsys, apmixedsys_gp2, vlpckgen, armpll, ccipll, mfgpll and ptppll
  provide most of the PLLs which are generated from the SoC's 26MHZ crystal oscillator.
  The topckgen, topckgen_gp2 and vlpckgen provide dividers and muxes which
  provide the clock source to other IP blocks.

properties:
  compatible:
    items:
      - enum:
          - mediatek,mt8196-apmixedsys
          - mediatek,mt8196-armpll-b-pll-ctrl
          - mediatek,mt8196-armpll-bl-pll-ctrl
          - mediatek,mt8196-armpll-ll-pll-ctrl
          - mediatek,mt8196-apmixedsys-gp2
          - mediatek,mt8196-ccipll-pll-ctrl
          - mediatek,mt8196-mfgpll-pll-ctrl
          - mediatek,mt8196-mfgpll-sc0-pll-ctrl
          - mediatek,mt8196-mfgpll-sc1-pll-ctrl
          - mediatek,mt8196-ptppll-pll-ctrl
          - mediatek,mt8196-topckgen
          - mediatek,mt8196-topckgen-gp2
          - mediatek,mt8196-vlpckgen
      - const: syscon

  reg:
    maxItems: 1

  '#clock-cells':
    const: 1

  mediatek,hardware-voter:
    $ref: /schemas/types.yaml#/definitions/phandle
    description: |
      Phandle to the "Hardware Voter" (HWV), as named in the vendor
      documentation for MT8196/MT6991.

      The HWV is a SoC-internal fixed-function MCU used to collect votes from
      both the Application Processor and other remote processors within the SoC.
      It is intended to transparently enable or disable hardware resources (such
      as power domains or clocks) based on internal vote aggregation handled by
      the MCU's internal state machine.

      However, in practice, this design is incomplete. While the HWV performs
      some internal vote aggregation,software is still required to
      - Manually enable power supplies externally, if present and if required
      - Manually enable parent clocks via direct MMIO writes to clock controllers
      - Enable the FENC after the clock has been ungated via direct MMIO
      writes to clock controllers

      As such, the HWV behaves more like a hardware-managed clock reference
      counter than a true voter. Furthermore, it is not a separate
      controller. It merely serves as an alternative interface to the same
      underlying clock or power controller. Actual control still requires
      direct access to the controller's own MMIO register space, in
      addition to writing to the HWV's MMIO region.

      For this reason, a custom phandle is used here - drivers need to directly
      access the HWV MMIO region in a syscon-like fashion, due to how the
      hardware is wired. This differs from true hardware voting systems, which
      typically do not require custom phandles and rely instead on generic APIs
      (clocks, power domains, interconnects).

      The name "hardware-voter" is retained to match vendor documentation, but
      this should not be reused or misunderstood as a proper voting mechanism.

required:
  - compatible
  - reg
  - '#clock-cells'

additionalProperties: false

examples:
  - |
    apmixedsys_clk: syscon@10000800 {
        compatible = "mediatek,mt8196-apmixedsys", "syscon";
        reg = <0x10000800 0x1000>;
        #clock-cells = <1>;
    };
  - |
    topckgen: syscon@10000000 {
        compatible = "mediatek,mt8196-topckgen", "syscon";
        reg = <0x10000000 0x800>;
        mediatek,hardware-voter = <&scp_hwv>;
        #clock-cells = <1>;
    };
```

## Documentation/devicetree/bindings/clock/mediatek,mt8365-clock.yaml
```yaml
# SPDX-License-Identifier: (GPL-2.0 OR BSD-2-Clause)
%YAML 1.2
---
$id: http://devicetree.org/schemas/clock/mediatek,mt8365-clock.yaml#
$schema: http://devicetree.org/meta-schemas/core.yaml#

title: MediaTek Functional Clock Controller for MT8365

maintainers:
  - Markus Schneider-Pargmann <msp@baylibre.com>

properties:
  compatible:
    items:
      - enum:
          - mediatek,mt8365-apu
          - mediatek,mt8365-imgsys
          - mediatek,mt8365-mfgcfg
          - mediatek,mt8365-vdecsys
          - mediatek,mt8365-vencsys
      - const: syscon

  reg:
    maxItems: 1

  '#clock-cells':
    const: 1

required:
  - compatible
  - reg
  - '#clock-cells'

additionalProperties: false

examples:
  - |
    apu: clock-controller@19020000 {
        compatible = "mediatek,mt8365-apu", "syscon";
        reg = <0x19020000 0x1000>;
        #clock-cells = <1>;
    };
```

## Documentation/devicetree/bindings/clock/mediatek,mt8365-sys-clock.yaml
```yaml
# SPDX-License-Identifier: (GPL-2.0 OR BSD-2-Clause)
%YAML 1.2
---
$id: http://devicetree.org/schemas/clock/mediatek,mt8365-sys-clock.yaml#
$schema: http://devicetree.org/meta-schemas/core.yaml#

title: MediaTek System Clock Controller for MT8365

maintainers:
  - Markus Schneider-Pargmann <msp@baylibre.com>

description:
  The apmixedsys module provides most of PLLs which generated from SoC 26m.
  The topckgen provides dividers and muxes which provides the clock source to other IP blocks.
  The infracfg_ao and pericfg_ao provides clock gate in peripheral and infrastructure IP blocks.

properties:
  compatible:
    items:
      - enum:
          - mediatek,mt8365-topckgen
          - mediatek,mt8365-infracfg
          - mediatek,mt8365-apmixedsys
          - mediatek,mt8365-pericfg
          - mediatek,mt8365-mcucfg
      - const: syscon

  reg:
    maxItems: 1

  '#clock-cells':
    const: 1

required:
  - compatible
  - reg
  - '#clock-cells'

additionalProperties: false

examples:
  - |
    topckgen: clock-controller@10000000 {
        compatible = "mediatek,mt8365-topckgen", "syscon";
        reg = <0x10000000 0x1000>;
        #clock-cells = <1>;
    };
```

## Documentation/devicetree/bindings/clock/mediatek,mtmips-sysc.yaml
```yaml
# SPDX-License-Identifier: (GPL-2.0-only OR BSD-2-Clause)
%YAML 1.2
---
$id: http://devicetree.org/schemas/clock/mediatek,mtmips-sysc.yaml#
$schema: http://devicetree.org/meta-schemas/core.yaml#

title: MTMIPS SoCs System Controller

maintainers:
  - Sergio Paracuellos <sergio.paracuellos@gmail.com>

description: |
  MediaTek MIPS and Ralink SoCs provides a system controller to allow
  to access to system control registers. These registers include clock
  and reset related ones so this node is both clock and reset provider
  for the rest of the world.

  These SoCs have an XTAL from where the cpu clock is
  provided as well as derived clocks for the bus and the peripherals.

  Each clock is assigned an identifier and client nodes use this identifier
  to specify the clock which they consume.

  All these identifiers could be found in:
  [1]: <include/dt-bindings/clock/mediatek,mtmips-sysc.h>.

properties:
  compatible:
    oneOf:
      - items:
          - enum:
              - ralink,mt7620-sysc
              - ralink,mt7688-sysc
              - ralink,rt2880-sysc
              - ralink,rt3050-sysc
              - ralink,rt3052-sysc
              - ralink,rt3352-sysc
              - ralink,rt3883-sysc
              - ralink,rt5350-sysc
          - const: syscon
      - items:
          - const: ralink,mt7628-sysc
          - const: ralink,mt7688-sysc
          - const: syscon

  reg:
    maxItems: 1

  '#clock-cells':
    description:
      The first cell indicates the clock number, see [1] for available
      clocks.
    const: 1

  '#reset-cells':
    description:
      The first cell indicates the reset bit within the register.
    const: 1

required:
  - compatible
  - reg
  - '#clock-cells'
  - '#reset-cells'

additionalProperties: false

examples:
  - |
    #include <dt-bindings/clock/mediatek,mtmips-sysc.h>

    syscon@0 {
      compatible = "ralink,rt5350-sysc", "syscon";
      reg = <0x0 0x100>;
      #clock-cells = <1>;
      #reset-cells = <1>;
    };
```

## Documentation/devicetree/bindings/clock/mediatek,syscon.yaml
```yaml
# SPDX-License-Identifier: (GPL-2.0 OR BSD-2-Clause)
%YAML 1.2
---
$id: http://devicetree.org/schemas/clock/mediatek,syscon.yaml#
$schema: http://devicetree.org/meta-schemas/core.yaml#

title: MediaTek Clock controller syscon's

maintainers:
  - Matthias Brugger <matthias.bgg@gmail.com>
  - AngeloGioacchino Del Regno <angelogioacchino.delregno@collabora.com>

description:
  The MediaTek clock controller syscon's provide various clocks to the system.

properties:
  compatible:
    oneOf:
      - items:
          - enum:
              - mediatek,mt2701-bdpsys
              - mediatek,mt2701-imgsys
              - mediatek,mt2701-vdecsys
              - mediatek,mt2712-bdpsys
              - mediatek,mt2712-imgsys
              - mediatek,mt2712-jpgdecsys
              - mediatek,mt2712-mcucfg
              - mediatek,mt2712-mfgcfg
              - mediatek,mt2712-vdecsys
              - mediatek,mt2712-vencsys
              - mediatek,mt6765-camsys
              - mediatek,mt6765-imgsys
              - mediatek,mt6765-mipi0a
              - mediatek,mt6765-vcodecsys
              - mediatek,mt6779-camsys
              - mediatek,mt6779-imgsys
              - mediatek,mt6779-ipesys
              - mediatek,mt6779-mfgcfg
              - mediatek,mt6779-vdecsys
              - mediatek,mt6779-vencsys
              - mediatek,mt6797-imgsys
              - mediatek,mt6797-vdecsys
              - mediatek,mt6797-vencsys
              - mediatek,mt8167-imgsys
              - mediatek,mt8167-mfgcfg
              - mediatek,mt8167-vdecsys
              - mediatek,mt8173-imgsys
              - mediatek,mt8173-vdecsys
              - mediatek,mt8173-vencltsys
              - mediatek,mt8173-vencsys
              - mediatek,mt8183-camsys
              - mediatek,mt8183-imgsys
              - mediatek,mt8183-ipu_conn
              - mediatek,mt8183-ipu_adl
              - mediatek,mt8183-ipu_core0
              - mediatek,mt8183-ipu_core1
              - mediatek,mt8183-mcucfg
              - mediatek,mt8183-mfgcfg
              - mediatek,mt8183-vdecsys
              - mediatek,mt8183-vencsys
          - const: syscon
      - items:
          - const: mediatek,mt7623-bdpsys
          - const: mediatek,mt2701-bdpsys
          - const: syscon
      - items:
          - const: mediatek,mt7623-imgsys
          - const: mediatek,mt2701-imgsys
          - const: syscon
      - items:
          - const: mediatek,mt7623-vdecsys
          - const: mediatek,mt2701-vdecsys
          - const: syscon

  reg:
    maxItems: 1

  '#clock-cells':
    const: 1

required:
  - compatible
  - '#clock-cells'

additionalProperties: false

examples:
  - |
    clock-controller@11220000 {
        compatible = "mediatek,mt2701-bdpsys", "syscon";
        reg = <0x11220000 0x2000>;
        #clock-cells = <1>;
    };
```

## Documentation/devicetree/bindings/clock/mediatek,topckgen.yaml
```yaml
# SPDX-License-Identifier: (GPL-2.0 OR BSD-2-Clause)
%YAML 1.2
---
$id: "http://devicetree.org/schemas/clock/mediatek,topckgen.yaml#"
$schema: "http://devicetree.org/meta-schemas/core.yaml#"

title: MediaTek Top Clock Generator Controller

maintainers:
  - Michael Turquette <mturquette@baylibre.com>
  - Stephen Boyd <sboyd@kernel.org>

description:
  The Mediatek topckgen controller provides various clocks to the system.
  The clock values can be found in <dt-bindings/clock/mt*-clk.h>.

properties:
  compatible:
    oneOf:
      - enum:
          - mediatek,mt6797-topckgen
          - mediatek,mt7622-topckgen
          - mediatek,mt8135-topckgen
          - mediatek,mt8173-topckgen
          - mediatek,mt8516-topckgen
      - items:
          - const: mediatek,mt7623-topckgen
          - const: mediatek,mt2701-topckgen
          - const: syscon
      - items:
          - enum:
              - mediatek,mt2701-topckgen
              - mediatek,mt2712-topckgen
              - mediatek,mt6765-topckgen
              - mediatek,mt6779-topckgen
              - mediatek,mt6795-topckgen
              - mediatek,mt7629-topckgen
              - mediatek,mt7981-topckgen
              - mediatek,mt7986-topckgen
              - mediatek,mt8167-topckgen
              - mediatek,mt8183-topckgen
          - const: syscon

  reg:
    maxItems: 1

  '#clock-cells':
    const: 1

required:
  - compatible
  - reg
  - '#clock-cells'

additionalProperties: false

examples:
  - |
    topckgen: clock-controller@10000000 {
        compatible = "mediatek,mt8173-topckgen";
        reg = <0x10000000 0x1000>;
        #clock-cells = <1>;
    };
```

## Documentation/devicetree/bindings/clock/microchip,lan966x-gck.yaml
```yaml
# SPDX-License-Identifier: (GPL-2.0-only OR BSD-2-Clause)
%YAML 1.2
---
$id: http://devicetree.org/schemas/clock/microchip,lan966x-gck.yaml#
$schema: http://devicetree.org/meta-schemas/core.yaml#

title: Microchip LAN966X Generic Clock Controller

maintainers:
  - Kavyasree Kotagiri <kavyasree.kotagiri@microchip.com>

description: |
  The LAN966X Generic clock controller contains 3 PLLs - cpu_clk,
  ddr_clk and sys_clk. This clock controller generates and supplies
  clock to various peripherals within the SoC.

properties:
  compatible:
    oneOf:
      - enum:
          - microchip,lan966x-gck
          - microchip,lan9691-gck
      - items:
          - enum:
              - microchip,lan9698-gck
              - microchip,lan9696-gck
              - microchip,lan9694-gck
              - microchip,lan9693-gck
              - microchip,lan9692-gck
          - const: microchip,lan9691-gck

  reg:
    minItems: 1
    items:
      - description: Generic clock registers
      - description: Optional gate clock registers

  clocks:
    items:
      - description: CPU clock source
      - description: DDR clock source
      - description: System clock source

  clock-names:
    items:
      - const: cpu
      - const: ddr
      - const: sys

  '#clock-cells':
    const: 1

required:
  - compatible
  - reg
  - clocks
  - clock-names
  - '#clock-cells'

additionalProperties: false

examples:
  - |
    clks: clock-controller@e00c00a8 {
        compatible = "microchip,lan966x-gck";
        #clock-cells = <1>;
        clocks = <&cpu_clk>, <&ddr_clk>, <&sys_clk>;
        clock-names = "cpu", "ddr", "sys";
        reg = <0xe00c00a8 0x38>;
    };
...
```
