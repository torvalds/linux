## Documentation/devicetree/bindings/clock/actions,owl-cmu.txt
```
* Actions Semi Owl Clock Management Unit (CMU)

The Actions Semi Owl Clock Management Unit generates and supplies clock
to various controllers within the SoC. The clock binding described here is
applicable to S900, S700 and S500 SoC's.

Required Properties:

- compatible: should be one of the following,
	"actions,s900-cmu"
	"actions,s700-cmu"
	"actions,s500-cmu"
- reg: physical base address of the controller and length of memory mapped
  region.
- clocks: Reference to the parent clocks ("hosc", "losc")
- #clock-cells: should be 1.
- #reset-cells: should be 1.

Each clock is assigned an identifier, and client nodes can use this identifier
to specify the clock which they consume.

All available clocks are defined as preprocessor macros in corresponding
dt-bindings/clock/actions,s900-cmu.h or actions,s700-cmu.h or
actions,s500-cmu.h header and can be used in device tree sources.

External clocks:

The hosc clock used as input for the plls is generated outside the SoC. It is
expected that it is defined using standard clock bindings as "hosc".

Actions Semi S900 CMU also requires one more clock:
 - "losc" - internal low frequency oscillator

Example: Clock Management Unit node:

        cmu: clock-controller@e0160000 {
                compatible = "actions,s900-cmu";
                reg = <0x0 0xe0160000 0x0 0x1000>;
                clocks = <&hosc>, <&losc>;
                #clock-cells = <1>;
                #reset-cells = <1>;
        };

Example: UART controller node that consumes clock generated by the clock
management unit:

        uart: serial@e012a000 {
                compatible = "actions,s900-uart", "actions,owl-uart";
                reg = <0x0 0xe012a000 0x0 0x2000>;
                interrupts = <GIC_SPI 34 IRQ_TYPE_LEVEL_HIGH>;
                clocks = <&cmu CLK_UART5>;
        };
```

## Documentation/devicetree/bindings/clock/actions,owl-cmu.yaml
```yaml
# SPDX-License-Identifier: (GPL-2.0-only OR BSD-2-Clause)
%YAML 1.2
---
$id: http://devicetree.org/schemas/clock/actions,owl-cmu.yaml#
$schema: http://devicetree.org/meta-schemas/core.yaml#

title: Actions Semi Owl Clock Management Unit (CMU)

maintainers:
  - Manivannan Sadhasivam <manivannan.sadhasivam@linaro.org>

description: |
  The Actions Semi Owl Clock Management Unit generates and supplies clock
  to various controllers within the SoC.

  See also:
    include/dt-bindings/clock/actions,s500-cmu.h
    include/dt-bindings/clock/actions,s700-cmu.h
    include/dt-bindings/clock/actions,s900-cmu.h

properties:
  compatible:
    enum:
      - actions,s500-cmu
      - actions,s700-cmu
      - actions,s900-cmu

  reg:
    maxItems: 1

  clocks:
    items:
      - description: Host oscillator source
      - description: Internal low frequency oscillator source

  "#clock-cells":
    const: 1

  "#reset-cells":
    const: 1

required:
  - compatible
  - reg
  - clocks
  - "#clock-cells"
  - "#reset-cells"

additionalProperties: false

examples:
  - |
    clock-controller@e0160000 {
        compatible = "actions,s900-cmu";
        reg = <0xe0160000 0x1000>;
        clocks = <&hosc>, <&losc>;
        #clock-cells = <1>;
        #reset-cells = <1>;
    };
...
```

## Documentation/devicetree/bindings/clock/actions,s900-cmu.txt
```
* Actions S900 Clock Management Unit (CMU)

The Actions S900 clock management unit generates and supplies clock to various
controllers within the SoC. The clock binding described here is applicable to
S900 SoC.

Required Properties:

- compatible: should be "actions,s900-cmu"
- reg: physical base address of the controller and length of memory mapped
  region.
- clocks: Reference to the parent clocks ("hosc", "losc")
- #clock-cells: should be 1.

Each clock is assigned an identifier, and client nodes can use this identifier
to specify the clock which they consume.

All available clocks are defined as preprocessor macros in
dt-bindings/clock/actions,s900-cmu.h header and can be used in device
tree sources.

External clocks:

The hosc clock used as input for the plls is generated outside the SoC. It is
expected that it is defined using standard clock bindings as "hosc".

Actions S900 CMU also requires one more clock:
 - "losc" - internal low frequency oscillator

Example: Clock Management Unit node:

        cmu: clock-controller@e0160000 {
                compatible = "actions,s900-cmu";
                reg = <0x0 0xe0160000 0x0 0x1000>;
                clocks = <&hosc>, <&losc>;
                #clock-cells = <1>;
        };

Example: UART controller node that consumes clock generated by the clock
management unit:

        uart: serial@e012a000 {
                compatible = "actions,s900-uart", "actions,owl-uart";
                reg = <0x0 0xe012a000 0x0 0x2000>;
                interrupts = <GIC_SPI 34 IRQ_TYPE_LEVEL_HIGH>;
                clocks = <&cmu CLK_UART5>;
        };
```

## Documentation/devicetree/bindings/clock/adi,axi-clkgen.yaml
```yaml
# SPDX-License-Identifier: (GPL-2.0-only OR BSD-2-Clause)
%YAML 1.2
---
$id: http://devicetree.org/schemas/clock/adi,axi-clkgen.yaml#
$schema: http://devicetree.org/meta-schemas/core.yaml#

title: Analog Devices AXI clkgen pcore clock generator

maintainers:
  - Lars-Peter Clausen <lars@metafoo.de>
  - Michael Hennerich <michael.hennerich@analog.com>

description: |
  The axi_clkgen IP core is a software programmable clock generator,
  that can be synthesized on various FPGA platforms.

  Link: https://wiki.analog.com/resources/fpga/docs/axi_clkgen

properties:
  compatible:
    enum:
      - adi,axi-clkgen-2.00.a
      - adi,zynqmp-axi-clkgen-2.00.a

  clocks:
    description:
      Specifies the reference clock(s) from which the output frequency is
      derived. This must either reference one clock if only the first clock
      input is connected or two if both clock inputs are connected. The last
      clock is the AXI bus clock that needs to be enabled so we can access the
      core registers.
    minItems: 2
    maxItems: 3

  clock-names:
    oneOf:
      - items:
          - const: clkin1
          - const: s_axi_aclk
      - items:
          - const: clkin1
          - const: clkin2
          - const: s_axi_aclk

  clock-output-names:
    maxItems: 1

  '#clock-cells':
    const: 0

  reg:
    maxItems: 1

required:
  - compatible
  - reg
  - clocks
  - clock-names
  - '#clock-cells'

additionalProperties: false

examples:
  - |
    clock-controller@ff000000 {
      compatible = "adi,axi-clkgen-2.00.a";
      #clock-cells = <0>;
      reg = <0xff000000 0x1000>;
      clocks = <&osc 1>, <&clkc 15>;
      clock-names = "clkin1", "s_axi_aclk";
      clock-output-names = "spi_sclk";
    };
```

## Documentation/devicetree/bindings/clock/airoha,en7523-scu.yaml
```yaml
# SPDX-License-Identifier: (GPL-2.0-only OR BSD-2-Clause)
%YAML 1.2
---
$id: http://devicetree.org/schemas/clock/airoha,en7523-scu.yaml#
$schema: http://devicetree.org/meta-schemas/core.yaml#

title: EN7523 Clock

maintainers:
  - Felix Fietkau <nbd@nbd.name>
  - John Crispin <nbd@nbd.name>

description: |
  This node defines the System Control Unit of the EN7523 SoC,
  a collection of registers configuring many different aspects of the SoC.

  The clock driver uses it to read and configure settings of the
  PLL controller, which provides clocks for the CPU, the bus and
  other SoC internal peripherals.

  Each clock is assigned an identifier and client nodes use this identifier
  to specify which clock they consume.

  All these identifiers can be found in:
  [1]: <include/dt-bindings/clock/en7523-clk.h>.

  The clocks are provided inside a system controller node.

properties:
  compatible:
    items:
      - enum:
          - airoha,en7523-scu
          - airoha,en7581-scu

  reg:
    minItems: 2
    maxItems: 4

  "#clock-cells":
    description:
      The first cell indicates the clock number, see [1] for available
      clocks.
    const: 1

  '#reset-cells':
    description: ID of the controller reset line
    const: 1

required:
  - compatible
  - reg
  - '#clock-cells'

allOf:
  - if:
      properties:
        compatible:
          const: airoha,en7523-scu
    then:
      properties:
        reg:
          items:
            - description: scu base address
            - description: misc scu base address

        '#reset-cells': false

  - if:
      properties:
        compatible:
          const: airoha,en7581-scu
    then:
      properties:
        reg:
          items:
            - description: scu base address
            - description: misc scu base address
            - description: reset base address
            - description: pb scu base address

additionalProperties: false

examples:
  - |
    #include <dt-bindings/clock/en7523-clk.h>
    scu: system-controller@1fa20000 {
      compatible = "airoha,en7523-scu";
      reg = <0x1fa20000 0x400>,
            <0x1fb00000 0x1000>;
      #clock-cells = <1>;
    };

  - |
    soc {
      #address-cells = <2>;
      #size-cells = <2>;

      scuclk: clock-controller@1fa20000 {
        compatible = "airoha,en7581-scu";
        reg = <0x0 0x1fa20000 0x0 0x400>,
              <0x0 0x1fb00000 0x0 0x90>,
              <0x0 0x1fb00830 0x0 0x8>,
              <0x0 0x1fbe3400 0x0 0xfc>;
              #clock-cells = <1>;
              #reset-cells = <1>;
      };
    };
```

## Documentation/devicetree/bindings/clock/allwinner,sun4i-a10-ahb-clk.yaml
```yaml
# SPDX-License-Identifier: GPL-2.0
%YAML 1.2
---
$id: http://devicetree.org/schemas/clock/allwinner,sun4i-a10-ahb-clk.yaml#
$schema: http://devicetree.org/meta-schemas/core.yaml#

title: Allwinner A10 AHB Clock Device Tree Bindings

maintainers:
  - Chen-Yu Tsai <wens@csie.org>
  - Maxime Ripard <mripard@kernel.org>

deprecated: true

properties:
  "#clock-cells":
    const: 0

  compatible:
    enum:
      - allwinner,sun4i-a10-ahb-clk
      - allwinner,sun6i-a31-ahb1-clk
      - allwinner,sun8i-h3-ahb2-clk

  reg:
    maxItems: 1

  clocks:
    minItems: 1
    maxItems: 4
    description: >
      The parent order must match the hardware programming order.

  clock-output-names:
    maxItems: 1

required:
  - "#clock-cells"
  - compatible
  - reg
  - clocks
  - clock-output-names

additionalProperties: false

allOf:
  - if:
      properties:
        compatible:
          contains:
            const: allwinner,sun4i-a10-ahb-clk

    then:
      properties:
        clocks:
          maxItems: 1

  - if:
      properties:
        compatible:
          contains:
            const: allwinner,sun6i-a31-ahb1-clk

    then:
      properties:
        clocks:
          maxItems: 4

  - if:
      properties:
        compatible:
          contains:
            const: allwinner,sun8i-h3-ahb2-clk

    then:
      properties:
        clocks:
          maxItems: 2

examples:
  - |
    ahb@1c20054 {
        #clock-cells = <0>;
        compatible = "allwinner,sun4i-a10-ahb-clk";
        reg = <0x01c20054 0x4>;
        clocks = <&axi>;
        clock-output-names = "ahb";
    };

  - |
    ahb1@1c20054 {
        #clock-cells = <0>;
        compatible = "allwinner,sun6i-a31-ahb1-clk";
        reg = <0x01c20054 0x4>;
        clocks = <&osc32k>, <&osc24M>, <&axi>, <&pll6 0>;
        clock-output-names = "ahb1";
    };

  - |
    ahb2_clk@1c2005c {
        #clock-cells = <0>;
        compatible = "allwinner,sun8i-h3-ahb2-clk";
        reg = <0x01c2005c 0x4>;
        clocks = <&ahb1>, <&pll6d2>;
        clock-output-names = "ahb2";
    };

...
```

## Documentation/devicetree/bindings/clock/allwinner,sun4i-a10-apb1-clk.yaml
```yaml
# SPDX-License-Identifier: GPL-2.0
%YAML 1.2
---
$id: http://devicetree.org/schemas/clock/allwinner,sun4i-a10-apb1-clk.yaml#
$schema: http://devicetree.org/meta-schemas/core.yaml#

title: Allwinner A10 APB1 Bus Clock Device Tree Bindings

maintainers:
  - Chen-Yu Tsai <wens@csie.org>
  - Maxime Ripard <mripard@kernel.org>

deprecated: true

properties:
  "#clock-cells":
    const: 0

  compatible:
    const: allwinner,sun4i-a10-apb1-clk

  reg:
    maxItems: 1

  clocks:
    maxItems: 3
    description: >
      The parent order must match the hardware programming order.

  clock-output-names:
    maxItems: 1

required:
  - "#clock-cells"
  - compatible
  - reg
  - clocks
  - clock-output-names

additionalProperties: false

examples:
  - |
    clk@1c20058 {
        #clock-cells = <0>;
        compatible = "allwinner,sun4i-a10-apb1-clk";
        reg = <0x01c20058 0x4>;
        clocks = <&osc24M>, <&pll6 1>, <&osc32k>;
        clock-output-names = "apb1";
    };

...
```

## Documentation/devicetree/bindings/clock/allwinner,sun4i-a10-axi-clk.yaml
```yaml
# SPDX-License-Identifier: GPL-2.0
%YAML 1.2
---
$id: http://devicetree.org/schemas/clock/allwinner,sun4i-a10-axi-clk.yaml#
$schema: http://devicetree.org/meta-schemas/core.yaml#

title: Allwinner A10 AXI Clock Device Tree Bindings

maintainers:
  - Chen-Yu Tsai <wens@csie.org>
  - Maxime Ripard <mripard@kernel.org>

deprecated: true

properties:
  "#clock-cells":
    const: 0

  compatible:
    enum:
      - allwinner,sun4i-a10-axi-clk
      - allwinner,sun8i-a23-axi-clk

  reg:
    maxItems: 1

  clocks:
    maxItems: 1

  clock-output-names:
    maxItems: 1

required:
  - "#clock-cells"
  - compatible
  - reg
  - clocks
  - clock-output-names

additionalProperties: false

examples:
  - |
    axi@1c20054 {
        #clock-cells = <0>;
        compatible = "allwinner,sun4i-a10-axi-clk";
        reg = <0x01c20054 0x4>;
        clocks = <&cpu>;
        clock-output-names = "axi";
    };

  - |
    axi_clk@1c20050 {
        #clock-cells = <0>;
        compatible = "allwinner,sun8i-a23-axi-clk";
        reg = <0x01c20050 0x4>;
        clocks = <&cpu>;
        clock-output-names = "axi";
    };

...
```
