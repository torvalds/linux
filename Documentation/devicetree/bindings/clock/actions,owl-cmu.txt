## Documentation/devicetree/bindings/clock/allwinner,sun4i-a10-ccu.yaml
```yaml
# SPDX-License-Identifier: GPL-2.0
%YAML 1.2
---
$id: http://devicetree.org/schemas/clock/allwinner,sun4i-a10-ccu.yaml#
$schema: http://devicetree.org/meta-schemas/core.yaml#

title: Allwinner Clock Control Unit Device Tree Bindings

maintainers:
  - Chen-Yu Tsai <wens@csie.org>
  - Maxime Ripard <mripard@kernel.org>

properties:
  "#clock-cells":
    const: 1

  "#reset-cells":
    const: 1

  compatible:
    enum:
      - allwinner,sun4i-a10-ccu
      - allwinner,sun5i-a10s-ccu
      - allwinner,sun5i-a13-ccu
      - allwinner,sun6i-a31-ccu
      - allwinner,sun7i-a20-ccu
      - allwinner,sun8i-a23-ccu
      - allwinner,sun8i-a33-ccu
      - allwinner,sun8i-a83t-ccu
      - allwinner,sun8i-a83t-r-ccu
      - allwinner,sun8i-h3-ccu
      - allwinner,sun8i-h3-r-ccu
      - allwinner,sun8i-r40-ccu
      - allwinner,sun8i-v3-ccu
      - allwinner,sun8i-v3s-ccu
      - allwinner,sun9i-a80-ccu
      - allwinner,sun50i-a64-ccu
      - allwinner,sun50i-a64-r-ccu
      - allwinner,sun50i-a100-ccu
      - allwinner,sun50i-a100-r-ccu
      - allwinner,sun50i-h5-ccu
      - allwinner,sun50i-h6-ccu
      - allwinner,sun50i-h6-r-ccu
      - allwinner,suniv-f1c100s-ccu
      - nextthing,gr8-ccu

  reg:
    maxItems: 1

  clocks:
    minItems: 2
    maxItems: 4
    items:
      - description: High Frequency Oscillator (usually at 24MHz)
      - description: Low Frequency Oscillator (usually at 32kHz)
      - description: Internal Oscillator
      - description: Peripherals PLL

  clock-names:
    minItems: 2
    maxItems: 4
    items:
      - const: hosc
      - const: losc
      - const: iosc
      - const: pll-periph

required:
  - "#clock-cells"
  - "#reset-cells"
  - compatible
  - reg
  - clocks
  - clock-names

if:
  properties:
    compatible:
      enum:
        - allwinner,sun8i-a83t-r-ccu
        - allwinner,sun8i-h3-r-ccu
        - allwinner,sun50i-a64-r-ccu
        - allwinner,sun50i-a100-r-ccu
        - allwinner,sun50i-h6-r-ccu

then:
  properties:
    clocks:
      minItems: 4
      maxItems: 4

    clock-names:
      minItems: 4
      maxItems: 4

else:
  if:
    properties:
      compatible:
        enum:
          - allwinner,sun50i-a100-ccu
          - allwinner,sun50i-h6-ccu

  then:
    properties:
      clocks:
        minItems: 3
        maxItems: 3

      clock-names:
        minItems: 3
        maxItems: 3

  else:
    properties:
      clocks:
        minItems: 2
        maxItems: 2

      clock-names:
        minItems: 2
        maxItems: 2

additionalProperties: false

examples:
  - |
    ccu: clock@1c20000 {
        compatible = "allwinner,sun8i-h3-ccu";
        reg = <0x01c20000 0x400>;
        clocks = <&osc24M>, <&osc32k>;
        clock-names = "hosc", "losc";
        #clock-cells = <1>;
        #reset-cells = <1>;
    };

  - |
    r_ccu: clock@1f01400 {
        compatible = "allwinner,sun50i-a64-r-ccu";
        reg = <0x01f01400 0x100>;
        clocks = <&osc24M>, <&osc32k>, <&iosc>, <&ccu 11>;
        clock-names = "hosc", "losc", "iosc", "pll-periph";
        #clock-cells = <1>;
        #reset-cells = <1>;
    };

...
```

## Documentation/devicetree/bindings/clock/allwinner,sun4i-a10-cpu-clk.yaml
```yaml
# SPDX-License-Identifier: GPL-2.0
%YAML 1.2
---
$id: http://devicetree.org/schemas/clock/allwinner,sun4i-a10-cpu-clk.yaml#
$schema: http://devicetree.org/meta-schemas/core.yaml#

title: Allwinner A10 CPU Clock

maintainers:
  - Chen-Yu Tsai <wens@csie.org>
  - Maxime Ripard <mripard@kernel.org>

deprecated: true

properties:
  "#clock-cells":
    const: 0

  compatible:
    const: allwinner,sun4i-a10-cpu-clk

  reg:
    maxItems: 1

  clocks:
    maxItems: 4
    description: >
      The parent order must match the hardware programming order.

  clock-output-names:
    maxItems: 1

required:
  - "#clock-cells"
  - compatible
  - reg
  - clocks
  - clock-output-names

additionalProperties: false

examples:
  - |
    cpu@1c20054 {
        #clock-cells = <0>;
        compatible = "allwinner,sun4i-a10-cpu-clk";
        reg = <0x01c20054 0x4>;
        clocks = <&osc32k>, <&osc24M>, <&pll1>, <&dummy>;
        clock-output-names = "cpu";
    };

...
```

## Documentation/devicetree/bindings/clock/allwinner,sun4i-a10-display-clk.yaml
```yaml
# SPDX-License-Identifier: GPL-2.0
%YAML 1.2
---
$id: http://devicetree.org/schemas/clock/allwinner,sun4i-a10-display-clk.yaml#
$schema: http://devicetree.org/meta-schemas/core.yaml#

title: Allwinner A10 Display Clock Device Tree Bindings

maintainers:
  - Chen-Yu Tsai <wens@csie.org>
  - Maxime Ripard <mripard@kernel.org>

deprecated: true

properties:
  "#clock-cells":
    const: 0

  "#reset-cells":
    const: 0

  compatible:
    const: allwinner,sun4i-a10-display-clk

  reg:
    maxItems: 1

  clocks:
    maxItems: 3
    description: >
      The parent order must match the hardware programming order.

  clock-output-names:
    maxItems: 1

required:
  - "#clock-cells"
  - "#reset-cells"
  - compatible
  - reg
  - clocks
  - clock-output-names

additionalProperties: false

examples:
  - |
    clk@1c20104 {
        #clock-cells = <0>;
        #reset-cells = <0>;
        compatible = "allwinner,sun4i-a10-display-clk";
        reg = <0x01c20104 0x4>;
        clocks = <&pll3>, <&pll7>, <&pll5 1>;
        clock-output-names = "de-be";
    };

...
```

## Documentation/devicetree/bindings/clock/allwinner,sun4i-a10-gates-clk.yaml
```yaml
# SPDX-License-Identifier: GPL-2.0
%YAML 1.2
---
$id: http://devicetree.org/schemas/clock/allwinner,sun4i-a10-gates-clk.yaml#
$schema: http://devicetree.org/meta-schemas/core.yaml#

title: Allwinner A10 Bus Gates Clock Device Tree Bindings

maintainers:
  - Chen-Yu Tsai <wens@csie.org>
  - Maxime Ripard <mripard@kernel.org>

deprecated: true

properties:
  "#clock-cells":
    const: 1
    description: >
      This additional argument passed to that clock is the offset of
      the bit controlling this particular gate in the register.

  compatible:
    oneOf:
      - const: allwinner,sun4i-a10-gates-clk
      - const: allwinner,sun4i-a10-axi-gates-clk
      - const: allwinner,sun4i-a10-ahb-gates-clk
      - const: allwinner,sun5i-a10s-ahb-gates-clk
      - const: allwinner,sun5i-a13-ahb-gates-clk
      - const: allwinner,sun7i-a20-ahb-gates-clk
      - const: allwinner,sun6i-a31-ahb1-gates-clk
      - const: allwinner,sun8i-a23-ahb1-gates-clk
      - const: allwinner,sun9i-a80-ahb0-gates-clk
      - const: allwinner,sun9i-a80-ahb1-gates-clk
      - const: allwinner,sun9i-a80-ahb2-gates-clk
      - const: allwinner,sun4i-a10-apb0-gates-clk
      - const: allwinner,sun5i-a10s-apb0-gates-clk
      - const: allwinner,sun5i-a13-apb0-gates-clk
      - const: allwinner,sun7i-a20-apb0-gates-clk
      - const: allwinner,sun9i-a80-apb0-gates-clk
      - const: allwinner,sun8i-a83t-apb0-gates-clk
      - const: allwinner,sun4i-a10-apb1-gates-clk
      - const: allwinner,sun5i-a13-apb1-gates-clk
      - const: allwinner,sun5i-a10s-apb1-gates-clk
      - const: allwinner,sun6i-a31-apb1-gates-clk
      - const: allwinner,sun7i-a20-apb1-gates-clk
      - const: allwinner,sun8i-a23-apb1-gates-clk
      - const: allwinner,sun9i-a80-apb1-gates-clk
      - const: allwinner,sun6i-a31-apb2-gates-clk
      - const: allwinner,sun8i-a23-apb2-gates-clk
      - const: allwinner,sun8i-a83t-bus-gates-clk
      - const: allwinner,sun9i-a80-apbs-gates-clk
      - const: allwinner,sun4i-a10-dram-gates-clk

      - items:
        - const: allwinner,sun5i-a13-dram-gates-clk
        - const: allwinner,sun4i-a10-gates-clk

      - items:
        - const: allwinner,sun8i-h3-apb0-gates-clk
        - const: allwinner,sun4i-a10-gates-clk

  reg:
    maxItems: 1

  clocks:
    maxItems: 1

  clock-indices:
    minItems: 1
    maxItems: 64

  clock-output-names:
    minItems: 1
    maxItems: 64

required:
  - "#clock-cells"
  - compatible
  - reg
  - clocks
  - clock-indices
  - clock-output-names

additionalProperties: false

examples:
  - |
    clk@1c2005c {
        #clock-cells = <1>;
        compatible = "allwinner,sun4i-a10-axi-gates-clk";
        reg = <0x01c2005c 0x4>;
        clocks = <&axi>;
        clock-indices = <0>;
        clock-output-names = "axi_dram";
    };

  - |
    clk@1c20060 {
        #clock-cells = <1>;
        compatible = "allwinner,sun4i-a10-ahb-gates-clk";
        reg = <0x01c20060 0x8>;
        clocks = <&ahb>;
        clock-indices = <0>, <1>,
                        <2>, <3>,
                        <4>, <5>, <6>,
                        <7>, <8>, <9>,
                        <10>, <11>, <12>,
                        <13>, <14>, <16>,
                        <17>, <18>, <20>,
                        <21>, <22>, <23>,
                        <24>, <25>, <26>,
                        <32>, <33>, <34>,
                        <35>, <36>, <37>,
                        <40>, <41>, <43>,
                        <44>, <45>,
                        <46>, <47>,
                        <50>, <52>;
        clock-output-names = "ahb_usb0", "ahb_ehci0",
                             "ahb_ohci0", "ahb_ehci1",
                             "ahb_ohci1", "ahb_ss", "ahb_dma",
                             "ahb_bist", "ahb_mmc0", "ahb_mmc1",
                             "ahb_mmc2", "ahb_mmc3", "ahb_ms",
                             "ahb_nand", "ahb_sdram", "ahb_ace",
                             "ahb_emac", "ahb_ts", "ahb_spi0",
                             "ahb_spi1", "ahb_spi2", "ahb_spi3",
                             "ahb_pata", "ahb_sata", "ahb_gps",
                             "ahb_ve", "ahb_tvd", "ahb_tve0",
                             "ahb_tve1", "ahb_lcd0", "ahb_lcd1",
                             "ahb_csi0", "ahb_csi1", "ahb_hdmi",
                             "ahb_de_be0", "ahb_de_be1",
                             "ahb_de_fe0", "ahb_de_fe1",
                             "ahb_mp", "ahb_mali400";
    };


  - |
    clk@1c20068 {
        #clock-cells = <1>;
        compatible = "allwinner,sun4i-a10-apb0-gates-clk";
        reg = <0x01c20068 0x4>;
        clocks = <&apb0>;
        clock-indices = <0>, <1>,
                        <2>, <3>,
                        <5>, <6>,
                        <7>, <10>;
        clock-output-names = "apb0_codec", "apb0_spdif",
                             "apb0_ac97", "apb0_iis",
                             "apb0_pio", "apb0_ir0",
                             "apb0_ir1", "apb0_keypad";
    };

...
```

## Documentation/devicetree/bindings/clock/allwinner,sun4i-a10-mbus-clk.yaml
```yaml
# SPDX-License-Identifier: GPL-2.0
%YAML 1.2
---
$id: http://devicetree.org/schemas/clock/allwinner,sun4i-a10-mbus-clk.yaml#
$schema: http://devicetree.org/meta-schemas/core.yaml#

title: Allwinner A10 MBUS Clock Device Tree Bindings

maintainers:
  - Chen-Yu Tsai <wens@csie.org>
  - Maxime Ripard <mripard@kernel.org>

deprecated: true

properties:
  "#clock-cells":
    const: 0

  compatible:
    enum:
      - allwinner,sun5i-a13-mbus-clk
      - allwinner,sun8i-a23-mbus-clk

  reg:
    maxItems: 1

  clocks:
    maxItems: 3
    description: >
      The parent order must match the hardware programming order.

  clock-output-names:
    maxItems: 1

required:
  - "#clock-cells"
  - compatible
  - reg
  - clocks
  - clock-output-names

additionalProperties: false

examples:
  - |
    clk@1c2015c {
        #clock-cells = <0>;
        compatible = "allwinner,sun5i-a13-mbus-clk";
        reg = <0x01c2015c 0x4>;
        clocks = <&osc24M>, <&pll6 1>, <&pll5 1>;
        clock-output-names = "mbus";
    };

  - |
    clk@1c2015c {
        #clock-cells = <0>;
        compatible = "allwinner,sun8i-a23-mbus-clk";
        reg = <0x01c2015c 0x4>;
        clocks = <&osc24M>, <&pll6 1>, <&pll5>;
        clock-output-names = "mbus";
    };

...
```

## Documentation/devicetree/bindings/clock/allwinner,sun4i-a10-mmc-clk.yaml
```yaml
# SPDX-License-Identifier: GPL-2.0
%YAML 1.2
---
$id: http://devicetree.org/schemas/clock/allwinner,sun4i-a10-mmc-clk.yaml#
$schema: http://devicetree.org/meta-schemas/core.yaml#

title: Allwinner A10 Module 1 Clock Device Tree Bindings

maintainers:
  - Chen-Yu Tsai <wens@csie.org>
  - Maxime Ripard <mripard@kernel.org>

deprecated: true

properties:
  "#clock-cells":
    const: 1
    description: >
      There is three different outputs: the main clock, with the ID 0,
      and the output and sample clocks, with the IDs 1 and 2,
      respectively.

  compatible:
    enum:
      - allwinner,sun4i-a10-mmc-clk
      - allwinner,sun9i-a80-mmc-clk

  reg:
    maxItems: 1

  clocks:
    minItems: 2
    maxItems: 3
    description: >
      The parent order must match the hardware programming order.

  clock-output-names:
    maxItems: 3

required:
  - "#clock-cells"
  - compatible
  - reg
  - clocks
  - clock-output-names

additionalProperties: false

if:
  properties:
    compatible:
      contains:
        const: allwinner,sun4i-a10-mmc-clk

then:
  properties:
    clocks:
      maxItems: 3

else:
  properties:
    clocks:
      maxItems: 2

examples:
  - |
    clk@1c20088 {
        #clock-cells = <1>;
        compatible = "allwinner,sun4i-a10-mmc-clk";
        reg = <0x01c20088 0x4>;
        clocks = <&osc24M>, <&pll6 1>, <&pll5 1>;
        clock-output-names = "mmc0",
                             "mmc0_output",
                             "mmc0_sample";
    };

  - |
    clk@6000410 {
        #clock-cells = <1>;
        compatible = "allwinner,sun9i-a80-mmc-clk";
        reg = <0x06000410 0x4>;
        clocks = <&osc24M>, <&pll4>;
        clock-output-names = "mmc0", "mmc0_output",
                             "mmc0_sample";
    };

...
```

## Documentation/devicetree/bindings/clock/allwinner,sun4i-a10-mod0-clk.yaml
```yaml
# SPDX-License-Identifier: GPL-2.0
%YAML 1.2
---
$id: http://devicetree.org/schemas/clock/allwinner,sun4i-a10-mod0-clk.yaml#
$schema: http://devicetree.org/meta-schemas/core.yaml#

title: Allwinner A10 Module 0 Clock

maintainers:
  - Chen-Yu Tsai <wens@csie.org>
  - Maxime Ripard <mripard@kernel.org>

deprecated: true

select:
  properties:
    compatible:
      contains:
        enum:
          - allwinner,sun4i-a10-mod0-clk
          - allwinner,sun9i-a80-mod0-clk

  # The PRCM on the A31 and A23 will have the reg property missing,
  # since it's set at the upper level node, and will be validated by
  # PRCM's schema. Make sure we only validate standalone nodes.
  required:
    - compatible
    - reg

properties:
  "#clock-cells":
    const: 0

  compatible:
    enum:
      - allwinner,sun4i-a10-mod0-clk
      - allwinner,sun9i-a80-mod0-clk

  reg:
    maxItems: 1

  clocks:
    # On the A80, the PRCM mod0 clocks have 2 parents.
    minItems: 2
    maxItems: 3
    description: >
      The parent order must match the hardware programming order.

  clock-output-names:
    maxItems: 1

required:
  - "#clock-cells"
  - compatible
  - reg
  - clocks
  - clock-output-names

additionalProperties: false

examples:
  - |
    clk@1c20080 {
        #clock-cells = <0>;
        compatible = "allwinner,sun4i-a10-mod0-clk";
        reg = <0x01c20080 0x4>;
        clocks = <&osc24M>, <&pll6 1>, <&pll5 1>;
        clock-output-names = "nand";
    };

  - |
    clk@8001454 {
        #clock-cells = <0>;
        compatible = "allwinner,sun4i-a10-mod0-clk";
        reg = <0x08001454 0x4>;
        clocks = <&osc32k>, <&osc24M>;
        clock-output-names = "r_ir";
    };

...
```
