## Documentation/devicetree/bindings/clock/allwinner,sun4i-a10-mod1-clk.yaml
```yaml
# SPDX-License-Identifier: GPL-2.0
%YAML 1.2
---
$id: http://devicetree.org/schemas/clock/allwinner,sun4i-a10-mod1-clk.yaml#
$schema: http://devicetree.org/meta-schemas/core.yaml#

title: Allwinner A10 Module 1 Clock

maintainers:
  - Chen-Yu Tsai <wens@csie.org>
  - Maxime Ripard <mripard@kernel.org>

deprecated: true

properties:
  "#clock-cells":
    const: 0

  compatible:
    const: allwinner,sun4i-a10-mod1-clk

  reg:
    maxItems: 1

  clocks:
    maxItems: 4
    description: >
      The parent order must match the hardware programming order.

  clock-output-names:
    maxItems: 1

required:
  - "#clock-cells"
  - compatible
  - reg
  - clocks
  - clock-output-names

additionalProperties: false

examples:
  - |
    #include <dt-bindings/clock/sun4i-a10-pll2.h>

    clk@1c200c0 {
        #clock-cells = <0>;
        compatible = "allwinner,sun4i-a10-mod1-clk";
        reg = <0x01c200c0 0x4>;
        clocks = <&pll2 SUN4I_A10_PLL2_8X>,
                 <&pll2 SUN4I_A10_PLL2_4X>,
                 <&pll2 SUN4I_A10_PLL2_2X>,
                 <&pll2 SUN4I_A10_PLL2_1X>;
        clock-output-names = "spdif";
    };

...
```

## Documentation/devicetree/bindings/clock/allwinner,sun4i-a10-osc-clk.yaml
```yaml
# SPDX-License-Identifier: GPL-2.0
%YAML 1.2
---
$id: http://devicetree.org/schemas/clock/allwinner,sun4i-a10-osc-clk.yaml#
$schema: http://devicetree.org/meta-schemas/core.yaml#

title: Allwinner A10 Gatable Oscillator Clock

maintainers:
  - Chen-Yu Tsai <wens@csie.org>
  - Maxime Ripard <mripard@kernel.org>

deprecated: true

properties:
  "#clock-cells":
    const: 0

  compatible:
    const: allwinner,sun4i-a10-osc-clk

  reg:
    maxItems: 1

  clock-frequency:
    description: >
      Frequency of the main oscillator.

  clock-output-names:
    maxItems: 1

required:
  - "#clock-cells"
  - compatible
  - reg
  - clock-frequency
  - clock-output-names

additionalProperties: false

examples:
  - |
    osc24M: clk@1c20050 {
        #clock-cells = <0>;
        compatible = "allwinner,sun4i-a10-osc-clk";
        reg = <0x01c20050 0x4>;
        clock-frequency = <24000000>;
        clock-output-names = "osc24M";
    };

...
```

## Documentation/devicetree/bindings/clock/allwinner,sun4i-a10-pll1-clk.yaml
```yaml
# SPDX-License-Identifier: GPL-2.0
%YAML 1.2
---
$id: http://devicetree.org/schemas/clock/allwinner,sun4i-a10-pll1-clk.yaml#
$schema: http://devicetree.org/meta-schemas/core.yaml#

title: Allwinner A10 CPU PLL Device Tree Bindings

maintainers:
  - Chen-Yu Tsai <wens@csie.org>
  - Maxime Ripard <mripard@kernel.org>

deprecated: true

properties:
  "#clock-cells":
    const: 0

  compatible:
    enum:
      - allwinner,sun4i-a10-pll1-clk
      - allwinner,sun6i-a31-pll1-clk
      - allwinner,sun8i-a23-pll1-clk

  reg:
    maxItems: 1

  clocks:
    maxItems: 1

  clock-output-names:
    maxItems: 1

required:
  - "#clock-cells"
  - compatible
  - reg
  - clocks
  - clock-output-names

additionalProperties: false

examples:
  - |
    clk@1c20000 {
        #clock-cells = <0>;
        compatible = "allwinner,sun4i-a10-pll1-clk";
        reg = <0x01c20000 0x4>;
        clocks = <&osc24M>;
        clock-output-names = "osc24M";
    };

  - |
    clk@1c20000 {
        #clock-cells = <0>;
        compatible = "allwinner,sun6i-a31-pll1-clk";
        reg = <0x01c20000 0x4>;
        clocks = <&osc24M>;
        clock-output-names = "pll1";
    };

  - |
    clk@1c20000 {
        #clock-cells = <0>;
        compatible = "allwinner,sun8i-a23-pll1-clk";
        reg = <0x01c20000 0x4>;
        clocks = <&osc24M>;
        clock-output-names = "pll1";
    };

...
```

## Documentation/devicetree/bindings/clock/allwinner,sun4i-a10-pll3-clk.yaml
```yaml
# SPDX-License-Identifier: GPL-2.0
%YAML 1.2
---
$id: http://devicetree.org/schemas/clock/allwinner,sun4i-a10-pll3-clk.yaml#
$schema: http://devicetree.org/meta-schemas/core.yaml#

title: Allwinner A10 Video PLL

maintainers:
  - Chen-Yu Tsai <wens@csie.org>
  - Maxime Ripard <mripard@kernel.org>

deprecated: true

properties:
  "#clock-cells":
    const: 0

  compatible:
    const: allwinner,sun4i-a10-pll3-clk

  reg:
    maxItems: 1

  clocks:
    maxItems: 1

  clock-output-names:
    maxItems: 1

required:
  - "#clock-cells"
  - compatible
  - reg
  - clocks
  - clock-output-names

additionalProperties: false

examples:
  - |
    clk@1c20010 {
        #clock-cells = <0>;
        compatible = "allwinner,sun4i-a10-pll3-clk";
        reg = <0x01c20010 0x4>;
        clocks = <&osc3M>;
        clock-output-names = "pll3";
    };

...
```

## Documentation/devicetree/bindings/clock/allwinner,sun4i-a10-pll5-clk.yaml
```yaml
# SPDX-License-Identifier: GPL-2.0
%YAML 1.2
---
$id: http://devicetree.org/schemas/clock/allwinner,sun4i-a10-pll5-clk.yaml#
$schema: http://devicetree.org/meta-schemas/core.yaml#

title: Allwinner A10 DRAM PLL Device Tree Bindings

maintainers:
  - Chen-Yu Tsai <wens@csie.org>
  - Maxime Ripard <mripard@kernel.org>

deprecated: true

properties:
  "#clock-cells":
    const: 1
    description: >
      The first output is the DRAM clock output, the second is meant
      for peripherals on the SoC.

  compatible:
    const: allwinner,sun4i-a10-pll5-clk

  reg:
    maxItems: 1

  clocks:
    maxItems: 1

  clock-output-names:
    maxItems: 2

required:
  - "#clock-cells"
  - compatible
  - reg
  - clocks
  - clock-output-names

additionalProperties: false

examples:
  - |
    clk@1c20020 {
        #clock-cells = <1>;
        compatible = "allwinner,sun4i-a10-pll5-clk";
        reg = <0x01c20020 0x4>;
        clocks = <&osc24M>;
        clock-output-names = "pll5_ddr", "pll5_other";
    };

...
```

## Documentation/devicetree/bindings/clock/allwinner,sun4i-a10-pll6-clk.yaml
```yaml
# SPDX-License-Identifier: GPL-2.0
%YAML 1.2
---
$id: http://devicetree.org/schemas/clock/allwinner,sun4i-a10-pll6-clk.yaml#
$schema: http://devicetree.org/meta-schemas/core.yaml#

title: Allwinner A10 Peripheral PLL Device Tree Bindings

maintainers:
  - Chen-Yu Tsai <wens@csie.org>
  - Maxime Ripard <mripard@kernel.org>

deprecated: true

properties:
  "#clock-cells":
    const: 1
    description: >
      The first output is the SATA clock output, the second is the
      regular PLL output, the third is a PLL output at twice the rate.

  compatible:
    const: allwinner,sun4i-a10-pll6-clk

  reg:
    maxItems: 1

  clocks:
    maxItems: 1

  clock-output-names:
    maxItems: 3

required:
  - "#clock-cells"
  - compatible
  - reg
  - clocks
  - clock-output-names

additionalProperties: false

examples:
  - |
    clk@1c20028 {
        #clock-cells = <1>;
        compatible = "allwinner,sun4i-a10-pll6-clk";
        reg = <0x01c20028 0x4>;
        clocks = <&osc24M>;
        clock-output-names = "pll6_sata", "pll6_other", "pll6";
    };

...
```

## Documentation/devicetree/bindings/clock/allwinner,sun4i-a10-tcon-ch0-clk.yaml
```yaml
# SPDX-License-Identifier: GPL-2.0
%YAML 1.2
---
$id: http://devicetree.org/schemas/clock/allwinner,sun4i-a10-tcon-ch0-clk.yaml#
$schema: http://devicetree.org/meta-schemas/core.yaml#

title: Allwinner A10 TCON Channel 0 Clock Device Tree Bindings

maintainers:
  - Chen-Yu Tsai <wens@csie.org>
  - Maxime Ripard <mripard@kernel.org>

deprecated: true

properties:
  "#clock-cells":
    const: 0

  "#reset-cells":
    const: 1

  compatible:
    enum:
      - allwinner,sun4i-a10-tcon-ch0-clk
      - allwinner,sun4i-a10-tcon-ch1-clk

  reg:
    maxItems: 1

  clocks:
    maxItems: 4
    description: >
      The parent order must match the hardware programming order.

  clock-output-names:
    maxItems: 1

required:
  - "#clock-cells"
  - compatible
  - reg
  - clocks
  - clock-output-names

if:
  properties:
    compatible:
      contains:
        const: allwinner,sun4i-a10-tcon-ch0-clk

then:
  required:
    - "#reset-cells"

additionalProperties: false

examples:
  - |
    clk@1c20118 {
        #clock-cells = <0>;
        #reset-cells = <1>;
        compatible = "allwinner,sun4i-a10-tcon-ch0-clk";
        reg = <0x01c20118 0x4>;
        clocks = <&pll3>, <&pll7>, <&pll3x2>, <&pll7x2>;
        clock-output-names = "tcon-ch0-sclk";
    };

  - |
    clk@1c2012c {
        #clock-cells = <0>;
        compatible = "allwinner,sun4i-a10-tcon-ch1-clk";
        reg = <0x01c2012c 0x4>;
        clocks = <&pll3>, <&pll7>, <&pll3x2>, <&pll7x2>;
        clock-output-names = "tcon-ch1-sclk";
    };

...
```

## Documentation/devicetree/bindings/clock/allwinner,sun4i-a10-usb-clk.yaml
```yaml
# SPDX-License-Identifier: GPL-2.0
%YAML 1.2
---
$id: http://devicetree.org/schemas/clock/allwinner,sun4i-a10-usb-clk.yaml#
$schema: http://devicetree.org/meta-schemas/core.yaml#

title: Allwinner A10 USB Clock

maintainers:
  - Chen-Yu Tsai <wens@csie.org>
  - Maxime Ripard <mripard@kernel.org>

deprecated: true

properties:
  "#clock-cells":
    const: 1
    description: >
      The additional ID argument passed to the clock shall refer to
      the index of the output.

  "#reset-cells":
    const: 1

  compatible:
    enum:
      - allwinner,sun4i-a10-usb-clk
      - allwinner,sun5i-a13-usb-clk
      - allwinner,sun6i-a31-usb-clk
      - allwinner,sun8i-a23-usb-clk
      - allwinner,sun8i-h3-usb-clk

  reg:
    maxItems: 1

  clocks:
    maxItems: 1

  clock-output-names:
    minItems: 2
    maxItems: 8

required:
  - "#clock-cells"
  - "#reset-cells"
  - compatible
  - reg
  - clocks
  - clock-output-names

additionalProperties: false

allOf:
  - if:
      properties:
        compatible:
          contains:
            const: allwinner,sun4i-a10-usb-clk

    then:
      properties:
        clock-output-names:
          maxItems: 3

  - if:
      properties:
        compatible:
          contains:
            const: allwinner,sun5i-a13-usb-clk

    then:
      properties:
        clock-output-names:
          maxItems: 2

  - if:
      properties:
        compatible:
          contains:
            const: allwinner,sun6i-a31-usb-clk

    then:
      properties:
        clock-output-names:
          maxItems: 6

  - if:
      properties:
        compatible:
          contains:
            const: allwinner,sun8i-a23-usb-clk

    then:
      properties:
        clock-output-names:
          maxItems: 5

  - if:
      properties:
        compatible:
          contains:
            const: allwinner,sun8i-h3-usb-clk

    then:
      properties:
        clock-output-names:
          maxItems: 8

examples:
  - |
    clk@1c200cc {
        #clock-cells = <1>;
        #reset-cells = <1>;
        compatible = "allwinner,sun4i-a10-usb-clk";
        reg = <0x01c200cc 0x4>;
        clocks = <&pll6 1>;
        clock-output-names = "usb_ohci0", "usb_ohci1", "usb_phy";
    };

  - |
    clk@1c200cc {
        #clock-cells = <1>;
        #reset-cells = <1>;
        compatible = "allwinner,sun5i-a13-usb-clk";
        reg = <0x01c200cc 0x4>;
        clocks = <&pll6 1>;
        clock-output-names = "usb_ohci0", "usb_phy";
    };

  - |
    clk@1c200cc {
        #clock-cells = <1>;
        #reset-cells = <1>;
        compatible = "allwinner,sun6i-a31-usb-clk";
        reg = <0x01c200cc 0x4>;
        clocks = <&osc24M>;
        clock-output-names = "usb_phy0", "usb_phy1", "usb_phy2",
                             "usb_ohci0", "usb_ohci1",
                             "usb_ohci2";
    };

  - |
    clk@1c200cc {
        #clock-cells = <1>;
        #reset-cells = <1>;
        compatible = "allwinner,sun8i-a23-usb-clk";
        reg = <0x01c200cc 0x4>;
        clocks = <&osc24M>;
        clock-output-names = "usb_phy0", "usb_phy1", "usb_hsic",
                             "usb_hsic_12M", "usb_ohci0";
    };

  - |
    clk@1c200cc {
        #clock-cells = <1>;
        #reset-cells = <1>;
        compatible = "allwinner,sun8i-h3-usb-clk";
        reg = <0x01c200cc 0x4>;
        clocks = <&osc24M>;
        clock-output-names = "usb_phy0", "usb_phy1",
                             "usb_phy2", "usb_phy3",
                             "usb_ohci0", "usb_ohci1",
                             "usb_ohci2", "usb_ohci3";
    };

...
```

## Documentation/devicetree/bindings/clock/allwinner,sun4i-a10-ve-clk.yaml
```yaml
# SPDX-License-Identifier: GPL-2.0
%YAML 1.2
---
$id: http://devicetree.org/schemas/clock/allwinner,sun4i-a10-ve-clk.yaml#
$schema: http://devicetree.org/meta-schemas/core.yaml#

title: Allwinner A10 Video Engine Clock Device Tree Bindings

maintainers:
  - Chen-Yu Tsai <wens@csie.org>
  - Maxime Ripard <mripard@kernel.org>

deprecated: true

properties:
  "#clock-cells":
    const: 0

  "#reset-cells":
    const: 0

  compatible:
    const: allwinner,sun4i-a10-ve-clk

  reg:
    maxItems: 1

  clocks:
    maxItems: 1

  clock-output-names:
    maxItems: 1

required:
  - "#clock-cells"
  - "#reset-cells"
  - compatible
  - reg
  - clocks
  - clock-output-names

additionalProperties: false

examples:
  - |
    clk@1c2013c {
        #clock-cells = <0>;
        #reset-cells = <0>;
        compatible = "allwinner,sun4i-a10-ve-clk";
        reg = <0x01c2013c 0x4>;
        clocks = <&pll4>;
        clock-output-names = "ve";
    };

...
```

## Documentation/devicetree/bindings/clock/allwinner,sun55i-a523-ccu.yaml
```yaml
# SPDX-License-Identifier: (GPL-2.0-only OR BSD-2-Clause)
%YAML 1.2
---
$id: http://devicetree.org/schemas/clock/allwinner,sun55i-a523-ccu.yaml#
$schema: http://devicetree.org/meta-schemas/core.yaml#

title: Allwinner A523 Clock Control Unit

maintainers:
  - Andre Przywara <andre.przywara@arm.com>

properties:
  "#clock-cells":
    const: 1

  "#reset-cells":
    const: 1

  compatible:
    enum:
      - allwinner,sun55i-a523-ccu
      - allwinner,sun55i-a523-r-ccu

  reg:
    maxItems: 1

  clocks:
    minItems: 4
    maxItems: 5

  clock-names:
    minItems: 4
    maxItems: 5

required:
  - "#clock-cells"
  - "#reset-cells"
  - compatible
  - reg
  - clocks
  - clock-names

allOf:
  - if:
      properties:
        compatible:
          enum:
            - allwinner,sun55i-a523-ccu

    then:
      properties:
        clocks:
          items:
            - description: High Frequency Oscillator (usually at 24MHz)
            - description: Low Frequency Oscillator (usually at 32kHz)
            - description: Internal Oscillator
            - description: Low Frequency Oscillator fanout

        clock-names:
          items:
            - const: hosc
            - const: losc
            - const: iosc
            - const: losc-fanout

  - if:
      properties:
        compatible:
          enum:
            - allwinner,sun55i-a523-r-ccu

    then:
      properties:
        clocks:
          items:
            - description: High Frequency Oscillator (usually at 24MHz)
            - description: Low Frequency Oscillator (usually at 32kHz)
            - description: Internal Oscillator
            - description: Peripherals PLL
            - description: Audio PLL

        clock-names:
          items:
            - const: hosc
            - const: losc
            - const: iosc
            - const: pll-periph
            - const: pll-audio

additionalProperties: false

examples:
  - |
    clock-controller@2001000 {
        compatible = "allwinner,sun55i-a523-ccu";
        reg = <0x02001000 0x1000>;
        clocks = <&osc24M>, <&osc32k>, <&iosc>, <&r_ccu 1>;
        clock-names = "hosc", "losc", "iosc", "losc-fanout";
        #clock-cells = <1>;
        #reset-cells = <1>;
    };

...
```
