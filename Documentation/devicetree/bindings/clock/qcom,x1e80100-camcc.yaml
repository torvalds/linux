## Documentation/devicetree/bindings/clock/renesas,emev2-smu.yaml
```yaml
# SPDX-License-Identifier: (GPL-2.0-only OR BSD-2-Clause)
%YAML 1.2
---
$id: http://devicetree.org/schemas/clock/renesas,emev2-smu.yaml#
$schema: http://devicetree.org/meta-schemas/core.yaml#

title: Renesas EMMA Mobile EV2 System Management Unit

maintainers:
  - Geert Uytterhoeven <geert+renesas@glider.be>
  - Magnus Damm <magnus.damm@gmail.com>

description: |
  The System Management Unit is described in user's manual R19UH0037EJ1000_SMU.
  This is not a clock provider, but clocks under SMU depend on it.

properties:
  compatible:
    const: renesas,emev2-smu

  reg:
    maxItems: 1

  '#address-cells':
    const: 2

  '#size-cells':
    const: 0

required:
  - compatible
  - reg
  - '#address-cells'
  - '#size-cells'

patternProperties:
  ".*sclkdiv@.*":
    type: object

    description: |
      Function block with an input mux and a divider, which corresponds to
      "Serial clock generator" in fig. "Clock System Overview" of the manual,
      and "xxx frequency division setting register" (XXXCLKDIV) registers.
      This makes internal (neither input nor output) clock that is provided
      to input of xxxGCLK block.

    properties:
      compatible:
        const: renesas,emev2-smu-clkdiv

      reg:
        maxItems: 1
        description:
          Byte offset from SMU base and Bit position in the register.

      clocks:
        minItems: 1
        maxItems: 4

      '#clock-cells':
        const: 0

    required:
      - compatible
      - reg
      - clocks
      - '#clock-cells'

    additionalProperties: false

  ".*sclk@.*":
    type: object

    description: |
      Clock gating node shown as "Clock stop processing block" in the
      fig. "Clock System Overview" of the manual.
      Registers are "xxx clock gate control register" (XXXGCLKCTRL).

    properties:
      compatible:
        const: renesas,emev2-smu-gclk

      reg:
        maxItems: 1
        description:
          Byte offset from SMU base and Bit position in the register.

      clocks:
        maxItems: 1

      '#clock-cells':
        const: 0

    required:
      - compatible
      - reg
      - clocks
      - '#clock-cells'

    additionalProperties: false

additionalProperties: true

examples:
  - |
    // Example of clock-tree description:
    //
    //  This describes a clock path in the clock tree
    //   c32ki -> pll3_fo -> usia_u0_sclkdiv -> usia_u0_sclk
    clocks@e0110000 {
            compatible = "renesas,emev2-smu";
            reg = <0xe0110000 0x10000>;
            #address-cells = <2>;
            #size-cells = <0>;

            c32ki: c32ki {
                    compatible = "fixed-clock";
                    clock-frequency = <32768>;
                    #clock-cells = <0>;
            };
            pll3_fo: pll3_fo {
                    compatible = "fixed-factor-clock";
                    clocks = <&c32ki>;
                    clock-div = <1>;
                    clock-mult = <7000>;
                    #clock-cells = <0>;
            };
            usia_u0_sclkdiv: usia_u0_sclkdiv@610,0 {
                    compatible = "renesas,emev2-smu-clkdiv";
                    reg = <0x610 0>;
                    clocks = <&pll3_fo>;
                    #clock-cells = <0>;
            };
            usia_u0_sclk: usia_u0_sclk@4a0,1 {
                    compatible = "renesas,emev2-smu-gclk";
                    reg = <0x4a0 1>;
                    clocks = <&usia_u0_sclkdiv>;
                    #clock-cells = <0>;
            };
    };
```

## Documentation/devicetree/bindings/clock/renesas,h8300-div-clock.txt
```
* Renesas H8/300 divider clock

Required Properties:

  - compatible: Must be "renesas,sh73a0-h8300-div-clock"

  - clocks: Reference to the parent clocks ("extal1" and "extal2")

  - #clock-cells: Must be 1

  - reg: Base address and length of the divide rate selector

  - renesas,width: bit width of selector

Example
-------

		cclk: cclk {
			compatible = "renesas,h8300-div-clock";
			clocks = <&xclk>;
			#clock-cells = <0>;
			reg = <0xfee01b 2>;
			renesas,width = <2>;
		};
```

## Documentation/devicetree/bindings/clock/renesas,h8s2678-pll-clock.txt
```
Renesas H8S2678 PLL clock

This device is Clock multiplyer

Required Properties:

  - compatible: Must be "renesas,h8s2678-pll-clock"

  - clocks: Reference to the parent clocks

  - #clock-cells: Must be 0

  - reg: Two rate selector (Multiply / Divide) register address

Example
-------

		pllclk: pllclk {
			compatible = "renesas,h8s2678-pll-clock";
			clocks = <&xclk>;
			#clock-cells = <0>;
			reg = <0xfee03b 2>, <0xfee045 2>;
		};
```

## Documentation/devicetree/bindings/clock/renesas,r8a73a4-cpg-clocks.txt
```
* Renesas R8A73A4 Clock Pulse Generator (CPG)

The CPG generates core clocks for the R8A73A4 SoC. It includes five PLLs
and several fixed ratio dividers.

Required Properties:

  - compatible: Must be "renesas,r8a73a4-cpg-clocks"

  - reg: Base address and length of the memory resource used by the CPG

  - clocks: Reference to the parent clocks ("extal1" and "extal2")

  - #clock-cells: Must be 1

  - clock-output-names: The names of the clocks. Supported clocks are "main",
    "pll0", "pll1", "pll2", "pll2s", "pll2h", "z", "z2", "i", "m3", "b",
    "m1", "m2", "zx", "zs", and "hp".


Example
-------

        cpg_clocks: cpg_clocks@e6150000 {
                compatible = "renesas,r8a73a4-cpg-clocks";
                reg = <0 0xe6150000 0 0x10000>;
                clocks = <&extal1_clk>, <&extal2_clk>;
                #clock-cells = <1>;
                clock-output-names = "main", "pll0", "pll1", "pll2",
                                     "pll2s", "pll2h", "z", "z2",
                                     "i", "m3", "b", "m1", "m2",
                                     "zx", "zs", "hp";
        };
```

## Documentation/devicetree/bindings/clock/renesas,r8a7740-cpg-clocks.txt
```
These bindings should be considered EXPERIMENTAL for now.

* Renesas R8A7740  Clock Pulse Generator (CPG)

The CPG generates core clocks for the R8A7740 SoC. It includes three PLLs
and several fixed ratio and variable ratio dividers.

Required Properties:

  - compatible: Must be "renesas,r8a7740-cpg-clocks"

  - reg: Base address and length of the memory resource used by the CPG

  - clocks: Reference to the three parent clocks
  - #clock-cells: Must be 1
  - clock-output-names: The names of the clocks. Supported clocks are
    "system", "pllc0", "pllc1", "pllc2", "r", "usb24s", "i", "zg", "b",
    "m1", "hp", "hpp", "usbp", "s", "zb", "m3", and "cp".

  - renesas,mode: board-specific settings of the MD_CK* bits


Example
-------

cpg_clocks: cpg_clocks@e6150000 {
        compatible = "renesas,r8a7740-cpg-clocks";
        reg = <0xe6150000 0x10000>;
        clocks = <&extal1_clk>, <&extal2_clk>, <&extalr_clk>;
        #clock-cells = <1>;
        clock-output-names = "system", "pllc0", "pllc1",
                             "pllc2", "r",
                             "usb24s",
                             "i", "zg", "b", "m1", "hp",
                             "hpp", "usbp", "s", "zb", "m3",
                             "cp";
};

&cpg_clocks {
	renesas,mode = <0x05>;
};
```

## Documentation/devicetree/bindings/clock/renesas,r8a7778-cpg-clocks.txt
```
* Renesas R8A7778 Clock Pulse Generator (CPG)

The CPG generates core clocks for the R8A7778. It includes two PLLs and
several fixed ratio dividers.
The CPG also provides a Clock Domain for SoC devices, in combination with the
CPG Module Stop (MSTP) Clocks.

Required Properties:

  - compatible: Must be "renesas,r8a7778-cpg-clocks"
  - reg: Base address and length of the memory resource used by the CPG
  - #clock-cells: Must be 1
  - clock-output-names: The names of the clocks. Supported clocks are
    "plla", "pllb", "b", "out", "p", "s", and "s1".
  - #power-domain-cells: Must be 0

SoC devices that are part of the CPG/MSTP Clock Domain and can be power-managed
through an MSTP clock should refer to the CPG device node in their
"power-domains" property, as documented by the generic PM domain bindings in
Documentation/devicetree/bindings/power/power_domain.txt.


Examples
--------

  - CPG device node:

	cpg_clocks: cpg_clocks@ffc80000 {
		compatible = "renesas,r8a7778-cpg-clocks";
		reg = <0xffc80000 0x80>;
		#clock-cells = <1>;
		clocks = <&extal_clk>;
		clock-output-names = "plla", "pllb", "b",
				     "out", "p", "s", "s1";
		#power-domain-cells = <0>;
	};


  - CPG/MSTP Clock Domain member device node:

	sdhi0: sd@ffe4c000 {
		compatible = "renesas,sdhi-r8a7778";
		reg = <0xffe4c000 0x100>;
		interrupts = <0 87 IRQ_TYPE_LEVEL_HIGH>;
		clocks = <&mstp3_clks R8A7778_CLK_SDHI0>;
		power-domains = <&cpg_clocks>;
	};
```

## Documentation/devicetree/bindings/clock/renesas,r8a7779-cpg-clocks.txt
```
* Renesas R8A7779 Clock Pulse Generator (CPG)

The CPG generates core clocks for the R8A7779. It includes one PLL and
several fixed ratio dividers.
The CPG also provides a Clock Domain for SoC devices, in combination with the
CPG Module Stop (MSTP) Clocks.

Required Properties:

  - compatible: Must be "renesas,r8a7779-cpg-clocks"
  - reg: Base address and length of the memory resource used by the CPG

  - clocks: Reference to the parent clock
  - #clock-cells: Must be 1
  - clock-output-names: The names of the clocks. Supported clocks are "plla",
    "z", "zs", "s", "s1", "p", "b", "out".
  - #power-domain-cells: Must be 0

SoC devices that are part of the CPG/MSTP Clock Domain and can be power-managed
through an MSTP clock should refer to the CPG device node in their
"power-domains" property, as documented by the generic PM domain bindings in
Documentation/devicetree/bindings/power/power_domain.txt.


Examples
--------

  - CPG device node:

	cpg_clocks: cpg_clocks@ffc80000 {
		compatible = "renesas,r8a7779-cpg-clocks";
		reg = <0xffc80000 0x30>;
		clocks = <&extal_clk>;
		#clock-cells = <1>;
		clock-output-names = "plla", "z", "zs", "s", "s1", "p",
		                     "b", "out";
		#power-domain-cells = <0>;
	};


  - CPG/MSTP Clock Domain member device node:

	sata: sata@fc600000 {
		compatible = "renesas,sata-r8a7779", "renesas,rcar-sata";
		reg = <0xfc600000 0x2000>;
		interrupts = <0 100 IRQ_TYPE_LEVEL_HIGH>;
		clocks = <&mstp1_clks R8A7779_CLK_SATA>;
		power-domains = <&cpg_clocks>;
	};
```

## Documentation/devicetree/bindings/clock/renesas,r9a06g032-sysctrl.txt
```
* Renesas R9A06G032 SYSCTRL

Required Properties:

  - compatible: Must be:
    - "renesas,r9a06g032-sysctrl"
  - reg: Base address and length of the SYSCTRL IO block.
  - #clock-cells: Must be 1
  - clocks: References to the parent clocks:
	- external 40mhz crystal.
	- external (optional) 32.768khz
	- external (optional) jtag input
	- external (optional) RGMII_REFCLK
  - clock-names: Must be:
        clock-names = "mclk", "rtc", "jtag", "rgmii_ref_ext";
  - #power-domain-cells: Must be 0

Examples
--------

  - SYSCTRL node:

	sysctrl: system-controller@4000c000 {
		compatible = "renesas,r9a06g032-sysctrl";
		reg = <0x4000c000 0x1000>;
		#clock-cells = <1>;

		clocks = <&ext_mclk>, <&ext_rtc_clk>,
				<&ext_jtag_clk>, <&ext_rgmii_ref>;
		clock-names = "mclk", "rtc", "jtag", "rgmii_ref_ext";
		#power-domain-cells = <0>;
	};

  - Other nodes can use the clocks provided by SYSCTRL as in:

	#include <dt-bindings/clock/r9a06g032-sysctrl.h>
	uart0: serial@40060000 {
		compatible = "snps,dw-apb-uart";
		reg = <0x40060000 0x400>;
		interrupts = <GIC_SPI 6 IRQ_TYPE_LEVEL_HIGH>;
		reg-shift = <2>;
		reg-io-width = <4>;
		clocks = <&sysctrl R9A06G032_CLK_UART0>, <&sysctrl R9A06G032_HCLK_UART0>;
		clock-names = "baudclk", "apb_pclk";
		power-domains = <&sysctrl>;
	};
```

## Documentation/devicetree/bindings/clock/renesas,r9a06g032-sysctrl.yaml
```yaml
# SPDX-License-Identifier: (GPL-2.0-only OR BSD-2-Clause)
%YAML 1.2
---
$id: http://devicetree.org/schemas/clock/renesas,r9a06g032-sysctrl.yaml#
$schema: http://devicetree.org/meta-schemas/core.yaml#

title: Renesas RZ/N1D (R9A06G032) System Controller

maintainers:
  - Gareth Williams <gareth.williams.jx@renesas.com>
  - Geert Uytterhoeven <geert+renesas@glider.be>

properties:
  compatible:
    const: renesas,r9a06g032-sysctrl

  reg:
    maxItems: 1

  clocks:
    minItems: 1
    items:
      - description: External 40 MHz crystal
      - description: Optional external 32.768 kHz crystal
      - description: Optional external JTAG input
      - description: Optional external RGMII_REFCLK

  clock-names:
    minItems: 1
    items:
      - const: mclk
      - const: rtc
      - const: jtag
      - const: rgmii_ref_ext

  '#clock-cells':
    const: 1

  '#power-domain-cells':
    const: 0

required:
  - compatible
  - reg
  - clocks
  - clock-names
  - '#clock-cells'
  - '#power-domain-cells'

additionalProperties: false

examples:
  - |
    sysctrl: system-controller@4000c000 {
            compatible = "renesas,r9a06g032-sysctrl";
            reg = <0x4000c000 0x1000>;
            clocks = <&ext_mclk>, <&ext_rtc_clk>, <&ext_jtag_clk>,
                     <&ext_rgmii_ref>;
            clock-names = "mclk", "rtc", "jtag", "rgmii_ref_ext";
            #clock-cells = <1>;
            #power-domain-cells = <0>;
    };
```

## Documentation/devicetree/bindings/clock/renesas,r9a08g045-vbattb.yaml
```yaml
# SPDX-License-Identifier: (GPL-2.0-only OR BSD-2-Clause)
%YAML 1.2
---
$id: http://devicetree.org/schemas/clock/renesas,r9a08g045-vbattb.yaml#
$schema: http://devicetree.org/meta-schemas/core.yaml#

title: Renesas Battery Backup Function (VBATTB)

description:
  Renesas VBATTB is an always on powered module (backed by battery) which
  controls the RTC clock (VBATTCLK), tamper detection logic and a small
  general usage memory (128B).

maintainers:
  - Claudiu Beznea <claudiu.beznea.uj@bp.renesas.com>

properties:
  compatible:
    const: renesas,r9a08g045-vbattb

  reg:
    maxItems: 1

  interrupts:
    items:
      - description: tamper detector interrupt

  clocks:
    items:
      - description: VBATTB module clock
      - description: RTC input clock (crystal or external clock device)

  clock-names:
    items:
      - const: bclk
      - const: rtx

  '#clock-cells':
    const: 1

  power-domains:
    maxItems: 1

  resets:
    items:
      - description: VBATTB module reset

  quartz-load-femtofarads:
    description: load capacitance of the on board crystal
    enum: [ 4000, 7000, 9000, 12500 ]
    default: 4000

required:
  - compatible
  - reg
  - interrupts
  - clocks
  - clock-names
  - '#clock-cells'
  - power-domains
  - resets

additionalProperties: false

examples:
  - |
    #include <dt-bindings/clock/r9a08g045-cpg.h>
    #include <dt-bindings/clock/renesas,r9a08g045-vbattb.h>
    #include <dt-bindings/interrupt-controller/arm-gic.h>
    #include <dt-bindings/interrupt-controller/irq.h>

    clock-controller@1005c000 {
        compatible = "renesas,r9a08g045-vbattb";
        reg = <0x1005c000 0x1000>;
        interrupts = <GIC_SPI 43 IRQ_TYPE_LEVEL_HIGH>;
        clocks = <&cpg CPG_MOD R9A08G045_VBAT_BCLK>, <&vbattb_xtal>;
        clock-names = "bclk", "rtx";
        assigned-clocks = <&vbattb VBATTB_MUX>;
        assigned-clock-parents = <&vbattb VBATTB_XC>;
        #clock-cells = <1>;
        power-domains = <&cpg>;
        resets = <&cpg R9A08G045_VBAT_BRESETN>;
        quartz-load-femtofarads = <12500>;
    };
```
