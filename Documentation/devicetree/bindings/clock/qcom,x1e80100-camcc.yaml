## Documentation/devicetree/bindings/clock/qcom,x1e80100-camcc.yaml
```yaml
# SPDX-License-Identifier: (GPL-2.0-only OR BSD-2-Clause)
%YAML 1.2
---
$id: http://devicetree.org/schemas/clock/qcom,x1e80100-camcc.yaml#
$schema: http://devicetree.org/meta-schemas/core.yaml#

title: Qualcomm Camera Clock & Reset Controller on x1e80100

maintainers:
  - Bryan O'Donoghue <bryan.odonoghue@linaro.org>

description: |
  Qualcomm camera clock control module provides the clocks, resets and power
  domains on x1e80100.

  See also:
    include/dt-bindings/clock/qcom,x1e80100-camcc.h

allOf:
  - $ref: qcom,gcc.yaml#

properties:
  compatible:
    enum:
      - qcom,x1e80100-camcc

  reg:
    maxItems: 1

  clocks:
    items:
      - description: Camera AHB clock from GCC
      - description: Board XO source
      - description: Board active XO source
      - description: Sleep clock source

  power-domains:
    items:
      - description: A phandle to the MXC power-domain
      - description: A phandle to the MMCX power-domain

  required-opps:
    items:
      - description: A phandle to an OPP node describing MXC performance points
      - description: A phandle to an OPP node describing MMCX performance points

required:
  - compatible
  - clocks
  - power-domains
  - required-opps

unevaluatedProperties: false

examples:
  - |
    #include <dt-bindings/clock/qcom,x1e80100-gcc.h>
    #include <dt-bindings/clock/qcom,rpmh.h>
    #include <dt-bindings/power/qcom,rpmhpd.h>
    clock-controller@ade0000 {
      compatible = "qcom,x1e80100-camcc";
      reg = <0xade0000 0x20000>;
      clocks = <&gcc GCC_CAMERA_AHB_CLK>,
               <&rpmhcc RPMH_CXO_CLK>,
               <&rpmhcc RPMH_CXO_CLK_A>,
               <&sleep_clk>;
      power-domains = <&rpmhpd RPMHPD_MXC>,
                      <&rpmhpd RPMHPD_MMCX>;
      required-opps = <&rpmhpd_opp_low_svs>,
                      <&rpmhpd_opp_low_svs>;
      #clock-cells = <1>;
      #reset-cells = <1>;
      #power-domain-cells = <1>;
    };
...
```

## Documentation/devicetree/bindings/clock/qcom,x1e80100-gcc.yaml
```yaml
# SPDX-License-Identifier: (GPL-2.0-only OR BSD-2-Clause)
%YAML 1.2
---
$id: http://devicetree.org/schemas/clock/qcom,x1e80100-gcc.yaml#
$schema: http://devicetree.org/meta-schemas/core.yaml#

title: Qualcomm Global Clock & Reset Controller on X1E80100

maintainers:
  - Rajendra Nayak <quic_rjendra@quicinc.com>

description: |
  Qualcomm global clock control module provides the clocks, resets and power
  domains on X1E80100

  See also: include/dt-bindings/clock/qcom,x1e80100-gcc.h

properties:
  compatible:
    oneOf:
      - items:
          - const: qcom,x1p42100-gcc
          - const: qcom,x1e80100-gcc
      - const: qcom,x1e80100-gcc

  clocks:
    items:
      - description: Board XO source
      - description: Sleep clock source
      - description: PCIe 3 pipe clock
      - description: PCIe 4 pipe clock
      - description: PCIe 5 pipe clock
      - description: PCIe 6a pipe clock
      - description: PCIe 6b pipe clock
      - description: USB4_0 QMPPHY clock source
      - description: USB4_1 QMPPHY clock source
      - description: USB4_2 QMPPHY clock source
      - description: USB4_0 PHY DP0 GMUX clock source
      - description: USB4_0 PHY DP1 GMUX clock source
      - description: USB4_0 PHY PCIE PIPEGMUX clock source
      - description: USB4_0 PHY PIPEGMUX clock source
      - description: USB4_0 PHY SYS PCIE PIPEGMUX clock source
      - description: USB4_1 PHY DP0 GMUX 2 clock source
      - description: USB4_1 PHY DP1 GMUX 2 clock source
      - description: USB4_1 PHY PCIE PIPEGMUX clock source
      - description: USB4_1 PHY PIPEGMUX clock source
      - description: USB4_1 PHY SYS PCIE PIPEGMUX clock source
      - description: USB4_2 PHY DP0 GMUX 2 clock source
      - description: USB4_2 PHY DP1 GMUX 2 clock source
      - description: USB4_2 PHY PCIE PIPEGMUX clock source
      - description: USB4_2 PHY PIPEGMUX clock source
      - description: USB4_2 PHY SYS PCIE PIPEGMUX clock source
      - description: USB4_0 PHY RX 0 clock source
      - description: USB4_0 PHY RX 1 clock source
      - description: USB4_1 PHY RX 0 clock source
      - description: USB4_1 PHY RX 1 clock source
      - description: USB4_2 PHY RX 0 clock source
      - description: USB4_2 PHY RX 1 clock source
      - description: USB4_0 PHY PCIE PIPE clock source
      - description: USB4_0 PHY max PIPE clock source
      - description: USB4_1 PHY PCIE PIPE clock source
      - description: USB4_1 PHY max PIPE clock source
      - description: USB4_2 PHY PCIE PIPE clock source
      - description: USB4_2 PHY max PIPE clock source

  power-domains:
    description:
      A phandle and PM domain specifier for the CX power domain.
    maxItems: 1

required:
  - compatible
  - clocks
  - power-domains
  - '#power-domain-cells'

allOf:
  - $ref: qcom,gcc.yaml#

unevaluatedProperties: false

examples:
  - |
    #include <dt-bindings/power/qcom,rpmhpd.h>
    clock-controller@100000 {
      compatible = "qcom,x1e80100-gcc";
      reg = <0x00100000 0x200000>;
      clocks = <&bi_tcxo_div2>,
               <&sleep_clk>,
               <&pcie3_phy>,
               <&pcie4_phy>,
               <&pcie5_phy>,
               <&pcie6a_phy>,
               <&pcie6b_phy>,
               <&usb_1_ss0_qmpphy 0>,
               <&usb_1_ss1_qmpphy 1>,
               <&usb_1_ss2_qmpphy 2>,
               <&usb4_0_phy_dp0_gmux_clk>,
               <&usb4_0_phy_dp1_gmux_clk>,
               <&usb4_0_phy_pcie_pipegmux_clk>,
               <&usb4_0_phy_pipegmux_clk>,
               <&usb4_0_phy_sys_pcie_pipegmux_clk>,
               <&usb4_1_phy_dp0_gmux_2_clk>,
               <&usb4_1_phy_dp1_gmux_2_clk>,
               <&usb4_1_phy_pcie_pipegmux_clk>,
               <&usb4_1_phy_pipegmux_clk>,
               <&usb4_1_phy_sys_pcie_pipegmux_clk>,
               <&usb4_2_phy_dp0_gmux_2_clk>,
               <&usb4_2_phy_dp1_gmux_2_clk>,
               <&usb4_2_phy_pcie_pipegmux_clk>,
               <&usb4_2_phy_pipegmux_clk>,
               <&usb4_2_phy_sys_pcie_pipegmux_clk>,
               <&usb4_0_phy_rx_0_clk>,
               <&usb4_0_phy_rx_1_clk>,
               <&usb4_1_phy_rx_0_clk>,
               <&usb4_1_phy_rx_1_clk>,
               <&usb4_2_phy_rx_0_clk>,
               <&usb4_2_phy_rx_1_clk>,
               <&usb4_0_phy_pcie_pipe_clk>,
               <&usb4_0_phy_max_pipe_clk>,
               <&usb4_1_phy_pcie_pipe_clk>,
               <&usb4_1_phy_max_pipe_clk>,
               <&usb4_2_phy_pcie_pipe_clk>,
               <&usb4_2_phy_max_pipe_clk>;
      power-domains = <&rpmhpd RPMHPD_CX>;
      #clock-cells = <1>;
      #reset-cells = <1>;
      #power-domain-cells = <1>;
    };

...
```

## Documentation/devicetree/bindings/clock/qoriq-clock.txt
```
* Clock Block on Freescale QorIQ Platforms

Freescale QorIQ chips take primary clocking input from the external
SYSCLK signal. The SYSCLK input (frequency) is multiplied using
multiple phase locked loops (PLL) to create a variety of frequencies
which can then be passed to a variety of internal logic, including
cores and peripheral IP blocks.
Please refer to the Reference Manual for details.

All references to "1.0" and "2.0" refer to the QorIQ chassis version to
which the chip complies.

Chassis Version		Example Chips
---------------		-------------
1.0			p4080, p5020, p5040
2.0			t4240, b4860

1. Clock Block Binding

Required properties:
- compatible: Should contain a chip-specific clock block compatible
	string and (if applicable) may contain a chassis-version clock
	compatible string.

	Chip-specific strings are of the form "fsl,<chip>-clockgen", such as:
	* "fsl,p2041-clockgen"
	* "fsl,p3041-clockgen"
	* "fsl,p4080-clockgen"
	* "fsl,p5020-clockgen"
	* "fsl,p5040-clockgen"
	* "fsl,t4240-clockgen"
	* "fsl,b4420-clockgen"
	* "fsl,b4860-clockgen"
	* "fsl,ls1012a-clockgen"
	* "fsl,ls1021a-clockgen"
	* "fsl,ls1043a-clockgen"
	* "fsl,ls1046a-clockgen"
	* "fsl,ls1088a-clockgen"
	* "fsl,ls2080a-clockgen"
	Chassis-version clock strings include:
	* "fsl,qoriq-clockgen-1.0": for chassis 1.0 clocks
	* "fsl,qoriq-clockgen-2.0": for chassis 2.0 clocks
- reg: Describes the address of the device's resources within the
	address space defined by its parent bus, and resource zero
	represents the clock register set

Optional properties:
- ranges: Allows valid translation between child's address space and
	parent's. Must be present if the device has sub-nodes.
- #address-cells: Specifies the number of cells used to represent
	physical base addresses.  Must be present if the device has
	sub-nodes and set to 1 if present
- #size-cells: Specifies the number of cells used to represent
	the size of an address. Must be present if the device has
	sub-nodes and set to 1 if present
- clock-frequency: Input system clock frequency (SYSCLK)
- clocks: If clock-frequency is not specified, sysclk may be provided
	as an input clock.  Either clock-frequency or clocks must be
	provided.

2. Clock Provider

The clockgen node should act as a clock provider, though in older device
trees the children of the clockgen node are the clock providers.

When the clockgen node is a clock provider, #clock-cells = <2>.
The first cell of the clock specifier is the clock type, and the
second cell is the clock index for the specified type.

	Type#	Name		Index Cell
	0	sysclk		must be 0
	1	cmux		index (n in CLKCnCSR)
	2	hwaccel		index (n in CLKCGnHWACSR)
	3	fman		0 for fm1, 1 for fm2
	4	platform pll	0=pll, 1=pll/2, 2=pll/3, 3=pll/4

3. Example

	clockgen: global-utilities@e1000 {
		compatible = "fsl,p5020-clockgen", "fsl,qoriq-clockgen-1.0";
		clock-frequency = <133333333>;
		reg = <0xe1000 0x1000>;
		#clock-cells = <2>;
	};

	fman@400000 {
		...
		clocks = <&clockgen 3 0>;
		...
	};
}
4. Legacy Child Nodes

NOTE: These nodes are deprecated.  Kernels should continue to support
device trees with these nodes, but new device trees should not use them.

Most of the bindings are from the common clock binding[1].
 [1] Documentation/devicetree/bindings/clock/clock-bindings.txt

Required properties:
- compatible : Should include one of the following:
	* "fsl,qoriq-core-pll-1.0" for core PLL clocks (v1.0)
	* "fsl,qoriq-core-pll-2.0" for core PLL clocks (v2.0)
	* "fsl,qoriq-core-mux-1.0" for core mux clocks (v1.0)
	* "fsl,qoriq-core-mux-2.0" for core mux clocks (v2.0)
	* "fsl,qoriq-sysclk-1.0": for input system clock (v1.0).
		It takes parent's clock-frequency as its clock.
	* "fsl,qoriq-sysclk-2.0": for input system clock (v2.0).
		It takes parent's clock-frequency as its clock.
	* "fsl,qoriq-platform-pll-1.0" for the platform PLL clock (v1.0)
	* "fsl,qoriq-platform-pll-2.0" for the platform PLL clock (v2.0)
- #clock-cells: From common clock binding. The number of cells in a
	clock-specifier. Should be <0> for "fsl,qoriq-sysclk-[1,2].0"
	clocks, or <1> for "fsl,qoriq-core-pll-[1,2].0" clocks.
	For "fsl,qoriq-core-pll-[1,2].0" clocks, the single
	clock-specifier cell may take the following values:
	* 0 - equal to the PLL frequency
	* 1 - equal to the PLL frequency divided by 2
	* 2 - equal to the PLL frequency divided by 4

Recommended properties:
- clocks: Should be the phandle of input parent clock
- clock-names: From common clock binding, indicates the clock name
- clock-output-names: From common clock binding, indicates the names of
	output clocks
- reg: Should be the offset and length of clock block base address.
	The length should be 4.

Legacy Example:
/ {
	clockgen: global-utilities@e1000 {
		compatible = "fsl,p5020-clockgen", "fsl,qoriq-clockgen-1.0";
		ranges = <0x0 0xe1000 0x1000>;
		clock-frequency = <133333333>;
		reg = <0xe1000 0x1000>;
		#address-cells = <1>;
		#size-cells = <1>;

		sysclk: sysclk {
			#clock-cells = <0>;
			compatible = "fsl,qoriq-sysclk-1.0";
			clock-output-names = "sysclk";
		};

		pll0: pll0@800 {
			#clock-cells = <1>;
			reg = <0x800 0x4>;
			compatible = "fsl,qoriq-core-pll-1.0";
			clocks = <&sysclk>;
			clock-output-names = "pll0", "pll0-div2";
		};

		pll1: pll1@820 {
			#clock-cells = <1>;
			reg = <0x820 0x4>;
			compatible = "fsl,qoriq-core-pll-1.0";
			clocks = <&sysclk>;
			clock-output-names = "pll1", "pll1-div2";
		};

		mux0: mux0@0 {
			#clock-cells = <0>;
			reg = <0x0 0x4>;
			compatible = "fsl,qoriq-core-mux-1.0";
			clocks = <&pll0 0>, <&pll0 1>, <&pll1 0>, <&pll1 1>;
			clock-names = "pll0", "pll0-div2", "pll1", "pll1-div2";
			clock-output-names = "cmux0";
		};

		mux1: mux1@20 {
			#clock-cells = <0>;
			reg = <0x20 0x4>;
			compatible = "fsl,qoriq-core-mux-1.0";
			clocks = <&pll0 0>, <&pll0 1>, <&pll1 0>, <&pll1 1>;
			clock-names = "pll0", "pll0-div2", "pll1", "pll1-div2";
			clock-output-names = "cmux1";
		};

		platform-pll: platform-pll@c00 {
			#clock-cells = <1>;
			reg = <0xc00 0x4>;
			compatible = "fsl,qoriq-platform-pll-1.0";
			clocks = <&sysclk>;
			clock-output-names = "platform-pll", "platform-pll-div2";
		};
	};
};

Example for legacy clock consumer:

/ {
	cpu0: PowerPC,e5500@0 {
		...
		clocks = <&mux0>;
		...
	};
};
```

## Documentation/devicetree/bindings/clock/raspberrypi,rp1-clocks.yaml
```yaml
# SPDX-License-Identifier: (GPL-2.0-only OR BSD-2-Clause)
%YAML 1.2
---
$id: http://devicetree.org/schemas/clock/raspberrypi,rp1-clocks.yaml#
$schema: http://devicetree.org/meta-schemas/core.yaml#

title: RaspberryPi RP1 clock generator

maintainers:
  - A. della Porta <andrea.porta@suse.com>

description: |
  The RP1 contains a clock generator designed as three PLLs (CORE, AUDIO,
  VIDEO), and each PLL output can be programmed through dividers to generate
  the clocks to drive the sub-peripherals embedded inside the chipset.

  Link to datasheet:
  https://datasheets.raspberrypi.com/rp1/rp1-peripherals.pdf

properties:
  compatible:
    const: raspberrypi,rp1-clocks

  reg:
    maxItems: 1

  '#clock-cells':
    const: 1
    description:
      The available clocks are defined in
      include/dt-bindings/clock/raspberrypi,rp1-clocks.h.

  clocks:
    maxItems: 1

required:
  - compatible
  - reg
  - '#clock-cells'
  - clocks

additionalProperties: false

examples:
  - |
    #include <dt-bindings/clock/raspberrypi,rp1-clocks.h>

    rp1 {
        #address-cells = <2>;
        #size-cells = <2>;

        clocks@c040018000 {
            compatible = "raspberrypi,rp1-clocks";
            reg = <0xc0 0x40018000 0x0 0x10038>;
            #clock-cells = <1>;
            clocks = <&clk_rp1_xosc>;
        };
    };
```
