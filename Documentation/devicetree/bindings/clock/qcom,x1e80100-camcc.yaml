## Documentation/devicetree/bindings/clock/renesas,5p35023.yaml
```yaml
# SPDX-License-Identifier: (GPL-2.0-only OR BSD-2-Clause)
%YAML 1.2
---
$id: http://devicetree.org/schemas/clock/renesas,5p35023.yaml#
$schema: http://devicetree.org/meta-schemas/core.yaml#

title: Renesas 5p35023 VersaClock 3 programmable I2C clock generator

maintainers:
  - Biju Das <biju.das.jz@bp.renesas.com>

description: |
  The 5P35023 is a VersaClock programmable clock generator and
  is designed for low-power, consumer, and high-performance PCI
  express applications. The 5P35023 device is a three PLL
  architecture design, and each PLL is individually programmable
  and allowing for up to 6 unique frequency outputs.

  An internal OTP memory allows the user to store the configuration
  in the device. After power up, the user can change the device register
  settings through the I2C interface when I2C mode is selected.

  The driver can read a full register map from the DT, and will use that
  register map to initialize the attached part (via I2C) when the system
  boots. Any configuration not supported by the common clock framework
  must be done via the full register map, including optimized settings.

  Link to datasheet:
  https://www.renesas.com/us/en/products/clocks-timing/clock-generation/programmable-clocks/5p35023-versaclock-3s-programmable-clock-generator

properties:
  compatible:
    enum:
      - renesas,5p35023

  reg:
    maxItems: 1

  '#clock-cells':
    const: 1

  clocks:
    maxItems: 1

  renesas,settings:
    description: Optional, complete register map of the device.
      Optimized settings for the device must be provided in full
      and are written during initialization.
    $ref: /schemas/types.yaml#/definitions/uint8-array
    maxItems: 37

required:
  - compatible
  - reg
  - '#clock-cells'
  - clocks

additionalProperties: false

examples:
  - |
    i2c {
        #address-cells = <1>;
        #size-cells = <0>;

        versa3: clock-generator@68 {
            compatible = "renesas,5p35023";
            reg = <0x68>;
            #clock-cells = <1>;

            clocks = <&x1_x2>;

            renesas,settings = [
                80 00 11 19 4c 02 23 7f 83 19 08 a9 5f 25 24 bf
                00 14 7a e1 00 00 00 00 01 55 59 bb 3f 30 90 b6
                80 b0 45 c4 95
            ];

            assigned-clocks = <&versa3 0>, <&versa3 1>,
                              <&versa3 2>, <&versa3 3>,
                              <&versa3 4>, <&versa3 5>;
            assigned-clock-rates = <12288000>, <25000000>,
                                   <12000000>, <11289600>,
                                   <11289600>, <24000000>;
        };
    };
```

## Documentation/devicetree/bindings/clock/renesas,9series.yaml
```yaml
# SPDX-License-Identifier: (GPL-2.0-only OR BSD-2-Clause)
%YAML 1.2
---
$id: http://devicetree.org/schemas/clock/renesas,9series.yaml#
$schema: http://devicetree.org/meta-schemas/core.yaml#

title: Renesas 9-series I2C PCIe clock generators

description: |
  The Renesas 9-series are I2C PCIe clock generators providing
  from 1 to 20 output clocks.

  When referencing the provided clock in the DT using phandle
  and clock specifier, the following mapping applies:

  - 9FGV0241:
    0 -- DIF0
    1 -- DIF1
  - 9FGV0441:
    0 -- DIF0
    1 -- DIF1
    2 -- DIF2
    3 -- DIF3
  - 9FGV0841:
    0 -- DIF0
    1 -- DIF1
    2 -- DIF2
    3 -- DIF3
    4 -- DIF4
    5 -- DIF5
    6 -- DIF6
    7 -- DIF7

maintainers:
  - Marek Vasut <marex@denx.de>

properties:
  compatible:
    enum:
      - renesas,9fgv0241
      - renesas,9fgv0441
      - renesas,9fgv0841

  reg:
    description: I2C device address
    enum: [ 0x68, 0x6a ]

  '#clock-cells':
    const: 1

  clocks:
    items:
      - description: XTal input clock

  renesas,out-amplitude-microvolt:
    enum: [ 600000, 700000, 800000, 900000 ]
    description: Output clock signal amplitude

  renesas,out-spread-spectrum:
    $ref: /schemas/types.yaml#/definitions/uint32
    enum: [ 100000, 99750, 99500 ]
    description: Output clock down spread in pcm (1/1000 of percent)

patternProperties:
  "^DIF[0-19]$":
    type: object
    description:
      Description of one of the outputs (DIF0..DIF19).

    properties:
      renesas,slew-rate:
        $ref: /schemas/types.yaml#/definitions/uint32
        enum: [ 2000000, 3000000 ]
        description: Output clock slew rate select in V/ns

    additionalProperties: false

required:
  - compatible
  - reg
  - clocks
  - '#clock-cells'

additionalProperties: false

examples:
  - |
    /* 25MHz reference crystal */
    ref25: ref25m {
        compatible = "fixed-clock";
        #clock-cells = <0>;
        clock-frequency = <25000000>;
    };

    i2c@0 {
        reg = <0x0 0x100>;
        #address-cells = <1>;
        #size-cells = <0>;

        rs9: clock-generator@6a {
            compatible = "renesas,9fgv0241";
            reg = <0x6a>;
            #clock-cells = <1>;

            clocks = <&ref25m>;

            DIF0 {
                renesas,slew-rate = <3000000>;
            };
        };
    };

...
```

## Documentation/devicetree/bindings/clock/renesas,cpg-clocks.yaml
```yaml
# SPDX-License-Identifier: (GPL-2.0-only OR BSD-2-Clause)
%YAML 1.2
---
$id: http://devicetree.org/schemas/clock/renesas,cpg-clocks.yaml#
$schema: http://devicetree.org/meta-schemas/core.yaml#

title: Renesas Clock Pulse Generator (CPG)

maintainers:
  - Geert Uytterhoeven <geert+renesas@glider.be>

description:
  The Clock Pulse Generator (CPG) generates core clocks for the SoC.  It
  includes PLLs, and fixed and variable ratio dividers.

  The CPG may also provide a Clock Domain for SoC devices, in combination with
  the CPG Module Stop (MSTP) Clocks.

properties:
  compatible:
    oneOf:
      - const: renesas,r8a73a4-cpg-clocks     # R-Mobile APE6
      - const: renesas,r8a7740-cpg-clocks     # R-Mobile A1
      - const: renesas,r8a7778-cpg-clocks     # R-Car M1
      - const: renesas,r8a7779-cpg-clocks     # R-Car H1
      - items:
          - enum:
              - renesas,r7s72100-cpg-clocks   # RZ/A1H
          - const: renesas,rz-cpg-clocks      # RZ/A1
      - const: renesas,sh73a0-cpg-clocks      # SH-Mobile AG5

  reg:
    maxItems: 1

  clocks:
    minItems: 1
    maxItems: 3

  '#clock-cells':
    const: 1

  clock-output-names:
    minItems: 3
    maxItems: 17

  renesas,mode:
    description: Board-specific settings of the MD_CK* bits on R-Mobile A1
    $ref: /schemas/types.yaml#/definitions/uint32
    minimum: 0
    maximum: 7

  '#power-domain-cells':
    const: 0

required:
  - compatible
  - reg
  - clocks
  - '#clock-cells'
  - clock-output-names

allOf:
  - if:
      properties:
        compatible:
          contains:
            const: renesas,r8a73a4-cpg-clocks
    then:
      properties:
        clocks:
          items:
            - description: extal1
            - description: extal2

        clock-output-names:
          items:
            - const: main
            - const: pll0
            - const: pll1
            - const: pll2
            - const: pll2s
            - const: pll2h
            - const: z
            - const: z2
            - const: i
            - const: m3
            - const: b
            - const: m1
            - const: m2
            - const: zx
            - const: zs
            - const: hp

  - if:
      properties:
        compatible:
          contains:
            const: renesas,r8a7740-cpg-clocks
    then:
      properties:
        clocks:
          items:
            - description: extal1
            - description: extal2
            - description: extalr

        clock-output-names:
          items:
            - const: system
            - const: pllc0
            - const: pllc1
            - const: pllc2
            - const: r
            - const: usb24s
            - const: i
            - const: zg
            - const: b
            - const: m1
            - const: hp
            - const: hpp
            - const: usbp
            - const: s
            - const: zb
            - const: m3
            - const: cp

      required:
        - renesas,mode

  - if:
      properties:
        compatible:
          contains:
            const: renesas,r8a7778-cpg-clocks
    then:
      properties:
        clocks:
          maxItems: 1

        clock-output-names:
          items:
            - const: plla
            - const: pllb
            - const: b
            - const: out
            - const: p
            - const: s
            - const: s1

  - if:
      properties:
        compatible:
          contains:
            const: renesas,r8a7779-cpg-clocks
    then:
      properties:
        clocks:
          maxItems: 1

        clock-output-names:
          items:
            - const: plla
            - const: z
            - const: zs
            - const: s
            - const: s1
            - const: p
            - const: b
            - const: out

  - if:
      properties:
        compatible:
          contains:
            const: renesas,r7s72100-cpg-clocks
    then:
      properties:
        clocks:
          items:
            - description: extal1
            - description: usb_x1

        clock-output-names:
          items:
            - const: pll
            - const: i
            - const: g

  - if:
      properties:
        compatible:
          contains:
            const: renesas,sh73a0-cpg-clocks
    then:
      properties:
        clocks:
          items:
            - description: extal1
            - description: extal2

        clock-output-names:
          items:
            - const: main
            - const: pll0
            - const: pll1
            - const: pll2
            - const: pll3
            - const: dsi0phy
            - const: dsi1phy
            - const: zg
            - const: m3
            - const: b
            - const: m1
            - const: m2
            - const: z
            - const: zx
            - const: hp

  - if:
      properties:
        compatible:
          contains:
            enum:
              - renesas,r8a7778-cpg-clocks
              - renesas,r8a7779-cpg-clocks
              - renesas,rz-cpg-clocks
    then:
      required:
        - '#power-domain-cells'

additionalProperties: false

examples:
  - |
    #include <dt-bindings/clock/r8a7740-clock.h>
    cpg_clocks: cpg_clocks@e6150000 {
            compatible = "renesas,r8a7740-cpg-clocks";
            reg = <0xe6150000 0x10000>;
            clocks = <&extal1_clk>, <&extal2_clk>, <&extalr_clk>;
            #clock-cells = <1>;
            clock-output-names = "system", "pllc0", "pllc1", "pllc2", "r",
                                 "usb24s", "i", "zg", "b", "m1", "hp", "hpp",
                                 "usbp", "s", "zb", "m3", "cp";
            renesas,mode = <0x05>;
    };
```

## Documentation/devicetree/bindings/clock/renesas,cpg-div6-clock.yaml
```yaml
# SPDX-License-Identifier: (GPL-2.0-only OR BSD-2-Clause)
%YAML 1.2
---
$id: http://devicetree.org/schemas/clock/renesas,cpg-div6-clock.yaml#
$schema: http://devicetree.org/meta-schemas/core.yaml#

title: Renesas CPG DIV6 Clock

maintainers:
  - Geert Uytterhoeven <geert+renesas@glider.be>

description:
  The CPG DIV6 clocks are variable factor clocks provided by the Clock Pulse
  Generator (CPG). Their clock input is divided by a configurable factor from 1
  to 64.

properties:
  compatible:
    items:
      - enum:
          - renesas,r8a73a4-div6-clock # R-Mobile APE6
          - renesas,r8a7740-div6-clock # R-Mobile A1
          - renesas,sh73a0-div6-clock  # SH-Mobile AG5
      - const: renesas,cpg-div6-clock

  reg:
    maxItems: 1

  clocks:
    oneOf:
      - maxItems: 1
      - maxItems: 4
      - maxItems: 8
    description:
      For clocks with multiple parents, invalid settings must be specified as
      "<0>".

  '#clock-cells':
    const: 0

  clock-output-names: true

required:
  - compatible
  - reg
  - clocks
  - '#clock-cells'

additionalProperties: false

examples:
  - |
    #include <dt-bindings/clock/r8a73a4-clock.h>

    cpg_clocks: cpg_clocks@e6150000 {
            compatible = "renesas,r8a73a4-cpg-clocks";
            reg = <0xe6150000 0x10000>;
            clocks = <&extal1_clk>, <&extal2_clk>;
            #clock-cells = <1>;
            clock-output-names = "main", "pll0", "pll1", "pll2",
                                  "pll2s", "pll2h", "z", "z2",
                                  "i", "m3", "b", "m1", "m2",
                                  "zx", "zs", "hp";
    };

    sdhi2_clk: sdhi2_clk@e615007c {
            compatible = "renesas,r8a73a4-div6-clock", "renesas,cpg-div6-clock";
            reg = <0xe615007c 4>;
            clocks = <&pll1_div2_clk>, <&cpg_clocks R8A73A4_CLK_PLL2S>, <0>,
                     <&extal2_clk>;
            #clock-cells = <0>;
    };
```

## Documentation/devicetree/bindings/clock/renesas,cpg-div6-clocks.txt
```
* Renesas CPG DIV6 Clock

The CPG DIV6 clocks are variable factor clocks provided by the Clock Pulse
Generator (CPG). Their clock input is divided by a configurable factor from 1
to 64.

Required Properties:

  - compatible: Must be one of the following
    - "renesas,r8a73a4-div6-clock" for R8A73A4 (R-Mobile APE6) DIV6 clocks
    - "renesas,r8a7740-div6-clock" for R8A7740 (R-Mobile A1) DIV6 clocks
    - "renesas,r8a7790-div6-clock" for R8A7790 (R-Car H2) DIV6 clocks
    - "renesas,r8a7791-div6-clock" for R8A7791 (R-Car M2-W) DIV6 clocks
    - "renesas,r8a7793-div6-clock" for R8A7793 (R-Car M2-N) DIV6 clocks
    - "renesas,r8a7794-div6-clock" for R8A7794 (R-Car E2) DIV6 clocks
    - "renesas,sh73a0-div6-clock" for SH73A0 (SH-Mobile AG5) DIV6 clocks
    and "renesas,cpg-div6-clock" as a fallback.
  - reg: Base address and length of the memory resource used by the DIV6 clock
  - clocks: Reference to the parent clock(s); either one, four, or eight
    clocks must be specified.  For clocks with multiple parents, invalid
    settings must be specified as "<0>".
  - #clock-cells: Must be 0
  - clock-output-names: The name of the clock as a free-form string


Example
-------

	sdhi2_clk: sdhi2_clk@e615007c {
		compatible = "renesas,r8a73a4-div6-clock", "renesas,cpg-div6-clock";
		reg = <0 0xe615007c 0 4>;
		clocks = <&pll1_div2_clk>, <&cpg_clocks R8A73A4_CLK_PLL2S>,
			 <0>, <&extal2_clk>;
		#clock-cells = <0>;
		clock-output-names = "sdhi2ck";
	};
```
