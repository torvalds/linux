## Documentation/devicetree/bindings/clock/idt,versaclock5.yaml
```yaml
# SPDX-License-Identifier: (GPL-2.0-only OR BSD-2-Clause)
%YAML 1.2
---
$id: http://devicetree.org/schemas/clock/idt,versaclock5.yaml#
$schema: http://devicetree.org/meta-schemas/core.yaml#

title: IDT VersaClock 5 and 6 programmable I2C clock generators

description: |
  The IDT VersaClock 5 and VersaClock 6 are programmable I2C
  clock generators providing from 3 to 12 output clocks.

  When referencing the provided clock in the DT using phandle and clock
  specifier, the following mapping applies:

  - 5P49V5923:
    0 -- OUT0_SEL_I2CB
    1 -- OUT1
    2 -- OUT2

  - 5P49V5933:
    0 -- OUT0_SEL_I2CB
    1 -- OUT1
    2 -- OUT4

  - other parts:
    0 -- OUT0_SEL_I2CB
    1 -- OUT1
    2 -- OUT2
    3 -- OUT3
    4 -- OUT4

  The idt,shutdown and idt,output-enable-active properties control the
  SH (en_global_shutdown) and SP bits of the Primary Source and Shutdown
  Register, respectively. Their behavior is summarized by the following
  table:

  SH SP Output when the SD/OE pin is Low/High
  == == =====================================
   0  0 Active/Inactive
   0  1 Inactive/Active
   1  0 Active/Shutdown
   1  1 Inactive/Shutdown

  The case where SH and SP are both 1 is likely not very interesting.

maintainers:
  - Luca Ceresoli <luca.ceresoli@bootlin.com>

properties:
  compatible:
    enum:
      - idt,5p49v5923
      - idt,5p49v5925
      - idt,5p49v5933
      - idt,5p49v5935
      - idt,5p49v6901
      - idt,5p49v6965
      - idt,5p49v6975

  reg:
    description: I2C device address
    enum: [ 0x68, 0x6a ]

  '#clock-cells':
    const: 1

  clock-names:
    minItems: 1
    maxItems: 2
    items:
      enum: [ xin, clkin ]
  clocks:
    minItems: 1
    maxItems: 2

  idt,xtal-load-femtofarads:
    minimum: 9000
    maximum: 22760
    description: Optional load capacitor for XTAL1 and XTAL2

  idt,shutdown:
    $ref: /schemas/types.yaml#/definitions/uint32
    enum: [0, 1]
    description: |
      If 1, this enables the shutdown functionality: the chip will be
      shut down if the SD/OE pin is driven high. If 0, this disables the
      shutdown functionality: the chip will never be shut down based on
      the value of the SD/OE pin. This property corresponds to the SH
      bit of the Primary Source and Shutdown Register.

  idt,output-enable-active:
    $ref: /schemas/types.yaml#/definitions/uint32
    enum: [0, 1]
    description: |
      If 1, this enables output when the SD/OE pin is high, and disables
      output when the SD/OE pin is low. If 0, this disables output when
      the SD/OE pin is high, and enables output when the SD/OE pin is
      low. This corresponds to the SP bit of the Primary Source and
      Shutdown Register.

patternProperties:
  "^OUT[1-4]$":
    type: object
    description:
      Description of one of the outputs (OUT1..OUT4). See "Clock1 Output
      Configuration" in the Versaclock 5/6/6E Family Register Description
      and Programming Guide.
    properties:
      idt,mode:
        description:
          The output drive mode. Values defined in dt-bindings/clock/versaclock.h
        $ref: /schemas/types.yaml#/definitions/uint32
        minimum: 0
        maximum: 6
      idt,voltage-microvolt:
        description: The output drive voltage.
        enum: [ 1800000, 2500000, 3300000 ]
      idt,slew-percent:
        description: The Slew rate control for CMOS single-ended.
        enum: [ 80, 85, 90, 100 ]
    additionalProperties: false

required:
  - compatible
  - reg
  - '#clock-cells'
  - idt,shutdown
  - idt,output-enable-active

allOf:
  - if:
      properties:
        compatible:
          enum:
            - idt,5p49v5933
            - idt,5p49v5935
            - idt,5p49v6975
    then:
      # Devices with builtin crystal + optional external input
      properties:
        clock-names:
          const: clkin
        clocks:
          maxItems: 1
    else:
      # Devices without builtin crystal
      required:
        - clock-names
        - clocks

additionalProperties: false

examples:
  - |
    #include <dt-bindings/clock/versaclock.h>

    /* 25MHz reference crystal */
    ref25: ref25m {
        compatible = "fixed-clock";
        #clock-cells = <0>;
        clock-frequency = <25000000>;
    };

    i2c@0 {
        reg = <0x0 0x100>;
        #address-cells = <1>;
        #size-cells = <0>;

        /* IDT 5P49V5923 I2C clock generator */
        vc5: clock-generator@6a {
            compatible = "idt,5p49v5923";
            reg = <0x6a>;
            #clock-cells = <1>;

            /* Connect XIN input to 25MHz reference */
            clocks = <&ref25m>;
            clock-names = "xin";

            /* Set the SD/OE pin's settings */
            idt,shutdown = <0>;
            idt,output-enable-active = <0>;

            OUT1 {
                idt,mode = <VC5_CMOSD>;
                idt,voltage-microvolt = <1800000>;
                idt,slew-percent = <80>;
            };

            OUT4 {
                idt,mode = <VC5_LVDS>;
            };
        };
    };

...
```

## Documentation/devicetree/bindings/clock/img,boston-clock.txt
```
Binding for Imagination Technologies MIPS Boston clock sources.

This binding uses the common clock binding[1].

[1] Documentation/devicetree/bindings/clock/clock-bindings.txt

The device node must be a child node of the syscon node corresponding to the
Boston system's platform registers.

Required properties:
- compatible : Should be "img,boston-clock".
- #clock-cells : Should be set to 1.
  Values available for clock consumers can be found in the header file:
    <dt-bindings/clock/boston-clock.h>

Example:

	system-controller@17ffd000 {
		compatible = "img,boston-platform-regs", "syscon";
		reg = <0x17ffd000 0x1000>;

		clk_boston: clock {
			compatible = "img,boston-clock";
			#clock-cells = <1>;
		};
	};

	uart0: uart@17ffe000 {
		/* ... */
		clocks = <&clk_boston BOSTON_CLK_SYS>;
	};
```

## Documentation/devicetree/bindings/clock/img,pistachio-clk.yaml
```yaml
# SPDX-License-Identifier: (GPL-2.0-only OR BSD-2-Clause)
%YAML 1.2
---
$id: http://devicetree.org/schemas/clock/img,pistachio-clk.yaml#
$schema: http://devicetree.org/meta-schemas/core.yaml#

title: Imagination Technologies Pistachio SoC clock controllers

maintainers:
  - Andrew Bresticker <abrestic@chromium.org>

description: |
  Pistachio has four clock controllers (core clock, peripheral clock, peripheral
  general control, and top general control) which are instantiated individually
  from the device-tree.

  Core clock controller:

  The core clock controller generates clocks for the CPU, RPU (WiFi + BT
  co-processor), audio, and several peripherals.

  Peripheral clock controller:

  The peripheral clock controller generates clocks for the DDR, ROM, and other
  peripherals. The peripheral system clock ("periph_sys") generated by the core
  clock controller is the input clock to the peripheral clock controller.

  Peripheral general control:

  The peripheral general control block generates system interface clocks and
  resets for various peripherals. It also contains miscellaneous peripheral
  control registers.

  Top-level general control:

  The top-level general control block contains miscellaneous control registers
  and gates for the external clocks "audio_clk_in" and "enet_clk_in".

properties:
  compatible:
    items:
      - enum:
          - img,pistachio-clk
          - img,pistachio-clk-periph
          - img,pistachio-cr-periph
          - img,pistachio-cr-top

  reg:
    maxItems: 1

  '#clock-cells':
    const: 1

  clocks:
    minItems: 1
    maxItems: 3

  clock-names:
    minItems: 1
    maxItems: 3

required:
  - compatible
  - reg
  - '#clock-cells'
  - clocks
  - clock-names

allOf:
  - if:
      properties:
        compatible:
          contains:
            const: img,pistachio-clk
    then:
      properties:
        clocks:
          items:
            - description: External 52Mhz oscillator
            - description: Alternate audio reference clock
            - description: Alternate ethernet PHY clock

        clock-names:
          items:
            - const: xtal
            - const: audio_refclk_ext_gate
            - const: ext_enet_in_gate

  - if:
      properties:
        compatible:
          contains:
            const: img,pistachio-clk-periph
    then:
      properties:
        clocks:
          items:
            - description: Peripheral system clock

        clock-names:
          items:
            - const: periph_sys_core

  - if:
      properties:
        compatible:
          contains:
            const: img,pistachio-cr-periph
    then:
      properties:
        clocks:
          items:
            - description: System interface clock

        clock-names:
          items:
            - const: sys

  - if:
      properties:
        compatible:
          contains:
            const: img,pistachio-cr-top
    then:
      properties:
        clocks:
          items:
            - description: External audio reference clock
            - description: External ethernet PHY clock

        clock-names:
          items:
            - const: audio_clk_in
            - const: enet_clk_in

additionalProperties: false
```

## Documentation/devicetree/bindings/clock/imx1-clock.txt
```
* Clock bindings for Freescale i.MX1 CPUs

Required properties:
- compatible: Should be "fsl,imx1-ccm".
- reg: Address and length of the register set.
- #clock-cells: Should be <1>.

The clock consumer should specify the desired clock by having the clock
ID in its "clocks" phandle cell. See include/dt-bindings/clock/imx1-clock.h
for the full list of i.MX1 clock IDs.

Examples:
	clks: ccm@0021b000 {
		#clock-cells = <1>;
		compatible = "fsl,imx1-ccm";
		reg = <0x0021b000 0x1000>;
	};

	pwm: pwm@00208000 {
		#pwm-cells = <2>;
		compatible = "fsl,imx1-pwm";
		reg = <0x00208000 0x1000>;
		interrupts = <34>;
		clocks = <&clks IMX1_CLK_DUMMY>, <&clks IMX1_CLK_PER1>;
		clock-names = "ipg", "per";
	};
```

## Documentation/devicetree/bindings/clock/imx1-clock.yaml
```yaml
# SPDX-License-Identifier: (GPL-2.0-only OR BSD-2-Clause)
%YAML 1.2
---
$id: http://devicetree.org/schemas/clock/imx1-clock.yaml#
$schema: http://devicetree.org/meta-schemas/core.yaml#

title: Freescale i.MX1 CPUs Clock Controller

maintainers:
  - Alexander Shiyan <shc_work@mail.ru>

description: |
  The clock consumer should specify the desired clock by having the clock
  ID in its "clocks" phandle cell. See include/dt-bindings/clock/imx1-clock.h
  for the full list of i.MX1 clock IDs.

properties:
  compatible:
    const: fsl,imx1-ccm

  reg:
    maxItems: 1

  '#clock-cells':
    const: 1

required:
  - compatible
  - reg
  - '#clock-cells'

additionalProperties: false

examples:
  - |
    #include <dt-bindings/clock/imx1-clock.h>

    clock-controller@21b000 {
        #clock-cells = <1>;
        compatible = "fsl,imx1-ccm";
        reg = <0x0021b000 0x1000>;
    };
```

## Documentation/devicetree/bindings/clock/imx21-clock.txt
```
* Clock bindings for Freescale i.MX21

Required properties:
- compatible  : Should be "fsl,imx21-ccm".
- reg         : Address and length of the register set.
- interrupts  : Should contain CCM interrupt.
- #clock-cells: Should be <1>.

The clock consumer should specify the desired clock by having the clock
ID in its "clocks" phandle cell. See include/dt-bindings/clock/imx21-clock.h
for the full list of i.MX21 clock IDs.

Examples:
	clks: ccm@10027000{
		compatible = "fsl,imx21-ccm";
		reg = <0x10027000 0x800>;
		#clock-cells = <1>;
	};

	uart1: serial@1000a000 {
		compatible = "fsl,imx21-uart";
		reg = <0x1000a000 0x1000>;
		interrupts = <20>;
		clocks = <&clks IMX21_CLK_UART1_IPG_GATE>,
			 <&clks IMX21_CLK_PER1>;
		clock-names = "ipg", "per";
	};
```

## Documentation/devicetree/bindings/clock/imx21-clock.yaml
```yaml
# SPDX-License-Identifier: (GPL-2.0-only OR BSD-2-Clause)
%YAML 1.2
---
$id: http://devicetree.org/schemas/clock/imx21-clock.yaml#
$schema: http://devicetree.org/meta-schemas/core.yaml#

title: Freescale i.MX21 Clock Controller

maintainers:
  - Alexander Shiyan <shc_work@mail.ru>

description: |
  The clock consumer should specify the desired clock by having the clock
  ID in its "clocks" phandle cell. See include/dt-bindings/clock/imx21-clock.h
  for the full list of i.MX21 clock IDs.

properties:
  compatible:
    const: fsl,imx21-ccm

  reg:
    maxItems: 1

  '#clock-cells':
    const: 1

required:
  - compatible
  - reg
  - '#clock-cells'

additionalProperties: false

examples:
  - |
    #include <dt-bindings/clock/imx21-clock.h>

    clock-controller@10027000 {
        compatible = "fsl,imx21-ccm";
        reg = <0x10027000 0x800>;
        #clock-cells = <1>;
    };
```

## Documentation/devicetree/bindings/clock/imx23-clock.txt
```
* Clock bindings for Freescale i.MX23

Required properties:
- compatible: Should be "fsl,imx23-clkctrl"
- reg: Address and length of the register set
- #clock-cells: Should be <1>

The clock consumer should specify the desired clock by having the clock
ID in its "clocks" phandle cell.  The following is a full list of i.MX23
clocks and IDs.

	Clock		ID
	------------------
	ref_xtal	0
	pll		1
	ref_cpu		2
	ref_emi		3
	ref_pix		4
	ref_io		5
	saif_sel	6
	lcdif_sel	7
	gpmi_sel	8
	ssp_sel		9
	emi_sel		10
	cpu		11
	etm_sel		12
	cpu_pll		13
	cpu_xtal	14
	hbus		15
	xbus		16
	lcdif_div	17
	ssp_div		18
	gpmi_div	19
	emi_pll		20
	emi_xtal	21
	etm_div		22
	saif_div	23
	clk32k_div	24
	rtc		25
	adc		26
	spdif_div	27
	clk32k		28
	dri		29
	pwm		30
	filt		31
	uart		32
	ssp		33
	gpmi		34
	spdif		35
	emi		36
	saif		37
	lcdif		38
	etm		39
	usb		40
	usb_pwr		41

Examples:

clks: clkctrl@80040000 {
	compatible = "fsl,imx23-clkctrl";
	reg = <0x80040000 0x2000>;
	#clock-cells = <1>;
	clock-output-names =
		...
		"uart",		/* 32 */
		...
		"end_of_list";
};

auart0: serial@8006c000 {
	compatible = "fsl,imx23-auart";
	reg = <0x8006c000 0x2000>;
	interrupts = <24 25 23>;
	clocks = <&clks 32>;
	status = "disabled";
};
```

## Documentation/devicetree/bindings/clock/imx23-clock.yaml
```yaml
# SPDX-License-Identifier: (GPL-2.0-only OR BSD-2-Clause)
%YAML 1.2
---
$id: http://devicetree.org/schemas/clock/imx23-clock.yaml#
$schema: http://devicetree.org/meta-schemas/core.yaml#

title: Clock bindings for Freescale i.MX23

maintainers:
  - Shawn Guo <shawn.guo@linaro.org>

description: |
  The clock consumer should specify the desired clock by having the clock
  ID in its "clocks" phandle cell. The following is a full list of i.MX23
  clocks and IDs.

        Clock		ID
        ------------------
        ref_xtal	0
        pll		1
        ref_cpu		2
        ref_emi		3
        ref_pix		4
        ref_io		5
        saif_sel	6
        lcdif_sel	7
        gpmi_sel	8
        ssp_sel		9
        emi_sel		10
        cpu		11
        etm_sel		12
        cpu_pll		13
        cpu_xtal	14
        hbus		15
        xbus		16
        lcdif_div	17
        ssp_div		18
        gpmi_div	19
        emi_pll		20
        emi_xtal	21
        etm_div		22
        saif_div	23
        clk32k_div	24
        rtc		25
        adc		26
        spdif_div	27
        clk32k		28
        dri		29
        pwm		30
        filt		31
        uart		32
        ssp		33
        gpmi		34
        spdif		35
        emi		36
        saif		37
        lcdif		38
        etm		39
        usb		40
        usb_phy		41

properties:
  compatible:
    const: fsl,imx23-clkctrl

  reg:
    maxItems: 1

  '#clock-cells':
    const: 1

required:
  - compatible
  - reg
  - '#clock-cells'

additionalProperties: false

examples:
  - |
    clock-controller@80040000 {
        compatible = "fsl,imx23-clkctrl";
        reg = <0x80040000 0x2000>;
        #clock-cells = <1>;
    };

    serial@8006c000 {
        compatible = "fsl,imx23-auart";
        reg = <0x8006c000 0x2000>;
        interrupts = <24 25 23>;
        clocks = <&clks 32>;
    };
```
