## Documentation/devicetree/bindings/clock/hi3620-clock.txt
```
* Hisilicon Hi3620 Clock Controller

The Hi3620 clock controller generates and supplies clock to various
controllers within the Hi3620 SoC.

Required Properties:

- compatible: should be one of the following.
  - "hisilicon,hi3620-clock" - controller compatible with Hi3620 SoC.
  - "hisilicon,hi3620-mmc-clock" - controller specific for Hi3620 mmc.

- reg: physical base address of the controller and length of memory mapped
  region.

- #clock-cells: should be 1.

Each clock is assigned an identifier and client nodes use this identifier
to specify the clock which they consume.

All these identifier could be found in <dt-bindings/clock/hi3620-clock.h>.
```

## Documentation/devicetree/bindings/clock/hi3660-clock.txt
```
* Hisilicon Hi3660 Clock Controller

The Hi3660 clock controller generates and supplies clock to various
controllers within the Hi3660 SoC.

Required Properties:

- compatible: the compatible should be one of the following strings to
	indicate the clock controller functionality.

	- "hisilicon,hi3660-crgctrl"
	- "hisilicon,hi3660-pctrl"
	- "hisilicon,hi3660-pmuctrl"
	- "hisilicon,hi3660-sctrl"
	- "hisilicon,hi3660-iomcu"
	- "hisilicon,hi3660-stub-clk"

- reg: physical base address of the controller and length of memory mapped
  region.

- #clock-cells: should be 1.

Optional Properties:

- mboxes: Phandle to the mailbox for sending message to MCU.
            (See: ../mailbox/hisilicon,hi3660-mailbox.txt for more info)

Each clock is assigned an identifier and client nodes use this identifier
to specify the clock which they consume.

All these identifier could be found in <dt-bindings/clock/hi3660-clock.h>.

Examples:
	crg_ctrl: clock-controller@fff35000 {
		compatible = "hisilicon,hi3660-crgctrl", "syscon";
		reg = <0x0 0xfff35000 0x0 0x1000>;
		#clock-cells = <1>;
	};

	uart0: serial@fdf02000 {
		compatible = "arm,pl011", "arm,primecell";
		reg = <0x0 0xfdf02000 0x0 0x1000>;
		interrupts = <GIC_SPI 74 IRQ_TYPE_LEVEL_HIGH>;
		clocks = <&crg_ctrl HI3660_CLK_MUX_UART0>,
			 <&crg_ctrl HI3660_PCLK>;
		clock-names = "uartclk", "apb_pclk";
	};
```

## Documentation/devicetree/bindings/clock/hi3670-clock.txt
```
* Hisilicon Hi3670 Clock Controller

The Hi3670 clock controller generates and supplies clock to various
controllers within the Hi3670 SoC.

Required Properties:

- compatible: the compatible should be one of the following strings to
	indicate the clock controller functionality.

	- "hisilicon,hi3670-crgctrl"
	- "hisilicon,hi3670-pctrl"
	- "hisilicon,hi3670-pmuctrl"
	- "hisilicon,hi3670-sctrl"
	- "hisilicon,hi3670-iomcu"
	- "hisilicon,hi3670-media1-crg"
	- "hisilicon,hi3670-media2-crg"

- reg: physical base address of the controller and length of memory mapped
  region.

- #clock-cells: should be 1.

Each clock is assigned an identifier and client nodes use this identifier
to specify the clock which they consume.

All these identifier could be found in <dt-bindings/clock/hi3670-clock.h>.

Examples:
	crg_ctrl: clock-controller@fff35000 {
		compatible = "hisilicon,hi3670-crgctrl", "syscon";
		reg = <0x0 0xfff35000 0x0 0x1000>;
		#clock-cells = <1>;
	};

	uart0: serial@fdf02000 {
		compatible = "arm,pl011", "arm,primecell";
		reg = <0x0 0xfdf02000 0x0 0x1000>;
		interrupts = <GIC_SPI 74 IRQ_TYPE_LEVEL_HIGH>;
		clocks = <&crg_ctrl HI3670_CLK_GATE_UART0>,
			 <&crg_ctrl HI3670_PCLK>;
		clock-names = "uartclk", "apb_pclk";
	};
```

## Documentation/devicetree/bindings/clock/hi3716.txt
```
Device Tree Clock bindings for hi3716

This binding uses the common clock binding[1].

[1] Documentation/devicetree/bindings/clock/clock-bindings.txt

Clock control register
Required properties:
- compatible : "hisilicon,clkbase"
- reg : Address and size of clkbase.

Device Clocks

Device clocks are required to have one or both of the following sets of
properties:


Gated device clocks:

Required properties:
- compatible : "hisilicon,hi3716-clk-gate"
- gate-reg : shall be the register offset from clkbase and enable bit, reset bit
- clock-output-names : shall be reference name


Mux device clocks:

Required properties:
- compatible : "hisilicon,hi3716-clk-mux"
- mux-reg : shall be the register offset from clkbase and mux_shift mux_width
- mux-table : shall be reg value to be choose clocks accordingly
- clock-output-names : shall be reference name


Fixed divisor device clocks:

Required properties:
- compatible : "hisilicon,hi3716-fixed-divider"
- div-table : shall be divisor sequence
- clock-output-names : shall be reference name according to divisor


Fixed pll clocks:

Required properties:
- compatible : "hisilicon,hi3716-fixed-pll"
- clock-frequency : shall be output clock frequence sequence
- clock-output-names : shall be reference name according to clock-frequnce

For example:
	clkbase@f8a22000 {
		compatible = "hisilicon,clkbase";
		reg = <0xf8a22000 0x1000>;
	};

	osc24m: osc {
		compatible = "fixed-clock";
		#clock-cells = <0>;
		clock-frequency = <24000000>;
		clock-output-names = "osc24mhz";
	};

	bpll: bpll {
		compatible = "hisilicon,hi3716-fixed-pll";
		#clock-cells = <1>;
		clocks = <&osc24m>;
		clock-frequency = <1200000000>,
				  <600000000>,
				  <300000000>,
				  <200000000>,
				  <150000000>;
		clock-output-names = "bpll_fout0",
				     "bpll_fout1",
				     "bpll_fout2",
				     "bpll_fout3",
				     "bpll_fout4";
	};

	bpll_fout0_div: bpll_fout0_div {/* 1200Mhz */
		compatible = "hisilicon,hi3716-fixed-divider";
		#clock-cells = <1>;
		clocks = <&bpll 0>;
		div-table = <3 14 25 50>;
		clock-output-names = "fout0_400m", "fout0_86m",
					"fout0_48m", "fout0_24m";
	};

	bpll_fout3_div: bpll_fout3_div {
		compatible = "hisilicon,hi3716-fixed-divider";
		#clock-cells = <1>;
		clocks = <&bpll 3>;
		div-table = <2 4 5 8>;
		clock-output-names = "fout3_100m", "fout3_50m",
					"fout3_40m", "fout3_25m";
	};

	clk_sfc_mux: clk_sfc_mux {
		compatible = "hisilicon,hi3716-clk-mux";
		#clock-cells = <0>;
		/* clks: 24M 75M 100M 150M 200M */
		clocks = <&osc24m>, <&bpll_fout2_div>,
		       <&bpll_fout3_div 0>, <&bpll 4>, <&bpll 3>;

		/* offset mux_shift mux_width */
		mux-reg = <0x5c 8 3>;
		/* mux reg value to choose clks */
		mux-table = <0 7 6 4 5>;

		clock-output-names = "sfc_mux";
	};

	clk_sfc: clk_sfc {
		compatible = "hisilicon,hi3716-clk-gate";
		#clock-cells = <0>;
		clocks = <&clk_sfc_mux>;

		/* offset, enable, reset */
		gate-reg = <0x5c 0 4>;

		clock-output-names = "sfc";
	};
```

## Documentation/devicetree/bindings/clock/hi6220-clock.txt
```
* Hisilicon Hi6220 Clock Controller

Clock control registers reside in different Hi6220 system controllers,
please refer the following document to know more about the binding rules
for these system controllers:

Documentation/devicetree/bindings/arm/hisilicon/hisilicon.txt

Required Properties:

- compatible: the compatible should be one of the following strings to
	indicate the clock controller functionality.

	- "hisilicon,hi6220-aoctrl"
	- "hisilicon,hi6220-sysctrl"
	- "hisilicon,hi6220-mediactrl"
	- "hisilicon,hi6220-pmctrl"
	- "hisilicon,hi6220-stub-clk"

- reg: physical base address of the controller and length of memory mapped
  region.

- #clock-cells: should be 1.

Optional Properties:

- hisilicon,hi6220-clk-sram: phandle to the syscon managing the SoC internal sram;
  the driver need use the sram to pass parameters for frequency change.

- mboxes: use the label reference for the mailbox as the first parameter, the
  second parameter is the channel number.

Example 1:
	sys_ctrl: sys_ctrl@f7030000 {
		compatible = "hisilicon,hi6220-sysctrl", "syscon";
		reg = <0x0 0xf7030000 0x0 0x2000>;
		#clock-cells = <1>;
	};

Example 2:
	stub_clock: stub_clock {
		compatible = "hisilicon,hi6220-stub-clk";
		hisilicon,hi6220-clk-sram = <&sram>;
		#clock-cells = <1>;
		mboxes = <&mailbox 1>;
	};

Each clock is assigned an identifier and client nodes use this identifier
to specify the clock which they consume.

All these identifier could be found in <dt-bindings/clock/hi6220-clock.h>.
```

## Documentation/devicetree/bindings/clock/hisilicon,hi3559av100-clock.yaml
```yaml
# SPDX-License-Identifier: (GPL-2.0-only OR BSD-2-Clause)
%YAML 1.2
---
$id: http://devicetree.org/schemas/clock/hisilicon,hi3559av100-clock.yaml#
$schema: http://devicetree.org/meta-schemas/core.yaml#

title: Hisilicon SOC Clock for HI3559AV100

maintainers:
  - Dongjiu Geng <gengdongjiu@huawei.com>

description: |
  Hisilicon SOC clock control module which supports the clocks, resets and
  power domains on HI3559AV100.

  See also:
    dt-bindings/clock/hi3559av100-clock.h

properties:
  compatible:
    enum:
      - hisilicon,hi3559av100-clock
      - hisilicon,hi3559av100-shub-clock

  reg:
    minItems: 1
    maxItems: 2

  '#clock-cells':
    const: 1

  '#reset-cells':
    const: 2
    description: |
      First cell is reset request register offset.
      Second cell is bit offset in reset request register.

required:
  - compatible
  - reg
  - '#clock-cells'
  - '#reset-cells'

additionalProperties: false

examples:
  - |
    soc {
        #address-cells = <2>;
        #size-cells = <2>;

        clock-controller@12010000 {
            compatible = "hisilicon,hi3559av100-clock";
            #clock-cells = <1>;
            #reset-cells = <2>;
            reg = <0x0 0x12010000 0x0 0x10000>;
        };
    };
...
```

## Documentation/devicetree/bindings/clock/hix5hd2-clock.txt
```
* Hisilicon Hix5hd2 Clock Controller

The hix5hd2 clock controller generates and supplies clock to various
controllers within the hix5hd2 SoC.

Required Properties:

- compatible: should be "hisilicon,hix5hd2-clock"
- reg: Address and length of the register set
- #clock-cells: Should be <1>

Each clock is assigned an identifier and client nodes use this identifier
to specify the clock which they consume.

All these identifier could be found in <dt-bindings/clock/hix5hd2-clock.h>.

Examples:
	clock: clock@f8a22000 {
		compatible = "hisilicon,hix5hd2-clock";
		reg = <0xf8a22000 0x1000>;
		#clock-cells = <1>;
	};

	uart0: uart@f8b00000 {
		compatible = "arm,pl011", "arm,primecell";
		reg = <0xf8b00000 0x1000>;
		interrupts = <0 49 4>;
		clocks = <&clock HIX5HD2_FIXED_83M>;
		clock-names = "apb_pclk";
		status = "disabled";
	};
```

## Documentation/devicetree/bindings/clock/idt,versaclock5.txt
```
Binding for IDT VersaClock 5,6 programmable i2c clock generators.

The IDT VersaClock 5 and VersaClock 6 are programmable i2c clock
generators providing from 3 to 12 output clocks.

==I2C device node==

Required properties:
- compatible:	shall be one of
		"idt,5p49v5923"
		"idt,5p49v5925"
		"idt,5p49v5933"
		"idt,5p49v5935"
		"idt,5p49v6901"
- reg:		i2c device address, shall be 0x68 or 0x6a.
- #clock-cells:	from common clock binding; shall be set to 1.
- clocks:	from common clock binding; list of parent clock handles,
		- 5p49v5923 and
		  5p49v5925 and
		  5p49v6901: (required) either or both of XTAL or CLKIN
					reference clock.
		- 5p49v5933 and
		- 5p49v5935: (optional) property not present (internal
					Xtal used) or CLKIN reference
					clock.
- clock-names:	from common clock binding; clock input names, can be
		- 5p49v5923 and
		  5p49v5925 and
		  5p49v6901: (required) either or both of "xin", "clkin".
		- 5p49v5933 and
		- 5p49v5935: (optional) property not present or "clkin".

==Mapping between clock specifier and physical pins==

When referencing the provided clock in the DT using phandle and
clock specifier, the following mapping applies:

5P49V5923:
	0 -- OUT0_SEL_I2CB
	1 -- OUT1
	2 -- OUT2

5P49V5933:
	0 -- OUT0_SEL_I2CB
	1 -- OUT1
	2 -- OUT4

5P49V5925 and
5P49V5935:
	0 -- OUT0_SEL_I2CB
	1 -- OUT1
	2 -- OUT2
	3 -- OUT3
	4 -- OUT4

5P49V6901:
	0 -- OUT0_SEL_I2CB
	1 -- OUT1
	2 -- OUT2
	3 -- OUT3
	4 -- OUT4

==Example==

/* 25MHz reference crystal */
ref25: ref25m {
	compatible = "fixed-clock";
	#clock-cells = <0>;
	clock-frequency = <25000000>;
};

i2c-master-node {

	/* IDT 5P49V5923 i2c clock generator */
	vc5: clock-generator@6a {
		compatible = "idt,5p49v5923";
		reg = <0x6a>;
		#clock-cells = <1>;

		/* Connect XIN input to 25MHz reference */
		clocks = <&ref25m>;
		clock-names = "xin";
	};
};

/* Consumer referencing the 5P49V5923 pin OUT1 */
consumer {
	...
	clocks = <&vc5 1>;
	...
}
```
