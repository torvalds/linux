## Documentation/devicetree/bindings/clock/imx25-clock.txt
```
* Clock bindings for Freescale i.MX25

Required properties:
- compatible: Should be "fsl,imx25-ccm"
- reg: Address and length of the register set
- interrupts: Should contain CCM interrupt
- #clock-cells: Should be <1>

The clock consumer should specify the desired clock by having the clock
ID in its "clocks" phandle cell.  The following is a full list of i.MX25
clocks and IDs.

	Clock			ID
	---------------------------
	dummy			0
	osc			1
	mpll			2
	upll			3
	mpll_cpu_3_4		4
	cpu_sel			5
	cpu			6
	ahb			7
	usb_div			8
	ipg			9
	per0_sel		10
	per1_sel		11
	per2_sel		12
	per3_sel		13
	per4_sel		14
	per5_sel		15
	per6_sel		16
	per7_sel		17
	per8_sel		18
	per9_sel		19
	per10_sel		20
	per11_sel		21
	per12_sel		22
	per13_sel		23
	per14_sel		24
	per15_sel		25
	per0			26
	per1			27
	per2			28
	per3			29
	per4			30
	per5			31
	per6			32
	per7			33
	per8			34
	per9			35
	per10			36
	per11			37
	per12			38
	per13			39
	per14			40
	per15			41
	csi_ipg_per		42
	epit_ipg_per		43
	esai_ipg_per		44
	esdhc1_ipg_per		45
	esdhc2_ipg_per		46
	gpt_ipg_per		47
	i2c_ipg_per		48
	lcdc_ipg_per		49
	nfc_ipg_per		50
	owire_ipg_per		51
	pwm_ipg_per		52
	sim1_ipg_per		53
	sim2_ipg_per		54
	ssi1_ipg_per		55
	ssi2_ipg_per		56
	uart_ipg_per		57
	ata_ahb			58
	reserved		59
	csi_ahb			60
	emi_ahb			61
	esai_ahb		62
	esdhc1_ahb		63
	esdhc2_ahb		64
	fec_ahb			65
	lcdc_ahb		66
	rtic_ahb		67
	sdma_ahb		68
	slcdc_ahb		69
	usbotg_ahb		70
	reserved		71
	reserved		72
	reserved		73
	reserved		74
	can1_ipg		75
	can2_ipg		76
	csi_ipg			77
	cspi1_ipg		78
	cspi2_ipg		79
	cspi3_ipg		80
	dryice_ipg		81
	ect_ipg			82
	epit1_ipg		83
	epit2_ipg		84
	reserved		85
	esdhc1_ipg		86
	esdhc2_ipg		87
	fec_ipg			88
	reserved		89
	reserved		90
	reserved		91
	gpt1_ipg		92
	gpt2_ipg		93
	gpt3_ipg		94
	gpt4_ipg		95
	reserved		96
	reserved		97
	reserved		98
	iim_ipg			99
	reserved		100
	reserved		101
	kpp_ipg			102
	lcdc_ipg		103
	reserved		104
	pwm1_ipg		105
	pwm2_ipg		106
	pwm3_ipg		107
	pwm4_ipg		108
	rngb_ipg		109
	reserved		110
	scc_ipg			111
	sdma_ipg		112
	sim1_ipg		113
	sim2_ipg		114
	slcdc_ipg		115
	spba_ipg		116
	ssi1_ipg		117
	ssi2_ipg		118
	tsc_ipg			119
	uart1_ipg		120
	uart2_ipg		121
	uart3_ipg		122
	uart4_ipg		123
	uart5_ipg		124
	reserved		125
	wdt_ipg			126
	cko_div			127
	cko_sel			128
	cko			129

Examples:

clks: ccm@53f80000 {
	compatible = "fsl,imx25-ccm";
	reg = <0x53f80000 0x4000>;
	interrupts = <31>;
};

uart1: serial@43f90000 {
	compatible = "fsl,imx25-uart", "fsl,imx21-uart";
	reg = <0x43f90000 0x4000>;
	interrupts = <45>;
	clocks = <&clks 79>, <&clks 50>;
	clock-names = "ipg", "per";
};
```

## Documentation/devicetree/bindings/clock/imx27-clock.txt
```
* Clock bindings for Freescale i.MX27

Required properties:
- compatible: Should be "fsl,imx27-ccm"
- reg: Address and length of the register set
- interrupts: Should contain CCM interrupt
- #clock-cells: Should be <1>

The clock consumer should specify the desired clock by having the clock
ID in its "clocks" phandle cell. See include/dt-bindings/clock/imx27-clock.h
for the full list of i.MX27 clock IDs.

Examples:
	clks: ccm@10027000{
		compatible = "fsl,imx27-ccm";
		reg = <0x10027000 0x1000>;
		#clock-cells = <1>;
	};

	uart1: serial@1000a000 {
		compatible = "fsl,imx27-uart", "fsl,imx21-uart";
		reg = <0x1000a000 0x1000>;
		interrupts = <20>;
		clocks = <&clks IMX27_CLK_UART1_IPG_GATE>,
			 <&clks IMX27_CLK_PER1_GATE>;
		clock-names = "ipg", "per";
		status = "disabled";
	};
```

## Documentation/devicetree/bindings/clock/imx27-clock.yaml
```yaml
# SPDX-License-Identifier: (GPL-2.0-only OR BSD-2-Clause)
%YAML 1.2
---
$id: http://devicetree.org/schemas/clock/imx27-clock.yaml#
$schema: http://devicetree.org/meta-schemas/core.yaml#

title: Freescale i.MX27 Clock Controller

maintainers:
  - Fabio Estevam <festevam@gmail.com>

description: |
  The clock consumer should specify the desired clock by having the clock
  ID in its "clocks" phandle cell. See include/dt-bindings/clock/imx27-clock.h
  for the full list of i.MX27 clock IDs.

properties:
  compatible:
    const: fsl,imx27-ccm

  reg:
    maxItems: 1

  interrupts:
    maxItems: 1

  '#clock-cells':
    const: 1

required:
  - compatible
  - reg
  - '#clock-cells'

additionalProperties: false

examples:
  - |
    #include <dt-bindings/clock/imx27-clock.h>

    clock-controller@10027000 {
        compatible = "fsl,imx27-ccm";
        reg = <0x10027000 0x1000>;
        interrupts = <31>;
        #clock-cells = <1>;
    };
```

## Documentation/devicetree/bindings/clock/imx28-clock.yaml
```yaml
# SPDX-License-Identifier: (GPL-2.0-only OR BSD-2-Clause)
%YAML 1.2
---
$id: http://devicetree.org/schemas/clock/imx28-clock.yaml#
$schema: http://devicetree.org/meta-schemas/core.yaml#

title: Clock bindings for Freescale i.MX28

maintainers:
  - Shawn Guo <shawnguo@kernel.org>

description: |
  The clock consumer should specify the desired clock by having the clock
  ID in its "clocks" phandle cell. The following is a full list of i.MX28
  clocks and IDs.

        Clock		ID
        ------------------
        ref_xtal	0
        pll0		1
        pll1		2
        pll2		3
        ref_cpu		4
        ref_emi		5
        ref_io0		6
        ref_io1		7
        ref_pix		8
        ref_hsadc	9
        ref_gpmi	10
        saif0_sel	11
        saif1_sel	12
        gpmi_sel	13
        ssp0_sel	14
        ssp1_sel	15
        ssp2_sel	16
        ssp3_sel	17
        emi_sel		18
        etm_sel		19
        lcdif_sel	20
        cpu		21
        ptp_sel		22
        cpu_pll		23
        cpu_xtal	24
        hbus		25
        xbus		26
        ssp0_div	27
        ssp1_div	28
        ssp2_div	29
        ssp3_div	30
        gpmi_div	31
        emi_pll		32
        emi_xtal	33
        lcdif_div	34
        etm_div		35
        ptp		36
        saif0_div	37
        saif1_div	38
        clk32k_div	39
        rtc		40
        lradc		41
        spdif_div	42
        clk32k		43
        pwm		44
        uart		45
        ssp0		46
        ssp1		47
        ssp2		48
        ssp3		49
        gpmi		50
        spdif		51
        emi		52
        saif0		53
        saif1		54
        lcdif		55
        etm		56
        fec		57
        can0		58
        can1		59
        usb0		60
        usb1		61
        usb0_phy	62
        usb1_phy	63
        enet_out	64

properties:
  compatible:
    const: fsl,imx28-clkctrl

  reg:
    maxItems: 1

  '#clock-cells':
    const: 1

required:
  - compatible
  - reg
  - '#clock-cells'

additionalProperties: false

examples:
  - |
    clock-controller@80040000 {
        compatible = "fsl,imx28-clkctrl";
        reg = <0x80040000 0x2000>;
        #clock-cells = <1>;
    };

    serial@8006a000 {
        compatible = "fsl,imx28-auart", "fsl,imx23-auart";
        reg = <0x8006a000 0x2000>;
        interrupts = <112 70 71>;
        clocks = <&clks 45>;
    };
```

## Documentation/devicetree/bindings/clock/imx31-clock.txt
```
* Clock bindings for Freescale i.MX31

Required properties:
- compatible: Should be "fsl,imx31-ccm"
- reg: Address and length of the register set
- interrupts: Should contain CCM interrupt
- #clock-cells: Should be <1>

The clock consumer should specify the desired clock by having the clock
ID in its "clocks" phandle cell.  The following is a full list of i.MX31
clocks and IDs.

	Clock		    ID
	-----------------------
	dummy	             0
	ckih                 1
	ckil                 2
	mpll                 3
	spll                 4
	upll                 5
	mcu_main             6
	hsp                  7
	ahb                  8
	nfc                  9
	ipg                  10
	per_div              11
	per                  12
	csi_sel              13
	fir_sel              14
	csi_div              15
	usb_div_pre          16
	usb_div_post         17
	fir_div_pre          18
	fir_div_post         19
	sdhc1_gate           20
	sdhc2_gate           21
	gpt_gate             22
	epit1_gate           23
	epit2_gate           24
	iim_gate             25
	ata_gate             26
	sdma_gate            27
	cspi3_gate           28
	rng_gate             29
	uart1_gate           30
	uart2_gate           31
	ssi1_gate            32
	i2c1_gate            33
	i2c2_gate            34
	i2c3_gate            35
	hantro_gate          36
	mstick1_gate         37
	mstick2_gate         38
	csi_gate             39
	rtc_gate             40
	wdog_gate            41
	pwm_gate             42
	sim_gate             43
	ect_gate             44
	usb_gate             45
	kpp_gate             46
	ipu_gate             47
	uart3_gate           48
	uart4_gate           49
	uart5_gate           50
	owire_gate           51
	ssi2_gate            52
	cspi1_gate           53
	cspi2_gate           54
	gacc_gate            55
	emi_gate             56
	rtic_gate            57
	firi_gate            58

Examples:

clks: ccm@53f80000{
	compatible = "fsl,imx31-ccm";
	reg = <0x53f80000 0x4000>;
	interrupts = <31>, <53>;
	#clock-cells = <1>;
};

uart1: serial@43f90000 {
	compatible = "fsl,imx31-uart", "fsl,imx21-uart";
	reg = <0x43f90000 0x4000>;
	interrupts = <45>;
	clocks = <&clks 10>, <&clks 30>;
	clock-names = "ipg", "per";
	status = "disabled";
};
```

## Documentation/devicetree/bindings/clock/imx31-clock.yaml
```yaml
# SPDX-License-Identifier: (GPL-2.0-only OR BSD-2-Clause)
%YAML 1.2
---
$id: http://devicetree.org/schemas/clock/imx31-clock.yaml#
$schema: http://devicetree.org/meta-schemas/core.yaml#

title: Clock bindings for Freescale i.MX31

maintainers:
  - Fabio Estevam <fabio.estevam@freescale.com>

description: |
  The clock consumer should specify the desired clock by having the clock
  ID in its "clocks" phandle cell. The following is a full list of i.MX31
  clocks and IDs.

        Clock		    ID
        -----------------------
        dummy	             0
        ckih                 1
        ckil                 2
        mpll                 3
        spll                 4
        upll                 5
        mcu_main             6
        hsp                  7
        ahb                  8
        nfc                  9
        ipg                  10
        per_div              11
        per                  12
        csi_sel              13
        fir_sel              14
        csi_div              15
        usb_div_pre          16
        usb_div_post         17
        fir_div_pre          18
        fir_div_post         19
        sdhc1_gate           20
        sdhc2_gate           21
        gpt_gate             22
        epit1_gate           23
        epit2_gate           24
        iim_gate             25
        ata_gate             26
        sdma_gate            27
        cspi3_gate           28
        rng_gate             29
        uart1_gate           30
        uart2_gate           31
        ssi1_gate            32
        i2c1_gate            33
        i2c2_gate            34
        i2c3_gate            35
        hantro_gate          36
        mstick1_gate         37
        mstick2_gate         38
        csi_gate             39
        rtc_gate             40
        wdog_gate            41
        pwm_gate             42
        sim_gate             43
        ect_gate             44
        usb_gate             45
        kpp_gate             46
        ipu_gate             47
        uart3_gate           48
        uart4_gate           49
        uart5_gate           50
        owire_gate           51
        ssi2_gate            52
        cspi1_gate           53
        cspi2_gate           54
        gacc_gate            55
        emi_gate             56
        rtic_gate            57
        firi_gate            58

properties:
  compatible:
    const: fsl,imx31-ccm

  reg:
    maxItems: 1

  interrupts:
    description: CCM provides 2 interrupt requests, request 1 is to generate
      interrupt for DVFS when a frequency change is requested, request 2 is
      to generate interrupt for DPTC when a voltage change is requested.
    items:
      - description: CCM DVFS interrupt request 1
      - description: CCM DPTC interrupt request 2

  '#clock-cells':
    const: 1

required:
  - compatible
  - reg
  - interrupts
  - '#clock-cells'

additionalProperties: false

examples:
  - |
    clock-controller@53f80000 {
        compatible = "fsl,imx31-ccm";
        reg = <0x53f80000 0x4000>;
        interrupts = <31>, <53>;
        #clock-cells = <1>;
    };

    serial@43f90000 {
        compatible = "fsl,imx31-uart", "fsl,imx21-uart";
        reg = <0x43f90000 0x4000>;
        interrupts = <45>;
        clocks = <&clks 10>, <&clks 30>;
        clock-names = "ipg", "per";
    };
```

## Documentation/devicetree/bindings/clock/imx35-clock.yaml
```yaml
# SPDX-License-Identifier: (GPL-2.0-only OR BSD-2-Clause)
%YAML 1.2
---
$id: http://devicetree.org/schemas/clock/imx35-clock.yaml#
$schema: http://devicetree.org/meta-schemas/core.yaml#

title: Clock bindings for Freescale i.MX35

maintainers:
  - Steffen Trumtrar <s.trumtrar@pengutronix.de>

description: |
  The clock consumer should specify the desired clock by having the clock
  ID in its "clocks" phandle cell. The following is a full list of i.MX35
  clocks and IDs.

        Clock			ID
        ---------------------------
        ckih			0
        mpll			1
        ppll			2
        mpll_075		3
        arm			4
        hsp			5
        hsp_div			6
        hsp_sel			7
        ahb			8
        ipg			9
        arm_per_div		10
        ahb_per_div		11
        ipg_per			12
        uart_sel		13
        uart_div		14
        esdhc_sel		15
        esdhc1_div		16
        esdhc2_div		17
        esdhc3_div		18
        spdif_sel		19
        spdif_div_pre		20
        spdif_div_post		21
        ssi_sel			22
        ssi1_div_pre		23
        ssi1_div_post		24
        ssi2_div_pre		25
        ssi2_div_post		26
        usb_sel			27
        usb_div			28
        nfc_div			29
        asrc_gate		30
        pata_gate		31
        audmux_gate		32
        can1_gate		33
        can2_gate		34
        cspi1_gate		35
        cspi2_gate		36
        ect_gate		37
        edio_gate		38
        emi_gate		39
        epit1_gate		40
        epit2_gate		41
        esai_gate		42
        esdhc1_gate		43
        esdhc2_gate		44
        esdhc3_gate		45
        fec_gate		46
        gpio1_gate		47
        gpio2_gate		48
        gpio3_gate		49
        gpt_gate		50
        i2c1_gate		51
        i2c2_gate		52
        i2c3_gate		53
        iomuxc_gate		54
        ipu_gate		55
        kpp_gate		56
        mlb_gate		57
        mshc_gate		58
        owire_gate		59
        pwm_gate		60
        rngc_gate		61
        rtc_gate		62
        rtic_gate		63
        scc_gate		64
        sdma_gate		65
        spba_gate		66
        spdif_gate		67
        ssi1_gate		68
        ssi2_gate		69
        uart1_gate		70
        uart2_gate		71
        uart3_gate		72
        usbotg_gate		73
        wdog_gate		74
        max_gate		75
        admux_gate		76
        csi_gate		77
        csi_div			78
        csi_sel			79
        iim_gate		80
        gpu2d_gate		81
        ckli_gate		82

properties:
  compatible:
    const: fsl,imx35-ccm

  reg:
    maxItems: 1

  interrupts:
    maxItems: 1

  '#clock-cells':
    const: 1

required:
  - compatible
  - reg
  - interrupts
  - '#clock-cells'

additionalProperties: false

examples:
  - |
    clock-controller@53f80000 {
        compatible = "fsl,imx35-ccm";
        reg = <0x53f80000 0x4000>;
        interrupts = <31>;
        #clock-cells = <1>;
    };
```
