## Documentation/devicetree/bindings/clock/ti/davinci/ti,da850-pll.yaml
```yaml
# SPDX-License-Identifier: (GPL-2.0-only OR BSD-2-Clause)
%YAML 1.2
---
$id: http://devicetree.org/schemas/clock/ti/davinci/ti,da850-pll.yaml#
$schema: http://devicetree.org/meta-schemas/core.yaml#

title: TI DaVinci PLL Controllers

maintainers:
  - David Lechner <david@lechnology.com>

description:
  The PLL provides clocks to most of the components on the SoC. In addition to
  the PLL itself, this controller also contains bypasses, gates, dividers, an
  multiplexers for various clock signals.

properties:
  compatible:
    enum:
      - ti,da850-pll0
      - ti,da850-pll1

  reg:
    maxItems: 1

  clocks:
    minItems: 1
    items:
      - description: Primary reference clock input
      - description: External clock source

  clock-names:
    minItems: 1
    items:
      - const: clksrc
      - const: extclksrc

  ti,clkmode-square-wave:
    type: boolean
    description:
      Indicates that the board is supplying a square wave input on the OSCIN
      pin instead of using a crystal oscillator.

  pllout:
    type: object
    description:
      Main PLL clock output before POSTDIV.

    properties:
      '#clock-cells':
        const: 0

    required:
      - '#clock-cells'

    additionalProperties: false

  sysclk:
    type: object
    description:
      PLLDIVn divider clocks that provide the SYSCLKn clock domains. Consumers
      of this node should use "n" in "SYSCLKn" as the index parameter for the
      clock cell.

    properties:
      '#clock-cells':
        const: 1

    required:
      - '#clock-cells'

    additionalProperties: false

  auxclk:
    type: object
    description:
      AUXCLK output of the PLL

    properties:
      '#clock-cells':
        const: 0

    required:
      - '#clock-cells'

    additionalProperties: false

  obsclk:
    type: object
    description:
      the OBSCLK output of the PLL.

    properties:
      '#clock-cells':
        const: 0

    required:
      - '#clock-cells'

    additionalProperties: false

required:
  - compatible
  - reg
  - clocks
  - clock-names

additionalProperties: false

allOf:
  - if:
      properties:
        compatible:
          const: ti,da850-pll1
    then:
      properties:
        clocks:
          maxItems: 1
        clock-names:
          maxItems: 1
        ti,clkmode-square-wave: false
        auxclk: false

examples:
  - |
    clock-controller@11000 {
        compatible = "ti,da850-pll0";
        reg = <0x11000 0x1000>;
        clocks = <&ref_clk>, <&pll1_sysclk 3>;
        clock-names = "clksrc", "extclksrc";
        ti,clkmode-square-wave;

        pllout {
            #clock-cells = <0>;
        };

        sysclk {
            #clock-cells = <1>;
        };

        auxclk {
            #clock-cells = <0>;
        };

        obsclk {
            #clock-cells = <0>;
        };
    };

  - |
    clock-controller@21a000 {
        compatible = "ti,da850-pll1";
        reg = <0x21a000 0x1000>;
        clocks = <&ref_clk>;
        clock-names = "clksrc";

        sysclk {
            #clock-cells = <1>;
        };

        obsclk {
            #clock-cells = <0>;
        };
    };
```

## Documentation/devicetree/bindings/clock/ti/ti,apll-clock.yaml
```yaml
# SPDX-License-Identifier: (GPL-2.0-only OR BSD-2-Clause)
%YAML 1.2
---
$id: http://devicetree.org/schemas/clock/ti/ti,apll-clock.yaml#
$schema: http://devicetree.org/meta-schemas/core.yaml#

title: Texas Instruments APLL clock

maintainers:
  - Eduard Bostina <egbostina@gmail.com>

allOf:
  - $ref: /schemas/clock/clock.yaml#

description:
  This binding assumes a register-mapped APLL with usually two selectable
  input clocks (reference clock and bypass clock), with analog phase locked
  loop logic for multiplying the input clock to a desired output clock.
  This clock also typically supports different operation modes (locked, low
  power stop etc.) APLL mostly behaves like a subtype of a DPLL, although
  a simplified one at that.

properties:
  compatible:
    enum:
      - ti,dra7-apll-clock
      - ti,omap2-apll-clock

  "#clock-cells":
    const: 0

  clocks:
    minItems: 1
    maxItems: 2
    description: Link phandles of parent clocks (clk-ref and clk-bypass)

  reg:
    minItems: 2
    maxItems: 3
    description: |
      Address and length of the register set for controlling the APLL.
      It contains the information of registers in the following order:
      "control" - contains the control register offset
      "idlest" - contains the idlest register offset
      "autoidle" - contains the autoidle register offset (OMAP2 only)

  ti,clock-frequency:
    $ref: /schemas/types.yaml#/definitions/uint32
    description: static clock frequency for the clock (OMAP2 only)

  ti,idlest-shift:
    $ref: /schemas/types.yaml#/definitions/uint32
    description: bit-shift for the idlest field (OMAP2 only)

  ti,bit-shift:
    $ref: /schemas/types.yaml#/definitions/uint32
    description: bit-shift for enable and autoidle fields (OMAP2 only)

required:
  - compatible
  - "#clock-cells"
  - clocks
  - reg

unevaluatedProperties: false

examples:
  - |
    bus {
        #address-cells = <1>;
        #size-cells = <0>;

        clock@21c {
            #clock-cells = <0>;
            compatible = "ti,dra7-apll-clock";
            clocks = <&apll_pcie_in_clk_mux>, <&dpll_pcie_ref_ck>;
            reg = <0x021c>, <0x0220>;
        };

        clock@500 {
            #clock-cells = <0>;
            compatible = "ti,omap2-apll-clock";
            clocks = <&sys_ck>;
            ti,bit-shift = <2>;
            ti,idlest-shift = <8>;
            ti,clock-frequency = <96000000>;
            reg = <0x0500>, <0x0530>, <0x0520>;
        };
    };
```

## Documentation/devicetree/bindings/clock/ti/ti,clockdomain.yaml
```yaml
# SPDX-License-Identifier: (GPL-2.0-only OR BSD-2-Clause)
%YAML 1.2
---
$id: http://devicetree.org/schemas/clock/ti/ti,clockdomain.yaml#
$schema: http://devicetree.org/meta-schemas/core.yaml#

title: Texas Instruments clockdomain

maintainers:
  - Tero Kristo <kristo@kernel.org>

description:
  This binding uses the common clock binding in consumer role. Every clock on TI
  SoC belongs to one clockdomain, but software only needs this information for
  specific clocks which require their parent clockdomain to be controlled when
  the clock is enabled/disabled. This binding doesn't define a new clock binding
  type, it is used to group existing clock nodes under hardware hierarchy.

properties:
  compatible:
    const: ti,clockdomain

  "#clock-cells":
    const: 0

  clocks:
    minItems: 1
    maxItems: 64

  clock-output-names:
    maxItems: 1

required:
  - compatible
  - clocks

additionalProperties: false

examples:
  - |
    dss_clkdm {
        compatible = "ti,clockdomain";
        clocks = <&dss1_alwon_fck_3430es2>, <&dss_ick_3430es2>;
    };
```

## Documentation/devicetree/bindings/clock/ti/ti,dm814-adpll-clock.yaml
```yaml
# SPDX-License-Identifier: (GPL-2.0-only OR BSD-2-Clause)
%YAML 1.2
---
$id: http://devicetree.org/schemas/clock/ti/ti,dm814-adpll-clock.yaml#
$schema: http://devicetree.org/meta-schemas/core.yaml#

title: Texas Instruments DM814x ADPLL Clock

maintainers:
  - Tony Lindgren <tony@atomide.com>

description:
  The ADPLL is a register-mapped clock generator found on TI DM814x SoCs. It
  provides multiple output clocks from two or three selectable input clocks and
  three to four children.

properties:
  compatible:
    enum:
      - ti,dm814-adpll-s-clock
      - ti,dm814-adpll-lj-clock

  reg:
    maxItems: 1

  '#clock-cells':
    const: 1

  clocks:
    minItems: 2
    maxItems: 3

  clock-names:
    minItems: 2
    items:
      - const: clkinp
      - const: clkinpulow
      - const: clkinphif

  clock-output-names:
    minItems: 3
    maxItems: 4

required:
  - compatible
  - reg
  - '#clock-cells'
  - clocks
  - clock-output-names

if:
  properties:
    compatible:
      contains:
        const: ti,dm814-adpll-s-clock
then:
  properties:
    clocks:
      minItems: 3
    clock-names:
      minItems: 3
    clock-output-names:
      minItems: 4

else:
  properties:
    clocks:
      maxItems: 2
    clock-names:
      maxItems: 2
    clock-output-names:
      maxItems: 3

additionalProperties: false

examples:
  - |
    adpll@40 {
        compatible = "ti,dm814-adpll-s-clock";
        reg = <0x40 0x40>;
        #clock-cells = <1>;
        clocks = <&devosc_ck &devosc_ck &devosc_ck>;
        clock-names = "clkinp", "clkinpulow", "clkinphif";
        clock-output-names = "481c5040.adpll.dcoclkldo",
                             "481c5040.adpll.clkout",
                             "481c5040.adpll.clkoutx2",
                             "481c5040.adpll.clkouthif";
    };
```

## Documentation/devicetree/bindings/clock/ti/ti,dm816-fapll-clock.yaml
```yaml
# SPDX-License-Identifier: (GPL-2.0-only OR BSD-2-Clause)
%YAML 1.2
---
$id: http://devicetree.org/schemas/clock/ti/ti,dm816-fapll-clock.yaml#
$schema: http://devicetree.org/meta-schemas/core.yaml#

title: Texas Instruments FAPLL clock

maintainers:
  - Tony Lindgren <tony@atomide.com>
  - Tero Kristo <kristo@kernel.org>

description:
  FAPLL is register-mapped with usually two selectable input clocks
  (reference clock and bypass clock), and one or more child synthesizers.

properties:
  compatible:
    const: ti,dm816-fapll-clock

  "#clock-cells":
    const: 1

  reg:
    maxItems: 1

  clocks:
    items:
      - description: parent clock clk-ref
      - description: parent clock clk-bypass

  clock-indices:
    description:
      Maps child synthesizers to physical indices 1-7. Index 0 is physically
      reserved for the Master PLL.
    minItems: 1
    maxItems: 7
    items:
      minimum: 1
      maximum: 7

  clock-output-names:
    description:
      Names of the child synthesizer outputs. The length of this array must
      match clock-indices.
    minItems: 1
    maxItems: 7

required:
  - compatible
  - reg
  - clocks
  - "#clock-cells"
  - clock-indices
  - clock-output-names

additionalProperties: false

examples:
  - |
    clock-controller@400 {
        #clock-cells = <1>;
        compatible = "ti,dm816-fapll-clock";
        reg = <0x400 0x40>;
        clocks = <&sys_clkin_ck &sys_clkin_ck>;
        clock-indices = <1>, <2>, <3>, <4>, <5>, <6>, <7>;
        clock-output-names = "main_pll_clk1", "main_pll_clk2", "main_pll_clk3",
                             "main_pll_clk4", "main_pll_clk5", "main_pll_clk6",
                             "main_pll_clk7";

    };
```

## Documentation/devicetree/bindings/clock/ti/ti,dra7-atl-clock.yaml
```yaml
# SPDX-License-Identifier: (GPL-2.0-only OR BSD-2-Clause)
%YAML 1.2
---
$id: http://devicetree.org/schemas/clock/ti/ti,dra7-atl-clock.yaml#
$schema: http://devicetree.org/meta-schemas/core.yaml#

title: TI DRA7 ATL (Audio Tracking Logic) clock output

maintainers:
  - Peter Ujfalusi <peter.ujfalusi@ti.com>

properties:
  compatible:
    const: ti,dra7-atl-clock

  "#clock-cells":
    const: 0

  clocks:
    maxItems: 1

  clock-output-names:
    maxItems: 1

required:
  - compatible
  - "#clock-cells"
  - clocks

additionalProperties: false

examples:
  - |
    atl_clkin0_ck {
        compatible = "ti,dra7-atl-clock";
        #clock-cells = <0>;
        clocks = <&atl_gfclk_mux>;
    };
```

## Documentation/devicetree/bindings/clock/ti/ti,dra7-atl.yaml
```yaml
# SPDX-License-Identifier: (GPL-2.0-only OR BSD-2-Clause)
%YAML 1.2
---
$id: http://devicetree.org/schemas/clock/ti/ti,dra7-atl.yaml#
$schema: http://devicetree.org/meta-schemas/core.yaml#

title: TI DRA7 ATL (Audio Tracking Logic) Clock Controller

maintainers:
  - Peter Ujfalusi <peter.ujfalusi@ti.com>

description:
  The ATL IP is used to generate clock to be used to synchronize baseband and
  audio codec. A single ATL IP provides four ATL clock instances sharing the
  same functional clock but can be configured to provide different clocks.
  ATL can maintain a clock averages to some desired frequency based on the
  bws/aws signals - can compensate the drift between the two ws signal.

  See also Documentation/devicetree/bindings/clock/ti/ti,dra7-atl-clock.yaml

properties:
  compatible:
    const: ti,dra7-atl

  reg:
    maxItems: 1

  clocks:
    maxItems: 1

  clock-names:
    items:
      - const: fck

  ti,provided-clocks:
    $ref: /schemas/types.yaml#/definitions/phandle-array
    description:
      List of phandles to the clocks associated with the ATL.
    minItems: 4
    maxItems: 4
    items:
      maxItems: 1

  ti,hwmods:
    $ref: /schemas/types.yaml#/definitions/string
    description:
      Name of the hwmod associated with the ATL.
    deprecated: true
    const: atl

patternProperties:
  "^atl[0-3]$":
    type: object
    additionalProperties: false
    description:
      Configuration of ATL instances.

    properties:
      bws:
        $ref: /schemas/types.yaml#/definitions/uint32
        description:
          Baseband word select signal selection.
        maximum: 15

      aws:
        $ref: /schemas/types.yaml#/definitions/uint32
        description:
          Audio word select signal selection.
        maximum: 15

    required:
      - bws
      - aws

required:
  - compatible
  - reg
  - clocks
  - clock-names
  - ti,provided-clocks

additionalProperties: false

examples:
  - |
    #include <dt-bindings/clock/ti-dra7-atl.h>

    atl@4843c000 {
        compatible = "ti,dra7-atl";
        reg = <0x4843c000 0x3ff>;
        clocks = <&atl_gfclk_mux>;
        clock-names = "fck";
        ti,provided-clocks = <&atl_clkin0_ck>, <&atl_clkin1_ck>,
                             <&atl_clkin2_ck>, <&atl_clkin3_ck>;

        atl2 {
            bws = <DRA7_ATL_WS_MCASP2_FSX>;
            aws = <DRA7_ATL_WS_MCASP3_FSX>;
        };
    };
```

## Documentation/devicetree/bindings/clock/ultrarisc,dp1000-clk.yaml
```yaml
# SPDX-License-Identifier: (GPL-2.0-only OR BSD-2-Clause)
%YAML 1.2
---
$id: http://devicetree.org/schemas/clock/ultrarisc,dp1000-clk.yaml#
$schema: http://devicetree.org/meta-schemas/core.yaml#

title: UltraRISC DP1000 Clock Controller

maintainers:
  - Jia Wang <wangjia@ultrarisc.com>

description: |
  The UltraRISC DP1000 clock controller is driven from a single external
  oscillator input. It provides a system PLL with fractional multiplier
  and post-divider stages, several fixed-ratio derived clocks for
  the on-chip subsystem, Clock Configuration Register (CCR) divider
  outputs for GMAC and the UART, I2C, and SPI root clocks, and
  per-instance gate clocks for UART0-3, I2C0-3, and SPI0-1.

  All available clocks are defined as preprocessor macros in
  include/dt-bindings/clock/ultrarisc,dp1000-clk.h

properties:
  compatible:
    const: ultrarisc,dp1000-clk

  reg:
    maxItems: 1

  clocks:
    maxItems: 1
    description:
      External oscillator input clock used as the parent of the PLLs.

  "#clock-cells":
    const: 1

required:
  - compatible
  - reg
  - clocks
  - "#clock-cells"

additionalProperties: false

examples:
  - |
    #include <dt-bindings/clock/ultrarisc,dp1000-clk.h>

    soc {
      #address-cells = <2>;
      #size-cells = <2>;

      clock-controller@11080000 {
        compatible = "ultrarisc,dp1000-clk";
        reg = <0x0 0x11080000 0x0 0x1000>;
        clocks = <&osc>;
        #clock-cells = <1>;
      };
    };
```
