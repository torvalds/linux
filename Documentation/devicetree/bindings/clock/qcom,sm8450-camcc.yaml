## Documentation/devicetree/bindings/clock/qcom,sm8450-camcc.yaml
```yaml
# SPDX-License-Identifier: (GPL-2.0-only OR BSD-2-Clause)
%YAML 1.2
---
$id: http://devicetree.org/schemas/clock/qcom,sm8450-camcc.yaml#
$schema: http://devicetree.org/meta-schemas/core.yaml#

title: Qualcomm Camera Clock & Reset Controller on SM8450

maintainers:
  - Vladimir Zapolskiy <vladimir.zapolskiy@linaro.org>
  - Jagadeesh Kona <quic_jkona@quicinc.com>
  - Taniya Das <taniya.das@oss.qualcomm.com>

description: |
  Qualcomm camera clock control module provides the clocks, resets and power
  domains on SM8450.

  See also:
    include/dt-bindings/clock/qcom,hawi-camcc.h
    include/dt-bindings/clock/qcom,kaanapali-camcc.h
    include/dt-bindings/clock/qcom,kaanapali-cambistmclkcc.h
    include/dt-bindings/clock/qcom,nord-camcc.h
    include/dt-bindings/clock/qcom,sm8450-camcc.h
    include/dt-bindings/clock/qcom,sm8550-camcc.h
    include/dt-bindings/clock/qcom,sm8650-camcc.h
    include/dt-bindings/clock/qcom,sm8750-cambistmclkcc.h
    include/dt-bindings/clock/qcom,sm8750-camcc.h

properties:
  compatible:
    oneOf:
      - enum:
          - qcom,hawi-camcc
          - qcom,kaanapali-cambistmclkcc
          - qcom,kaanapali-camcc
          - qcom,maili-camcc
          - qcom,nord-camcc
          - qcom,sm8450-camcc
          - qcom,sm8475-camcc
          - qcom,sm8550-camcc
          - qcom,sm8650-camcc
          - qcom,sm8750-cambistmclkcc
          - qcom,sm8750-camcc
      - items:
          - enum:
              - qcom,hawi-cambistmclkcc
              - qcom,maili-cambistmclkcc
          - const: qcom,kaanapali-cambistmclkcc

  clocks:
    items:
      - description: Camera AHB clock from GCC
      - description: Board XO source
      - description: Board active XO source
      - description: Sleep clock source

  interconnects:
    items:
      - description: Interconnect path to enable the MultiMedia NoC

  power-domains:
    description:
      Power domains required for the clock controller to operate
    items:
      - description: MMCX power domain
      - description: MXC power domain

  required-opps:
    description:
      OPP nodes that describe required performance points on power domains
    items:
      - description: MMCX performance point
      - description: MXC performance point

  reg:
    maxItems: 1

required:
  - compatible
  - clocks
  - power-domains

allOf:
  - $ref: qcom,gcc.yaml#
  - if:
      properties:
        compatible:
          not:
            contains:
              enum:
                - qcom,sm8475-camcc
                - qcom,sm8650-camcc
    then:
      required:
        - required-opps
  - if:
      properties:
        compatible:
          contains:
            enum:
              - qcom,hawi-camcc
              - qcom,maili-camcc
    then:
      required:
        - interconnects

unevaluatedProperties: false

examples:
  - |
    #include <dt-bindings/clock/qcom,gcc-sm8450.h>
    #include <dt-bindings/interconnect/qcom,icc.h>
    #include <dt-bindings/interconnect/qcom,sm8450.h>
    #include <dt-bindings/clock/qcom,rpmh.h>
    #include <dt-bindings/power/qcom,rpmhpd.h>
    clock-controller@ade0000 {
      compatible = "qcom,sm8450-camcc";
      reg = <0xade0000 0x20000>;
      clocks = <&gcc GCC_CAMERA_AHB_CLK>,
               <&rpmhcc RPMH_CXO_CLK>,
               <&rpmhcc RPMH_CXO_CLK_A>,
               <&sleep_clk>;
      power-domains = <&rpmhpd RPMHPD_MMCX>,
                      <&rpmhpd RPMHPD_MXC>;
      required-opps = <&rpmhpd_opp_low_svs>,
                      <&rpmhpd_opp_low_svs>;
      interconnects = <&mmss_noc MASTER_CAMNOC_HF QCOM_ICC_TAG_ALWAYS
                      &mmss_noc SLAVE_MNOC_HF_MEM_NOC QCOM_ICC_TAG_ALWAYS>;
      #clock-cells = <1>;
      #reset-cells = <1>;
      #power-domain-cells = <1>;
    };
...
```

## Documentation/devicetree/bindings/clock/qcom,x1e80100-tcsr.yaml
```yaml
# SPDX-License-Identifier: (GPL-2.0-only OR BSD-2-Clause)
%YAML 1.2
---
$id: http://devicetree.org/schemas/clock/qcom,x1e80100-tcsr.yaml#
$schema: http://devicetree.org/meta-schemas/core.yaml#

title: Qualcomm TCSR Clock Controller on X1E80100

maintainers:
  - Bjorn Andersson <andersson@kernel.org>
  - Taniya Das <taniya.das@oss.qualcomm.com>

description: |
  Qualcomm TCSR clock control module provides the clocks on X1E80100

  See also:
  - include/dt-bindings/clock/qcom,x1e80100-tcsr.h

properties:
  compatible:
    items:
      - enum:
          - qcom,x1e80100-tcsr
      - const: syscon

  clocks:
    items:
      - description: TCXO pad clock

  reg:
    maxItems: 1

  '#clock-cells':
    const: 1

  vdda-qrefrpt0-0p9-supply: true
  vdda-qrefrpt1-0p9-supply: true
  vdda-qrefrpt2-0p9-supply: true
  vdda-qrefrpt3-0p9-supply: true
  vdda-qrefrpt4-0p9-supply: true
  vdda-qrefrx0-0p9-supply: true
  vdda-qrefrx1-0p9-supply: true
  vdda-qrefrx2-0p9-supply: true
  vdda-qrefrx3-0p9-supply: true
  vdda-qrefrx4-0p9-supply: true
  vdda-qreftx0-0p9-supply: true
  vdda-qreftx0-1p2-supply: true
  vdda-qreftx1-0p9-supply: true
  vdda-qreftx1-1p2-supply: true
  vdda-refgen0-0p9-supply: true
  vdda-refgen0-1p2-supply: true
  vdda-refgen2-0p9-supply: true
  vdda-refgen2-1p2-supply: true

required:
  - compatible
  - clocks
  - '#clock-cells'
  - vdda-qrefrpt0-0p9-supply
  - vdda-qrefrpt1-0p9-supply
  - vdda-qrefrpt2-0p9-supply
  - vdda-qrefrpt3-0p9-supply
  - vdda-qrefrpt4-0p9-supply
  - vdda-qrefrx0-0p9-supply
  - vdda-qrefrx1-0p9-supply
  - vdda-qrefrx2-0p9-supply
  - vdda-qrefrx3-0p9-supply
  - vdda-qrefrx4-0p9-supply
  - vdda-qreftx0-0p9-supply
  - vdda-qreftx0-1p2-supply
  - vdda-qreftx1-0p9-supply
  - vdda-qreftx1-1p2-supply
  - vdda-refgen0-0p9-supply
  - vdda-refgen0-1p2-supply
  - vdda-refgen2-0p9-supply
  - vdda-refgen2-1p2-supply

additionalProperties: false

examples:
  - |
    #include <dt-bindings/clock/qcom,rpmh.h>

    soc {
      #address-cells = <2>;
      #size-cells = <2>;

      clock-controller@1fc0000 {
        compatible = "qcom,x1e80100-tcsr", "syscon";
        reg = <0x0 0x1fc0000 0x0 0x30000>;
        clocks = <&rpmhcc RPMH_CXO_CLK>;
        #clock-cells = <1>;
        vdda-qrefrpt0-0p9-supply = <&vreg_l1a>;
        vdda-qrefrpt1-0p9-supply = <&vreg_l1a>;
        vdda-qrefrpt2-0p9-supply = <&vreg_l1a>;
        vdda-qrefrpt3-0p9-supply = <&vreg_l1a>;
        vdda-qrefrpt4-0p9-supply = <&vreg_l1a>;
        vdda-qrefrx0-0p9-supply = <&vreg_l1a>;
        vdda-qrefrx1-0p9-supply = <&vreg_l1a>;
        vdda-qrefrx2-0p9-supply = <&vreg_l1a>;
        vdda-qrefrx3-0p9-supply = <&vreg_l1a>;
        vdda-qrefrx4-0p9-supply = <&vreg_l1a>;
        vdda-qreftx0-0p9-supply = <&vreg_l1a>;
        vdda-qreftx0-1p2-supply = <&vreg_l2a>;
        vdda-qreftx1-0p9-supply = <&vreg_l1a>;
        vdda-qreftx1-1p2-supply = <&vreg_l2a>;
        vdda-refgen0-0p9-supply = <&vreg_l1a>;
        vdda-refgen0-1p2-supply = <&vreg_l2a>;
        vdda-refgen2-0p9-supply = <&vreg_l1a>;
        vdda-refgen2-1p2-supply = <&vreg_l2a>;
      };
    };

...
```

## Documentation/devicetree/bindings/clock/renesas,r8a78000-cpg.yaml
```yaml
# SPDX-License-Identifier: (GPL-2.0-only OR BSD-2-Clause)
%YAML 1.2
---
$id: http://devicetree.org/schemas/clock/renesas,r8a78000-cpg.yaml#
$schema: http://devicetree.org/meta-schemas/core.yaml#

title: Renesas R-Car X5H Clock Pulse Generator

maintainers:
  - Geert Uytterhoeven <geert+renesas@glider.be>

description:
  The R-Car X5H Clock Pulse Generator (CLK CONTROL) consists of oscillators,
  PLL circuits, clock dividers and clock control circuits.  It provides various
  clocks for other modules.

properties:
  compatible:
    const: renesas,r8a78000-cpg

  reg:
    maxItems: 1

  clocks:
    maxItems: 2

  clock-names:
    items:
      - const: extal
      - const: extalr

  '#clock-cells':
    description:
      The single clock specifier cell must be the clock number, as defined in
      <dt-bindings/clock/renesas,r8a78000-cpg.h>.
    const: 1

required:
  - compatible
  - reg
  - clocks
  - clock-names
  - '#clock-cells'

additionalProperties: false

examples:
  - |
    clock-controller@c1320000 {
            compatible = "renesas,r8a78000-cpg";
            reg = <0xc1320000 0x10000>;
            clocks = <&extal_clk>, <&extalr_clk>;
            clock-names = "extal", "extalr";
            #clock-cells = <1>;
    };
```

## Documentation/devicetree/bindings/clock/rockchip,rv1106-cru.yaml
```yaml
# SPDX-License-Identifier: GPL-2.0-only OR BSD-2-Clause
%YAML 1.2
---
$id: http://devicetree.org/schemas/clock/rockchip,rv1106-cru.yaml#
$schema: http://devicetree.org/meta-schemas/core.yaml#

title: Rockchip RV1106 Clock and Reset Unit

maintainers:
  - Simon Glass <sjg@chromium.org>
  - Heiko Stuebner <heiko@sntech.de>

description:
  The RV1106 clock controller generates the clock and also implements a
  reset controller for SoC peripherals.

properties:
  compatible:
    const: rockchip,rv1106-cru

  reg:
    maxItems: 1

  "#clock-cells":
    const: 1

  "#reset-cells":
    const: 1

  clocks:
    maxItems: 1

  clock-names:
    const: xin24m

  rockchip,grf:
    $ref: /schemas/types.yaml#/definitions/phandle
    description:
      Phandle to the syscon managing the "general register files" (GRF).
      If missing, pll rates are not changeable due to the missing pll
      lock status, and the MMC drive and sample phase clocks, whose
      control registers live in the GRF region, are not registered.

required:
  - compatible
  - reg
  - "#clock-cells"
  - "#reset-cells"

additionalProperties: false

examples:
  - |
    clock-controller@ff3b0000 {
      compatible = "rockchip,rv1106-cru";
      reg = <0xff3b0000 0x20000>;
      rockchip,grf = <&grf>;
      #clock-cells = <1>;
      #reset-cells = <1>;
    };
```

## Documentation/devicetree/bindings/clock/samsung,exynos5515-cmu.yaml
```yaml
# SPDX-License-Identifier: (GPL-2.0-only OR BSD-2-Clause)
%YAML 1.2
---
$id: http://devicetree.org/schemas/clock/samsung,exynos5515-cmu.yaml#
$schema: http://devicetree.org/meta-schemas/core.yaml#

title: Samsung Exynos5515 SoC clock controller

maintainers:
  - Aiden Isik <aidenisik+git@member.fsf.org>
  - Chanwoo Choi <cw00.choi@samsung.com>
  - Krzysztof Kozlowski <krzk@kernel.org>

description: |
  Exynos5515 clock controller is comprised of several CMU units, generating
  clocks for different domains. Those CMU units are modeled as separate device
  tree nodes, and might depend on each other. The root clock in that root tree
  is an external clock: OSCCLK (26 MHz). This external clock must be defined
  as a fixed-rate clock in dts.

  CMU_TOP is a top-level CMU, where all base clocks are prepared using PLLs and
  dividers; all other clocks of function blocks (other CMUs) are usually
  derived from CMU_TOP.

  Each clock is assigned an identifier and client nodes can use this identifier
  to specify the clock which they consume. All clocks available for usage
  in clock consumer nodes are defined as preprocessor macros in
  'include/dt-bindings/clock/samsung,exynos5515-cmu.h' header.

properties:
  compatible:
    enum:
      - samsung,exynos5515-cmu-fsys
      - samsung,exynos5515-cmu-peri
      - samsung,exynos5515-cmu-top

  clocks:
    minItems: 1
    maxItems: 5

  clock-names:
    minItems: 1
    maxItems: 5

  "#clock-cells":
    const: 1

  reg:
    maxItems: 1

  samsung,sysreg:
    $ref: /schemas/types.yaml#/definitions/phandle
    description:
      Phandle to system registers interface.

required:
  - compatible
  - clocks
  - clock-names
  - "#clock-cells"
  - reg
  - samsung,sysreg

allOf:
  - if:
      properties:
        compatible:
          contains:
            enum:
              - samsung,exynos5515-cmu-fsys

    then:
      properties:
        clocks:
          items:
            - description: External reference clock (26MHz)
            - description: CMU_FSYS BUS clock (from CMU_TOP)
            - description: CMU_FSYS MMC card clock (from CMU_TOP)
            - description: CMU_FSYS MMC embedded clock (from CMU_TOP)
            - description: CMU_FSYS USB20DRD clock (from CMU_TOP)

        clock-names:
          items:
            - const: oscclk
            - const: bus
            - const: mmc_card
            - const: mmc_embd
            - const: usb20drd

  - if:
      properties:
        compatible:
          contains:
            enum:
              - samsung,exynos5515-cmu-peri

    then:
      properties:
        clocks:
          items:
            - description: External reference clock (26MHz)
            - description: CMU_PERI BUS clock (from CMU_TOP)
            - description: CMU_PERI IP clock (from CMU_TOP)
            - description: CMU_PERI UART clock (from CMU_TOP)

        clock-names:
          items:
            - const: oscclk
            - const: bus
            - const: ip
            - const: uart

  - if:
      properties:
        compatible:
          contains:
            const: samsung,exynos5515-cmu-top

    then:
      properties:
        clocks:
          items:
            - description: External reference clock (26 MHz)

        clock-names:
          items:
            - const: oscclk

additionalProperties: false

examples:
  - |
    #include <dt-bindings/clock/samsung,exynos5515-cmu.h>

    cmu_top: clock-controller@15410000 {
        compatible = "samsung,exynos5515-cmu-top";
        reg = <0x15410000 0x10000>;
        #clock-cells = <1>;

        clocks = <&oscclk>;
        clock-names = "oscclk";
        samsung,sysreg = <&sysreg_top>;
    };

...
```

## Documentation/devicetree/bindings/clock/starfive,jhb100-per0crg.yaml
```yaml
# SPDX-License-Identifier: GPL-2.0-only OR BSD-2-Clause
%YAML 1.2
---
$id: http://devicetree.org/schemas/clock/starfive,jhb100-per0crg.yaml#
$schema: http://devicetree.org/meta-schemas/core.yaml#

title: StarFive JHB100 Peripheral-0 Clock and Reset Generator

maintainers:
  - Changhuang Liang <changhuang.liang@starfivetech.com>

properties:
  compatible:
    const: starfive,jhb100-per0crg

  reg:
    maxItems: 1

  clocks:
    items:
      - description: Main Oscillator (25 MHz)
      - description: PLL6
      - description: Configure 400MHz
      - description: Configure 800MHZ
      - description: Non Coherent NOC Initiator
      - description: Non Coherent NOC Target

  clock-names:
    items:
      - const: osc
      - const: pll6
      - const: cfg_400
      - const: cfg_800
      - const: ncnoc_init
      - const: ncnoc_targ

  '#clock-cells':
    const: 1
    description:
      See <dt-bindings/clock/starfive,jhb100-crg.h> for valid indices.

  '#reset-cells':
    const: 1
    description:
      See <dt-bindings/reset/starfive,jhb100-crg.h> for valid indices.

required:
  - compatible
  - reg
  - clocks
  - clock-names
  - '#clock-cells'
  - '#reset-cells'

additionalProperties: false

examples:
  - |
    clock-controller@11a08000 {
      compatible = "starfive,jhb100-per0crg";
      reg = <0x11a08000 0x1000>;
      clocks = <&osc>, <&pll6>, <&sys0crg 71>,
               <&sys0crg 72>, <&sys0crg 70>,
               <&sys2crg 23>;
      clock-names = "osc", "pll6", "cfg_400",
                    "cfg_800", "ncnoc_init",
                    "ncnoc_targ";
      #clock-cells = <1>;
      #reset-cells = <1>;
    };
```
