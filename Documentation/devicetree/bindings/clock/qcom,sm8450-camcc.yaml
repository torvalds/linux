## Documentation/devicetree/bindings/clock/starfive,jhb100-per1crg.yaml
```yaml
# SPDX-License-Identifier: GPL-2.0-only OR BSD-2-Clause
%YAML 1.2
---
$id: http://devicetree.org/schemas/clock/starfive,jhb100-per1crg.yaml#
$schema: http://devicetree.org/meta-schemas/core.yaml#

title: StarFive JHB100 Peripheral-1 Clock and Reset Generator

maintainers:
  - Changhuang Liang <changhuang.liang@starfivetech.com>

properties:
  compatible:
    const: starfive,jhb100-per1crg

  reg:
    maxItems: 1

  clocks:
    items:
      - description: PLL7
      - description: Non Coherent NOC Initiator
      - description: Configure 800MHz
      - description: Non Coherent NOC Target
      - description: Configure 143MHz

  clock-names:
    items:
      - const: pll7
      - const: ncnoc_init
      - const: cfg_800
      - const: ncnoc_targ
      - const: cfg_143

  '#clock-cells':
    const: 1
    description:
      See <dt-bindings/clock/starfive,jhb100-crg.h> for valid indices.

  '#reset-cells':
    const: 1
    description:
      See <dt-bindings/reset/starfive,jhb100-crg.h> for valid indices.

required:
  - compatible
  - reg
  - clocks
  - clock-names
  - '#clock-cells'
  - '#reset-cells'

additionalProperties: false

examples:
  - |
    clock-controller@11b40000 {
      compatible = "starfive,jhb100-per1crg";
      reg = <0x11b40000 0x1000>;
      clocks = <&pll7>,
               <&sys0crg 68>,
               <&sys0crg 69>,
               <&sys2crg 19>,
               <&sys2crg 22>;
      clock-names = "pll7", "ncnoc_init",
                    "cfg_800", "ncnoc_targ",
                    "cfg_143";
      #clock-cells = <1>;
      #reset-cells = <1>;
    };
```

## Documentation/devicetree/bindings/clock/starfive,jhb100-per2crg.yaml
```yaml
# SPDX-License-Identifier: GPL-2.0-only OR BSD-2-Clause
%YAML 1.2
---
$id: http://devicetree.org/schemas/clock/starfive,jhb100-per2crg.yaml#
$schema: http://devicetree.org/meta-schemas/core.yaml#

title: StarFive JHB100 Peripheral-2 Clock and Reset Generator

maintainers:
  - Changhuang Liang <changhuang.liang@starfivetech.com>

properties:
  compatible:
    const: starfive,jhb100-per2crg

  reg:
    maxItems: 1

  clocks:
    items:
      - description: Non Coherent NOC Initiator
      - description: Configure 400MHz
      - description: Configure 125MHz
      - description: GMAC2 RGMII RX
      - description: GMAC2 RMII Reference
      - description: GMAC3 SGMII TX
      - description: GMAC3 SGMII RX
      - description: Main Oscillator (25 MHz)

  clock-names:
    items:
      - const: ncnoc_init
      - const: cfg_400
      - const: cfg_125
      - const: gmac2_rgmii_rx
      - const: gmac2_rmii_ref
      - const: gmac3_sgmii_tx
      - const: gmac3_sgmii_rx
      - const: osc

  '#clock-cells':
    const: 1
    description:
      See <dt-bindings/clock/starfive,jhb100-crg.h> for valid indices.

  '#reset-cells':
    const: 1
    description:
      See <dt-bindings/reset/starfive,jhb100-crg.h> for valid indices.

required:
  - compatible
  - reg
  - clocks
  - clock-names
  - '#clock-cells'
  - '#reset-cells'

additionalProperties: false

examples:
  - |
    clock-controller@11bc0000 {
      compatible = "starfive,jhb100-per2crg";
      reg = <0x11bc0000 0x1000>;
      clocks = <&sys0crg 52>, <&sys0crg 54>, <&sys0crg 55>,
               <&per2_gmac2_rgmii_rx>, <&per2_gmac2_rmii_ref>,
               <&per2_gmac3_sgmii_tx>, <&per2_gmac3_sgmii_rx>,
               <&osc>;
      clock-names = "ncnoc_init", "cfg_400", "cfg_125",
                    "gmac2_rgmii_rx", "gmac2_rmii_ref",
                    "gmac3_sgmii_tx", "gmac3_sgmii_rx",
                    "osc";
      #clock-cells = <1>;
      #reset-cells = <1>;
    };
```

## Documentation/devicetree/bindings/clock/starfive,jhb100-per3crg.yaml
```yaml
# SPDX-License-Identifier: GPL-2.0-only OR BSD-2-Clause
%YAML 1.2
---
$id: http://devicetree.org/schemas/clock/starfive,jhb100-per3crg.yaml#
$schema: http://devicetree.org/meta-schemas/core.yaml#

title: StarFive JHB100 Peripheral-3 Clock and Reset Generator

maintainers:
  - Changhuang Liang <changhuang.liang@starfivetech.com>

properties:
  compatible:
    const: starfive,jhb100-per3crg

  reg:
    maxItems: 1

  clocks:
    items:
      - description: Non Coherent NOC Initiator
      - description: Non Coherent NOC Target
      - description: Configure 125MHz
      - description: GMAC0 RMII Reference clock
      - description: GMAC1 SGMII TX
      - description: GMAC1 SGMII RX
      - description: Main Oscillator (25 MHz)

  clock-names:
    items:
      - const: ncnoc_init
      - const: ncnoc_targ
      - const: cfg_125
      - const: gmac0_rmii_rclki
      - const: gmac1_sgmii_tx
      - const: gmac1_sgmii_rx
      - const: osc

  '#clock-cells':
    const: 1
    description:
      See <dt-bindings/clock/starfive,jhb100-crg.h> for valid indices.

  '#reset-cells':
    const: 1
    description:
      See <dt-bindings/reset/starfive,jhb100-crg.h> for valid indices.

required:
  - compatible
  - reg
  - clocks
  - clock-names
  - '#clock-cells'
  - '#reset-cells'

additionalProperties: false

examples:
  - |
    clock-controller@11c40000 {
      compatible = "starfive,jhb100-per3crg";
      reg = <0x11c40000 0x1000>;
      clocks = <&sys0crg 65>,
               <&sys1crg 18>,
               <&sys1crg 19>,
               <&per3_gmac0_rmii_rclki>,
               <&per3_gmac1_sgmii_tx>,
               <&per3_gmac1_sgmii_rx>,
               <&osc>;
      clock-names = "ncnoc_init", "ncnoc_targ", "cfg_125",
                    "gmac0_rmii_rclki", "gmac1_sgmii_tx",
                    "gmac1_sgmii_rx", "osc";
      #clock-cells = <1>;
      #reset-cells = <1>;
    };
```

## Documentation/devicetree/bindings/clock/starfive,jhb100-sys0crg.yaml
```yaml
# SPDX-License-Identifier: GPL-2.0-only OR BSD-2-Clause
%YAML 1.2
---
$id: http://devicetree.org/schemas/clock/starfive,jhb100-sys0crg.yaml#
$schema: http://devicetree.org/meta-schemas/core.yaml#

title: StarFive JHB100 System-0 Clock and Reset Generator

maintainers:
  - Changhuang Liang <changhuang.liang@starfivetech.com>

properties:
  compatible:
    const: starfive,jhb100-sys0crg

  reg:
    maxItems: 1

  clocks:
    items:
      - description: Main Oscillator (25 MHz)
      - description: PLL0
      - description: PLL1
      - description: PLL2

  clock-names:
    items:
      - const: osc
      - const: pll0
      - const: pll1
      - const: pll2

  '#clock-cells':
    const: 1
    description:
      See <dt-bindings/clock/starfive,jhb100-crg.h> for valid indices.

  '#reset-cells':
    const: 1
    description:
      See <dt-bindings/reset/starfive,jhb100-crg.h> for valid indices.

required:
  - compatible
  - reg
  - clocks
  - clock-names
  - '#clock-cells'
  - '#reset-cells'

additionalProperties: false

examples:
  - |
    clock-controller@13000000 {
      compatible = "starfive,jhb100-sys0crg";
      reg = <0x13000000 0x4000>;
      clocks = <&osc>, <&pll0>, <&pll1>,
               <&syspll 0>;
      clock-names = "osc", "pll0", "pll1", "pll2";
      #clock-cells = <1>;
      #reset-cells = <1>;
    };
```

## Documentation/devicetree/bindings/clock/starfive,jhb100-sys1crg.yaml
```yaml
# SPDX-License-Identifier: GPL-2.0-only OR BSD-2-Clause
%YAML 1.2
---
$id: http://devicetree.org/schemas/clock/starfive,jhb100-sys1crg.yaml#
$schema: http://devicetree.org/meta-schemas/core.yaml#

title: StarFive JHB100 System-1 Clock and Reset Generator

maintainers:
  - Changhuang Liang <changhuang.liang@starfivetech.com>

properties:
  compatible:
    const: starfive,jhb100-sys1crg

  reg:
    maxItems: 1

  clocks:
    items:
      - description: Main Oscillator (25 MHz)
      - description: PLL0
      - description: PLL1
      - description: PLL2
      - description: PLL4
      - description: PLL5
      - description: NPU Non Coherent NOC Initiator

  clock-names:
    items:
      - const: osc
      - const: pll0
      - const: pll1
      - const: pll2
      - const: pll4
      - const: pll5
      - const: npu_ncnoc_init

  '#clock-cells':
    const: 1
    description:
      See <dt-bindings/clock/starfive,jhb100-crg.h> for valid indices.

  '#reset-cells':
    const: 1
    description:
      See <dt-bindings/reset/starfive,jhb100-crg.h> for valid indices.

required:
  - compatible
  - reg
  - clocks
  - clock-names
  - '#clock-cells'
  - '#reset-cells'

additionalProperties: false

examples:
  - |
    clock-controller@13004000 {
      compatible = "starfive,jhb100-sys1crg";
      reg = <0x13004000 0x4000>;
      clocks = <&osc>, <&pll0>, <&pll1>,
               <&syspll 0>, <&syspll 2>,
               <&syspll 3>, <&sys0crg 61>;
      clock-names = "osc", "pll0", "pll1", "pll2",
                    "pll4", "pll5", "npu_ncnoc_init";
      #clock-cells = <1>;
      #reset-cells = <1>;
    };
```

## Documentation/devicetree/bindings/clock/starfive,jhb100-sys2crg.yaml
```yaml
# SPDX-License-Identifier: GPL-2.0-only OR BSD-2-Clause
%YAML 1.2
---
$id: http://devicetree.org/schemas/clock/starfive,jhb100-sys2crg.yaml#
$schema: http://devicetree.org/meta-schemas/core.yaml#

title: StarFive JHB100 System-2 Clock and Reset Generator

maintainers:
  - Changhuang Liang <changhuang.liang@starfivetech.com>

properties:
  compatible:
    const: starfive,jhb100-sys2crg

  reg:
    maxItems: 1

  clocks:
    items:
      - description: Main Oscillator (25 MHz)
      - description: PLL1
      - description: GPU0 Non Coherent NOC Initiator
      - description: GPU1 Non Coherent NOC Initiator

  clock-names:
    items:
      - const: osc
      - const: pll1
      - const: gpu0_ncnoc_init
      - const: gpu1_ncnoc_init

  '#clock-cells':
    const: 1
    description:
      See <dt-bindings/clock/starfive,jhb100-crg.h> for valid indices.

  '#reset-cells':
    const: 1
    description:
      See <dt-bindings/reset/starfive,jhb100-crg.h> for valid indices.

required:
  - compatible
  - reg
  - clocks
  - clock-names
  - '#clock-cells'
  - '#reset-cells'

additionalProperties: false

examples:
  - |
    clock-controller@13008000 {
      compatible = "starfive,jhb100-sys2crg";
      reg = <0x13008000 0x4000>;
      clocks = <&osc>, <&pll1>, <&sys0crg 73>,
               <&sys0crg 74>;
      clock-names = "osc", "pll1", "gpu0_ncnoc_init",
                    "gpu1_ncnoc_init";
      #clock-cells = <1>;
      #reset-cells = <1>;
    };
```

## Documentation/devicetree/bindings/clock/ti,keystone,psc-clock.yaml
```yaml
# SPDX-License-Identifier: (GPL-2.0-only OR BSD-2-Clause)
%YAML 1.2
---
$id: http://devicetree.org/schemas/clock/ti,keystone,psc-clock.yaml#
$schema: http://devicetree.org/meta-schemas/core.yaml#

title: TI Keystone PSC clock

maintainers:
  - Santosh Shilimkar <santosh.shilimkar@ti.com>
  - Murali Karicheri <m-karicheri2@ti.com>

properties:
  compatible:
    const: ti,keystone,psc-clock

  reg:
    items:
      - description: PSC control
      - description: Domain

  reg-names:
    items:
      - const: control
      - const: domain

  domain-id:
    $ref: /schemas/types.yaml#/definitions/uint32
    description: PSC domain id needed to check the transition state register

  clocks:
    maxItems: 1

  clock-output-names:
    maxItems: 1

  "#clock-cells":
    const: 0

required:
  - compatible
  - reg
  - reg-names
  - domain-id
  - clocks
  - "#clock-cells"

additionalProperties: false

examples:
  - |
    clkusb@2350008 {
        compatible = "ti,keystone,psc-clock";
        reg = <0x02350008 0xb00>, <0x02350000 0x400>;
        reg-names = "control", "domain";
        domain-id = <0>;
        clocks = <&chipclk16>;
        clock-output-names = "usb";
        #clock-cells = <0>;
    };
```

## Documentation/devicetree/bindings/clock/ti,palmas-clk32kg.yaml
```yaml
# SPDX-License-Identifier: (GPL-2.0-only OR BSD-2-Clause)
%YAML 1.2
---
$id: http://devicetree.org/schemas/clock/ti,palmas-clk32kg.yaml#
$schema: http://devicetree.org/meta-schemas/core.yaml#

title: Texas Instruments Palmas 32KHz Clocks

maintainers:
  - Eduard Bostina <egbostina@gmail.com>

description:
  The Palmas device family has two clock output pins for 32KHz,
  KG and KG_AUDIO.

allOf:
  - $ref: /schemas/clock/clock.yaml#

properties:
  compatible:
    enum:
      - ti,palmas-clk32kg
      - ti,palmas-clk32kgaudio

  "#clock-cells":
    const: 0

  ti,external-sleep-control:
    $ref: /schemas/types.yaml#/definitions/uint32
    enum: [ 0, 1, 2, 3 ]
    description: |
      The external enable input pins control the enable/disable of clocks.
      The valid values (defined in dt-bindings/mfd/palmas.h) are:
        1: PALMAS_EXT_CONTROL_PIN_ENABLE1
        2: PALMAS_EXT_CONTROL_PIN_ENABLE2
        3: PALMAS_EXT_CONTROL_PIN_NSLEEP
      Option 0 or missing this property means the clock is enabled/disabled
      via register access and these pins do not have any control.

required:
  - compatible
  - "#clock-cells"

unevaluatedProperties: false

examples:
  - |
    #include <dt-bindings/mfd/palmas.h>

    pmic {
        clock-controller {
            compatible = "ti,palmas-clk32kg";
            #clock-cells = <0>;
            ti,external-sleep-control = <PALMAS_EXT_CONTROL_PIN_NSLEEP>;
        };
    };
```
