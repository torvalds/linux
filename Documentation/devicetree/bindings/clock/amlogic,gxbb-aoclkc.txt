## Documentation/devicetree/bindings/clock/amlogic,t7-peripherals-clkc.yaml
```yaml
# SPDX-License-Identifier: (GPL-2.0-only OR BSD-2-Clause)
# Copyright (C) 2024-2025 Amlogic, Inc. All rights reserved
%YAML 1.2
---
$id: http://devicetree.org/schemas/clock/amlogic,t7-peripherals-clkc.yaml#
$schema: http://devicetree.org/meta-schemas/core.yaml#

title: Amlogic T7 Peripherals Clock Controller

maintainers:
  - Neil Armstrong <neil.armstrong@linaro.org>
  - Jerome Brunet <jbrunet@baylibre.com>
  - Xianwei Zhao <xianwei.zhao@amlogic.com>
  - Jian Hu <jian.hu@amlogic.com>

properties:
  compatible:
    const: amlogic,t7-peripherals-clkc

  reg:
    maxItems: 1

  '#clock-cells':
    const: 1

  clocks:
    minItems: 14
    items:
      - description: input oscillator
      - description: input sys clk
      - description: input fixed pll
      - description: input fclk div 2
      - description: input fclk div 2p5
      - description: input fclk div 3
      - description: input fclk div 4
      - description: input fclk div 5
      - description: input fclk div 7
      - description: input hifi pll
      - description: input gp0 pll
      - description: input gp1 pll
      - description: input mpll1
      - description: input mpll2
      - description: external input rmii oscillator (optional)
      - description: input video pll0 (optional)
      - description: external pad input for rtc (optional)

  clock-names:
    minItems: 14
    items:
      - const: xtal
      - const: sys
      - const: fix
      - const: fdiv2
      - const: fdiv2p5
      - const: fdiv3
      - const: fdiv4
      - const: fdiv5
      - const: fdiv7
      - const: hifi
      - const: gp0
      - const: gp1
      - const: mpll1
      - const: mpll2
      - const: ext_rmii
      - const: vid_pll0
      - const: ext_rtc

required:
  - compatible
  - '#clock-cells'
  - reg
  - clocks
  - clock-names

additionalProperties: false

examples:
  - |
    apb {
        #address-cells = <2>;
        #size-cells = <2>;

        clkc_periphs:clock-controller@0 {
            compatible = "amlogic,t7-peripherals-clkc";
            reg = <0 0x0 0 0x1c8>;
            #clock-cells = <1>;
            clocks = <&xtal>,
                     <&scmi_clk 13>,
                     <&scmi_clk 16>,
                     <&scmi_clk 18>,
                     <&scmi_clk 20>,
                     <&scmi_clk 22>,
                     <&scmi_clk 24>,
                     <&scmi_clk 26>,
                     <&scmi_clk 28>,
                     <&hifi 1>,
                     <&gp0 1>,
                     <&gp1 1>,
                     <&mpll 4>,
                     <&mpll 6>;
            clock-names = "xtal",
                          "sys",
                          "fix",
                          "fdiv2",
                          "fdiv2p5",
                          "fdiv3",
                          "fdiv4",
                          "fdiv5",
                          "fdiv7",
                          "hifi",
                          "gp0",
                          "gp1",
                          "mpll1",
                          "mpll2";
        };
    };
```

## Documentation/devicetree/bindings/clock/amlogic,t7-pll-clkc.yaml
```yaml
# SPDX-License-Identifier: (GPL-2.0-only OR BSD-2-Clause)
# Copyright (C) 2024-2025 Amlogic, Inc. All rights reserved
%YAML 1.2
---
$id: http://devicetree.org/schemas/clock/amlogic,t7-pll-clkc.yaml#
$schema: http://devicetree.org/meta-schemas/core.yaml#

title: Amlogic T7 PLL Clock Control Controller

maintainers:
  - Neil Armstrong <neil.armstrong@linaro.org>
  - Jerome Brunet <jbrunet@baylibre.com>
  - Jian Hu <jian.hu@amlogic.com>
  - Xianwei Zhao <xianwei.zhao@amlogic.com>

properties:
  compatible:
    enum:
      - amlogic,t7-gp0-pll
      - amlogic,t7-gp1-pll
      - amlogic,t7-hifi-pll
      - amlogic,t7-pcie-pll
      - amlogic,t7-mpll
      - amlogic,t7-hdmi-pll
      - amlogic,t7-mclk-pll

  reg:
    maxItems: 1

  '#clock-cells':
    const: 1

  clocks:
    items:
      - description: mclk pll input oscillator gate
      - description: oscillator input clock source for mclk_sel_0
      - description: fixed input clock source for mclk_sel_0
    minItems: 1

  clock-names:
    items:
      - const: in0
      - const: in1
      - const: in2
    minItems: 1

required:
  - compatible
  - '#clock-cells'
  - reg
  - clocks
  - clock-names

allOf:
  - if:
      properties:
        compatible:
          contains:
            const: amlogic,t7-mclk-pll

    then:
      properties:
        clocks:
          minItems: 3

        clock-names:
          minItems: 3

  - if:
      properties:
        compatible:
          contains:
            enum:
              - amlogic,t7-gp0-pll
              - amlogic,t7-gp1--pll
              - amlogic,t7-hifi-pll
              - amlogic,t7-pcie-pll
              - amlogic,t7-mpll
              - amlogic,t7-hdmi-pll

    then:
      properties:
        clocks:
          maxItems: 1

        clock-names:
          maxItems: 1

additionalProperties: false

examples:
  - |
    apb {
        #address-cells = <2>;
        #size-cells = <2>;

        clock-controller@8080 {
            compatible = "amlogic,t7-gp0-pll";
            reg = <0 0x8080 0 0x20>;
            clocks = <&scmi_clk 2>;
            clock-names = "in0";
            #clock-cells = <1>;
        };

        clock-controller@8300 {
            compatible = "amlogic,t7-mclk-pll";
            reg = <0 0x8300 0 0x18>;
            clocks = <&scmi_clk 2>,
                     <&xtal>,
                     <&scmi_clk 31>;
            clock-names = "in0", "in1", "in2";
            #clock-cells = <1>;
        };
    };
```

## Documentation/devicetree/bindings/clock/apm,xgene-device-clock.yaml
```yaml
# SPDX-License-Identifier: (GPL-2.0-only OR BSD-2-Clause)
%YAML 1.2
---
$id: http://devicetree.org/schemas/clock/apm,xgene-device-clock.yaml#
$schema: http://devicetree.org/meta-schemas/core.yaml#

title: APM X-Gene SoC device clocks

maintainers:
  - Khuong Dinh <khuong@os.amperecomputing.com>

properties:
  compatible:
    const: apm,xgene-device-clock

  reg:
    minItems: 1
    maxItems: 2

  reg-names:
    items:
      - enum: [ csr-reg, div-reg ]
      - const: div-reg
    minItems: 1

  clocks:
    maxItems: 1

  "#clock-cells":
    const: 1

  clock-output-names:
    maxItems: 1

  clock-names:
    maxItems: 1

  csr-offset:
    description: Offset to the CSR reset register
    $ref: /schemas/types.yaml#/definitions/uint32
    default: 0

  csr-mask:
    description: CSR reset mask bit
    $ref: /schemas/types.yaml#/definitions/uint32
    default: 0xf

  enable-offset:
    description: Offset to the enable register
    $ref: /schemas/types.yaml#/definitions/uint32
    default: 8

  enable-mask:
    description: CSR enable mask bit
    $ref: /schemas/types.yaml#/definitions/uint32
    default: 0xf

  divider-offset:
    description: Offset to the divider register
    $ref: /schemas/types.yaml#/definitions/uint32
    default: 0

  divider-width:
    description: Width of the divider register
    $ref: /schemas/types.yaml#/definitions/uint32
    default: 0

  divider-shift:
    description: Bit shift of the divider register
    $ref: /schemas/types.yaml#/definitions/uint32
    default: 0

required:
  - compatible
  - reg
  - clocks
  - '#clock-cells'
  - clock-output-names

additionalProperties: false
```

## Documentation/devicetree/bindings/clock/apm,xgene-socpll-clock.yaml
```yaml
# SPDX-License-Identifier: (GPL-2.0-only OR BSD-2-Clause)
%YAML 1.2
---
$id: http://devicetree.org/schemas/clock/apm,xgene-socpll-clock.yaml#
$schema: http://devicetree.org/meta-schemas/core.yaml#

title: APM X-Gene SoC PLL, PCPPLL, and PMD clocks

maintainers:
  - Khuong Dinh <khuong@os.amperecomputing.com>

properties:
  compatible:
    items:
      - enum:
          - apm,xgene-pcppll-clock
          - apm,xgene-pcppll-v2-clock
          - apm,xgene-pmd-clock
          - apm,xgene-socpll-clock
          - apm,xgene-socpll-v2-clock

  reg:
    maxItems: 1

  reg-names:
    items:
      - enum: [ csr-reg, div-reg ]
      - const: div-reg
    minItems: 1

  clocks:
    maxItems: 1

  clock-names:
    enum: [ pcppll, socpll ]

  "#clock-cells":
    const: 1

  clock-output-names:
    maxItems: 1

required:
  - compatible
  - reg
  - clocks
  - '#clock-cells'
  - clock-output-names

additionalProperties: false
```

## Documentation/devicetree/bindings/clock/apple,nco.yaml
```yaml
# SPDX-License-Identifier: (GPL-2.0-only OR BSD-2-Clause)
%YAML 1.2
---
$id: http://devicetree.org/schemas/clock/apple,nco.yaml#
$schema: http://devicetree.org/meta-schemas/core.yaml#

title: Apple SoCs' NCO block

maintainers:
  - Martin Povišer <povik+lin@cutebit.org>

description: |
  The NCO (Numerically Controlled Oscillator) block found on Apple SoCs
  such as the t8103 (M1) is a programmable clock generator performing
  fractional division of a high frequency input clock.

  It carries a number of independent channels and is typically used for
  generation of audio bitclocks.

properties:
  compatible:
    oneOf:
      - items:
          - const: apple,t6020-nco
          - const: apple,t8103-nco
      - items:
          - enum:
              # Do not add additional SoC to this list.
              - apple,t6000-nco
              - apple,t8103-nco
              - apple,t8112-nco
          - const: apple,nco

  clocks:
    description:
      Specifies the reference clock from which the output clocks
      are derived through fractional division.
    maxItems: 1

  '#clock-cells':
    const: 1

  reg:
    maxItems: 1

required:
  - compatible
  - clocks
  - '#clock-cells'
  - reg

additionalProperties: false

examples:
  - |
    nco_clkref: clock-ref {
      compatible = "fixed-clock";
      #clock-cells = <0>;
      clock-frequency = <900000000>;
      clock-output-names = "nco-ref";
    };

    nco: clock-controller@23b044000 {
      compatible = "apple,t8103-nco", "apple,nco";
      reg = <0x3b044000 0x14000>;
      #clock-cells = <1>;
      clocks = <&nco_clkref>;
    };
```

## Documentation/devicetree/bindings/clock/arm,syscon-icst.yaml
```yaml
# SPDX-License-Identifier: (GPL-2.0-only OR BSD-2-Clause)
%YAML 1.2
---
$id: http://devicetree.org/schemas/clock/arm,syscon-icst.yaml#
$schema: http://devicetree.org/meta-schemas/core.yaml#

title: ARM System Controller ICST Clocks

maintainers:
  - Linus Walleij <linusw@kernel.org>

description: |
  The ICS525 and ICS307 oscillators are produced by Integrated
  Devices Technology (IDT). ARM integrated these oscillators deeply into their
  reference designs by adding special control registers that manage such
  oscillators to their system controllers.

  The various ARM system controllers contain logic to serialize and initialize
  an ICST clock request after a write to the 32 bit register at an offset
  into the system controller. Furthermore, to even be able to alter one of
  these frequencies, the system controller must first be unlocked by
  writing a special token to another offset in the system controller.

  Some ARM hardware contain special versions of the serial interface that only
  connects the low 8 bits of the VDW (missing one bit), hard-wires RDW to
  different values and sometimes also hard-wires the output divider. They
  therefore have special compatible strings as per this table (the OD value is
  the value on the pins, not the resulting output divider).

  In the core modules and logic tiles, the ICST is a configurable clock fed
  from a 24 MHz clock on the motherboard (usually the main crystal) used for
  generating e.g. video clocks. It is located on the core module and there is
  only one of these. This clock node must be a subnode of the core module.

  Hardware variant         RDW     OD          VDW

  Integrator/AP            22      1           Bit 8 0, rest variable
  integratorap-cm

  Integrator/AP            46      3           Bit 8 0, rest variable
  integratorap-sys

  Integrator/AP            22 or   1           17 or (33 or 25 MHz)
  integratorap-pci         14      1           14

  Integrator/CP            22      variable    Bit 8 0, rest variable
  integratorcp-cm-core

  Integrator/CP            22      variable    Bit 8 0, rest variable
  integratorcp-cm-mem

  The ICST oscillator must be provided inside a system controller node.

properties:
  "#clock-cells":
    const: 0

  compatible:
    enum:
      - arm,syscon-icst525
      - arm,syscon-icst307
      - arm,syscon-icst525-integratorap-cm
      - arm,syscon-icst525-integratorap-sys
      - arm,syscon-icst525-integratorap-pci
      - arm,syscon-icst525-integratorcp-cm-core
      - arm,syscon-icst525-integratorcp-cm-mem
      - arm,integrator-cm-auxosc
      - arm,versatile-cm-auxosc
      - arm,impd-vco1
      - arm,impd-vco2

  clocks:
    description: Parent clock for the ICST VCO
    maxItems: 1

  clock-output-names:
    maxItems: 1

  lock-offset:
    $ref: '/schemas/types.yaml#/definitions/uint32'
    description: Offset to the unlocking register for the oscillator

  vco-offset:
    $ref: '/schemas/types.yaml#/definitions/uint32'
    description: Offset to the VCO register for the oscillator

required:
  - "#clock-cells"
  - compatible
  - clocks

additionalProperties: false

examples:
  - |
    vco1: clock {
      compatible = "arm,impd1-vco1";
      #clock-cells = <0>;
      lock-offset = <0x08>;
      vco-offset = <0x00>;
      clocks = <&sysclk>;
      clock-output-names = "IM-PD1-VCO1";
    };

...
```

## Documentation/devicetree/bindings/clock/arm-integrator.txt
```
Clock bindings for ARM Integrator and Versatile Core Module clocks

Auxiliary Oscillator Clock

This is a configurable clock fed from a 24 MHz chrystal,
used for generating e.g. video clocks. It is located on the
core module and there is only one of these.

This clock node *must* be a subnode of the core module, since
it obtains the base address for it's address range from its
parent node.


Required properties:
- compatible: must be "arm,integrator-cm-auxosc" or "arm,versatile-cm-auxosc"
- #clock-cells: must be <0>

Optional properties:
- clocks: parent clock(s)

Example:

core-module@10000000 {
	xtal24mhz: xtal24mhz@24M {
		#clock-cells = <0>;
		compatible = "fixed-clock";
		clock-frequency = <24000000>;
	};
	auxosc: cm_aux_osc@25M {
		#clock-cells = <0>;
		compatible = "arm,integrator-cm-auxosc";
		clocks = <&xtal24mhz>;
	};
};
```
