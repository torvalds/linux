## Documentation/devicetree/bindings/clock/amlogic,gxbb-aoclkc.txt
```
* Amlogic GXBB AO Clock and Reset Unit

The Amlogic GXBB AO clock controller generates and supplies clock to various
controllers within the Always-On part of the SoC.

Required Properties:

- compatible: value should be different for each SoC family as :
	- GXBB (S905) : "amlogic,meson-gxbb-aoclkc"
	- GXL (S905X, S905D) : "amlogic,meson-gxl-aoclkc"
	- GXM (S912) : "amlogic,meson-gxm-aoclkc"
	- AXG (A113D, A113X) : "amlogic,meson-axg-aoclkc"
	followed by the common "amlogic,meson-gx-aoclkc"
- clocks: list of clock phandle, one for each entry clock-names.
- clock-names: should contain the following:
  * "xtal"     : the platform xtal
  * "mpeg-clk" : the main clock controller mother clock (aka clk81)
  * "ext-32k-0"  : external 32kHz reference #0 if any (optional)
  * "ext-32k-1"  : external 32kHz reference #1 if any (optional - gx only)
  * "ext-32k-2"  : external 32kHz reference #2 if any (optional - gx only)

- #clock-cells: should be 1.

Each clock is assigned an identifier and client nodes can use this identifier
to specify the clock which they consume. All available clocks are defined as
preprocessor macros in the dt-bindings/clock/gxbb-aoclkc.h header and can be
used in device tree sources.

- #reset-cells: should be 1.

Each reset is assigned an identifier and client nodes can use this identifier
to specify the reset which they consume. All available resets are defined as
preprocessor macros in the dt-bindings/reset/gxbb-aoclkc.h header and can be
used in device tree sources.

Parent node should have the following properties :
- compatible: "amlogic,meson-gx-ao-sysctrl", "syscon", "simple-mfd"
- reg: base address and size of the AO system control register space.

Example: AO Clock controller node:

ao_sysctrl: sys-ctrl@0 {
	compatible = "amlogic,meson-gx-ao-sysctrl", "syscon", "simple-mfd";
	reg =  <0x0 0x0 0x0 0x100>;

	clkc_AO: clock-controller {
		compatible = "amlogic,meson-gxbb-aoclkc", "amlogic,meson-gx-aoclkc";
		#clock-cells = <1>;
		#reset-cells = <1>;
		clocks = <&xtal>, <&clkc CLKID_CLK81>;
		clock-names = "xtal", "mpeg-clk";
	};

Example: UART controller node that consumes the clock and reset generated
  by the clock controller:

	uart_AO: serial@4c0 {
		compatible = "amlogic,meson-uart";
		reg = <0x4c0 0x14>;
		interrupts = <0 90 1>;
		clocks = <&clkc_AO CLKID_AO_UART1>;
		resets = <&clkc_AO RESET_AO_UART1>;
	};
```

## Documentation/devicetree/bindings/clock/amlogic,gxbb-aoclkc.yaml
```yaml
# SPDX-License-Identifier: (GPL-2.0-only OR BSD-2-Clause)
%YAML 1.2
---
$id: http://devicetree.org/schemas/clock/amlogic,gxbb-aoclkc.yaml#
$schema: http://devicetree.org/meta-schemas/core.yaml#

title: Amlogic Always-On Clock Controller

maintainers:
  - Neil Armstrong <neil.armstrong@linaro.org>

properties:
  compatible:
    oneOf:
      - items:
          - enum:
              - amlogic,meson-gxbb-aoclkc
              - amlogic,meson-gxl-aoclkc
              - amlogic,meson-gxm-aoclkc
              - amlogic,meson-axg-aoclkc
          - const: amlogic,meson-gx-aoclkc
      - enum:
          - amlogic,meson-axg-aoclkc
          - amlogic,meson-g12a-aoclkc

  clocks:
    minItems: 2
    maxItems: 5

  clock-names:
    minItems: 2
    items:
      - const: xtal
      - const: mpeg-clk
      - const: ext-32k-0
      - const: ext-32k-1
      - const: ext-32k-2

  '#clock-cells':
    const: 1

  '#reset-cells':
    const: 1

required:
  - compatible
  - clocks
  - clock-names
  - '#clock-cells'
  - '#reset-cells'

allOf:
  - if:
      properties:
        compatible:
          enum:
            - amlogic,meson-g12a-aoclkc

    then:
      properties:
        clocks:
          minItems: 2
          maxItems: 3

        clock-names:
          minItems: 2
          maxItems: 3

  - if:
      properties:
        compatible:
          enum:
            - amlogic,meson-gxl-aoclkc
            - amlogic,meson-gxm-aoclkc
            - amlogic,meson-axg-aoclkc

    then:
      properties:
        clocks:
          maxItems: 2

        clock-names:
          maxItems: 2

additionalProperties: false
```

## Documentation/devicetree/bindings/clock/amlogic,gxbb-clkc.txt
```
* Amlogic GXBB Clock and Reset Unit

The Amlogic GXBB clock controller generates and supplies clock to various
controllers within the SoC.

Required Properties:

- compatible: should be:
		"amlogic,gxbb-clkc" for GXBB SoC,
		"amlogic,gxl-clkc" for GXL and GXM SoC,
		"amlogic,axg-clkc" for AXG SoC.
		"amlogic,g12a-clkc" for G12A SoC.
		"amlogic,g12b-clkc" for G12B SoC.
- clocks : list of clock phandle, one for each entry clock-names.
- clock-names : should contain the following:
  * "xtal": the platform xtal

- #clock-cells: should be 1.

Each clock is assigned an identifier and client nodes can use this identifier
to specify the clock which they consume. All available clocks are defined as
preprocessor macros in the dt-bindings/clock/gxbb-clkc.h header and can be
used in device tree sources.

Parent node should have the following properties :
- compatible: "syscon", "simple-mfd, and "amlogic,meson-gx-hhi-sysctrl" or
              "amlogic,meson-axg-hhi-sysctrl"
- reg: base address and size of the HHI system control register space.

Example: Clock controller node:

sysctrl: system-controller@0 {
	compatible = "amlogic,meson-gx-hhi-sysctrl", "syscon", "simple-mfd";
	reg = <0 0 0 0x400>;

	clkc: clock-controller {
		#clock-cells = <1>;
		compatible = "amlogic,gxbb-clkc";
		clocks = <&xtal>;
		clock-names = "xtal";
	};
};

Example: UART controller node that consumes the clock generated by the clock
  controller:

	uart_AO: serial@c81004c0 {
		compatible = "amlogic,meson-uart";
		reg = <0xc81004c0 0x14>;
		interrupts = <0 90 1>;
		clocks = <&clkc CLKID_CLK81>;
	};
```

## Documentation/devicetree/bindings/clock/amlogic,gxbb-clkc.yaml
```yaml
# SPDX-License-Identifier: (GPL-2.0-only OR BSD-2-Clause)
%YAML 1.2
---
$id: http://devicetree.org/schemas/clock/amlogic,gxbb-clkc.yaml#
$schema: http://devicetree.org/meta-schemas/core.yaml#

title: Amlogic Clock Controller

maintainers:
  - Neil Armstrong <neil.armstrong@linaro.org>

properties:
  compatible:
    enum:
      - amlogic,gxbb-clkc
      - amlogic,gxl-clkc
      - amlogic,axg-clkc
      - amlogic,g12a-clkc
      - amlogic,g12b-clkc
      - amlogic,sm1-clkc

  clocks:
    maxItems: 1

  clock-names:
    const: xtal

  '#clock-cells':
    const: 1

required:
  - compatible
  - clocks
  - clock-names
  - '#clock-cells'

additionalProperties: false
```

## Documentation/devicetree/bindings/clock/amlogic,meson8-clkc.yaml
```yaml
# SPDX-License-Identifier: (GPL-2.0-only OR BSD-2-Clause)
%YAML 1.2
---
$id: http://devicetree.org/schemas/clock/amlogic,meson8-clkc.yaml#
$schema: http://devicetree.org/meta-schemas/core.yaml#

title: Amlogic Meson8, Meson8b and Meson8m2 Clock and Reset Controller

maintainers:
  - Neil Armstrong <neil.armstrong@linaro.org>

properties:
  compatible:
    oneOf:
      - enum:
          - amlogic,meson8-clkc
          - amlogic,meson8b-clkc
      - items:
          - const: amlogic,meson8m2-clkc
          - const: amlogic,meson8-clkc

  clocks:
    minItems: 2
    maxItems: 3

  clock-names:
    minItems: 2
    items:
      - const: xtal
      - const: ddr_pll
      - const: clk_32k

  '#clock-cells':
    const: 1

  '#reset-cells':
    const: 1

required:
  - compatible
  - clocks
  - clock-names
  - '#reset-cells'

additionalProperties: false
```

## Documentation/devicetree/bindings/clock/amlogic,meson8-ddr-clkc.yaml
```yaml
# SPDX-License-Identifier: (GPL-2.0-only OR BSD-2-Clause)
%YAML 1.2
---
$id: http://devicetree.org/schemas/clock/amlogic,meson8-ddr-clkc.yaml#
$schema: http://devicetree.org/meta-schemas/core.yaml#

title: Amlogic DDR Clock Controller

maintainers:
  - Martin Blumenstingl <martin.blumenstingl@googlemail.com>

properties:
  compatible:
    enum:
      - amlogic,meson8-ddr-clkc
      - amlogic,meson8b-ddr-clkc

  reg:
    maxItems: 1

  clocks:
    maxItems: 1

  clock-names:
    items:
      - const: xtal

  "#clock-cells":
    const: 1

required:
  - compatible
  - reg
  - clocks
  - clock-names
  - "#clock-cells"

additionalProperties: false

examples:
  - |
    ddr_clkc: clock-controller@400 {
      compatible = "amlogic,meson8-ddr-clkc";
      reg = <0x400 0x20>;
      clocks = <&xtal>;
      clock-names = "xtal";
      #clock-cells = <1>;
    };

...
```

## Documentation/devicetree/bindings/clock/amlogic,meson8b-clkc.txt
```
* Amlogic Meson8, Meson8b and Meson8m2 Clock and Reset Unit

The Amlogic Meson8 / Meson8b / Meson8m2 clock controller generates and
supplies clock to various controllers within the SoC.

Required Properties:

- compatible: must be one of:
	- "amlogic,meson8-clkc" for Meson8 (S802) SoCs
	- "amlogic,meson8b-clkc" for Meson8 (S805) SoCs
	- "amlogic,meson8m2-clkc" for Meson8m2 (S812) SoCs
- #clock-cells: should be 1.
- #reset-cells: should be 1.

Parent node should have the following properties :
- compatible: "amlogic,meson-hhi-sysctrl", "simple-mfd", "syscon"
- reg: base address and size of the HHI system control register space.

Each clock is assigned an identifier and client nodes can use this identifier
to specify the clock which they consume. All available clocks are defined as
preprocessor macros in the dt-bindings/clock/meson8b-clkc.h header and can be
used in device tree sources.

Similarly a preprocessor macro for each reset line is defined in
dt-bindings/reset/amlogic,meson8b-clkc-reset.h (which can be used from the
device tree sources).


Example: Clock controller node:

	clkc: clock-controller {
		compatible = "amlogic,meson8b-clkc";
		#clock-cells = <1>;
		#reset-cells = <1>;
	};


Example: UART controller node that consumes the clock generated by the clock
  controller:

	uart_AO: serial@c81004c0 {
		compatible = "amlogic,meson-uart";
		reg = <0xc81004c0 0x14>;
		interrupts = <0 90 1>;
		clocks = <&clkc CLKID_CLK81>;
	};
```

## Documentation/devicetree/bindings/clock/amlogic,s4-peripherals-clkc.yaml
```yaml
# SPDX-License-Identifier: (GPL-2.0-only OR BSD-2-Clause)
# Copyright (C) 2022-2023 Amlogic, Inc. All rights reserved
%YAML 1.2
---
$id: http://devicetree.org/schemas/clock/amlogic,s4-peripherals-clkc.yaml#
$schema: http://devicetree.org/meta-schemas/core.yaml#

title: Amlogic S4 Peripherals Clock Controller

maintainers:
  - Yu Tu <yu.tu@amlogic.com>

properties:
  compatible:
    const: amlogic,s4-peripherals-clkc

  reg:
    maxItems: 1

  clocks:
    minItems: 14
    items:
      - description: input fixed pll div2
      - description: input fixed pll div2p5
      - description: input fixed pll div3
      - description: input fixed pll div4
      - description: input fixed pll div5
      - description: input fixed pll div7
      - description: input hifi pll
      - description: input gp0 pll
      - description: input mpll0
      - description: input mpll1
      - description: input mpll2
      - description: input mpll3
      - description: input hdmi pll
      - description: input oscillator (usually at 24MHz)
      - description: input external 32kHz reference (optional)

  clock-names:
    minItems: 14
    items:
      - const: fclk_div2
      - const: fclk_div2p5
      - const: fclk_div3
      - const: fclk_div4
      - const: fclk_div5
      - const: fclk_div7
      - const: hifi_pll
      - const: gp0_pll
      - const: mpll0
      - const: mpll1
      - const: mpll2
      - const: mpll3
      - const: hdmi_pll
      - const: xtal
      - const: ext_32k

  "#clock-cells":
    const: 1

required:
  - compatible
  - reg
  - clocks
  - clock-names
  - "#clock-cells"

additionalProperties: false

examples:
  - |
    #include <dt-bindings/clock/amlogic,s4-peripherals-clkc.h>

    clkc_periphs: clock-controller@fe000000 {
      compatible = "amlogic,s4-peripherals-clkc";
      reg = <0xfe000000 0x49c>;
      clocks = <&clkc_pll 3>,
              <&clkc_pll 13>,
              <&clkc_pll 5>,
              <&clkc_pll 7>,
              <&clkc_pll 9>,
              <&clkc_pll 11>,
              <&clkc_pll 17>,
              <&clkc_pll 15>,
              <&clkc_pll 25>,
              <&clkc_pll 27>,
              <&clkc_pll 29>,
              <&clkc_pll 31>,
              <&clkc_pll 20>,
              <&xtal>;
      clock-names = "fclk_div2", "fclk_div2p5", "fclk_div3", "fclk_div4",
                    "fclk_div5", "fclk_div7", "hifi_pll", "gp0_pll",
                    "mpll0", "mpll1", "mpll2", "mpll3", "hdmi_pll", "xtal";
      #clock-cells = <1>;
    };
...
```

## Documentation/devicetree/bindings/clock/amlogic,s4-pll-clkc.yaml
```yaml
# SPDX-License-Identifier: (GPL-2.0-only OR BSD-2-Clause)
# Copyright (C) 2022-2023 Amlogic, Inc. All rights reserved
%YAML 1.2
---
$id: http://devicetree.org/schemas/clock/amlogic,s4-pll-clkc.yaml#
$schema: http://devicetree.org/meta-schemas/core.yaml#

title: Amlogic S4 PLL Clock Controller

maintainers:
  - Yu Tu <yu.tu@amlogic.com>

properties:
  compatible:
    const: amlogic,s4-pll-clkc

  reg:
    maxItems: 1

  clocks:
    maxItems: 1

  clock-names:
    items:
      - const: xtal

  "#clock-cells":
    const: 1

required:
  - compatible
  - reg
  - clocks
  - clock-names
  - "#clock-cells"

additionalProperties: false

examples:
  - |
    clkc_pll: clock-controller@fe008000 {
      compatible = "amlogic,s4-pll-clkc";
      reg = <0xfe008000 0x1e8>;
      clocks = <&xtal>;
      clock-names = "xtal";
      #clock-cells = <1>;
    };

...
```
