## Documentation/devicetree/bindings/clock/qcom,aoncc-sm8250.yaml
```yaml
# SPDX-License-Identifier: (GPL-2.0-only OR BSD-2-Clause)
%YAML 1.2
---
$id: http://devicetree.org/schemas/clock/qcom,aoncc-sm8250.yaml#
$schema: http://devicetree.org/meta-schemas/core.yaml#

title: LPASS Always ON Clock Controller on SM8250 SoCs

maintainers:
  - Srinivas Kandagatla <srinivas.kandagatla@linaro.org>

description: |
  The clock consumer should specify the desired clock by having the clock
  ID in its "clocks" phandle cell.
  See include/dt-bindings/clock/qcom,sm8250-lpass-aoncc.h for the full list
  of Audio Clock controller clock IDs.

properties:
  compatible:
    const: qcom,sm8250-lpass-aoncc

  reg:
    maxItems: 1

  '#clock-cells':
    const: 1

  clocks:
    items:
      - description: LPASS Core voting clock
      - description: LPASS Audio codec voting clock
      - description: Glitch Free Mux register clock

  clock-names:
    items:
      - const: core
      - const: audio
      - const: bus

required:
  - compatible
  - reg
  - '#clock-cells'
  - clocks
  - clock-names

additionalProperties: false

examples:
  - |
    #include <dt-bindings/clock/qcom,sm8250-lpass-aoncc.h>
    #include <dt-bindings/sound/qcom,q6afe.h>
    clock-controller@3800000 {
      #clock-cells = <1>;
      compatible = "qcom,sm8250-lpass-aoncc";
      reg = <0x03380000 0x40000>;
      clocks = <&q6afecc LPASS_HW_MACRO_VOTE LPASS_CLK_ATTRIBUTE_COUPLE_NO>,
               <&q6afecc LPASS_HW_DCODEC_VOTE LPASS_CLK_ATTRIBUTE_COUPLE_NO>,
               <&q6afecc LPASS_CLK_ID_TX_CORE_MCLK LPASS_CLK_ATTRIBUTE_COUPLE_NO>;
      clock-names = "core", "audio", "bus";
    };
```

## Documentation/devicetree/bindings/clock/qcom,apcs-msm8953.yaml
```yaml
# SPDX-License-Identifier: (GPL-2.0-only OR BSD-2-Clause)
%YAML 1.2
---
$id: http://devicetree.org/schemas/clock/qcom,apcs-cc-msm8953.yaml#
$schema: http://devicetree.org/meta-schemas/core.yaml#

title: Qualcomm APCS Clock Controller for MSM8953 and SDM632

description:
  Qualcomm APCS clock controller provides the clocks for CPU and Cache
  Interconnect (CCI). It supports up to 9 clocks.

  See also:: include/dt-bindings/clock/qcom,apcs-msm8953.h

properties:
  compatible:
    enum:
      - qcom,apcs-cc-msm8953

  reg:
    items:
      - description: CPU0 Mux/Divider/Gate region
      - description: CPU0 Mux/Divider/Gate region
      - description: CCI Mux/Divider/Gate region
      - description: CPU0 PLL region
      - description: CPU4 PLL region
      - description: CCI PLL region

  reg-names:
    items:
      - const: cpu0_rcg_cbr
      - const: cpu4_rcg_cbr
      - const: cci_rcg_cbr
      - const: cpu0_pll
      - const: cpu4_pll
      - const: cci_pll

  '#clock-cells':
    const: 1

  clocks:
    items:
      - description: external oscillator (XO)
      - description: auxillary external clock (GPLL0)
      - description: auxillary external clock (GPLL2)
      - description: auxillary external clock (GPLL4)


  clock-names:
    items:
      - const: osc
      - const: gpll0
      - const: gpll2
      - const: gpll4

  '#interconnect-cells':
    const: 1

  operating-points-v2: true

required:
  - compatible
  - clocks
  - clock-names
  - reg
  - reg-names
  - '#clock-cells'

additionalProperties: true

examples:
  - |
      #include <dt-bindings/clock/qcom,apcs-msm8953.h>
 
      apcscc: clock-controller@b011050 {
         compatible = "qcom,apcs-cc-msm8953";
         reg = <0x0b011050 0x10>,
               <0x0b016000 0x50>,
               <0x0b111050 0x10>,
               <0x0b116000 0x50>,
               <0x0b1d0000 0x50>,
               <0x0b1d1050 0x10>;
           reg-names = "cpu4_rcg_cbr",
                       "cpu4_pll",
                       "cpu0_rcg_cbr",
                       "cpu0_pll",
                       "cci_pll",
                       "cci_rcg_cbr";

           clocks = <&xo_board>,
                    <&gcc GPLL0_EARLY>,
                    <&gcc GPLL2_EARLY>;
                    <&gcc GPLL4_EARLY>;
           clock-names = "osc",
                         "gpll0",
                         "gpll2",
                         "gpll4";

           #clock-cells = <1>;
      };
```

## Documentation/devicetree/bindings/clock/qcom,camcc-sm8250.yaml
```yaml
# SPDX-License-Identifier: (GPL-2.0-only OR BSD-2-Clause)
%YAML 1.2
---
$id: http://devicetree.org/schemas/clock/qcom,camcc-sm8250.yaml#
$schema: http://devicetree.org/meta-schemas/core.yaml#

title: Qualcomm Camera Clock & Reset Controller on SM8250

maintainers:
  - Jonathan Marek <jonathan@marek.ca>

description: |
  Qualcomm camera clock control module provides the clocks, resets and
  power domains on SM8250.

  See also: include/dt-bindings/clock/qcom,camcc-sm8250.h

allOf:
  - $ref: qcom,gcc.yaml#

properties:
  compatible:
    const: qcom,sm8250-camcc

  clocks:
    items:
      - description: AHB
      - description: Board XO source
      - description: Board active XO source
      - description: Sleep clock source

  clock-names:
    items:
      - const: iface
      - const: bi_tcxo
      - const: bi_tcxo_ao
      - const: sleep_clk

  power-domains:
    items:
      - description: MMCX power domain

  reg:
    maxItems: 1

  required-opps:
    maxItems: 1
    description:
      OPP node describing required MMCX performance point.

required:
  - compatible
  - clocks
  - clock-names

unevaluatedProperties: false

examples:
  - |
    #include <dt-bindings/clock/qcom,gcc-sm8250.h>
    #include <dt-bindings/clock/qcom,rpmh.h>
    clock-controller@ad00000 {
      compatible = "qcom,sm8250-camcc";
      reg = <0x0ad00000 0x10000>;
      clocks = <&gcc GCC_CAMERA_AHB_CLK>,
               <&rpmhcc RPMH_CXO_CLK>,
               <&rpmhcc RPMH_CXO_CLK_A>,
               <&sleep_clk>;
      clock-names = "iface", "bi_tcxo", "bi_tcxo_ao", "sleep_clk";
      #clock-cells = <1>;
      #reset-cells = <1>;
      #power-domain-cells = <1>;
    };
...
```

## Documentation/devicetree/bindings/clock/qcom,camcc.txt
```
Qualcomm Camera Clock & Reset Controller Binding
------------------------------------------------

Required properties :
- compatible : shall contain "qcom,sdm845-camcc".
- reg : shall contain base register location and length.
- #clock-cells : from common clock binding, shall contain 1.
- #reset-cells : from common reset binding, shall contain 1.
- #power-domain-cells : from generic power domain binding, shall contain 1.

Example:
	camcc: clock-controller@ad00000 {
		compatible = "qcom,sdm845-camcc";
		reg = <0xad00000 0x10000>;
		#clock-cells = <1>;
		#reset-cells = <1>;
		#power-domain-cells = <1>;
	};
```

## Documentation/devicetree/bindings/clock/qcom,dispcc-sc8280xp.yaml
```yaml
# SPDX-License-Identifier: (GPL-2.0-only OR BSD-2-Clause)
%YAML 1.2
---
$id: http://devicetree.org/schemas/clock/qcom,dispcc-sc8280xp.yaml#
$schema: http://devicetree.org/meta-schemas/core.yaml#

title: Qualcomm Display Clock & Reset Controller Binding for SC8280XP

maintainers:
  - Bjorn Andersson <bjorn.andersson@linaro.org>

description: |
  Qualcomm display clock control module which supports the clocks, resets and
  power domains for the two MDSS instances on SC8280XP.

  See also:
    include/dt-bindings/clock/qcom,dispcc-sc8280xp.h

properties:
  compatible:
    enum:
      - qcom,sc8280xp-dispcc0
      - qcom,sc8280xp-dispcc1

  clocks:
    items:
      - description: AHB interface clock,
      - description: SoC CXO clock
      - description: SoC sleep clock
      - description: DisplayPort 0 link clock
      - description: DisplayPort 0 VCO div clock
      - description: DisplayPort 1 link clock
      - description: DisplayPort 1 VCO div clock
      - description: DisplayPort 2 link clock
      - description: DisplayPort 2 VCO div clock
      - description: DisplayPort 3 link clock
      - description: DisplayPort 3 VCO div clock
      - description: DSI 0 PLL byte clock
      - description: DSI 0 PLL DSI clock
      - description: DSI 1 PLL byte clock
      - description: DSI 1 PLL DSI clock

  '#clock-cells':
    const: 1

  '#reset-cells':
    const: 1

  '#power-domain-cells':
    const: 1

  reg:
    maxItems: 1

  power-domains:
    items:
      - description: MMCX power domain

required:
  - compatible
  - reg
  - clocks
  - '#clock-cells'
  - '#reset-cells'
  - '#power-domain-cells'

additionalProperties: false

examples:
  - |
    #include <dt-bindings/clock/qcom,gcc-sc8280xp.h>
    #include <dt-bindings/clock/qcom,rpmh.h>
    #include <dt-bindings/power/qcom-rpmpd.h>
    clock-controller@af00000 {
      compatible = "qcom,sc8280xp-dispcc0";
      reg = <0x0af00000 0x20000>;
      clocks = <&gcc GCC_DISP_AHB_CLK>,
               <&rpmhcc RPMH_CXO_CLK>,
               <&sleep_clk>,
               <&mdss0_dp_phy0 0>,
               <&mdss0_dp_phy0 1>,
               <&mdss0_dp_phy1 0>,
               <&mdss0_dp_phy1 1>,
               <&mdss0_dp_phy2 0>,
               <&mdss0_dp_phy2 1>,
               <&mdss0_dp_phy3 0>,
               <&mdss0_dp_phy3 1>,
               <&mdss0_dsi0_phy 0>,
               <&mdss0_dsi0_phy 1>,
               <&mdss0_dsi1_phy 0>,
               <&mdss0_dsi1_phy 1>;
      power-domains = <&rpmhpd SC8280XP_MMCX>;
      #clock-cells = <1>;
      #reset-cells = <1>;
      #power-domain-cells = <1>;
    };
...
```

## Documentation/devicetree/bindings/clock/qcom,dispcc-sm6125.yaml
```yaml
# SPDX-License-Identifier: (GPL-2.0-only OR BSD-2-Clause)
%YAML 1.2
---
$id: http://devicetree.org/schemas/clock/qcom,dispcc-sm6125.yaml#
$schema: http://devicetree.org/meta-schemas/core.yaml#

title: Qualcomm Display Clock Controller on SM6125

maintainers:
  - Martin Botka <martin.botka@somainline.org>

description: |
  Qualcomm display clock control module provides the clocks and power domains
  on SM6125.

  See also:: include/dt-bindings/clock/qcom,dispcc-sm6125.h

properties:
  compatible:
    enum:
      - qcom,sm6125-dispcc

  clocks:
    items:
      - description: Board XO source
      - description: Byte clock from DSI PHY0
      - description: Pixel clock from DSI PHY0
      - description: Pixel clock from DSI PHY1
      - description: Link clock from DP PHY
      - description: VCO DIV clock from DP PHY
      - description: AHB config clock from GCC

  clock-names:
    items:
      - const: bi_tcxo
      - const: dsi0_phy_pll_out_byteclk
      - const: dsi0_phy_pll_out_dsiclk
      - const: dsi1_phy_pll_out_dsiclk
      - const: dp_phy_pll_link_clk
      - const: dp_phy_pll_vco_div_clk
      - const: cfg_ahb_clk

  '#clock-cells':
    const: 1

  '#power-domain-cells':
    const: 1

  reg:
    maxItems: 1

required:
  - compatible
  - reg
  - clocks
  - clock-names
  - '#clock-cells'
  - '#power-domain-cells'

additionalProperties: false

examples:
  - |
    #include <dt-bindings/clock/qcom,rpmcc.h>
    #include <dt-bindings/clock/qcom,gcc-sm6125.h>
    clock-controller@5f00000 {
      compatible = "qcom,sm6125-dispcc";
      reg = <0x5f00000 0x20000>;
      clocks = <&rpmcc RPM_SMD_XO_CLK_SRC>,
               <&dsi0_phy 0>,
               <&dsi0_phy 1>,
               <&dsi1_phy 1>,
               <&dp_phy 0>,
               <&dp_phy 1>,
               <&gcc GCC_DISP_AHB_CLK>;
      clock-names = "bi_tcxo",
                    "dsi0_phy_pll_out_byteclk",
                    "dsi0_phy_pll_out_dsiclk",
                    "dsi1_phy_pll_out_dsiclk",
                    "dp_phy_pll_link_clk",
                    "dp_phy_pll_vco_div_clk",
                    "cfg_ahb_clk";
      #clock-cells = <1>;
      #power-domain-cells = <1>;
    };
...
```

## Documentation/devicetree/bindings/clock/qcom,dispcc-sm6350.yaml
```yaml
# SPDX-License-Identifier: (GPL-2.0-only OR BSD-2-Clause)
%YAML 1.2
---
$id: http://devicetree.org/schemas/clock/qcom,dispcc-sm6350.yaml#
$schema: http://devicetree.org/meta-schemas/core.yaml#

title: Qualcomm Display Clock & Reset Controller Binding for SM6350

maintainers:
  - Konrad Dybcio <konrad.dybcio@somainline.org>

description: |
  Qualcomm display clock control module which supports the clocks, resets and
  power domains on SM6350.

  See also dt-bindings/clock/qcom,dispcc-sm6350.h.

properties:
  compatible:
    const: qcom,sm6350-dispcc

  clocks:
    items:
      - description: Board XO source
      - description: GPLL0 source from GCC
      - description: Byte clock from DSI PHY
      - description: Pixel clock from DSI PHY
      - description: Link clock from DP PHY
      - description: VCO DIV clock from DP PHY

  clock-names:
    items:
      - const: bi_tcxo
      - const: gcc_disp_gpll0_clk
      - const: dsi0_phy_pll_out_byteclk
      - const: dsi0_phy_pll_out_dsiclk
      - const: dp_phy_pll_link_clk
      - const: dp_phy_pll_vco_div_clk

  '#clock-cells':
    const: 1

  '#reset-cells':
    const: 1

  '#power-domain-cells':
    const: 1

  reg:
    maxItems: 1

required:
  - compatible
  - reg
  - clocks
  - clock-names
  - '#clock-cells'
  - '#reset-cells'
  - '#power-domain-cells'

additionalProperties: false

examples:
  - |
    #include <dt-bindings/clock/qcom,gcc-sm6350.h>
    #include <dt-bindings/clock/qcom,rpmh.h>
    clock-controller@af00000 {
      compatible = "qcom,sm6350-dispcc";
      reg = <0x0af00000 0x20000>;
      clocks = <&rpmhcc RPMH_CXO_CLK>,
               <&gcc GCC_DISP_GPLL0_CLK>,
               <&dsi_phy 0>,
               <&dsi_phy 1>,
               <&dp_phy 0>,
               <&dp_phy 1>;
      clock-names = "bi_tcxo",
                    "gcc_disp_gpll0_clk",
                    "dsi0_phy_pll_out_byteclk",
                    "dsi0_phy_pll_out_dsiclk",
                    "dp_phy_pll_link_clk",
                    "dp_phy_pll_vco_div_clk";
      #clock-cells = <1>;
      #reset-cells = <1>;
      #power-domain-cells = <1>;
    };
...
```
