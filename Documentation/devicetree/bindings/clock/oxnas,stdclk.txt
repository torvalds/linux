## Documentation/devicetree/bindings/clock/oxnas,stdclk.txt
```
Oxford Semiconductor OXNAS SoC Family Standard Clocks
================================================

Please also refer to clock-bindings.txt in this directory for common clock
bindings usage.

Required properties:
- compatible: For OX810SE, should be "oxsemi,ox810se-stdclk"
	      For OX820, should be "oxsemi,ox820-stdclk"
- #clock-cells: 1, see below

Parent node should have the following properties :
- compatible: For OX810SE, should be
		"oxsemi,ox810se-sys-ctrl", "syscon", "simple-mfd"
	      For OX820, should be
		"oxsemi,ox820-sys-ctrl", "syscon", "simple-mfd"

example:

sys: sys-ctrl@000000 {
	compatible = "oxsemi,ox810se-sys-ctrl", "syscon", "simple-mfd";
	reg = <0x000000 0x100000>;

	stdclk: stdclk {
		compatible = "oxsemi,ox810se-stdclk";
		#clock-cells = <1>;
	};
};
```

## Documentation/devicetree/bindings/clock/pistachio-clock.txt
```
Imagination Technologies Pistachio SoC clock controllers
========================================================

Pistachio has four clock controllers (core clock, peripheral clock, peripheral
general control, and top general control) which are instantiated individually
from the device-tree.

External clocks:
----------------

There are three external inputs to the clock controllers which should be
defined with the following clock-output-names:
- "xtal": External 52Mhz oscillator (required)
- "audio_clk_in": Alternate audio reference clock (optional)
- "enet_clk_in": Alternate ethernet PHY clock (optional)

Core clock controller:
----------------------

The core clock controller generates clocks for the CPU, RPU (WiFi + BT
co-processor), audio, and several peripherals.

Required properties:
- compatible: Must be "img,pistachio-clk".
- reg: Must contain the base address and length of the core clock controller.
- #clock-cells: Must be 1.  The single cell is the clock identifier.
  See dt-bindings/clock/pistachio-clk.h for the list of valid identifiers.
- clocks: Must contain an entry for each clock in clock-names.
- clock-names: Must include "xtal" (see "External clocks") and
  "audio_clk_in_gate", "enet_clk_in_gate" which are generated by the
  top-level general control.

Example:
	clk_core: clock-controller@18144000 {
		compatible = "img,pistachio-clk";
		reg = <0x18144000 0x800>;
		clocks = <&xtal>, <&cr_top EXT_CLK_AUDIO_IN>,
			 <&cr_top EXT_CLK_ENET_IN>;
		clock-names = "xtal", "audio_clk_in_gate", "enet_clk_in_gate";

		#clock-cells = <1>;
	};

Peripheral clock controller:
----------------------------

The peripheral clock controller generates clocks for the DDR, ROM, and other
peripherals.  The peripheral system clock ("periph_sys") generated by the core
clock controller is the input clock to the peripheral clock controller.

Required properties:
- compatible: Must be "img,pistachio-periph-clk".
- reg: Must contain the base address and length of the peripheral clock
  controller.
- #clock-cells: Must be 1.  The single cell is the clock identifier.
  See dt-bindings/clock/pistachio-clk.h for the list of valid identifiers.
- clocks: Must contain an entry for each clock in clock-names.
- clock-names: Must include "periph_sys", the peripheral system clock generated
  by the core clock controller.

Example:
	clk_periph: clock-controller@18144800 {
		compatible = "img,pistachio-clk-periph";
		reg = <0x18144800 0x800>;
		clocks = <&clk_core CLK_PERIPH_SYS>;
		clock-names = "periph_sys";

		#clock-cells = <1>;
	};

Peripheral general control:
---------------------------

The peripheral general control block generates system interface clocks and
resets for various peripherals.  It also contains miscellaneous peripheral
control registers.  The system clock ("sys") generated by the peripheral clock
controller is the input clock to the system clock controller.

Required properties:
- compatible: Must include "img,pistachio-periph-cr" and "syscon".
- reg: Must contain the base address and length of the peripheral general
  control registers.
- #clock-cells: Must be 1.  The single cell is the clock identifier.
  See dt-bindings/clock/pistachio-clk.h for the list of valid identifiers.
- clocks: Must contain an entry for each clock in clock-names.
- clock-names: Must include "sys", the system clock generated by the peripheral
  clock controller.

Example:
	cr_periph: syscon@18144800 {
		compatible = "img,pistachio-cr-periph", "syscon";
		reg = <0x18148000 0x1000>;
		clocks = <&clock_periph PERIPH_CLK_PERIPH_SYS>;
		clock-names = "sys";

		#clock-cells = <1>;
	};

Top-level general control:
--------------------------

The top-level general control block contains miscellaneous control registers and
gates for the external clocks "audio_clk_in" and "enet_clk_in".

Required properties:
- compatible: Must include "img,pistachio-cr-top" and "syscon".
- reg: Must contain the base address and length of the top-level
  control registers.
- clocks: Must contain an entry for each clock in clock-names.
- clock-names: Two optional clocks, "audio_clk_in" and "enet_clk_in" (see
  "External clocks").
- #clock-cells: Must be 1.  The single cell is the clock identifier.
  See dt-bindings/clock/pistachio-clk.h for the list of valid identifiers.

Example:
	cr_top: syscon@18144800 {
		compatible = "img,pistachio-cr-top", "syscon";
		reg = <0x18149000 0x200>;
		clocks = <&audio_refclk>, <&ext_enet_in>;
		clock-names = "audio_clk_in", "enet_clk_in";

		#clock-cells = <1>;
	};
```

## Documentation/devicetree/bindings/clock/prima2-clock.txt
```
* Clock bindings for CSR SiRFprimaII

Required properties:
- compatible: Should be "sirf,prima2-clkc"
- reg: Address and length of the register set
- interrupts: Should contain clock controller interrupt
- #clock-cells: Should be <1>

The clock consumer should specify the desired clock by having the clock
ID in its "clocks" phandle cell.  The following is a full list of prima2
clocks and IDs.

	Clock			ID
	---------------------------
	rtc			0
	osc             	1
	pll1            	2
	pll2            	3
	pll3            	4
	mem             	5
	sys             	6
	security        	7
	dsp             	8
	gps             	9
	mf              	10
	io              	11
	cpu             	12
	uart0           	13
	uart1           	14
	uart2           	15
	tsc             	16
	i2c0            	17
	i2c1            	18
	spi0            	19
	spi1            	20
	pwmc            	21
	efuse           	22
	pulse           	23
	dmac0           	24
	dmac1           	25
	nand            	26
	audio           	27
	usp0            	28
	usp1            	29
	usp2            	30
	vip             	31
	gfx             	32
	mm              	33
	lcd             	34
	vpp             	35
	mmc01           	36
	mmc23           	37
	mmc45           	38
	usbpll          	39
	usb0            	40
	usb1			41

Examples:

clks: clock-controller@88000000 {
	compatible = "sirf,prima2-clkc";
	reg = <0x88000000 0x1000>;
	interrupts = <3>;
	#clock-cells = <1>;
};

i2c0: i2c@b00e0000 {
	cell-index = <0>;
	compatible = "sirf,prima2-i2c";
	reg = <0xb00e0000 0x10000>;
	interrupts = <24>;
	clocks = <&clks 17>;
};
```

## Documentation/devicetree/bindings/clock/pwm-clock.txt
```
Binding for an external clock signal driven by a PWM pin.

This binding uses the common clock binding[1] and the common PWM binding[2].

[1] Documentation/devicetree/bindings/clock/clock-bindings.txt
[2] Documentation/devicetree/bindings/pwm/pwm.txt

Required properties:
- compatible : shall be "pwm-clock".
- #clock-cells : from common clock binding; shall be set to 0.
- pwms : from common PWM binding; this determines the clock frequency
  via the period given in the PWM specifier.

Optional properties:
- clock-output-names : From common clock binding.
- clock-frequency : Exact output frequency, in case the PWM period
  is not exact but was rounded to nanoseconds.

Example:
	clock {
		compatible = "pwm-clock";
		#clock-cells = <0>;
		clock-frequency = <25000000>;
		clock-output-names = "mipi_mclk";
		pwms = <&pwm2 0 40>; /* 1 / 40 ns = 25 MHz */
	};
```

## Documentation/devicetree/bindings/clock/pwm-clock.yaml
```yaml
# SPDX-License-Identifier: GPL-2.0
%YAML 1.2
---
$id: http://devicetree.org/schemas/clock/pwm-clock.yaml#
$schema: http://devicetree.org/meta-schemas/core.yaml#

title: An external clock signal driven by a PWM pin.

maintainers:
  - Philipp Zabel <p.zabel@pengutronix.de>

properties:
  compatible:
    const: pwm-clock

  '#clock-cells':
    const: 0

  clock-frequency:
    description: Exact output frequency, in case the PWM period is not exact
      but was rounded to nanoseconds.

  clock-output-names:
    maxItems: 1

  pwms:
    maxItems: 1

required:
  - compatible
  - '#clock-cells'
  - pwms

additionalProperties: false

examples:
  - |
    clock {
        compatible = "pwm-clock";
        #clock-cells = <0>;
        clock-frequency = <25000000>;
        clock-output-names = "mipi_mclk";
        pwms = <&pwm2 0 40>; /* 1 / 40 ns = 25 MHz */
    };
...
```

## Documentation/devicetree/bindings/clock/pxa-clock.txt
```
* Clock bindings for Marvell PXA chips

Required properties:
- compatible: Should be "marvell,pxa-clocks"
- #clock-cells: Should be <1>

The clock consumer should specify the desired clock by having the clock
ID in its "clocks" phandle cell (see include/.../pxa-clock.h).

Examples:

pxa2xx_clks: pxa2xx_clks@41300004 {
        compatible = "marvell,pxa-clocks";
        #clock-cells = <1>;
};
```

## Documentation/devicetree/bindings/clock/qca,ath79-pll.txt
```
Binding for Qualcomm Atheros AR7xxx/AR9XXX PLL controller

The PPL controller provides the 3 main clocks of the SoC: CPU, DDR and AHB.

Required Properties:
- compatible: has to be "qca,<soctype>-pll" and one of the following
  fallbacks:
  - "qca,ar7100-pll"
  - "qca,ar7240-pll"
  - "qca,ar9130-pll"
  - "qca,ar9330-pll"
  - "qca,ar9340-pll"
  - "qca,qca9550-pll"
- reg: Base address and size of the controllers memory area
- clock-names: Name of the input clock, has to be "ref"
- clocks: phandle of the external reference clock
- #clock-cells: has to be one

Optional properties:
- clock-output-names: should be "cpu", "ddr", "ahb"

Example:

	pll-controller@18050000 {
		compatible = "qca,ar9132-pll", "qca,ar9130-pll";
		reg = <0x18050000 0x20>;

		clock-names = "ref";
		clocks = <&extosc>;

		#clock-cells = <1>;
		clock-output-names = "cpu", "ddr", "ahb";
	};
```

## Documentation/devicetree/bindings/clock/qca,ath79-pll.yaml
```yaml
# SPDX-License-Identifier: (GPL-2.0-only OR BSD-2-Clause)
%YAML 1.2
---
$id: http://devicetree.org/schemas/clock/qca,ath79-pll.yaml#
$schema: http://devicetree.org/meta-schemas/core.yaml#

title: Qualcomm Atheros ATH79 PLL controller

maintainers:
  - Alban Bedel <albeu@free.fr>
  - Antony Pavlov <antonynpavlov@gmail.com>

description: >
  The PLL controller provides the 3 main clocks of the SoC: CPU, DDR and AHB.

properties:
  compatible:
    oneOf:
      - items:
          - const: qca,ar9132-pll
          - const: qca,ar9130-pll
      - items:
          - enum:
              - qca,ar7100-pll
              - qca,ar7240-pll
              - qca,ar9130-pll
              - qca,ar9330-pll
              - qca,ar9340-pll
              - qca,qca9530-pll
              - qca,qca9550-pll
              - qca,qca9560-pll

  reg:
    maxItems: 1

  clock-names:
    items:
      - const: ref

  clocks:
    maxItems: 1

  '#clock-cells':
    const: 1

  clock-output-names:
    items:
      - const: cpu
      - const: ddr
      - const: ahb

required:
  - compatible
  - reg
  - clock-names
  - clocks
  - '#clock-cells'

additionalProperties: false

examples:
  - |
    clock-controller@18050000 {
        compatible = "qca,ar9132-pll", "qca,ar9130-pll";
        reg = <0x18050000 0x20>;
        clock-names = "ref";
        clocks = <&extosc>;
        #clock-cells = <1>;
        clock-output-names = "cpu", "ddr", "ahb";
    };
```

## Documentation/devicetree/bindings/clock/qcom,a53pll.txt
```
Qualcomm MSM8916 A53 PLL Binding
--------------------------------
The A53 PLL on MSM8916 platforms is the main CPU PLL used used for frequencies
above 1GHz.

Required properties :
- compatible : Shall contain only one of the following:

		"qcom,msm8916-a53pll"

- reg : shall contain base register location and length

- #clock-cells : must be set to <0>

Example:

	a53pll: clock@b016000 {
		compatible = "qcom,msm8916-a53pll";
		reg = <0xb016000 0x40>;
		#clock-cells = <0>;
	};
```

## Documentation/devicetree/bindings/clock/qcom,a53pll.yaml
```yaml
# SPDX-License-Identifier: (GPL-2.0-only OR BSD-2-Clause)
%YAML 1.2
---
$id: http://devicetree.org/schemas/clock/qcom,a53pll.yaml#
$schema: http://devicetree.org/meta-schemas/core.yaml#

title: Qualcomm A53 PLL clock

maintainers:
  - Bjorn Andersson <andersson@kernel.org>

description:
  The A53 PLL on few Qualcomm platforms is the main CPU PLL used used for
  frequencies above 1GHz.

properties:
  compatible:
    enum:
      - qcom,ipq5018-a53pll
      - qcom,ipq5332-a53pll
      - qcom,ipq6018-a53pll
      - qcom,ipq8074-a53pll
      - qcom,ipq9574-a73pll
      - qcom,msm8916-a53pll
      - qcom,msm8939-a53pll

  reg:
    maxItems: 1

  '#clock-cells':
    const: 0

  clocks:
    items:
      - description: board XO clock

  clock-names:
    items:
      - const: xo

  operating-points-v2: true

required:
  - compatible
  - reg
  - '#clock-cells'

additionalProperties: false

examples:
  # Example 1 - A53 PLL found on MSM8916 devices
  - |
    a53pll: clock@b016000 {
        compatible = "qcom,msm8916-a53pll";
        reg = <0xb016000 0x40>;
        #clock-cells = <0>;
    };
  # Example 2 - A53 PLL found on IPQ6018 devices
  - |
    a53pll_ipq: clock-controller@b116000 {
        compatible = "qcom,ipq6018-a53pll";
        reg = <0x0b116000 0x40>;
        #clock-cells = <0>;
        clocks = <&xo>;
        clock-names = "xo";
    };
```

## Documentation/devicetree/bindings/clock/qcom,a7pll.yaml
```yaml
# SPDX-License-Identifier: (GPL-2.0-only OR BSD-2-Clause)
%YAML 1.2
---
$id: http://devicetree.org/schemas/clock/qcom,a7pll.yaml#
$schema: http://devicetree.org/meta-schemas/core.yaml#

title: Qualcomm A7 PLL clock

maintainers:
  - Manivannan Sadhasivam <manivannan.sadhasivam@linaro.org>

description:
  The A7 PLL on the Qualcomm platforms like SDX55, SDX65 is used to provide high
  frequency clock to the CPU.

properties:
  compatible:
    enum:
      - qcom,sdx55-a7pll

  reg:
    maxItems: 1

  '#clock-cells':
    const: 0

  clocks:
    items:
      - description: board XO clock

  clock-names:
    items:
      - const: bi_tcxo

required:
  - compatible
  - reg
  - '#clock-cells'

additionalProperties: false

examples:
  - |
    #include <dt-bindings/clock/qcom,rpmh.h>
    a7pll: clock@17808000 {
        compatible = "qcom,sdx55-a7pll";
        reg = <0x17808000 0x1000>;
        clocks = <&rpmhcc RPMH_CXO_CLK>;
        clock-names = "bi_tcxo";
        #clock-cells = <0>;
    };
```
