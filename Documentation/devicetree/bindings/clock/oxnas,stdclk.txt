## Documentation/devicetree/bindings/clock/qcom,dispcc-sm8x50.yaml
```yaml
# SPDX-License-Identifier: (GPL-2.0-only OR BSD-2-Clause)
%YAML 1.2
---
$id: http://devicetree.org/schemas/clock/qcom,dispcc-sm8x50.yaml#
$schema: http://devicetree.org/meta-schemas/core.yaml#

title: Qualcomm Display Clock & Reset Controller on SM8150/SM8250/SM8350

maintainers:
  - Jonathan Marek <jonathan@marek.ca>

description: |
  Qualcomm display clock control module provides the clocks, resets and power
  domains on SM8150/SM8250/SM8350.

  See also::
    include/dt-bindings/clock/qcom,dispcc-sm8150.h
    include/dt-bindings/clock/qcom,dispcc-sm8250.h
    include/dt-bindings/clock/qcom,dispcc-sm8350.h

properties:
  compatible:
    enum:
      - qcom,sc8180x-dispcc
      - qcom,sm8150-dispcc
      - qcom,sm8250-dispcc
      - qcom,sm8350-dispcc

  clocks:
    minItems: 7
    items:
      - description: Board XO source
      - description: Byte clock from DSI PHY0
      - description: Pixel clock from DSI PHY0
      - description: Byte clock from DSI PHY1
      - description: Pixel clock from DSI PHY1
      - description: Link clock from DP PHY
      - description: VCO DIV clock from DP PHY
      - description: Link clock from eDP PHY
      - description: VCO DIV clock from eDP PHY
      - description: Link clock from DP1 PHY
      - description: VCO DIV clock from DP1 PHY
      - description: Link clock from DP2 PHY
      - description: VCO DIV clock from DP2 PHY

  clock-names:
    minItems: 7
    items:
      - const: bi_tcxo
      - const: dsi0_phy_pll_out_byteclk
      - const: dsi0_phy_pll_out_dsiclk
      - const: dsi1_phy_pll_out_byteclk
      - const: dsi1_phy_pll_out_dsiclk
      - const: dp_phy_pll_link_clk
      - const: dp_phy_pll_vco_div_clk
      - const: edp_phy_pll_link_clk
      - const: edp_phy_pll_vco_div_clk
      - const: dptx1_phy_pll_link_clk
      - const: dptx1_phy_pll_vco_div_clk
      - const: dptx2_phy_pll_link_clk
      - const: dptx2_phy_pll_vco_div_clk

  power-domains:
    description:
      A phandle and PM domain specifier for the MMCX power domain.
    maxItems: 1

  required-opps:
    description:
      A phandle to an OPP node describing required MMCX performance point.
    maxItems: 1

required:
  - compatible
  - clocks
  - clock-names
  - '#power-domain-cells'

allOf:
  - $ref: qcom,gcc.yaml#
  - if:
      not:
        properties:
          compatible:
            contains:
              const: qcom,sc8180x-dispcc
    then:
      properties:
        clocks:
          maxItems: 7
        clock-names:
          maxItems: 7

unevaluatedProperties: false

examples:
  - |
    #include <dt-bindings/clock/qcom,rpmh.h>
    #include <dt-bindings/power/qcom,rpmhpd.h>
    clock-controller@af00000 {
      compatible = "qcom,sm8250-dispcc";
      reg = <0x0af00000 0x10000>;
      clocks = <&rpmhcc RPMH_CXO_CLK>,
               <&dsi0_phy 0>,
               <&dsi0_phy 1>,
               <&dsi1_phy 0>,
               <&dsi1_phy 1>,
               <&dp_phy 0>,
               <&dp_phy 1>;
      clock-names = "bi_tcxo",
                    "dsi0_phy_pll_out_byteclk",
                    "dsi0_phy_pll_out_dsiclk",
                    "dsi1_phy_pll_out_byteclk",
                    "dsi1_phy_pll_out_dsiclk",
                    "dp_phy_pll_link_clk",
                    "dp_phy_pll_vco_div_clk";
      #clock-cells = <1>;
      #reset-cells = <1>;
      #power-domain-cells = <1>;
      power-domains = <&rpmhpd RPMHPD_MMCX>;
      required-opps = <&rpmhpd_opp_low_svs>;
    };
...
```

## Documentation/devicetree/bindings/clock/qcom,dispcc.txt
```
Qualcomm Technologies, Inc. Display Clock Controller Binding
------------------------------------------------------------

Required properties :

- compatible : shall contain "qcom,sdm845-dispcc"
- reg : shall contain base register location and length.
- #clock-cells : from common clock binding, shall contain 1.
- #reset-cells : from common reset binding, shall contain 1.
- #power-domain-cells : from generic power domain binding, shall contain 1.

Example:
	dispcc: clock-controller@af00000 {
		compatible = "qcom,sdm845-dispcc";
		reg = <0xaf00000 0x100000>;
		#clock-cells = <1>;
		#reset-cells = <1>;
		#power-domain-cells = <1>;
	};
```

## Documentation/devicetree/bindings/clock/qcom,dispcc.yaml
```yaml
# SPDX-License-Identifier: GPL-2.0-only
%YAML 1.2
---
$id: http://devicetree.org/schemas/bindings/clock/qcom,dispcc.yaml#
$schema: http://devicetree.org/meta-schemas/core.yaml#

title: Qualcomm Display Clock & Reset Controller Binding

maintainers:
  - Taniya Das <tdas@codeaurora.org>

description: |
  Qualcomm display clock control module which supports the clocks, resets and
  power domains.

properties:
  compatible:
    enum:
      - qcom,sc7180-dispcc
      - qcom,sdm845-dispcc

  clocks:
    minItems: 1
    maxItems: 2
    items:
      - description: Board XO source
      - description: GPLL0 source from GCC

  clock-names:
    items:
      - const: xo
      - const: gpll0

  '#clock-cells':
    const: 1

  '#reset-cells':
    const: 1

  '#power-domain-cells':
    const: 1

  reg:
    maxItems: 1

required:
  - compatible
  - reg
  - clocks
  - clock-names
  - '#clock-cells'
  - '#reset-cells'
  - '#power-domain-cells'

examples:
  # Example of DISPCC with clock node properties for SDM845:
  - |
    clock-controller@af00000 {
      compatible = "qcom,sdm845-dispcc";
      reg = <0xaf00000 0x10000>;
      clocks = <&rpmhcc 0>, <&gcc 24>;
      clock-names = "xo", "gpll0";
      #clock-cells = <1>;
      #reset-cells = <1>;
      #power-domain-cells = <1>;
     };
...
```

## Documentation/devicetree/bindings/clock/qcom,gcc-apq8064.yaml
```yaml
# SPDX-License-Identifier: GPL-2.0-only
%YAML 1.2
---
$id: http://devicetree.org/schemas/clock/qcom,gcc-apq8064.yaml#
$schema: http://devicetree.org/meta-schemas/core.yaml#

title: Qualcomm Global Clock & Reset Controller on APQ8064/MSM8960

maintainers:
  - Stephen Boyd <sboyd@kernel.org>
  - Taniya Das <quic_tdas@quicinc.com>

description: |
  Qualcomm global clock control module provides the clocks, resets and power
  domains on APQ8064.

  See also::
    include/dt-bindings/clock/qcom,gcc-msm8960.h
    include/dt-bindings/reset/qcom,gcc-msm8960.h

allOf:
  - $ref: qcom,gcc.yaml#

properties:
  compatible:
    oneOf:
      - items:
          - enum:
              - qcom,gcc-apq8064
              - qcom,gcc-msm8960
          - const: syscon
      - enum:
          - qcom,gcc-apq8064
          - qcom,gcc-msm8960
        deprecated: true

  thermal-sensor:
    description: child tsens device
    $ref: /schemas/thermal/qcom-tsens.yaml#

  clocks:
    maxItems: 3

  clock-names:
    items:
      - const: cxo
      - const: pxo
      - const: pll4

  nvmem-cells:
    minItems: 1
    maxItems: 2
    deprecated: true
    description:
      Qualcomm TSENS (thermal sensor device) on some devices can
      be part of GCC and hence the TSENS properties can also be part
      of the GCC/clock-controller node.
      For more details on the TSENS properties please refer
      Documentation/devicetree/bindings/thermal/qcom-tsens.yaml

  nvmem-cell-names:
    minItems: 1
    deprecated: true
    items:
      - const: calib
      - const: calib_backup

  '#thermal-sensor-cells':
    const: 1
    deprecated: true

  '#power-domain-cells': false

required:
  - compatible

unevaluatedProperties: false

examples:
  - |
    clock-controller@900000 {
      compatible = "qcom,gcc-apq8064", "syscon";
      reg = <0x00900000 0x4000>;
      #clock-cells = <1>;
      #reset-cells = <1>;

      thermal-sensor {
        compatible = "qcom,msm8960-tsens";

        nvmem-cells = <&tsens_calib>, <&tsens_backup>;
        nvmem-cell-names = "calib", "calib_backup";
        interrupts = <0 178 4>;
        interrupt-names = "uplow";

        #qcom,sensors = <11>;
        #thermal-sensor-cells = <1>;
      };
    };
...
```

## Documentation/devicetree/bindings/clock/qcom,gcc-apq8084.yaml
```yaml
# SPDX-License-Identifier: GPL-2.0-only OR BSD-2-Clause
%YAML 1.2
---
$id: http://devicetree.org/schemas/clock/qcom,gcc-apq8084.yaml#
$schema: http://devicetree.org/meta-schemas/core.yaml#

title: Qualcomm Global Clock & Reset Controller on APQ8084

maintainers:
  - Stephen Boyd <sboyd@kernel.org>
  - Taniya Das <quic_tdas@quicinc.com>

description: |
  Qualcomm global clock control module provides the clocks, resets and power
  domains on APQ8084.

  See also::
    include/dt-bindings/clock/qcom,gcc-apq8084.h
    include/dt-bindings/reset/qcom,gcc-apq8084.h

allOf:
  - $ref: qcom,gcc.yaml#

properties:
  compatible:
    const: qcom,gcc-apq8084

  clocks:
    items:
      - description: XO source
      - description: Sleep clock source
      - description: UFS RX symbol 0 clock
      - description: UFS RX symbol 1 clock
      - description: UFS TX symbol 0 clock
      - description: UFS TX symbol 1 clock
      - description: SATA ASIC0 clock
      - description: SATA RX clock
      - description: PCIe PIPE clock

  clock-names:
    items:
      - const: xo
      - const: sleep_clk
      - const: ufs_rx_symbol_0_clk_src
      - const: ufs_rx_symbol_1_clk_src
      - const: ufs_tx_symbol_0_clk_src
      - const: ufs_tx_symbol_1_clk_src
      - const: sata_asic0_clk
      - const: sata_rx_clk
      - const: pcie_pipe

required:
  - compatible
  - '#power-domain-cells'

unevaluatedProperties: false

examples:
  - |
    /* UFS PHY on APQ8084 is not supported (yet), so these bindings just serve an example */
    clock-controller@fc400000 {
        compatible = "qcom,gcc-apq8084";
        reg = <0xfc400000 0x4000>;
        #clock-cells = <1>;
        #reset-cells = <1>;
        #power-domain-cells = <1>;

        clocks = <&xo_board>,
                 <&sleep_clk>,
                 <&ufsphy 0>,
                 <&ufsphy 1>,
                 <&ufsphy 2>,
                 <&ufsphy 3>,
                 <&sata 0>,
                 <&sata 1>,
                 <&pcie_phy>;
        clock-names = "xo",
                      "sleep_clk",
                      "ufs_rx_symbol_0_clk_src",
                      "ufs_rx_symbol_1_clk_src",
                      "ufs_tx_symbol_0_clk_src",
                      "ufs_tx_symbol_1_clk_src",
                      "sata_asic0_clk",
                      "sata_rx_clk",
                      "pcie_pipe";
    };
...
```

## Documentation/devicetree/bindings/clock/qcom,gcc-ipq4019.yaml
```yaml
# SPDX-License-Identifier: (GPL-2.0-only OR BSD-2-Clause)
%YAML 1.2
---
$id: http://devicetree.org/schemas/clock/qcom,gcc-ipq4019.yaml#
$schema: http://devicetree.org/meta-schemas/core.yaml#

title: Qualcomm Global Clock & Reset Controller on IPQ4019

maintainers:
  - Stephen Boyd <sboyd@kernel.org>
  - Taniya Das <tdas@codeaurora.org>
  - Robert Marko <robert.markoo@sartura.hr>

description: |
  Qualcomm global clock control module provides the clocks, resets and power
  domains on IPQ4019.

  See also:: include/dt-bindings/clock/qcom,gcc-ipq4019.h

allOf:
  - $ref: qcom,gcc.yaml#

properties:
  compatible:
    const: qcom,gcc-ipq4019

  clocks:
    items:
      - description: board XO clock
      - description: sleep clock

  clock-names:
    items:
      - const: xo
      - const: sleep_clk

required:
  - compatible

unevaluatedProperties: false

examples:
  - |
    clock-controller@1800000 {
      compatible = "qcom,gcc-ipq4019";
      reg = <0x1800000 0x60000>;
      #clock-cells = <1>;
      #power-domain-cells = <1>;
      #reset-cells = <1>;
      clocks = <&xo>, <&sleep_clk>;
      clock-names = "xo", "sleep_clk";
    };
...
```

## Documentation/devicetree/bindings/clock/qcom,gcc-ipq6018.yaml
```yaml
# SPDX-License-Identifier: (GPL-2.0-only OR BSD-2-Clause)
%YAML 1.2
---
$id: http://devicetree.org/schemas/clock/qcom,gcc-ipq6018.yaml#
$schema: http://devicetree.org/meta-schemas/core.yaml#

title: Qualcomm Global Clock & Reset Controller on IPQ6018

maintainers:
  - Stephen Boyd <sboyd@kernel.org>
  - Taniya Das <quic_tdas@quicinc.com>
  - Robert Marko <robimarko@gmail.com>

description: |
  Qualcomm global clock control module provides the clocks, resets and power
  domains on IPQ6018.

  See also::
    include/dt-bindings/clock/qcom,gcc-ipq6018.h
    include/dt-bindings/reset/qcom,gcc-ipq6018.h

allOf:
  - $ref: qcom,gcc.yaml#

properties:
  compatible:
    const: qcom,gcc-ipq6018

  clocks:
    items:
      - description: board XO clock
      - description: sleep clock

  clock-names:
    items:
      - const: xo
      - const: sleep_clk

required:
  - compatible
  - clocks
  - clock-names

unevaluatedProperties: false

examples:
  - |
    clock-controller@1800000 {
      compatible = "qcom,gcc-ipq6018";
      reg = <0x01800000 0x80000>;
      clocks = <&xo>, <&sleep_clk>;
      clock-names = "xo", "sleep_clk";
      #clock-cells = <1>;
      #power-domain-cells = <1>;
      #reset-cells = <1>;
    };
...
```
