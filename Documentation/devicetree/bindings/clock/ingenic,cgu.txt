## Documentation/devicetree/bindings/clock/marvell,armada-3700-periph-clock.yaml
```yaml
# SPDX-License-Identifier: (GPL-2.0-only OR BSD-2-Clause)
%YAML 1.2
---
$id: http://devicetree.org/schemas/clock/marvell,armada-3700-periph-clock.yaml#
$schema: http://devicetree.org/meta-schemas/core.yaml#

title: Marvell Armada 37xx SoCs Peripheral Clocks

maintainers:
  - Andrew Lunn <andrew@lunn.ch>
  - Gregory Clement <gregory.clement@bootlin.com>

description: >
  Marvell Armada 37xx SoCs provide peripheral clocks which are used as clock
  source for the peripheral of the SoC.

  There are two different blocks associated to north bridge and south bridge.

  The following is a list of provided IDs for Armada 3700 North bridge clocks:

    ID	Clock name	Description
    -----------------------------------
    0	mmc		MMC controller
    1	sata_host	Sata Host
    2	sec_at		Security AT
    3	sac_dap		Security DAP
    4	tsecm		Security Engine
    5	setm_tmx	Serial Embedded Trace Module
    6	avs		Adaptive Voltage Scaling
    7	sqf		SPI
    8	pwm		PWM
    9	i2c_2		I2C 2
    10	i2c_1		I2C 1
    11	ddr_phy		DDR PHY
    12	ddr_fclk	DDR F clock
    13	trace		Trace
    14	counter		Counter
    15	eip97		EIP 97
    16	cpu		CPU

  The following is a list of provided IDs for Armada 3700 South bridge clocks:

    ID	Clock name	Description
    -----------------------------------
    0	gbe-50		50 MHz parent clock for Gigabit Ethernet
    1	gbe-core	parent clock for Gigabit Ethernet core
    2	gbe-125		125 MHz parent clock for Gigabit Ethernet
    3	gbe1-50		50 MHz clock for Gigabit Ethernet port 1
    4	gbe0-50		50 MHz clock for Gigabit Ethernet port 0
    5	gbe1-125	125 MHz clock for Gigabit Ethernet port 1
    6	gbe0-125	125 MHz clock for Gigabit Ethernet port 0
    7	gbe1-core	Gigabit Ethernet core port 1
    8	gbe0-core	Gigabit Ethernet core port 0
    9	gbe-bm		Gigabit Ethernet Buffer Manager
    10	sdio		SDIO
    11	usb32-sub2-sys	USB 2 clock
    12	usb32-ss-sys	USB 3 clock
    13	pcie		PCIe controller

properties:
  compatible:
    oneOf:
      - const: marvell,armada-3700-periph-clock-sb
      - items:
          - const: marvell,armada-3700-periph-clock-nb
          - const: syscon
  reg:
    maxItems: 1

  clocks:
    items:
      - description: TBG-A P clock and specifier
      - description: TBG-B P clock and specifier
      - description: TBG-A S clock and specifier
      - description: TBG-B S clock and specifier
      - description: Xtal clock and specifier

  '#clock-cells':
    const: 1

required:
  - compatible
  - reg
  - clocks
  - '#clock-cells'

additionalProperties: false

examples:
  - |
    clock-controller@13000{
        compatible = "marvell,armada-3700-periph-clock-sb";
        reg = <0x13000 0x1000>;
        clocks = <&tbg 0>, <&tbg 1>, <&tbg 2>, <&tbg 3>, <&xtalclk>;
        #clock-cells = <1>;
    };
```

## Documentation/devicetree/bindings/clock/marvell,armada-3700-tbg-clock.yaml
```yaml
# SPDX-License-Identifier: (GPL-2.0-only OR BSD-2-Clause)
%YAML 1.2
---
$id: http://devicetree.org/schemas/clock/marvell,armada-3700-tbg-clock.yaml#
$schema: http://devicetree.org/meta-schemas/core.yaml#

title: Marvell Armada 3700 Time Base Generator Clock

maintainers:
  - Andrew Lunn <andrew@lunn.ch>
  - Gregory Clement <gregory.clement@bootlin.com>

description: >
  Marvell Armada 37xx SoCs provide Time Base Generator clocks which are used as
  parent clocks for the peripheral clocks.

  The TBG clock consumer should specify the desired clock by having the clock ID
  in its "clocks" phandle cell.

  The following is a list of provided IDs and clock names on Armada 3700:

    0 = TBG A P
    1 = TBG B P
    2 = TBG A S
    3 = TBG B S

properties:
  compatible:
    const: marvell,armada-3700-tbg-clock

  reg:
    maxItems: 1

  clocks:
    maxItems: 1

  '#clock-cells':
    const: 1

required:
  - compatible
  - reg
  - '#clock-cells'

additionalProperties: false

examples:
  - |
    clock-controller@13200 {
        compatible = "marvell,armada-3700-tbg-clock";
        reg = <0x13200 0x1000>;
        clocks = <&xtalclk>;
        #clock-cells = <1>;
    };
```

## Documentation/devicetree/bindings/clock/marvell,armada-3700-uart-clock.yaml
```yaml
# SPDX-License-Identifier: GPL-2.0-only OR BSD-2-Clause
%YAML 1.2
---
$id: http://devicetree.org/schemas/clock/marvell,armada-3700-uart-clock.yaml#
$schema: http://devicetree.org/meta-schemas/core.yaml#
title: Marvell Armada 3720 UART clocks

maintainers:
  - Pali Rohár <pali@kernel.org>

properties:
  compatible:
    const: marvell,armada-3700-uart-clock

  reg:
    items:
      - description: UART Clock Control Register
      - description: UART 2 Baud Rate Divisor Register

  clocks:
    description: |
      List of parent clocks suitable for UART from following set:
        "TBG-A-P", "TBG-B-P", "TBG-A-S", "TBG-B-S", "xtal"
      UART clock can use one from this set and when more are provided
      then kernel would choose and configure the most suitable one.
      It is suggest to specify at least one TBG clock to achieve
      baudrates above 230400 and also to specify clock which bootloader
      used for UART (most probably xtal) for smooth boot log on UART.

  clock-names:
    items:
      - const: TBG-A-P
      - const: TBG-B-P
      - const: TBG-A-S
      - const: TBG-B-S
      - const: xtal
    minItems: 1

  '#clock-cells':
    const: 1

required:
  - compatible
  - reg
  - clocks
  - clock-names
  - '#clock-cells'

additionalProperties: false

examples:
  - |
    uartclk: clock-controller@12010 {
      compatible = "marvell,armada-3700-uart-clock";
      reg = <0x12010 0x4>, <0x12210 0x4>;
      clocks = <&tbg 0>, <&tbg 1>, <&tbg 2>, <&tbg 3>, <&xtalclk>;
      clock-names = "TBG-A-P", "TBG-B-P", "TBG-A-S", "TBG-B-S", "xtal";
      #clock-cells = <1>;
    };
```

## Documentation/devicetree/bindings/clock/marvell,armada-xp-cpu-clock.yaml
```yaml
# SPDX-License-Identifier: (GPL-2.0-only OR BSD-2-Clause)
---
$schema: http://devicetree.org/meta-schemas/core.yaml#
$id: http://devicetree.org/schemas/clock/marvell,armada-xp-cpu-clock.yaml#

title: Marvell EBU CPU Clock

maintainers:
  - Andrew Lunn <andrew@lunn.ch>
  - Gregory Clement <gregory.clement@bootlin.com>

properties:
  compatible:
    enum:
      - marvell,armada-xp-cpu-clock
      - marvell,mv98dx3236-cpu-clock

  reg:
    items:
      - description: Clock complex registers
      - description: PMU DFS registers

  '#clock-cells':
    const: 1

  clocks:
    maxItems: 1

required:
  - compatible
  - reg
  - '#clock-cells'
  - clocks

additionalProperties: false

examples:
  - |
    clock-controller@d0018700 {
        #clock-cells = <1>;
        compatible = "marvell,armada-xp-cpu-clock";
        reg = <0xd0018700 0xa0>, <0x1c054 0x10>;
        clocks = <&coreclk 1>;
    };
```

## Documentation/devicetree/bindings/clock/marvell,berlin.txt
```
Device Tree Clock bindings for Marvell Berlin

This binding uses the common clock binding[1].

[1] Documentation/devicetree/bindings/clock/clock-bindings.txt

Clock related registers are spread among the chip control registers. Berlin
clock node should be a sub-node of the chip controller node. Marvell Berlin2
(BG2, BG2CD, BG2Q) SoCs share the same IP for PLLs and clocks, with some
minor differences in features and register layout.

Required properties:
- compatible: must be "marvell,berlin2-clk" or "marvell,berlin2q-clk"
- #clock-cells: must be 1
- clocks: must be the input parent clock phandle
- clock-names: name of the input parent clock
	Allowed clock-names for the reference clocks are
	"refclk" for the SoCs oscillator input on all SoCs,
	and SoC-specific input clocks for
	BG2/BG2CD: "video_ext0" for the external video clock input


Example:

chip_clk: clock {
	compatible = "marvell,berlin2q-clk";

	#clock-cells = <1>;
	clocks = <&refclk>;
	clock-names = "refclk";
};
```
