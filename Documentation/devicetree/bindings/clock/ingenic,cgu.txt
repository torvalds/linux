## Documentation/devicetree/bindings/clock/lpc1850-ccu.txt
```
* NXP LPC1850 Clock Control Unit (CCU)

Each CGU base clock has several clock branches which can be turned on
or off independently by the Clock Control Units CCU1 or CCU2. The
branch clocks are distributed between CCU1 and CCU2.

 - Above text taken from NXP LPC1850 User Manual.

This binding uses the common clock binding:
    Documentation/devicetree/bindings/clock/clock-bindings.txt

Required properties:
- compatible:
	Should be "nxp,lpc1850-ccu"
- reg:
	Shall define the base and range of the address space
	containing clock control registers
- #clock-cells:
	Shall have value <1>.  The permitted clock-specifier values
	are the branch clock names defined in table below.
- clocks:
	Shall contain a list of phandles for the base clocks routed
	from the CGU to the specific CCU. See mapping of base clocks
	and CCU in table below.
- clock-names:
	Shall contain a list of names for the base clock routed
	from the CGU to the specific CCU. Valid CCU clock names:
	"base_usb0_clk",  "base_periph_clk", "base_usb1_clk",
	"base_cpu_clk",   "base_spifi_clk",  "base_spi_clk",
	"base_apb1_clk",  "base_apb3_clk",   "base_adchs_clk",
	"base_sdio_clk",  "base_ssp0_clk",   "base_ssp1_clk",
	"base_uart0_clk", "base_uart1_clk",  "base_uart2_clk",
	"base_uart3_clk", "base_audio_clk"

Which branch clocks that are available on the CCU depends on the
specific LPC part. Check the user manual for your specific part.

A list of CCU clocks can be found in dt-bindings/clock/lpc18xx-ccu.h.

Example board file:

soc {
	ccu1: clock-controller@40051000 {
		compatible = "nxp,lpc1850-ccu";
		reg = <0x40051000 0x1000>;
		#clock-cells = <1>;
		clocks = <&cgu BASE_APB3_CLK>,   <&cgu BASE_APB1_CLK>,
			 <&cgu BASE_SPIFI_CLK>,  <&cgu BASE_CPU_CLK>,
			 <&cgu BASE_PERIPH_CLK>, <&cgu BASE_USB0_CLK>,
			 <&cgu BASE_USB1_CLK>,   <&cgu BASE_SPI_CLK>;
		clock-names = "base_apb3_clk",   "base_apb1_clk",
			      "base_spifi_clk",  "base_cpu_clk",
			      "base_periph_clk", "base_usb0_clk",
			      "base_usb1_clk",   "base_spi_clk";
	};

	ccu2: clock-controller@40052000 {
		compatible = "nxp,lpc1850-ccu";
		reg = <0x40052000 0x1000>;
		#clock-cells = <1>;
		clocks = <&cgu BASE_AUDIO_CLK>, <&cgu BASE_UART3_CLK>,
			 <&cgu BASE_UART2_CLK>, <&cgu BASE_UART1_CLK>,
			 <&cgu BASE_UART0_CLK>, <&cgu BASE_SSP1_CLK>,
			 <&cgu BASE_SSP0_CLK>,  <&cgu BASE_SDIO_CLK>;
		clock-names = "base_audio_clk", "base_uart3_clk",
			      "base_uart2_clk", "base_uart1_clk",
			      "base_uart0_clk", "base_ssp1_clk",
			      "base_ssp0_clk",  "base_sdio_clk";
	};

	/* A user of CCU branch clocks */
	uart1: serial@40082000 {
		...
		clocks = <&ccu2 CLK_APB0_UART1>, <&ccu1 CLK_CPU_UART1>;
		...
	};
};
```

## Documentation/devicetree/bindings/clock/lpc1850-cgu.txt
```
* NXP LPC1850 Clock Generation Unit (CGU)

The CGU generates multiple independent clocks for the core and the
peripheral blocks of the LPC18xx. Each independent clock is called
a base clock and itself is one of the inputs to the two Clock
Control Units (CCUs) which control the branch clocks to the
individual peripherals.

The CGU selects the inputs to the clock generators from multiple
clock sources, controls the clock generation, and routes the outputs
of the clock generators through the clock source bus to the output
stages. Each output stage provides an independent clock source and
corresponds to one of the base clocks for the LPC18xx.

 - Above text taken from NXP LPC1850 User Manual.


This binding uses the common clock binding:
    Documentation/devicetree/bindings/clock/clock-bindings.txt

Required properties:
- compatible:
	Should be "nxp,lpc1850-cgu"
- reg:
	Shall define the base and range of the address space
	containing clock control registers
- #clock-cells:
	Shall have value <1>.  The permitted clock-specifier values
	are the base clock numbers defined below.
- clocks:
	Shall contain a list of phandles for the external input
	sources to the CGU. The list shall be in the following
	order: xtal, 32khz, enet_rx_clk, enet_tx_clk, gp_clkin.
- clock-indices:
	Shall be an ordered list of numbers defining the base clock
	number provided by the CGU.
- clock-output-names:
	Shall be an ordered list of strings defining the names of
	the clocks provided by the CGU.

Which base clocks that are available on the CGU depends on the
specific LPC part. Base clocks are numbered from 0 to 27.

Number:		Name:			Description:
 0		BASE_SAFE_CLK		Base safe clock (always on) for WWDT
 1		BASE_USB0_CLK		Base clock for USB0
 2		BASE_PERIPH_CLK		Base clock for Cortex-M0SUB subsystem,
					SPI, and SGPIO
 3		BASE_USB1_CLK		Base clock for USB1
 4		BASE_CPU_CLK		System base clock for ARM Cortex-M core
					and APB peripheral blocks #0 and #2
 5		BASE_SPIFI_CLK		Base clock for SPIFI
 6		BASE_SPI_CLK		Base clock for SPI
 7		BASE_PHY_RX_CLK		Base clock for Ethernet PHY Receive clock
 8		BASE_PHY_TX_CLK		Base clock for Ethernet PHY Transmit clock
 9		BASE_APB1_CLK		Base clock for APB peripheral block # 1
10		BASE_APB3_CLK		Base clock for APB peripheral block # 3
11		BASE_LCD_CLK		Base clock for LCD
12		BASE_ADCHS_CLK		Base clock for ADCHS
13		BASE_SDIO_CLK		Base clock for SD/MMC
14		BASE_SSP0_CLK		Base clock for SSP0
15		BASE_SSP1_CLK		Base clock for SSP1
16		BASE_UART0_CLK		Base clock for UART0
17		BASE_UART1_CLK		Base clock for UART1
18		BASE_UART2_CLK		Base clock for UART2
19		BASE_UART3_CLK		Base clock for UART3
20		BASE_OUT_CLK		Base clock for CLKOUT pin
24-21		-			Reserved
25		BASE_AUDIO_CLK		Base clock for audio system (I2S)
26 		BASE_CGU_OUT0_CLK	Base clock for CGU_OUT0 clock output
27 		BASE_CGU_OUT1_CLK	Base clock for CGU_OUT1 clock output

BASE_PERIPH_CLK and BASE_SPI_CLK is only available on LPC43xx.
BASE_ADCHS_CLK is only available on LPC4370.


Example board file:

/ {
	clocks {
		xtal: xtal {
			compatible = "fixed-clock";
			#clock-cells = <0>;
			clock-frequency = <12000000>;
		};

		xtal32: xtal32 {
			compatible = "fixed-clock";
			#clock-cells = <0>;
			clock-frequency = <32768>;
		};

		enet_rx_clk: enet_rx_clk {
			compatible = "fixed-clock";
			#clock-cells = <0>;
			clock-frequency = <0>;
			clock-output-names = "enet_rx_clk";
		};

		enet_tx_clk: enet_tx_clk {
			compatible = "fixed-clock";
			#clock-cells = <0>;
			clock-frequency = <0>;
			clock-output-names = "enet_tx_clk";
		};

		gp_clkin: gp_clkin {
			compatible = "fixed-clock";
			#clock-cells = <0>;
			clock-frequency = <0>;
			clock-output-names = "gp_clkin";
		};
	};

	soc {
		cgu: clock-controller@40050000 {
			compatible = "nxp,lpc1850-cgu";
			reg = <0x40050000 0x1000>;
			#clock-cells = <1>;
			clocks = <&xtal>, <&creg_clk 1>, <&enet_rx_clk>, <&enet_tx_clk>, <&gp_clkin>;
		};

		/* A CGU and CCU clock consumer */
		lcdc: lcdc@40008000 {
			...
			clocks = <&cgu BASE_LCD_CLK>, <&ccu1 CLK_CPU_LCD>;
			clock-names = "clcdclk", "apb_pclk";
			...
		};
	};
};
```

## Documentation/devicetree/bindings/clock/lpc1850-creg-clk.txt
```
* NXP LPC1850 CREG clocks

The NXP LPC18xx/43xx CREG (Configuration Registers) block contains
control registers for two low speed clocks. One of the clocks is a
32 kHz oscillator driver with power up/down and clock gating. Next
is a fixed divider that creates a 1 kHz clock from the 32 kHz osc.

These clocks are used by the RTC and the Event Router peripherals.
The 32 kHz can also be routed to other peripherals to enable low
power modes.

This binding uses the common clock binding:
    Documentation/devicetree/bindings/clock/clock-bindings.txt

Required properties:
- compatible:
	Should be "nxp,lpc1850-creg-clk"
- #clock-cells:
	Shall have value <1>.
- clocks:
	Shall contain a phandle to the fixed 32 kHz crystal.

The creg-clk node must be a child of the creg syscon node.

The following clocks are available from the clock node.

Clock ID	Name
   0		 1 kHz clock
   1		32 kHz Oscillator

Example:
soc {
	creg: syscon@40043000 {
		compatible = "nxp,lpc1850-creg", "syscon", "simple-mfd";
		reg = <0x40043000 0x1000>;

		creg_clk: clock-controller {
			compatible = "nxp,lpc1850-creg-clk";
			clocks = <&xtal32>;
			#clock-cells = <1>;
		};

		...
	};

	rtc: rtc@40046000 {
		...
		clocks = <&creg_clk 0>, <&ccu1 CLK_CPU_BUS>;
		clock-names = "rtc", "reg";
		...
	};
};
```

## Documentation/devicetree/bindings/clock/lsi,axm5516-clks.txt
```
AXM5516 clock driver bindings
-----------------------------

Required properties :
- compatible : shall contain "lsi,axm5516-clks"
- reg : shall contain base register location and length
- #clock-cells : shall contain 1

The consumer specifies the desired clock by having the clock ID in its "clocks"
phandle cell. See <dt-bindings/clock/lsi,axxia-clock.h> for the list of
supported clock IDs.

Example:

	clks: clock-controller@2010020000 {
		compatible = "lsi,axm5516-clks";
		#clock-cells = <1>;
		reg = <0x20 0x10020000 0 0x20000>;
	};

	serial0: uart@2010080000 {
		compatible = "arm,pl011", "arm,primecell";
		reg = <0x20 0x10080000 0 0x1000>;
		interrupts = <GIC_SPI 56 IRQ_TYPE_LEVEL_HIGH>;
		clocks = <&clks AXXIA_CLK_PER>;
		clock-names = "apb_pclk";
	};
																																};
```

## Documentation/devicetree/bindings/clock/lsi,axm5516-clks.yaml
```yaml
# SPDX-License-Identifier: (GPL-2.0-only OR BSD-2-Clause)
# Copyright 2025 LSI
%YAML 1.2
---
$id: http://devicetree.org/schemas/clock/lsi,axm5516-clks.yaml#
$schema: http://devicetree.org/meta-schemas/core.yaml#

title: LSI AXM5516 Clock Controller

maintainers:
  - Anders Berg <anders.berg@lsi.com>

description:
  See <dt-bindings/clock/lsi,axxia-clock.h> for the list of supported clock IDs.

properties:
  compatible:
    const: lsi,axm5516-clks

  reg:
    maxItems: 1

  '#clock-cells':
    const: 1

required:
  - compatible
  - reg
  - '#clock-cells'

additionalProperties: false

examples:
  - |
    bus {
        #address-cells = <2>;
        #size-cells = <1>;
        clock-controller@2010020000 {
            compatible = "lsi,axm5516-clks";
            #clock-cells = <1>;
            reg = <0x20 0x10020000 0x20000>;
        };
    };
```

## Documentation/devicetree/bindings/clock/lsi,nspire-cx-clock.yaml
```yaml
# SPDX-License-Identifier: (GPL-2.0-only OR BSD-2-Clause)
%YAML 1.2
---
$id: http://devicetree.org/schemas/clock/lsi,nspire-cx-clock.yaml#
$schema: http://devicetree.org/meta-schemas/core.yaml#

title: TI-NSPIRE Clocks

maintainers:
  - Daniel Tang <dt.tangr@gmail.com>

properties:
  compatible:
    enum:
      - lsi,nspire-cx-ahb-divider
      - lsi,nspire-classic-ahb-divider
      - lsi,nspire-cx-clock
      - lsi,nspire-classic-clock

  reg:
    maxItems: 1

  clocks:
    maxItems: 1

  '#clock-cells':
    const: 0

additionalProperties: false

required:
  - compatible
  - reg
```

## Documentation/devicetree/bindings/clock/marvell,ap80x-clock.yaml
```yaml
# SPDX-License-Identifier: (GPL-2.0-only OR BSD-2-Clause)
%YAML 1.2
---
$id: http://devicetree.org/schemas/clock/marvell,ap80x-clock.yaml#
$schema: http://devicetree.org/meta-schemas/core.yaml#

title: Marvell Armada AP80x System Controller Clocks

maintainers:
  - Gregory Clement <gregory.clement@bootlin.com>
  - Miquel Raynal <miquel.raynal@bootlin.com>

description: >
  The AP806/AP807 is one of the two core HW blocks of the Marvell Armada
  7K/8K/931x SoCs. It contains system controllers, which provide several
  registers giving access to numerous features: clocks, pin-muxing and many
  other SoC configuration items.

properties:
  compatible:
    enum:
      - marvell,ap806-clock
      - marvell,ap806-cpu-clock
      - marvell,ap807-clock
      - marvell,ap807-cpu-clock

  reg:
    maxItems: 1

  "#clock-cells":
    const: 1

  clocks:
    items:
      - description: cluster 0 parent clock phandle
      - description: cluster 1 parent clock phandle

required:
  - compatible
  - "#clock-cells"

additionalProperties: false

allOf:
  - if:
      properties:
        compatible:
          contains:
            enum:
              - marvell,ap806-cpu-clock
              - marvell,ap807-cpu-clock
    then:
      required:
        - clocks
```

## Documentation/devicetree/bindings/clock/marvell,armada-370-corediv-clock.yaml
```yaml
# SPDX-License-Identifier: (GPL-2.0-only OR BSD-2-Clause)
%YAML 1.2
---
$id: http://devicetree.org/schemas/marvell,armada-370-corediv-clock.yaml#
$schema: http://devicetree.org/meta-schemas/core.yaml#

title: Marvell MVEBU Core Divider Clock

maintainers:
  - Andrew Lunn <andrew@lunn.ch>
  - Gregory Clement <gregory.clement@bootlin.com>

properties:
  compatible:
    oneOf:
      - enum:
          - marvell,armada-370-corediv-clock
          - marvell,armada-375-corediv-clock
          - marvell,armada-380-corediv-clock
          - marvell,mv98dx3236-corediv-clock
      - items:
          - const: marvell,armada-390-corediv-clock
          - const: marvell,armada-380-corediv-clock

  reg:
    maxItems: 1

  "#clock-cells":
    const: 1

  clocks:
    maxItems: 1

  clock-output-names:
    maxItems: 1

required:
  - compatible
  - reg
  - "#clock-cells"
  - clocks

additionalProperties: false

examples:
  - |
    clock-controller@18740 {
        compatible = "marvell,armada-370-corediv-clock";
        reg = <0x18740 0xc>;
        #clock-cells = <1>;
        clocks = <&pll>;
    };
```
