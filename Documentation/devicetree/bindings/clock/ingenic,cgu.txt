## Documentation/devicetree/bindings/clock/ingenic,cgu.txt
```
Ingenic SoC CGU binding

The CGU in an Ingenic SoC provides all the clocks generated on-chip. It
typically includes a variety of PLLs, multiplexers, dividers & gates in order
to provide many different clock signals derived from only 2 external source
clocks.

Required properties:
- compatible : Should be "ingenic,<soctype>-cgu".
  For example "ingenic,jz4740-cgu" or "ingenic,jz4780-cgu".
- reg : The address & length of the CGU registers.
- clocks : List of phandle & clock specifiers for clocks external to the CGU.
  Two such external clocks should be specified - first the external crystal
  "ext" and second the RTC clock source "rtc".
- clock-names : List of name strings for the external clocks.
- #clock-cells: Should be 1.
  Clock consumers specify this argument to identify a clock. The valid values
  may be found in <dt-bindings/clock/<soctype>-cgu.h>.

Example SoC include file:

/ {
	cgu: jz4740-cgu {
		compatible = "ingenic,jz4740-cgu";
		reg = <0x10000000 0x100>;
		#clock-cells = <1>;
	};

	uart0: serial@10030000 {
		clocks = <&cgu JZ4740_CLK_UART0>;
	};
};

Example board file:

/ {
	ext: clock@0 {
		compatible = "fixed-clock";
		#clock-cells = <0>;
		clock-frequency = <12000000>;
	};

	rtc: clock@1 {
		compatible = "fixed-clock";
		#clock-cells = <0>;
		clock-frequency = <32768>;
	};

	&cgu {
		clocks = <&ext> <&rtc>;
		clock-names: "ext", "rtc";
	};
};
```

## Documentation/devicetree/bindings/clock/ingenic,cgu.yaml
```yaml
# SPDX-License-Identifier: (GPL-2.0-only OR BSD-2-Clause)
%YAML 1.2
---
$id: http://devicetree.org/schemas/clock/ingenic,cgu.yaml#
$schema: http://devicetree.org/meta-schemas/core.yaml#

title: Ingenic SoCs CGU devicetree bindings

description: |
  The CGU in an Ingenic SoC provides all the clocks generated on-chip. It
  typically includes a variety of PLLs, multiplexers, dividers & gates in order
  to provide many different clock signals derived from only 2 external source
  clocks.

maintainers:
  - Paul Cercueil <paul@crapouillou.net>

select:
  properties:
    compatible:
      contains:
        enum:
          - ingenic,jz4740-cgu
          - ingenic,jz4725b-cgu
          - ingenic,jz4770-cgu
          - ingenic,jz4780-cgu
          - ingenic,x1000-cgu
          - ingenic,x1830-cgu
  required:
    - compatible

properties:
  $nodename:
    pattern: "^clock-controller@[0-9a-f]+$"

  "#address-cells":
    const: 1

  "#size-cells":
    const: 1

  "#clock-cells":
    const: 1

  ranges: true

  compatible:
    items:
      - enum:
          - ingenic,jz4740-cgu
          - ingenic,jz4725b-cgu
          - ingenic,jz4770-cgu
          - ingenic,jz4780-cgu
          - ingenic,x1000-cgu
          - ingenic,x1830-cgu
      - const: simple-mfd
    minItems: 1

  reg:
    maxItems: 1

  clocks:
    items:
      - description: External oscillator clock
      - description: Internal 32 kHz RTC clock

  clock-names:
    items:
      - const: ext
      - enum:
          - rtc
          - osc32k # Different name, same clock

  assigned-clocks:
    minItems: 1
    maxItems: 64

  assigned-clock-parents:
    minItems: 1
    maxItems: 64

  assigned-clock-rates:
    minItems: 1
    maxItems: 64

required:
  - "#clock-cells"
  - compatible
  - reg
  - clocks
  - clock-names

patternProperties:
  "^usb-phy@[a-f0-9]+$":
    allOf: [ $ref: "../usb/ingenic,jz4770-phy.yaml#" ]

additionalProperties: false

examples:
  - |
    #include <dt-bindings/clock/jz4770-cgu.h>
    cgu: clock-controller@10000000 {
      compatible = "ingenic,jz4770-cgu", "simple-mfd";
      reg = <0x10000000 0x100>;
      #address-cells = <1>;
      #size-cells = <1>;
      ranges = <0x0 0x10000000 0x100>;

      clocks = <&ext>, <&osc32k>;
      clock-names = "ext", "osc32k";

      #clock-cells = <1>;

      otg_phy: usb-phy@3c {
        compatible = "ingenic,jz4770-phy";
        reg = <0x3c 0x10>;

        clocks = <&cgu JZ4770_CLK_OTG_PHY>;

        vcc-supply = <&ldo5>;

        #phy-cells = <0>;
      };
    };
```

## Documentation/devicetree/bindings/clock/intc_stratix10.txt
```
Device Tree Clock bindings for Intel's SoCFPGA Stratix10 platform

This binding uses the common clock binding[1].

[1] Documentation/devicetree/bindings/clock/clock-bindings.txt

Required properties:
- compatible : shall be
	"intel,stratix10-clkmgr"

- reg : shall be the control register offset from CLOCK_MANAGER's base for the clock.

- #clock-cells : from common clock binding, shall be set to 1.

Example:
	clkmgr: clock-controller@ffd10000 {
		compatible = "intel,stratix10-clkmgr";
		reg = <0xffd10000 0x1000>;
		#clock-cells = <1>;
	};
```

## Documentation/devicetree/bindings/clock/intel,agilex.yaml
```yaml
# SPDX-License-Identifier: (GPL-2.0-only OR BSD-2-Clause)
%YAML 1.2
---
$id: http://devicetree.org/schemas/clock/intel,agilex.yaml#
$schema: http://devicetree.org/meta-schemas/core.yaml#

title: Intel SoCFPGA Agilex platform clock controller

maintainers:
  - Dinh Nguyen <dinguyen@kernel.org>

description:
  The Intel Agilex Clock controller is an integrated clock controller, which
  generates and supplies to all modules.

properties:
  compatible:
    const: intel,agilex-clkmgr

  '#clock-cells':
    const: 1

  reg:
    maxItems: 1

  clocks:
    maxItems: 1

required:
  - compatible
  - reg
  - clocks
  - '#clock-cells'

additionalProperties: false

examples:
  # Clock controller node:
  - |
    clkmgr: clock-controller@ffd10000 {
      compatible = "intel,agilex-clkmgr";
      reg = <0xffd10000 0x1000>;
      clocks = <&osc1>;
      #clock-cells = <1>;
    };
...
```

## Documentation/devicetree/bindings/clock/intel,agilex5-clkmgr.yaml
```yaml
# SPDX-License-Identifier: (GPL-2.0-only OR BSD-2-Clause)
%YAML 1.2
---
$id: http://devicetree.org/schemas/clock/intel,agilex5-clkmgr.yaml#
$schema: http://devicetree.org/meta-schemas/core.yaml#

title: Intel SoCFPGA Agilex5 clock manager

maintainers:
  - Dinh Nguyen <dinguyen@kernel.org>

description:
  The Intel Agilex5 Clock Manager is an integrated clock controller, which
  generates and supplies clock to all the modules.

properties:
  compatible:
    const: intel,agilex5-clkmgr

  reg:
    maxItems: 1

  '#clock-cells':
    const: 1

required:
  - compatible
  - reg
  - '#clock-cells'

additionalProperties: false

examples:
  - |
    clkmgr: clock-controller@10d10000 {
      compatible = "intel,agilex5-clkmgr";
      reg = <0x10d10000 0x1000>;
      #clock-cells = <1>;
    };
...
```

## Documentation/devicetree/bindings/clock/intel,cgu-lgm.yaml
```yaml
# SPDX-License-Identifier: (GPL-2.0-only OR BSD-2-Clause)
%YAML 1.2
---
$id: http://devicetree.org/schemas/clock/intel,cgu-lgm.yaml#
$schema: http://devicetree.org/meta-schemas/core.yaml#

title: Intel Lightning Mountain SoC's Clock Controller(CGU)

maintainers:
  - Rahul Tanwar <rahul.tanwar@linux.intel.com>

description: |
  Lightning Mountain(LGM) SoC's Clock Generation Unit(CGU) driver provides
  all means to access the CGU hardware module in order to generate a series
  of clocks for the whole system and individual peripherals.

  Please refer to include/dt-bindings/clock/intel,lgm-clk.h header file, it
  defines all available clocks as macros. These macros can be used in device
  tree sources.

properties:
  compatible:
    const: intel,cgu-lgm

  reg:
    maxItems: 1

  '#clock-cells':
    const: 1

required:
  - compatible
  - reg
  - '#clock-cells'

additionalProperties: false

examples:
  - |
    cgu: clock-controller@e0200000 {
        compatible = "intel,cgu-lgm";
        reg = <0xe0200000 0x33c>;
        #clock-cells = <1>;
    };

...
```

## Documentation/devicetree/bindings/clock/intel,easic-n5x.yaml
```yaml
# SPDX-License-Identifier: (GPL-2.0-only OR BSD-2-Clause)
%YAML 1.2
---
$id: http://devicetree.org/schemas/clock/intel,easic-n5x.yaml#
$schema: http://devicetree.org/meta-schemas/core.yaml#

title: Intel SoCFPGA eASIC N5X platform clock controller

maintainers:
  - Dinh Nguyen <dinguyen@kernel.org>

description:
  The Intel eASIC N5X Clock controller is an integrated clock controller, which
  generates and supplies to all modules.

properties:
  compatible:
    const: intel,easic-n5x-clkmgr

  '#clock-cells':
    const: 1

  reg:
    maxItems: 1

  clocks:
    maxItems: 1

required:
  - compatible
  - reg
  - clocks
  - '#clock-cells'

additionalProperties: false

examples:
  # Clock controller node:
  - |
    clkmgr: clock-controller@ffd10000 {
      compatible = "intel,easic-n5x-clkmgr";
      reg = <0xffd10000 0x1000>;
      clocks = <&osc1>;
      #clock-cells = <1>;
    };
...
```

## Documentation/devicetree/bindings/clock/intel,stratix10.yaml
```yaml
# SPDX-License-Identifier: (GPL-2.0-only OR BSD-2-Clause)
%YAML 1.2
---
$id: http://devicetree.org/schemas/clock/intel,stratix10.yaml#
$schema: http://devicetree.org/meta-schemas/core.yaml#

title: Intel SoCFPGA Stratix10 platform clock controller binding

maintainers:
  - Dinh Nguyen <dinguyen@kernel.org>

properties:
  compatible:
    const: intel,stratix10-clkmgr

  '#clock-cells':
    const: 1

  reg:
    maxItems: 1

required:
  - compatible
  - reg
  - '#clock-cells'

additionalProperties: false

examples:
  - |
    clock-controller@ffd10000 {
        compatible = "intel,stratix10-clkmgr";
        reg = <0xffd10000 0x1000>;
        #clock-cells = <1>;
    };
```

## Documentation/devicetree/bindings/clock/keystone-gate.txt
```
Status: Unstable - ABI compatibility may be broken in the future

Binding for Keystone gate control driver which uses PSC controller IP.

This binding uses the common clock binding[1].

[1] Documentation/devicetree/bindings/clock/clock-bindings.txt

Required properties:
- compatible : shall be "ti,keystone,psc-clock".
- #clock-cells : from common clock binding; shall be set to 0.
- clocks : parent clock phandle
- reg :	psc control and domain address address space
- reg-names : psc control and domain registers
- domain-id : psc domain id needed to check the transition state register

Optional properties:
- clock-output-names : From common clock binding to override the
			default output clock name
Example:
	clkusb: clkusb {
		#clock-cells = <0>;
		compatible = "ti,keystone,psc-clock";
		clocks = <&chipclk16>;
		clock-output-names = "usb";
		reg = <0x02350008 0xb00>, <0x02350000 0x400>;
		reg-names = "control", "domain";
		domain-id = <0>;
	};
```

## Documentation/devicetree/bindings/clock/keystone-pll.txt
```
Status: Unstable - ABI compatibility may be broken in the future

Binding for keystone PLLs. The main PLL IP typically has a multiplier,
a divider and a post divider. The additional PLL IPs like ARMPLL, DDRPLL
and PAPLL are controlled by the memory mapped register where as the Main
PLL is controlled by a PLL controller registers along with memory mapped
registers.

This binding uses the common clock binding[1].

[1] Documentation/devicetree/bindings/clock/clock-bindings.txt

Required properties:
- #clock-cells : from common clock binding; shall be set to 0.
- compatible : shall be "ti,keystone,main-pll-clock" or "ti,keystone,pll-clock"
- clocks : parent clock phandle
- reg - pll control0 and pll multipler registers
- reg-names : control, multiplier and post-divider. The multiplier and
		post-divider registers are applicable only for main pll clock
- fixed-postdiv : fixed post divider value. If absent, use clkod register bits
		for postdiv

Example:
	mainpllclk: mainpllclk@2310110 {
		#clock-cells = <0>;
		compatible = "ti,keystone,main-pll-clock";
		clocks = <&refclksys>;
		reg = <0x02620350 4>, <0x02310110 4>, <0x02310108 4>;
		reg-names = "control", "multiplier", "post-divider";
		fixed-postdiv = <2>;
	};

	papllclk: papllclk@2620358 {
		#clock-cells = <0>;
		compatible = "ti,keystone,pll-clock";
		clocks = <&refclkpass>;
		clock-output-names = "pa-pll-clk";
		reg = <0x02620358 4>;
		reg-names = "control";
	};

Required properties:
- #clock-cells : from common clock binding; shall be set to 0.
- compatible : shall be "ti,keystone,pll-mux-clock"
- clocks : link phandles of parent clocks
- reg - pll mux register
- bit-shift : number of bits to shift the bit-mask
- bit-mask : arbitrary bitmask for programming the mux

Optional properties:
- clock-output-names : From common clock binding.

Example:
	mainmuxclk: mainmuxclk@2310108 {
		#clock-cells = <0>;
		compatible = "ti,keystone,pll-mux-clock";
		clocks = <&mainpllclk>, <&refclkmain>;
		reg = <0x02310108 4>;
		bit-shift = <23>;
		bit-mask = <1>;
		clock-output-names = "mainmuxclk";
	};

Required properties:
- #clock-cells : from common clock binding; shall be set to 0.
- compatible : shall be "ti,keystone,pll-divider-clock"
- clocks : parent clock phandle
- reg - pll mux register
- bit-shift : number of bits to shift the bit-mask
- bit-mask : arbitrary bitmask for programming the divider

Optional properties:
- clock-output-names : From common clock binding.

Example:
	gemtraceclk: gemtraceclk@2310120 {
		#clock-cells = <0>;
		compatible = "ti,keystone,pll-divider-clock";
		clocks = <&mainmuxclk>;
		reg = <0x02310120 4>;
		bit-shift = <0>;
		bit-mask = <8>;
		clock-output-names = "gemtraceclk";
	};
```

## Documentation/devicetree/bindings/clock/loongson,ls1x-clk.yaml
```yaml
# SPDX-License-Identifier: (GPL-2.0-only OR BSD-2-Clause)
%YAML 1.2
---
$id: http://devicetree.org/schemas/clock/loongson,ls1x-clk.yaml#
$schema: http://devicetree.org/meta-schemas/core.yaml#

title: Loongson-1 Clock Controller

maintainers:
  - Keguang Zhang <keguang.zhang@gmail.com>

properties:
  compatible:
    enum:
      - loongson,ls1b-clk
      - loongson,ls1c-clk

  reg:
    maxItems: 1

  clocks:
    maxItems: 1

  "#clock-cells":
    const: 1

required:
  - compatible
  - reg
  - clocks
  - "#clock-cells"

additionalProperties: false

examples:
  - |
    clkc: clock-controller@1fe78030 {
        compatible = "loongson,ls1b-clk";
        reg = <0x1fe78030 0x8>;

        clocks = <&xtal>;
        #clock-cells = <1>;
    };

...
```

## Documentation/devicetree/bindings/clock/loongson,ls2k-clk.yaml
```yaml
# SPDX-License-Identifier: (GPL-2.0-only OR BSD-2-Clause)
%YAML 1.2
---
$id: http://devicetree.org/schemas/clock/loongson,ls2k-clk.yaml#
$schema: http://devicetree.org/meta-schemas/core.yaml#

title: Loongson-2 SoC Clock Control Module

maintainers:
  - Yinbo Zhu <zhuyinbo@loongson.cn>

description: |
  Loongson-2 SoC clock control module is an integrated clock controller, which
  generates and supplies to all modules.

properties:
  compatible:
    enum:
      - loongson,ls2k0300-clk
      - loongson,ls2k0500-clk
      - loongson,ls2k-clk  # This is for Loongson-2K1000
      - loongson,ls2k2000-clk

  reg:
    maxItems: 1

  clocks:
    maxItems: 1

  clock-names:
    items:
      - const: ref_100m

  '#clock-cells':
    const: 1
    description:
      The clock consumer should specify the desired clock by having the clock
      ID in its "clocks" phandle cell. See include/dt-bindings/clock/loongson,ls2k-clk.h
      for the full list of Loongson-2 SoC clock IDs.

allOf:
  - if:
      properties:
        compatible:
          contains:
            const: loongson,ls2k0300-clk
    then:
      properties:
        clock-names: false
    else:
      required:
        - clock-names

required:
  - compatible
  - reg
  - clocks
  - '#clock-cells'

additionalProperties: false

examples:
  - |
    ref_100m: clock-ref-100m {
        compatible = "fixed-clock";
        #clock-cells = <0>;
        clock-frequency = <100000000>;
        clock-output-names = "ref_100m";
    };

    clk: clock-controller@1fe00480 {
        compatible = "loongson,ls2k-clk";
        reg = <0x1fe00480 0x58>;
        #clock-cells = <1>;
        clocks = <&ref_100m>;
        clock-names = "ref_100m";
    };
```
