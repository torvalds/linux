## Documentation/devicetree/bindings/clock/allwinner,sun5i-a13-ahb-clk.yaml
```yaml
# SPDX-License-Identifier: GPL-2.0
%YAML 1.2
---
$id: http://devicetree.org/schemas/clock/allwinner,sun5i-a13-ahb-clk.yaml#
$schema: http://devicetree.org/meta-schemas/core.yaml#

title: Allwinner A13 AHB Clock Device Tree Bindings

maintainers:
  - Chen-Yu Tsai <wens@csie.org>
  - Maxime Ripard <mripard@kernel.org>

deprecated: true

properties:
  "#clock-cells":
    const: 0

  compatible:
    const: allwinner,sun5i-a13-ahb-clk

  reg:
    maxItems: 1

  clocks:
    maxItems: 3
    description: >
      The parent order must match the hardware programming order.

  clock-output-names:
    maxItems: 1

required:
  - "#clock-cells"
  - compatible
  - reg
  - clocks
  - clock-output-names

additionalProperties: false

examples:
  - |
    ahb@1c20054 {
        #clock-cells = <0>;
        compatible = "allwinner,sun5i-a13-ahb-clk";
        reg = <0x01c20054 0x4>;
        clocks = <&axi>, <&cpu>, <&pll6 1>;
        clock-output-names = "ahb";
    };

...
```

## Documentation/devicetree/bindings/clock/allwinner,sun6i-a31-pll6-clk.yaml
```yaml
# SPDX-License-Identifier: GPL-2.0
%YAML 1.2
---
$id: http://devicetree.org/schemas/clock/allwinner,sun6i-a31-pll6-clk.yaml#
$schema: http://devicetree.org/meta-schemas/core.yaml#

title: Allwinner A31 Peripheral PLL Device Tree Bindings

maintainers:
  - Chen-Yu Tsai <wens@csie.org>
  - Maxime Ripard <mripard@kernel.org>

deprecated: true

properties:
  "#clock-cells":
    const: 1
    description: >
      The first output is the regular PLL output, the second is a PLL
      output at twice the rate.

  compatible:
    const: allwinner,sun6i-a31-pll6-clk

  reg:
    maxItems: 1

  clocks:
    maxItems: 1

  clock-output-names:
    maxItems: 2

required:
  - "#clock-cells"
  - compatible
  - reg
  - clocks
  - clock-output-names

additionalProperties: false

examples:
  - |
    clk@1c20028 {
        #clock-cells = <1>;
        compatible = "allwinner,sun6i-a31-pll6-clk";
        reg = <0x01c20028 0x4>;
        clocks = <&osc24M>;
        clock-output-names = "pll6", "pll6x2";
    };

...
```

## Documentation/devicetree/bindings/clock/allwinner,sun7i-a20-gmac-clk.yaml
```yaml
# SPDX-License-Identifier: GPL-2.0
%YAML 1.2
---
$id: http://devicetree.org/schemas/clock/allwinner,sun7i-a20-gmac-clk.yaml#
$schema: http://devicetree.org/meta-schemas/core.yaml#

title: Allwinner A20 GMAC TX Clock

maintainers:
  - Chen-Yu Tsai <wens@csie.org>
  - Maxime Ripard <mripard@kernel.org>

properties:
  "#clock-cells":
    const: 0

  compatible:
    const: allwinner,sun7i-a20-gmac-clk

  reg:
    maxItems: 1

  clocks:
    maxItems: 2
    description: >
      The parent clocks shall be fixed rate dummy clocks at 25 MHz and
      125 MHz, respectively.

  clock-output-names:
    maxItems: 1

required:
  - "#clock-cells"
  - compatible
  - reg
  - clocks
  - clock-output-names

additionalProperties: false

examples:
  - |
    clk@1c20164 {
        #clock-cells = <0>;
        compatible = "allwinner,sun7i-a20-gmac-clk";
        reg = <0x01c20164 0x4>;
        clocks = <&mii_phy_tx_clk>, <&gmac_int_tx_clk>;
        clock-output-names = "gmac_tx";
    };

...
```

## Documentation/devicetree/bindings/clock/allwinner,sun7i-a20-out-clk.yaml
```yaml
# SPDX-License-Identifier: GPL-2.0
%YAML 1.2
---
$id: http://devicetree.org/schemas/clock/allwinner,sun7i-a20-out-clk.yaml#
$schema: http://devicetree.org/meta-schemas/core.yaml#

title: Allwinner A20 Output Clock Device Tree Bindings

maintainers:
  - Chen-Yu Tsai <wens@csie.org>
  - Maxime Ripard <mripard@kernel.org>

deprecated: true

properties:
  "#clock-cells":
    const: 0

  compatible:
    const: allwinner,sun7i-a20-out-clk

  reg:
    maxItems: 1

  clocks:
    maxItems: 3
    description: >
      The parent order must match the hardware programming order.

  clock-output-names:
    maxItems: 1

required:
  - "#clock-cells"
  - compatible
  - reg
  - clocks
  - clock-output-names

additionalProperties: false

examples:
  - |
    clk@1c201f0 {
        #clock-cells = <0>;
        compatible = "allwinner,sun7i-a20-out-clk";
        reg = <0x01c201f0 0x4>;
        clocks = <&osc24M_32k>, <&osc32k>, <&osc24M>;
        clock-output-names = "clk_out_a";
    };

...
```

## Documentation/devicetree/bindings/clock/allwinner,sun8i-a83t-de2-clk.yaml
```yaml
# SPDX-License-Identifier: GPL-2.0+
%YAML 1.2
---
$id: http://devicetree.org/schemas/clock/allwinner,sun8i-a83t-de2-clk.yaml#
$schema: http://devicetree.org/meta-schemas/core.yaml#

title: Allwinner A83t Display Engine 2/3 Clock Controller Device Tree Bindings

maintainers:
  - Chen-Yu Tsai <wens@csie.org>
  - Maxime Ripard <mripard@kernel.org>

properties:
  "#clock-cells":
    const: 1

  "#reset-cells":
    const: 1

  compatible:
    oneOf:
      - const: allwinner,sun8i-a83t-de2-clk
      - const: allwinner,sun8i-h3-de2-clk
      - const: allwinner,sun8i-v3s-de2-clk
      - const: allwinner,sun50i-a64-de2-clk
      - const: allwinner,sun50i-h5-de2-clk
      - const: allwinner,sun50i-h6-de3-clk
      - items:
          - const: allwinner,sun8i-r40-de2-clk
          - const: allwinner,sun8i-h3-de2-clk

  reg:
    maxItems: 1

  clocks:
    items:
      - description: Bus Clock
      - description: Module Clock

  clock-names:
    items:
      - const: bus
      - const: mod

  resets:
    maxItems: 1

required:
  - "#clock-cells"
  - "#reset-cells"
  - compatible
  - reg
  - clocks
  - clock-names
  - resets

additionalProperties: false

examples:
  - |
    #include <dt-bindings/clock/sun8i-h3-ccu.h>
    #include <dt-bindings/reset/sun8i-h3-ccu.h>

    de2_clocks: clock@1000000 {
        compatible = "allwinner,sun8i-h3-de2-clk";
        reg = <0x01000000 0x100000>;
        clocks = <&ccu CLK_BUS_DE>,
                 <&ccu CLK_DE>;
        clock-names = "bus",
                      "mod";
        resets = <&ccu RST_BUS_DE>;
        #clock-cells = <1>;
        #reset-cells = <1>;
    };

...
```

## Documentation/devicetree/bindings/clock/allwinner,sun8i-h3-bus-gates-clk.yaml
```yaml
# SPDX-License-Identifier: GPL-2.0
%YAML 1.2
---
$id: http://devicetree.org/schemas/clock/allwinner,sun8i-h3-bus-gates-clk.yaml#
$schema: http://devicetree.org/meta-schemas/core.yaml#

title: Allwinner A10 Bus Gates Clock Device Tree Bindings

maintainers:
  - Chen-Yu Tsai <wens@csie.org>
  - Maxime Ripard <mripard@kernel.org>

deprecated: true

properties:
  "#clock-cells":
    const: 1
    description: >
      This additional argument passed to that clock is the offset of
      the bit controlling this particular gate in the register.

  compatible:
    const: allwinner,sun8i-h3-bus-gates-clk

  reg:
    maxItems: 1

  clocks:
    maxItems: 4

  clock-names:
    maxItems: 4
    description: >
      The parent order must match the hardware programming order.

  clock-indices:
    minItems: 1
    maxItems: 64

  clock-output-names:
    minItems: 1
    maxItems: 64

required:
  - "#clock-cells"
  - compatible
  - reg
  - clocks
  - clock-indices
  - clock-names
  - clock-output-names

additionalProperties: false

examples:
  - |
    clk@1c20060 {
        #clock-cells = <1>;
        compatible = "allwinner,sun8i-h3-bus-gates-clk";
        reg = <0x01c20060 0x14>;
        clocks = <&ahb1>, <&ahb2>, <&apb1>, <&apb2>;
        clock-names = "ahb1", "ahb2", "apb1", "apb2";
        clock-indices = <5>, <6>, <8>,
                        <9>, <10>, <13>,
                        <14>, <17>, <18>,
                        <19>, <20>,
                        <21>, <23>,
                        <24>, <25>,
                        <26>, <27>,
                        <28>, <29>,
                        <30>, <31>, <32>,
                        <35>, <36>, <37>,
                        <40>, <41>, <43>,
                        <44>, <52>, <53>,
                        <54>, <64>,
                        <65>, <69>, <72>,
                        <76>, <77>, <78>,
                        <96>, <97>, <98>,
                        <112>, <113>,
                        <114>, <115>,
                        <116>, <128>, <135>;
        clock-output-names = "bus_ce", "bus_dma", "bus_mmc0",
                             "bus_mmc1", "bus_mmc2", "bus_nand",
                             "bus_sdram", "bus_gmac", "bus_ts",
                             "bus_hstimer", "bus_spi0",
                             "bus_spi1", "bus_otg",
                             "bus_otg_ehci0", "bus_ehci1",
                             "bus_ehci2", "bus_ehci3",
                             "bus_otg_ohci0", "bus_ohci1",
                             "bus_ohci2", "bus_ohci3", "bus_ve",
                             "bus_lcd0", "bus_lcd1", "bus_deint",
                             "bus_csi", "bus_tve", "bus_hdmi",
                             "bus_de", "bus_gpu", "bus_msgbox",
                             "bus_spinlock", "bus_codec",
                             "bus_spdif", "bus_pio", "bus_ths",
                             "bus_i2s0", "bus_i2s1", "bus_i2s2",
                             "bus_i2c0", "bus_i2c1", "bus_i2c2",
                             "bus_uart0", "bus_uart1",
                             "bus_uart2", "bus_uart3",
                             "bus_scr", "bus_ephy", "bus_dbg";
    };

...
```

## Documentation/devicetree/bindings/clock/allwinner,sun9i-a80-ahb-clk.yaml
```yaml
# SPDX-License-Identifier: GPL-2.0
%YAML 1.2
---
$id: http://devicetree.org/schemas/clock/allwinner,sun9i-a80-ahb-clk.yaml#
$schema: http://devicetree.org/meta-schemas/core.yaml#

title: Allwinner A80 AHB Clock Device Tree Bindings

maintainers:
  - Chen-Yu Tsai <wens@csie.org>
  - Maxime Ripard <mripard@kernel.org>

deprecated: true

properties:
  "#clock-cells":
    const: 0

  compatible:
    const: allwinner,sun9i-a80-ahb-clk

  reg:
    maxItems: 1

  clocks:
    maxItems: 4
    description: >
      The parent order must match the hardware programming order.

  clock-output-names:
    maxItems: 1

required:
  - "#clock-cells"
  - compatible
  - reg
  - clocks
  - clock-output-names

additionalProperties: false

examples:
  - |
    clk@6000060 {
        #clock-cells = <0>;
        compatible = "allwinner,sun9i-a80-ahb-clk";
        reg = <0x06000060 0x4>;
        clocks = <&gt_clk>, <&pll4>, <&pll12>, <&pll12>;
        clock-output-names = "ahb0";
    };

...
```

## Documentation/devicetree/bindings/clock/allwinner,sun9i-a80-apb0-clk.yaml
```yaml
# SPDX-License-Identifier: GPL-2.0
%YAML 1.2
---
$id: http://devicetree.org/schemas/clock/allwinner,sun9i-a80-apb0-clk.yaml#
$schema: http://devicetree.org/meta-schemas/core.yaml#

title: Allwinner A80 APB0 Bus Clock

maintainers:
  - Chen-Yu Tsai <wens@csie.org>
  - Maxime Ripard <mripard@kernel.org>

deprecated: true

properties:
  "#clock-cells":
    const: 0

  compatible:
    enum:
      - allwinner,sun9i-a80-apb0-clk
      - allwinner,sun9i-a80-apb1-clk

  reg:
    maxItems: 1

  clocks:
    maxItems: 2
    description: >
      The parent order must match the hardware programming order.

  clock-output-names:
    maxItems: 1

required:
  - "#clock-cells"
  - compatible
  - reg
  - clocks
  - clock-output-names

additionalProperties: false

examples:
  - |
    clk@6000070 {
        #clock-cells = <0>;
        compatible = "allwinner,sun9i-a80-apb0-clk";
        reg = <0x06000070 0x4>;
        clocks = <&osc24M>, <&pll4>;
        clock-output-names = "apb0";
    };

  - |
    clk@6000074 {
        #clock-cells = <0>;
        compatible = "allwinner,sun9i-a80-apb1-clk";
        reg = <0x06000074 0x4>;
        clocks = <&osc24M>, <&pll4>;
        clock-output-names = "apb1";
    };

...
```

## Documentation/devicetree/bindings/clock/allwinner,sun9i-a80-cpus-clk.yaml
```yaml
# SPDX-License-Identifier: GPL-2.0
%YAML 1.2
---
$id: http://devicetree.org/schemas/clock/allwinner,sun9i-a80-cpus-clk.yaml#
$schema: http://devicetree.org/meta-schemas/core.yaml#

title: Allwinner A80 CPUS Clock

maintainers:
  - Chen-Yu Tsai <wens@csie.org>
  - Maxime Ripard <mripard@kernel.org>

deprecated: true

properties:
  "#clock-cells":
    const: 0

  compatible:
    const: allwinner,sun9i-a80-cpus-clk

  reg:
    maxItems: 1

  clocks:
    maxItems: 4
    description: >
      The parent order must match the hardware programming order.

  clock-output-names:
    maxItems: 1

required:
  - "#clock-cells"
  - compatible
  - reg
  - clocks
  - clock-output-names

additionalProperties: false

examples:
  - |
    clk@8001410 {
        compatible = "allwinner,sun9i-a80-cpus-clk";
        reg = <0x08001410 0x4>;
        #clock-cells = <0>;
        clocks = <&osc32k>, <&osc24M>, <&pll4>, <&pll3>;
        clock-output-names = "cpus";
    };

...
```

## Documentation/devicetree/bindings/clock/allwinner,sun9i-a80-de-clks.yaml
```yaml
# SPDX-License-Identifier: GPL-2.0+
%YAML 1.2
---
$id: http://devicetree.org/schemas/clock/allwinner,sun9i-a80-de-clks.yaml#
$schema: http://devicetree.org/meta-schemas/core.yaml#

title: Allwinner A80 Display Engine Clock Controller

maintainers:
  - Chen-Yu Tsai <wens@csie.org>
  - Maxime Ripard <mripard@kernel.org>

properties:
  "#clock-cells":
    const: 1

  "#reset-cells":
    const: 1

  compatible:
    const: allwinner,sun9i-a80-de-clks

  reg:
    maxItems: 1

  clocks:
    items:
      - description: Bus Clock
      - description: RAM Bus Clock
      - description: Module Clock

  clock-names:
    items:
      - const: mod
      - const: dram
      - const: bus

  resets:
    maxItems: 1

required:
  - "#clock-cells"
  - "#reset-cells"
  - compatible
  - reg
  - clocks
  - clock-names
  - resets

additionalProperties: false

examples:
  - |
    #include <dt-bindings/clock/sun9i-a80-ccu.h>
    #include <dt-bindings/reset/sun9i-a80-ccu.h>

    de_clocks: clock@3000000 {
        compatible = "allwinner,sun9i-a80-de-clks";
        reg = <0x03000000 0x30>;
        clocks = <&ccu CLK_DE>, <&ccu CLK_SDRAM>, <&ccu CLK_BUS_DE>;
        clock-names = "mod", "dram", "bus";
        resets = <&ccu RST_BUS_DE>;
        #clock-cells = <1>;
        #reset-cells = <1>;
    };

...
```

## Documentation/devicetree/bindings/clock/allwinner,sun9i-a80-gt-clk.yaml
```yaml
# SPDX-License-Identifier: GPL-2.0
%YAML 1.2
---
$id: http://devicetree.org/schemas/clock/allwinner,sun9i-a80-gt-clk.yaml#
$schema: http://devicetree.org/meta-schemas/core.yaml#

title: Allwinner A80 GT Bus Clock Device Tree Bindings

maintainers:
  - Chen-Yu Tsai <wens@csie.org>
  - Maxime Ripard <mripard@kernel.org>

deprecated: true

properties:
  "#clock-cells":
    const: 0

  compatible:
    const: allwinner,sun9i-a80-gt-clk

  reg:
    maxItems: 1

  clocks:
    maxItems: 4
    description: >
      The parent order must match the hardware programming order.

  clock-output-names:
    maxItems: 1

required:
  - "#clock-cells"
  - compatible
  - reg
  - clocks
  - clock-output-names

additionalProperties: false

examples:
  - |
    clk@600005c {
        #clock-cells = <0>;
        compatible = "allwinner,sun9i-a80-gt-clk";
        reg = <0x0600005c 0x4>;
        clocks = <&osc24M>, <&pll4>, <&pll12>, <&pll12>;
        clock-output-names = "gt";
    };

...
```
