## Documentation/devicetree/bindings/clock/allwinner,sun9i-a80-mmc-config-clk.yaml
```yaml
# SPDX-License-Identifier: GPL-2.0
%YAML 1.2
---
$id: http://devicetree.org/schemas/clock/allwinner,sun9i-a80-mmc-config-clk.yaml#
$schema: http://devicetree.org/meta-schemas/core.yaml#

title: Allwinner A80 MMC Configuration Clock Device Tree Bindings

maintainers:
  - Chen-Yu Tsai <wens@csie.org>
  - Maxime Ripard <mripard@kernel.org>

deprecated: true

description: >
  There is one clock/reset output per mmc controller. The number of
  outputs is determined by the size of the address block, which is
  related to the overall mmc block.

properties:
  "#clock-cells":
    const: 1
    description: >
      The additional ID argument passed to the clock shall refer to
      the index of the output.

  "#reset-cells":
    const: 1

  compatible:
    const: allwinner,sun9i-a80-mmc-config-clk

  reg:
    maxItems: 1

  clocks:
    maxItems: 1

  resets:
    maxItems: 1

  clock-output-names:
    maxItems: 4

required:
  - "#clock-cells"
  - "#reset-cells"
  - compatible
  - reg
  - clocks
  - clock-output-names

additionalProperties: false

examples:
  - |
    clk@1c13000 {
        #clock-cells = <1>;
        #reset-cells = <1>;
        compatible = "allwinner,sun9i-a80-mmc-config-clk";
        reg = <0x01c13000 0x10>;
        clocks = <&ahb0_gates 8>;
        resets = <&ahb0_resets 8>;
        clock-output-names = "mmc0_config", "mmc1_config",
                             "mmc2_config", "mmc3_config";
    };

...
```

## Documentation/devicetree/bindings/clock/allwinner,sun9i-a80-pll4-clk.yaml
```yaml
# SPDX-License-Identifier: GPL-2.0
%YAML 1.2
---
$id: http://devicetree.org/schemas/clock/allwinner,sun9i-a80-pll4-clk.yaml#
$schema: http://devicetree.org/meta-schemas/core.yaml#

title: Allwinner A80 Peripheral PLL Device Tree Bindings

maintainers:
  - Chen-Yu Tsai <wens@csie.org>
  - Maxime Ripard <mripard@kernel.org>

deprecated: true

properties:
  "#clock-cells":
    const: 0

  compatible:
    const: allwinner,sun9i-a80-pll4-clk

  reg:
    maxItems: 1

  clocks:
    maxItems: 1

  clock-output-names:
    maxItems: 1

required:
  - "#clock-cells"
  - compatible
  - reg
  - clocks
  - clock-output-names

additionalProperties: false

examples:
  - |
    clk@600000c {
        #clock-cells = <0>;
        compatible = "allwinner,sun9i-a80-pll4-clk";
        reg = <0x0600000c 0x4>;
        clocks = <&osc24M>;
        clock-output-names = "pll4";
    };

...
```

## Documentation/devicetree/bindings/clock/allwinner,sun9i-a80-usb-clks.yaml
```yaml
# SPDX-License-Identifier: GPL-2.0+
%YAML 1.2
---
$id: http://devicetree.org/schemas/clock/allwinner,sun9i-a80-usb-clks.yaml#
$schema: http://devicetree.org/meta-schemas/core.yaml#

title: Allwinner A80 USB Clock Controller

maintainers:
  - Chen-Yu Tsai <wens@csie.org>
  - Maxime Ripard <mripard@kernel.org>

properties:
  "#clock-cells":
    const: 1

  "#reset-cells":
    const: 1

  compatible:
    const: allwinner,sun9i-a80-usb-clks

  reg:
    maxItems: 1

  clocks:
    items:
      - description: Bus Clock
      - description: High Frequency Oscillator

  clock-names:
    items:
      - const: bus
      - const: hosc

required:
  - "#clock-cells"
  - "#reset-cells"
  - compatible
  - reg
  - clocks
  - clock-names

additionalProperties: false

examples:
  - |
    #include <dt-bindings/clock/sun9i-a80-ccu.h>

    usb_clocks: clock@a08000 {
        compatible = "allwinner,sun9i-a80-usb-clks";
        reg = <0x00a08000 0x8>;
        clocks = <&ccu CLK_BUS_USB>, <&osc24M>;
        clock-names = "bus", "hosc";
        #clock-cells = <1>;
        #reset-cells = <1>;
    };

...
```

## Documentation/devicetree/bindings/clock/allwinner,sun9i-a80-usb-mod-clk.yaml
```yaml
# SPDX-License-Identifier: GPL-2.0
%YAML 1.2
---
$id: http://devicetree.org/schemas/clock/allwinner,sun9i-a80-usb-mod-clk.yaml#
$schema: http://devicetree.org/meta-schemas/core.yaml#

title: Allwinner A80 USB Module Clock

maintainers:
  - Chen-Yu Tsai <wens@csie.org>
  - Maxime Ripard <mripard@kernel.org>

deprecated: true

properties:
  "#clock-cells":
    const: 1
    description: >
      The additional ID argument passed to the clock shall refer to
      the index of the output.

  "#reset-cells":
    const: 1

  compatible:
    const: allwinner,sun9i-a80-usb-mod-clk

  reg:
    maxItems: 1

  clocks:
    maxItems: 1

  clock-output-names:
    maxItems: 6

required:
  - "#clock-cells"
  - "#reset-cells"
  - compatible
  - reg
  - clocks
  - clock-output-names

additionalProperties: false

examples:
  - |
    clk@a08000 {
        #clock-cells = <1>;
        #reset-cells = <1>;
        compatible = "allwinner,sun9i-a80-usb-mod-clk";
        reg = <0x00a08000 0x4>;
        clocks = <&ahb1_gates 1>;
        clock-output-names = "usb0_ahb", "usb_ohci0",
                             "usb1_ahb", "usb_ohci1",
                             "usb2_ahb", "usb_ohci2";
    };

...
```

## Documentation/devicetree/bindings/clock/allwinner,sun9i-a80-usb-phy-clk.yaml
```yaml
# SPDX-License-Identifier: GPL-2.0
%YAML 1.2
---
$id: http://devicetree.org/schemas/clock/allwinner,sun9i-a80-usb-phy-clk.yaml#
$schema: http://devicetree.org/meta-schemas/core.yaml#

title: Allwinner A80 USB PHY Clock Device Tree Bindings

maintainers:
  - Chen-Yu Tsai <wens@csie.org>
  - Maxime Ripard <mripard@kernel.org>

deprecated: true

properties:
  "#clock-cells":
    const: 1
    description: >
      The additional ID argument passed to the clock shall refer to
      the index of the output.

  "#reset-cells":
    const: 1

  compatible:
    const: allwinner,sun9i-a80-usb-phy-clk

  reg:
    maxItems: 1

  clocks:
    maxItems: 1

  clock-output-names:
    maxItems: 6

required:
  - "#clock-cells"
  - "#reset-cells"
  - compatible
  - reg
  - clocks
  - clock-output-names

additionalProperties: false

examples:
  - |
    clk@a08004 {
        #clock-cells = <1>;
        #reset-cells = <1>;
        compatible = "allwinner,sun9i-a80-usb-phy-clk";
        reg = <0x00a08004 0x4>;
        clocks = <&ahb1_gates 1>;
        clock-output-names = "usb_phy0", "usb_hsic1_480M",
                             "usb_phy1", "usb_hsic2_480M",
                             "usb_phy2", "usb_hsic_12M";
    };

...
```

## Documentation/devicetree/bindings/clock/alphascale,acc.txt
```
Alphascale Clock Controller

The ACC (Alphascale Clock Controller) is responsible for choosing proper
clock source, setting dividers and clock gates.

Required properties for the ACC node:
 - compatible: must be "alphascale,asm9260-clock-controller"
 - reg: must contain the ACC register base and size
 - #clock-cells : shall be set to 1.

Simple one-cell clock specifier format is used, where the only cell is used
as an index of the clock inside the provider.
It is encouraged to use dt-binding for clock index definitions. SoC specific
dt-binding should be included to the device tree descriptor. For example
Alphascale ASM9260:
#include <dt-bindings/clock/alphascale,asm9260.h>

This binding contains two types of clock providers:
 _AHB_ - AHB gate;
 _SYS_ - adjustable clock source. Not all peripheral have _SYS_ clock provider.
All clock specific details can be found in the SoC documentation.
CLKID_AHB_ROM		0
CLKID_AHB_RAM		1
CLKID_AHB_GPIO		2
CLKID_AHB_MAC		3
CLKID_AHB_EMI		4
CLKID_AHB_USB0		5
CLKID_AHB_USB1		6
CLKID_AHB_DMA0		7
CLKID_AHB_DMA1		8
CLKID_AHB_UART0		9
CLKID_AHB_UART1		10
CLKID_AHB_UART2		11
CLKID_AHB_UART3		12
CLKID_AHB_UART4		13
CLKID_AHB_UART5		14
CLKID_AHB_UART6		15
CLKID_AHB_UART7		16
CLKID_AHB_UART8		17
CLKID_AHB_UART9		18
CLKID_AHB_I2S0		19
CLKID_AHB_I2C0		20
CLKID_AHB_I2C1		21
CLKID_AHB_SSP0		22
CLKID_AHB_IOCONFIG	23
CLKID_AHB_WDT		24
CLKID_AHB_CAN0		25
CLKID_AHB_CAN1		26
CLKID_AHB_MPWM		27
CLKID_AHB_SPI0		28
CLKID_AHB_SPI1		29
CLKID_AHB_QEI		30
CLKID_AHB_QUADSPI0	31
CLKID_AHB_CAMIF		32
CLKID_AHB_LCDIF		33
CLKID_AHB_TIMER0	34
CLKID_AHB_TIMER1	35
CLKID_AHB_TIMER2	36
CLKID_AHB_TIMER3	37
CLKID_AHB_IRQ		38
CLKID_AHB_RTC		39
CLKID_AHB_NAND		40
CLKID_AHB_ADC0		41
CLKID_AHB_LED		42
CLKID_AHB_DAC0		43
CLKID_AHB_LCD		44
CLKID_AHB_I2S1		45
CLKID_AHB_MAC1		46

CLKID_SYS_CPU		47
CLKID_SYS_AHB		48
CLKID_SYS_I2S0M		49
CLKID_SYS_I2S0S		50
CLKID_SYS_I2S1M		51
CLKID_SYS_I2S1S		52
CLKID_SYS_UART0		53
CLKID_SYS_UART1		54
CLKID_SYS_UART2		55
CLKID_SYS_UART3		56
CLKID_SYS_UART4		56
CLKID_SYS_UART5		57
CLKID_SYS_UART6		58
CLKID_SYS_UART7		59
CLKID_SYS_UART8		60
CLKID_SYS_UART9		61
CLKID_SYS_SPI0		62
CLKID_SYS_SPI1		63
CLKID_SYS_QUADSPI	64
CLKID_SYS_SSP0		65
CLKID_SYS_NAND		66
CLKID_SYS_TRACE		67
CLKID_SYS_CAMM		68
CLKID_SYS_WDT		69
CLKID_SYS_CLKOUT	70
CLKID_SYS_MAC		71
CLKID_SYS_LCD		72
CLKID_SYS_ADCANA	73

Example of clock consumer with _SYS_ and _AHB_ sinks.
uart4: serial@80010000 {
	compatible = "alphascale,asm9260-uart";
	reg = <0x80010000 0x4000>;
	clocks = <&acc CLKID_SYS_UART4>, <&acc CLKID_AHB_UART4>;
	interrupts = <19>;
};

Clock consumer with only one, _AHB_ sink.
timer0: timer@80088000 {
	compatible = "alphascale,asm9260-timer";
	reg = <0x80088000 0x4000>;
	clocks = <&acc CLKID_AHB_TIMER0>;
	interrupts = <29>;
};
```

## Documentation/devicetree/bindings/clock/alphascale,asm9260-clock-controller.yaml
```yaml
# SPDX-License-Identifier: (GPL-2.0-only OR BSD-2-Clause)
%YAML 1.2
---
$id: http://devicetree.org/schemas/clock/alphascale,asm9260-clock-controller.yaml#
$schema: http://devicetree.org/meta-schemas/core.yaml#

title: Alphascale Clock Controller

maintainers:
  - Oleksij Rempel <linux@rempel-privat.de>

description: |
  The ACC (Alphascale Clock Controller) is responsible for choosing proper
  clock source, setting dividers and clock gates.

  Simple one-cell clock specifier format is used, where the only cell is used
  as an index of the clock inside the provider.
  It is encouraged to use dt-binding for clock index definitions. SoC specific
  dt-binding should be included to the device tree descriptor. For example
  Alphascale ASM9260:

  #include <dt-bindings/clock/alphascale,asm9260.h>

  This binding contains two types of clock providers:

    _AHB_ - AHB gate;
    _SYS_ - adjustable clock source. Not all peripheral have _SYS_ clock provider.

  All clock specific details can be found in the SoC documentation.

properties:
  compatible:
    const: alphascale,asm9260-clock-controller

  reg:
    maxItems: 1

  '#clock-cells':
    const: 1

  clocks:
    maxItems: 1

required:
  - compatible
  - reg
  - '#clock-cells'

additionalProperties: false
```

## Documentation/devicetree/bindings/clock/altr_socfpga.txt
```
Device Tree Clock bindings for Altera's SoCFPGA platform

This binding uses the common clock binding[1].

[1] Documentation/devicetree/bindings/clock/clock-bindings.txt

Required properties:
- compatible : shall be one of the following:
	"altr,socfpga-pll-clock" - for a PLL clock
	"altr,socfpga-perip-clock" - The peripheral clock divided from the
		PLL clock.
	"altr,socfpga-gate-clk" - Clocks that directly feed peripherals and
		can get gated.

- reg : shall be the control register offset from CLOCK_MANAGER's base for the clock.
- clocks : shall be the input parent clock phandle for the clock. This is
	either an oscillator or a pll output.
- #clock-cells : from common clock binding, shall be set to 0.

Optional properties:
- fixed-divider : If clocks have a fixed divider value, use this property.
- clk-gate : For "socfpga-gate-clk", clk-gate contains the gating register
        and the bit index.
- div-reg : For "socfpga-gate-clk" and "socfpga-periph-clock", div-reg contains
	the divider register, bit shift, and width.
- clk-phase : For the sdmmc_clk, contains the value of the clock phase that controls
	the SDMMC CIU clock. The first value is the clk_sample(smpsel), and the second
	value is the cclk_in_drv(drvsel). The clk-phase is used to enable the correct
	hold/delay times that is needed for the SD/MMC CIU clock. The values of both
	can be 0-315 degrees, in 45 degree increments.
```

## Documentation/devicetree/bindings/clock/amlogic,a1-peripherals-clkc.yaml
```yaml
# SPDX-License-Identifier: GPL-2.0-only OR BSD-2-Clause
%YAML 1.2
---
$id: http://devicetree.org/schemas/clock/amlogic,a1-peripherals-clkc.yaml#
$schema: http://devicetree.org/meta-schemas/core.yaml#

title: Amlogic A1 Peripherals Clock Control Unit

maintainers:
  - Neil Armstrong <neil.armstrong@linaro.org>
  - Jerome Brunet <jbrunet@baylibre.com>
  - Jian Hu <jian.hu@jian.hu.com>
  - Dmitry Rokosov <ddrokosov@sberdevices.ru>

properties:
  compatible:
    const: amlogic,a1-peripherals-clkc

  '#clock-cells':
    const: 1

  reg:
    maxItems: 1

  clocks:
    items:
      - description: input fixed pll div2
      - description: input fixed pll div3
      - description: input fixed pll div5
      - description: input fixed pll div7
      - description: input hifi pll
      - description: input oscillator (usually at 24MHz)
      - description: input sys pll
    minItems: 6 # sys_pll is optional

  clock-names:
    items:
      - const: fclk_div2
      - const: fclk_div3
      - const: fclk_div5
      - const: fclk_div7
      - const: hifi_pll
      - const: xtal
      - const: sys_pll
    minItems: 6 # sys_pll is optional

required:
  - compatible
  - '#clock-cells'
  - reg
  - clocks
  - clock-names

additionalProperties: false

examples:
  - |
    #include <dt-bindings/clock/amlogic,a1-pll-clkc.h>
    apb {
        #address-cells = <2>;
        #size-cells = <2>;

        clock-controller@800 {
            compatible = "amlogic,a1-peripherals-clkc";
            reg = <0 0x800 0 0x104>;
            #clock-cells = <1>;
            clocks = <&clkc_pll CLKID_FCLK_DIV2>,
                     <&clkc_pll CLKID_FCLK_DIV3>,
                     <&clkc_pll CLKID_FCLK_DIV5>,
                     <&clkc_pll CLKID_FCLK_DIV7>,
                     <&clkc_pll CLKID_HIFI_PLL>,
                     <&xtal>,
                     <&clkc_pll CLKID_SYS_PLL>;
            clock-names = "fclk_div2", "fclk_div3",
                          "fclk_div5", "fclk_div7",
                          "hifi_pll", "xtal", "sys_pll";
        };
    };
```

## Documentation/devicetree/bindings/clock/amlogic,a1-pll-clkc.yaml
```yaml
# SPDX-License-Identifier: GPL-2.0-only OR BSD-2-Clause
%YAML 1.2
---
$id: http://devicetree.org/schemas/clock/amlogic,a1-pll-clkc.yaml#
$schema: http://devicetree.org/meta-schemas/core.yaml#

title: Amlogic A1 PLL Clock Control Unit

maintainers:
  - Neil Armstrong <neil.armstrong@linaro.org>
  - Jerome Brunet <jbrunet@baylibre.com>
  - Jian Hu <jian.hu@jian.hu.com>
  - Dmitry Rokosov <ddrokosov@sberdevices.ru>

properties:
  compatible:
    const: amlogic,a1-pll-clkc

  '#clock-cells':
    const: 1

  reg:
    maxItems: 1

  clocks:
    items:
      - description: input fixpll_in
      - description: input hifipll_in
      - description: input syspll_in
    minItems: 2 # syspll_in is optional

  clock-names:
    items:
      - const: fixpll_in
      - const: hifipll_in
      - const: syspll_in
    minItems: 2 # syspll_in is optional

required:
  - compatible
  - '#clock-cells'
  - reg
  - clocks
  - clock-names

additionalProperties: false

examples:
  - |
    #include <dt-bindings/clock/amlogic,a1-peripherals-clkc.h>
    apb {
        #address-cells = <2>;
        #size-cells = <2>;

        clock-controller@7c80 {
            compatible = "amlogic,a1-pll-clkc";
            reg = <0 0x7c80 0 0x18c>;
            #clock-cells = <1>;
            clocks = <&clkc_periphs CLKID_FIXPLL_IN>,
                     <&clkc_periphs CLKID_HIFIPLL_IN>,
                     <&clkc_periphs CLKID_SYSPLL_IN>;
            clock-names = "fixpll_in", "hifipll_in", "syspll_in";
        };
    };
```
