## Documentation/devicetree/bindings/clock/starfive,jh7110-stgcrg.yaml
```yaml
# SPDX-License-Identifier: GPL-2.0-only OR BSD-2-Clause
%YAML 1.2
---
$id: http://devicetree.org/schemas/clock/starfive,jh7110-stgcrg.yaml#
$schema: http://devicetree.org/meta-schemas/core.yaml#

title: StarFive JH7110 System-Top-Group Clock and Reset Generator

maintainers:
  - Xingyu Wu <xingyu.wu@starfivetech.com>

properties:
  compatible:
    const: starfive,jh7110-stgcrg

  reg:
    maxItems: 1

  clocks:
    items:
      - description: Main Oscillator (24 MHz)
      - description: HIFI4 core
      - description: STG AXI/AHB
      - description: USB (125 MHz)
      - description: CPU Bus
      - description: HIFI4 Axi
      - description: NOC STG Bus
      - description: APB Bus

  clock-names:
    items:
      - const: osc
      - const: hifi4_core
      - const: stg_axiahb
      - const: usb_125m
      - const: cpu_bus
      - const: hifi4_axi
      - const: nocstg_bus
      - const: apb_bus

  '#clock-cells':
    const: 1
    description:
      See <dt-bindings/clock/starfive,jh7110-crg.h> for valid indices.

  '#reset-cells':
    const: 1
    description:
      See <dt-bindings/reset/starfive,jh7110-crg.h> for valid indices.

required:
  - compatible
  - reg
  - clocks
  - clock-names
  - '#clock-cells'
  - '#reset-cells'

additionalProperties: false

examples:
  - |
    #include <dt-bindings/clock/starfive,jh7110-crg.h>

    stgcrg: clock-controller@10230000 {
        compatible = "starfive,jh7110-stgcrg";
        reg = <0x10230000 0x10000>;
        clocks = <&osc>,
                 <&syscrg JH7110_SYSCLK_HIFI4_CORE>,
                 <&syscrg JH7110_SYSCLK_STG_AXIAHB>,
                 <&syscrg JH7110_SYSCLK_USB_125M>,
                 <&syscrg JH7110_SYSCLK_CPU_BUS>,
                 <&syscrg JH7110_SYSCLK_HIFI4_AXI>,
                 <&syscrg JH7110_SYSCLK_NOCSTG_BUS>,
                 <&syscrg JH7110_SYSCLK_APB_BUS>;
        clock-names = "osc", "hifi4_core",
                      "stg_axiahb", "usb_125m",
                      "cpu_bus", "hifi4_axi",
                      "nocstg_bus", "apb_bus";
        #clock-cells = <1>;
        #reset-cells = <1>;
    };
```

## Documentation/devicetree/bindings/clock/starfive,jh7110-syscrg.yaml
```yaml
# SPDX-License-Identifier: GPL-2.0-only OR BSD-2-Clause
%YAML 1.2
---
$id: http://devicetree.org/schemas/clock/starfive,jh7110-syscrg.yaml#
$schema: http://devicetree.org/meta-schemas/core.yaml#

title: StarFive JH7110 System Clock and Reset Generator

maintainers:
  - Emil Renner Berthing <kernel@esmil.dk>

properties:
  compatible:
    const: starfive,jh7110-syscrg

  reg:
    maxItems: 1

  clocks:
    oneOf:
      - items:
          - description: Main Oscillator (24 MHz)
          - description: GMAC1 RMII reference or GMAC1 RGMII RX
          - description: External I2S TX bit clock
          - description: External I2S TX left/right channel clock
          - description: External I2S RX bit clock
          - description: External I2S RX left/right channel clock
          - description: External TDM clock
          - description: External audio master clock
          - description: PLL0
          - description: PLL1
          - description: PLL2

      - items:
          - description: Main Oscillator (24 MHz)
          - description: GMAC1 RMII reference
          - description: GMAC1 RGMII RX
          - description: External I2S TX bit clock
          - description: External I2S TX left/right channel clock
          - description: External I2S RX bit clock
          - description: External I2S RX left/right channel clock
          - description: External TDM clock
          - description: External audio master clock
          - description: PLL0
          - description: PLL1
          - description: PLL2

  clock-names:
    oneOf:
      - items:
          - const: osc
          - enum:
              - gmac1_rmii_refin
              - gmac1_rgmii_rxin
          - const: i2stx_bclk_ext
          - const: i2stx_lrck_ext
          - const: i2srx_bclk_ext
          - const: i2srx_lrck_ext
          - const: tdm_ext
          - const: mclk_ext
          - const: pll0_out
          - const: pll1_out
          - const: pll2_out

      - items:
          - const: osc
          - const: gmac1_rmii_refin
          - const: gmac1_rgmii_rxin
          - const: i2stx_bclk_ext
          - const: i2stx_lrck_ext
          - const: i2srx_bclk_ext
          - const: i2srx_lrck_ext
          - const: tdm_ext
          - const: mclk_ext
          - const: pll0_out
          - const: pll1_out
          - const: pll2_out

  '#clock-cells':
    const: 1
    description:
      See <dt-bindings/clock/starfive,jh7110-crg.h> for valid indices.

  '#reset-cells':
    const: 1
    description:
      See <dt-bindings/reset/starfive,jh7110-crg.h> for valid indices.

required:
  - compatible
  - reg
  - clocks
  - clock-names
  - '#clock-cells'
  - '#reset-cells'

additionalProperties: false

examples:
  - |
    clock-controller@13020000 {
        compatible = "starfive,jh7110-syscrg";
        reg = <0x13020000 0x10000>;
        clocks = <&osc>, <&gmac1_rmii_refin>,
                 <&gmac1_rgmii_rxin>,
                 <&i2stx_bclk_ext>, <&i2stx_lrck_ext>,
                 <&i2srx_bclk_ext>, <&i2srx_lrck_ext>,
                 <&tdm_ext>, <&mclk_ext>,
                 <&pllclk 0>, <&pllclk 1>, <&pllclk 2>;
        clock-names = "osc", "gmac1_rmii_refin",
                      "gmac1_rgmii_rxin",
                      "i2stx_bclk_ext", "i2stx_lrck_ext",
                      "i2srx_bclk_ext", "i2srx_lrck_ext",
                      "tdm_ext", "mclk_ext",
                      "pll0_out", "pll1_out", "pll2_out";
        #clock-cells = <1>;
        #reset-cells = <1>;
    };
```

## Documentation/devicetree/bindings/clock/starfive,jh7110-voutcrg.yaml
```yaml
# SPDX-License-Identifier: GPL-2.0-only OR BSD-2-Clause
%YAML 1.2
---
$id: http://devicetree.org/schemas/clock/starfive,jh7110-voutcrg.yaml#
$schema: http://devicetree.org/meta-schemas/core.yaml#

title: StarFive JH7110 Video-Output Clock and Reset Generator

maintainers:
  - Xingyu Wu <xingyu.wu@starfivetech.com>

properties:
  compatible:
    const: starfive,jh7110-voutcrg

  reg:
    maxItems: 1

  clocks:
    items:
      - description: Vout Top core
      - description: Vout Top Ahb
      - description: Vout Top Axi
      - description: Vout Top HDMI MCLK
      - description: I2STX0 BCLK
      - description: external HDMI pixel

  clock-names:
    items:
      - const: vout_src
      - const: vout_top_ahb
      - const: vout_top_axi
      - const: vout_top_hdmitx0_mclk
      - const: i2stx0_bclk
      - const: hdmitx0_pixelclk

  resets:
    maxItems: 1
    description: Vout Top core

  '#clock-cells':
    const: 1
    description:
      See <dt-bindings/clock/starfive,jh7110-crg.h> for valid indices.

  '#reset-cells':
    const: 1
    description:
      See <dt-bindings/reset/starfive,jh7110-crg.h> for valid indices.

  power-domains:
    maxItems: 1
    description:
      Vout domain power

required:
  - compatible
  - reg
  - clocks
  - clock-names
  - resets
  - '#clock-cells'
  - '#reset-cells'
  - power-domains

additionalProperties: false

examples:
  - |
    #include <dt-bindings/clock/starfive,jh7110-crg.h>
    #include <dt-bindings/power/starfive,jh7110-pmu.h>
    #include <dt-bindings/reset/starfive,jh7110-crg.h>

    voutcrg: clock-controller@295C0000 {
        compatible = "starfive,jh7110-voutcrg";
        reg = <0x295C0000 0x10000>;
        clocks = <&syscrg JH7110_SYSCLK_VOUT_SRC>,
                 <&syscrg JH7110_SYSCLK_VOUT_TOP_AHB>,
                 <&syscrg JH7110_SYSCLK_VOUT_TOP_AXI>,
                 <&syscrg JH7110_SYSCLK_VOUT_TOP_HDMITX0_MCLK>,
                 <&syscrg JH7110_SYSCLK_I2STX0_BCLK>,
                 <&hdmitx0_pixelclk>;
        clock-names = "vout_src", "vout_top_ahb",
                      "vout_top_axi", "vout_top_hdmitx0_mclk",
                      "i2stx0_bclk", "hdmitx0_pixelclk";
        resets = <&syscrg JH7110_SYSRST_VOUT_TOP_SRC>;
        #clock-cells = <1>;
        #reset-cells = <1>;
        power-domains = <&pwrc JH7110_PD_VOUT>;
    };
```

## Documentation/devicetree/bindings/clock/ste-u300-syscon-clock.txt
```
Clock bindings for ST-Ericsson U300 System Controller Clocks

Bindings for the gated system controller clocks:

Required properties:
- compatible: must be "stericsson,u300-syscon-clk"
- #clock-cells: must be <0>
- clock-type: specifies the type of clock:
  0 = slow clock
  1 = fast clock
  2 = rest/remaining clock
- clock-id: specifies the clock in the type range

Optional properties:
- clocks: parent clock(s)

The available clocks per type are as follows:

Type:  ID:   Clock:
-------------------
0      0     Slow peripheral bridge clock
0      1     UART0 clock
0      4     GPIO clock
0      6     RTC clock
0      7     Application timer clock
0      8     Access timer clock

1      0     Fast peripheral bridge clock
1      1     I2C bus 0 clock
1      2     I2C bus 1 clock
1      5     MMC interface peripheral (silicon) clock
1      6     SPI clock

2      3     CPU clock
2      4     DMA controller clock
2      5     External Memory Interface (EMIF) clock
2      6     NAND flask interface clock
2      8     XGAM graphics engine clock
2      9     Shared External Memory Interface (SEMI) clock
2      10    AHB Subsystem Bridge clock
2      12    Interrupt controller clock

Example:

gpio_clk: gpio_clk@13M {
	#clock-cells = <0>;
	compatible = "stericsson,u300-syscon-clk";
	clock-type = <0>; /* Slow */
	clock-id = <4>;
	clocks = <&slow_clk>;
};

gpio: gpio@c0016000 {
	compatible = "stericsson,gpio-coh901";
	(...)
	clocks = <&gpio_clk>;
};
```

## Documentation/devicetree/bindings/clock/stericsson,abx500.txt
```
Clock bindings for ST-Ericsson ABx500 clocks

Required properties :
- compatible : shall contain the following:
  "stericsson,ab8500-clk"
- #clock-cells should be <1>

The ABx500 clocks need to be placed as a subnode of an AB8500
device node, see mfd/ab8500.txt

All available clocks are defined as preprocessor macros in
dt-bindings/clock/ste-ab8500.h header and can be used in device
tree sources.

Example:

clock-controller {
	compatible = "stericsson,ab8500-clk";
	#clock-cells = <1>;
};
```

## Documentation/devicetree/bindings/clock/stericsson,u8500-clks.yaml
```yaml
# SPDX-License-Identifier: (GPL-2.0-only OR BSD-2-Clause)
%YAML 1.2
---
$id: http://devicetree.org/schemas/clock/stericsson,u8500-clks.yaml#
$schema: http://devicetree.org/meta-schemas/core.yaml#

title: ST-Ericsson DB8500 (U8500) clocks

maintainers:
  - Ulf Hansson <ulf.hansson@linaro.org>
  - Linus Walleij <linus.walleij@linaro.org>

description: While named "U8500 clocks" these clocks are inside the
  DB8500 digital baseband system-on-chip and its siblings such as
  DB8520. These bindings consider the clocks present in the SoC
  itself, not off-chip clocks. There are four different on-chip
  clocks - RTC (32 kHz), CPU clock (SMP TWD), PRCMU (power reset and
  control management unit) clocks and PRCC (peripheral reset and
  clock controller) clocks. For some reason PRCC 4 does not exist so
  the itemization can be a bit unintuitive.

properties:
  compatible:
    enum:
      - stericsson,u8500-clks
      - stericsson,u8540-clks
      - stericsson,u9540-clks

  reg:
    items:
      - description: PRCC 1 register area
      - description: PRCC 2 register area
      - description: PRCC 3 register area
      - description: PRCC 5 register area
      - description: PRCC 6 register area

  prcmu-clock:
    description: A subnode with one clock cell for PRCMU (power, reset, control
      management unit) clocks. The cell indicates which PRCMU clock in the
      prcmu-clock node the consumer wants to use.
    type: object

    properties:
      '#clock-cells':
        const: 1

    additionalProperties: false

  prcc-periph-clock:
    description: A subnode with two clock cells for PRCC (peripheral
      reset and clock controller) peripheral clocks. The first cell indicates
      which PRCC block the consumer wants to use, possible values are 1, 2, 3,
      5, 6. The second cell indicates which clock inside the PRCC block it
      wants, possible values are 0 thru 31.
    type: object

    properties:
      '#clock-cells':
        const: 2

    additionalProperties: false

  prcc-kernel-clock:
    description: A subnode with two clock cells for PRCC (peripheral reset
      and clock controller) kernel clocks. The first cell indicates which PRCC
      block the consumer wants to use, possible values are 1, 2, 3, 5, 6. The
      second cell indicates which clock inside the PRCC block it wants, possible
      values are 0 thru 31.
    type: object

    properties:
      '#clock-cells':
        const: 2

    additionalProperties: false

  prcc-reset-controller:
    description: A subnode with two reset cells for the reset portions of the
      PRCC (peripheral reset and clock controller). The first cell indicates
      which PRCC block the consumer wants to use, possible values are 1, 2, 3
      5 and 6. The second cell indicates which reset line inside the PRCC block
      it wants to control, possible values are 0 thru 31.
    type: object

    properties:
      '#reset-cells':
        const: 2

    additionalProperties: false

  rtc32k-clock:
    description: A subnode with zero clock cells for the 32kHz RTC clock.
    type: object

    properties:
      '#clock-cells':
        const: 0

    additionalProperties: false

  smp-twd-clock:
    description: A subnode for the ARM SMP Timer Watchdog cluster with zero
      clock cells.
    type: object

    properties:
      '#clock-cells':
        const: 0

    additionalProperties: false

  clkout-clock:
    description: A subnode with three clock cells for externally routed clocks,
      output clocks. These are two PRCMU-internal clocks that can be divided and
      muxed out on the pads of the DB8500 SoC.
    type: object

    properties:
      '#clock-cells':
        description:
          The first cell indicates which output clock we are using,
          possible values are 0 (CLKOUT1) and 1 (CLKOUT2).
          The second cell indicates which clock we want to use as source,
          possible values are 0 thru 7, see the defines for the different
          source clocks.
          The third cell is a divider, legal values are 1 thru 63.
        const: 3

    additionalProperties: false

required:
  - compatible
  - reg
  - prcmu-clock
  - prcc-periph-clock
  - prcc-kernel-clock
  - rtc32k-clock
  - smp-twd-clock

additionalProperties: false

examples:
  - |
    #include <dt-bindings/clock/ste-db8500-clkout.h>
    clocks@8012 {
      compatible = "stericsson,u8500-clks";
      reg = <0x8012f000 0x1000>, <0x8011f000 0x1000>,
            <0x8000f000 0x1000>, <0xa03ff000 0x1000>,
            <0xa03cf000 0x1000>;

      prcmu_clk: prcmu-clock {
        #clock-cells = <1>;
      };

      prcc_pclk: prcc-periph-clock {
        #clock-cells = <2>;
      };

      prcc_kclk: prcc-kernel-clock {
        #clock-cells = <2>;
      };

      prcc_reset: prcc-reset-controller {
        #reset-cells = <2>;
      };

      rtc_clk: rtc32k-clock {
        #clock-cells = <0>;
      };

      smp_twd_clk: smp-twd-clock {
        #clock-cells = <0>;
      };

      clkout_clk: clkout-clock {
        #clock-cells = <3>;
      };
    };
```
