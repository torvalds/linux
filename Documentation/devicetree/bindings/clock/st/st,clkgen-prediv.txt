## Documentation/devicetree/bindings/clock/st/st,clkgen-prediv.txt
```
Binding for a ST pre-divider clock driver.

This binding uses the common clock binding[1].
Base address is located to the parent node. See clock binding[2]

[1] Documentation/devicetree/bindings/clock/clock-bindings.txt
[2] Documentation/devicetree/bindings/clock/st/st,clkgen.txt

Required properties:

- compatible : shall be:
	"st,clkgena-prediv-c65",	"st,clkgena-prediv"
	"st,clkgena-prediv-c32",	"st,clkgena-prediv"

- #clock-cells : From common clock binding; shall be set to 0.

- clocks : From common clock binding

- clock-output-names : From common clock binding.

Example:

	clockgen-a@fd345000 {
		reg = <0xfd345000 0xb50>;

		clk_m_a2_osc_prediv: clk-m-a2-osc-prediv {
			#clock-cells = <0>;
			compatible = "st,clkgena-prediv-c32",
				     "st,clkgena-prediv";

			clocks = <&clk_sysin>;

			clock-output-names = "clk-m-a2-osc-prediv";
		};
	};
```

## Documentation/devicetree/bindings/clock/st/st,clkgen-vcc.txt
```
Binding for a type of STMicroelectronics clock crossbar (VCC).

The crossbar can take up to 4 input clocks and control up to 16
output clocks. Not all inputs or outputs have to be in use in a
particular instantiation. Each output can be individually enabled,
select any of the input clocks and apply a divide (by 1,2,4 or 8) to
that selected clock.

This binding uses the common clock binding[1].

[1] Documentation/devicetree/bindings/clock/clock-bindings.txt

Required properties:

- compatible : shall be:
	"st,stih416-clkgenc",		"st,vcc"
	"st,stih416-clkgenf",		"st,vcc"

- #clock-cells : from common clock binding; shall be set to 1.

- reg : A Base address and length of the register set.

- clocks : from common clock binding

- clock-output-names : From common clock binding. The block has 16
                       clock outputs but not all of them in a specific instance
                       have to be used in the SoC. If a clock name is left as
                       an empty string then no clock will be created for the
                       output associated with that string index. If fewer than
                       16 strings are provided then no clocks will be created
                       for the remaining outputs.

Example:

	clockgen_c_vcc: clockgen-c-vcc@0xfe8308ac {
		#clock-cells = <1>;
		compatible = "st,stih416-clkgenc", "st,clkgen-vcc";
		reg = <0xfe8308ac 12>;

		clocks = <&clk_s_vcc_hd>,
			 <&clockgen_c 1>,
			 <&clk_s_tmds_fromphy>,
			 <&clockgen_c 2>;

		clock-output-names  = "clk-s-pix-hdmi",
				      "clk-s-pix-dvo",
				      "clk-s-out-dvo",
				      "clk-s-pix-hd",
				      "clk-s-hddac",
				      "clk-s-denc",
				      "clk-s-sddac",
				      "clk-s-pix-main",
				      "clk-s-pix-aux",
				      "clk-s-stfe-frc-0",
				      "clk-s-ref-mcru",
				      "clk-s-slave-mcru",
				      "clk-s-tmds-hdmi",
				      "clk-s-hdmi-reject-pll",
				      "clk-s-thsens";
	};
```

## Documentation/devicetree/bindings/clock/st/st,clkgen.txt
```
Binding for a Clockgen hardware block found on
certain STMicroelectronics consumer electronics SoC devices.

A Clockgen node can contain pll, diviser or multiplexer nodes.

We will find only the base address of the Clockgen, this base
address is common of all subnode.

	clockgen_node {
		reg = <>;

		pll_node {
			...
		};

		quadfs_node {
			...
		};

		mux_node {
			...
		};

		flexgen_node {
			...
		};
		...
	};

This binding uses the common clock binding[1].
Each subnode should use the binding described in [2]..[7]

[1] Documentation/devicetree/bindings/clock/clock-bindings.txt
[3] Documentation/devicetree/bindings/clock/st,clkgen-mux.txt
[4] Documentation/devicetree/bindings/clock/st,clkgen-pll.txt
[7] Documentation/devicetree/bindings/clock/st,quadfs.txt
[8] Documentation/devicetree/bindings/clock/st,flexgen.txt


Required properties:
- reg : A Base address and length of the register set.

Example:

	clockgen-a@090ff000 {
		compatible = "st,clkgen-c32";
		reg = <0x90ff000 0x1000>;

		clk_s_a0_pll: clk-s-a0-pll {
			#clock-cells = <1>;
			compatible = "st,clkgen-pll0";

			clocks = <&clk_sysin>;

			clock-output-names = "clk-s-a0-pll-ofd-0";
		};

		clk_s_a0_flexgen: clk-s-a0-flexgen {
			compatible = "st,flexgen";

			#clock-cells = <1>;

			clocks = <&clk_s_a0_pll 0>,
				 <&clk_sysin>;

			clock-output-names = "clk-ic-lmi0";
		};
	};
```

## Documentation/devicetree/bindings/clock/st/st,flexgen.txt
```
Binding for a type of flexgen structure found on certain
STMicroelectronics consumer electronics SoC devices

This structure includes:
- a clock cross bar (represented by a mux element)
- a pre and final dividers (represented by a divider and gate elements)

Flexgen structure is a part of Clockgen[1].

Please find an example below:

    Clockgen block diagram
    -------------------------------------------------------------------
   |                     Flexgen structure                             |
   |                  ---------------------------------------------    |
   |                 |    -------       --------       --------    |   |
clk_sysin            |   |       |     |        |     |        |   |   |
---|-----------------|-->|       |     |        |     |        |   |   |
   | |               |   |       |     |        |     |        |   |   |
   | |   -------     |   |       |     |Pre     |     |Final   |   |   |
   | |  |PLL0   |    |   |       |     |Dividers|     |Dividers|   |   |
   | |->|       |    |   |       |     |  x32   |     |  x32   |   |   |
   | |  |  odf_0|----|-->|       |     |        |     |        |   |   |
   | |  |       |    |   |       |     |        |     |        |   |   |
   | |  |       |    |   |       |     |        |     |        |   |   |
   | |  |       |    |   |       |     |        |     |        |   |   |
   | |  |       |    |   |       |     |        |     |        |   |   |
   | |   -------     |   |       |     |        |     |        |   |   |
   | |               |   |       |     |        |     |        |   |   |
   | |   -------     |   | Clock |     |        |     |        |   |   |
   | |  |PLL1   |    |   |       |     |        |     |        |   |   |
   | |->|       |    |   | Cross |     |        |     |        |   |   |
   | |  |  odf_0|----|-->|       |     |        |     |        | CLK_DIV[31:0]
   | |  |       |    |   | Bar   |====>|        |====>|        |===|=========>
   | |  |       |    |   |       |     |        |     |        |   |   |
   | |  |       |    |   |       |     |        |     |        |   |   |
   | |  |       |    |   |       |     |        |     |        |   |   |
   | |   -------     |   |       |     |        |     |        |   |   |
   | |               |   |       |     |        |     |        |   |   |
   | |   -------     |   |       |     |        |     |        |   |   |
   | |  |QUADFS |    |   |       |     |        |     |        |   |   |
   | |->|    ch0|----|-->|       |     |        |     |        |   |   |
   |    |       |    |   |       |     |        |     |        |   |   |
   |    |    ch1|----|-->|       |     |        |     |        |   |   |
   |    |       |    |   |       |     |        |     |        |   |   |
   |    |    ch2|----|-->|       |     | DIV    |     | DIV    |   |   |
   |    |       |    |   |       |     |  1 to  |     |  1 to  |   |   |
   |    |    ch3|----|-->|       |     |   1024 |     |     64 |   |   |
   |     -------     |   |       |     |        |     |        |   |   |
   |                 |    -------       --------       --------    |   |
   |                   --------------------------------------------    |
   |                                                                   |
    -------------------------------------------------------------------

This binding uses the common clock binding[2].

[1] Documentation/devicetree/bindings/clock/st/st,clkgen.txt
[2] Documentation/devicetree/bindings/clock/clock-bindings.txt

Required properties:
- compatible : shall be:
  "st,flexgen"
  "st,flexgen-audio", "st,flexgen" (enable clock propagation on parent for
  audio use case)
  "st,flexgen-video", "st,flexgen" (enable clock propagation on parent
					and activate synchronous mode)
  "st,flexgen-stih410-a0"
  "st,flexgen-stih410-c0"
  "st,flexgen-stih418-c0"
  "st,flexgen-stih410-d0"
  "st,flexgen-stih407-d2"
  "st,flexgen-stih418-d2"
  "st,flexgen-stih407-d3"

- #clock-cells : from common clock binding; shall be set to 1 (multiple clock
  outputs).

- clocks : must be set to the parent's phandle. it could be output clocks of
  a quadsfs or/and a pll or/and clk_sysin (up to 7 clocks)

- clock-output-names : List of strings used to name the clock outputs.

Example:

	clk_s_c0_flexgen: clk-s-c0-flexgen {

		#clock-cells = <1>;
		compatible = "st,flexgen";

		clocks = <&clk_s_c0_pll0 0>,
			 <&clk_s_c0_pll1 0>,
			 <&clk_s_c0_quadfs 0>,
			 <&clk_s_c0_quadfs 1>,
			 <&clk_s_c0_quadfs 2>,
			 <&clk_s_c0_quadfs 3>,
			 <&clk_sysin>;

		clock-output-names = "clk-icn-gpu",
				     "clk-fdma",
				     "clk-nand",
				     "clk-hva",
				     "clk-proc-stfe",
				     "clk-proc-tp",
				     "clk-rx-icn-dmu",
				     "clk-rx-icn-hva",
				     "clk-icn-cpu",
				     "clk-tx-icn-dmu",
				     "clk-mmc-0",
				     "clk-mmc-1",
				     "clk-jpegdec",
				     "clk-ext2fa9",
				     "clk-ic-bdisp-0",
				     "clk-ic-bdisp-1",
				     "clk-pp-dmu",
				     "clk-vid-dmu",
				     "clk-dss-lpc",
				     "clk-st231-aud-0",
				     "clk-st231-gp-1",
				     "clk-st231-dmu",
				     "clk-icn-lmi",
				     "clk-tx-icn-disp-1",
				     "clk-icn-sbc",
				     "clk-stfe-frc2",
				     "clk-eth-phy",
				     "clk-eth-ref-phyclk",
				     "clk-flash-promip",
				     "clk-main-disp",
				     "clk-aux-disp",
				     "clk-compo-dvp";
	};
```

## Documentation/devicetree/bindings/clock/st/st,quadfs.txt
```
Binding for a type of quad channel digital frequency synthesizer found on
certain STMicroelectronics consumer electronics SoC devices.

This version contains a programmable PLL which can generate up to 216, 432
or 660MHz (from a 30MHz oscillator input) as the input to the digital
synthesizers.

This binding uses the common clock binding[1].

[1] Documentation/devicetree/bindings/clock/clock-bindings.txt

Required properties:
- compatible : shall be:
  "st,quadfs"
  "st,quadfs-pll"


- #clock-cells : from common clock binding; shall be set to 1.

- reg : A Base address and length of the register set.

- clocks : from common clock binding

- clock-output-names : From common clock binding. The block has 4
                       clock outputs but not all of them in a specific instance
                       have to be used in the SoC. If a clock name is left as
                       an empty string then no clock will be created for the
                       output associated with that string index. If fewer than
                       4 strings are provided then no clocks will be created
                       for the remaining outputs.

Example:

	clk_s_c0_quadfs: clk-s-c0-quadfs@9103000 {
		#clock-cells = <1>;
		compatible = "st,quadfs-pll";
		reg = <0x9103000 0x1000>;

		clocks = <&clk_sysin>;

		clock-output-names = "clk-s-c0-fs0-ch0",
				     "clk-s-c0-fs0-ch1",
				     "clk-s-c0-fs0-ch2",
				     "clk-s-c0-fs0-ch3";
	};
```

## Documentation/devicetree/bindings/clock/starfive,jh7100-audclk.yaml
```yaml
# SPDX-License-Identifier: GPL-2.0-only OR BSD-2-Clause
%YAML 1.2
---
$id: http://devicetree.org/schemas/clock/starfive,jh7100-audclk.yaml#
$schema: http://devicetree.org/meta-schemas/core.yaml#

title: StarFive JH7100 Audio Clock Generator

maintainers:
  - Emil Renner Berthing <kernel@esmil.dk>

properties:
  compatible:
    const: starfive,jh7100-audclk

  reg:
    maxItems: 1

  clocks:
    items:
      - description: Audio source clock
      - description: External 12.288MHz clock
      - description: Domain 7 AHB bus clock

  clock-names:
    items:
      - const: audio_src
      - const: audio_12288
      - const: dom7ahb_bus

  '#clock-cells':
    const: 1
    description:
      See <dt-bindings/clock/starfive-jh7100-audio.h> for valid indices.

required:
  - compatible
  - reg
  - clocks
  - clock-names
  - '#clock-cells'

additionalProperties: false

examples:
  - |
    #include <dt-bindings/clock/starfive-jh7100.h>

    clock-controller@10480000 {
            compatible = "starfive,jh7100-audclk";
            reg = <0x10480000 0x10000>;
            clocks = <&clkgen JH7100_CLK_AUDIO_SRC>,
                     <&clkgen JH7100_CLK_AUDIO_12288>,
                     <&clkgen JH7100_CLK_DOM7AHB_BUS>;
            clock-names = "audio_src", "audio_12288", "dom7ahb_bus";
            #clock-cells = <1>;
    };
```

## Documentation/devicetree/bindings/clock/starfive,jh7100-clkgen.yaml
```yaml
# SPDX-License-Identifier: GPL-2.0-only OR BSD-2-Clause
%YAML 1.2
---
$id: http://devicetree.org/schemas/clock/starfive,jh7100-clkgen.yaml#
$schema: http://devicetree.org/meta-schemas/core.yaml#

title: StarFive JH7100 Clock Generator

maintainers:
  - Geert Uytterhoeven <geert@linux-m68k.org>
  - Emil Renner Berthing <kernel@esmil.dk>

properties:
  compatible:
    const: starfive,jh7100-clkgen

  reg:
    maxItems: 1

  clocks:
    items:
      - description: Main clock source (25 MHz)
      - description: Application-specific clock source (12-27 MHz)
      - description: RMII reference clock (50 MHz)
      - description: RGMII RX clock (125 MHz)

  clock-names:
    items:
      - const: osc_sys
      - const: osc_aud
      - const: gmac_rmii_ref
      - const: gmac_gr_mii_rxclk

  '#clock-cells':
    const: 1
    description:
      See <dt-bindings/clock/starfive-jh7100.h> for valid indices.

required:
  - compatible
  - reg
  - clocks
  - clock-names
  - '#clock-cells'

additionalProperties: false

examples:
  - |
    clock-controller@11800000 {
            compatible = "starfive,jh7100-clkgen";
            reg = <0x11800000 0x10000>;
            clocks = <&osc_sys>, <&osc_aud>, <&gmac_rmii_ref>, <&gmac_gr_mii_rxclk>;
            clock-names = "osc_sys", "osc_aud", "gmac_rmii_ref", "gmac_gr_mii_rxclk";
            #clock-cells = <1>;
    };
```
