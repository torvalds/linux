## Documentation/devicetree/bindings/clock/samsung,s3c6400-clock.yaml
```yaml
# SPDX-License-Identifier: GPL-2.0-only OR BSD-2-Clause
%YAML 1.2
---
$id: http://devicetree.org/schemas/clock/samsung,s3c6400-clock.yaml#
$schema: http://devicetree.org/meta-schemas/core.yaml#

title: Samsung S3C6400 SoC clock controller

maintainers:
  - Krzysztof Kozlowski <krzk@kernel.org>

description: |
  There are several clocks that are generated outside the SoC. It is expected
  that they are defined using standard clock bindings with following
  clock-output-names and/or provided as clock inputs to this clock controller:
   - "fin_pll" - PLL input clock (xtal/extclk) - required,
   - "xusbxti" - USB xtal - required,
   - "iiscdclk0" - I2S0 codec clock - optional,
   - "iiscdclk1" - I2S1 codec clock - optional,
   - "iiscdclk2" - I2S2 codec clock - optional,
   - "pcmcdclk0" - PCM0 codec clock - optional,
   - "pcmcdclk1" - PCM1 codec clock - optional, only S3C6410.

  All available clocks are defined as preprocessor macros in
  include/dt-bindings/clock/samsung,s3c64xx-clock.h header.

properties:
  compatible:
    enum:
      - samsung,s3c6400-clock
      - samsung,s3c6410-clock

  reg:
    maxItems: 1

  clocks:
    maxItems: 1

  "#clock-cells":
    const: 1

required:
  - compatible
  - reg
  - clocks
  - "#clock-cells"

additionalProperties: false

examples:
  - |
    clock-controller@7e00f000 {
        compatible = "samsung,s3c6410-clock";
        reg = <0x7e00f000 0x1000>;
        #clock-cells = <1>;
        clocks = <&fin_pll>;
    };
```

## Documentation/devicetree/bindings/clock/samsung,s3c64xx-clock.txt
```
* Samsung S3C64xx Clock Controller

The S3C64xx clock controller generates and supplies clock to various controllers
within the SoC. The clock binding described here is applicable to all SoCs in
the S3C64xx family.

Required Properties:

- compatible: should be one of the following.
  - "samsung,s3c6400-clock" - controller compatible with S3C6400 SoC.
  - "samsung,s3c6410-clock" - controller compatible with S3C6410 SoC.

- reg: physical base address of the controller and length of memory mapped
  region.

- #clock-cells: should be 1.

Each clock is assigned an identifier and client nodes can use this identifier
to specify the clock which they consume. Some of the clocks are available only
on a particular S3C64xx SoC and this is specified where applicable.

All available clocks are defined as preprocessor macros in
dt-bindings/clock/samsung,s3c64xx-clock.h header and can be used in device
tree sources.

External clocks:

There are several clocks that are generated outside the SoC. It is expected
that they are defined using standard clock bindings with following
clock-output-names:
 - "fin_pll" - PLL input clock (xtal/extclk) - required,
 - "xusbxti" - USB xtal - required,
 - "iiscdclk0" - I2S0 codec clock - optional,
 - "iiscdclk1" - I2S1 codec clock - optional,
 - "iiscdclk2" - I2S2 codec clock - optional,
 - "pcmcdclk0" - PCM0 codec clock - optional,
 - "pcmcdclk1" - PCM1 codec clock - optional, only S3C6410.

Example: Clock controller node:

	clock: clock-controller@7e00f000 {
		compatible = "samsung,s3c6410-clock";
		reg = <0x7e00f000 0x1000>;
		#clock-cells = <1>;
	};

Example: Required external clocks:

	fin_pll: clock-fin-pll {
		compatible = "fixed-clock";
		clock-output-names = "fin_pll";
		clock-frequency = <12000000>;
		#clock-cells = <0>;
	};

	xusbxti: clock-xusbxti {
		compatible = "fixed-clock";
		clock-output-names = "xusbxti";
		clock-frequency = <48000000>;
		#clock-cells = <0>;
	};

Example: UART controller node that consumes the clock generated by the clock
  controller (refer to the standard clock bindings for information about
  "clocks" and "clock-names" properties):

		uart0: serial@7f005000 {
			compatible = "samsung,s3c6400-uart";
			reg = <0x7f005000 0x100>;
			interrupt-parent = <&vic1>;
			interrupts = <5>;
			clock-names = "uart", "clk_uart_baud2",
					"clk_uart_baud3";
			clocks = <&clock PCLK_UART0>, <&clocks PCLK_UART0>,
					<&clock SCLK_UART>;
		};
```

## Documentation/devicetree/bindings/clock/samsung,s5pv210-audss-clock.yaml
```yaml
# SPDX-License-Identifier: (GPL-2.0-only OR BSD-2-Clause)
%YAML 1.2
---
$id: http://devicetree.org/schemas/clock/samsung,s5pv210-audss-clock.yaml#
$schema: http://devicetree.org/meta-schemas/core.yaml#

title: Samsung S5Pv210 SoC Audio SubSystem clock controller

maintainers:
  - Chanwoo Choi <cw00.choi@samsung.com>
  - Krzysztof Kozlowski <krzk@kernel.org>
  - Sylwester Nawrocki <s.nawrocki@samsung.com>
  - Tomasz Figa <tomasz.figa@gmail.com>

description: |
  All available clocks are defined as preprocessor macros in
  include/dt-bindings/clock/s5pv210-audss.h header.

properties:
  compatible:
    const: samsung,s5pv210-audss-clock

  clocks:
    minItems: 4
    items:
      - description:
          AHB bus clock of the Audio Subsystem.
      - description:
          Optional fixed rate PLL reference clock, parent of mout_audss. If not
          specified (i.e. xusbxti is used for PLL reference), it is fixed to a
          clock named "xxti".
      - description:
          Input PLL to the AudioSS block, parent of mout_audss.
      - description:
          Audio bus clock, parent of mout_i2s.
      - description:
          Optional external i2s clock, parent of mout_i2s. If not specified, it
          is fixed to a clock named "iiscdclk0".

  clock-names:
    minItems: 4
    items:
      - const: hclk
      - const: xxti
      - const: fout_epll
      - const: sclk_audio0
      - const: iiscdclk0

  "#clock-cells":
    const: 1

  power-domains:
    maxItems: 1

  reg:
    maxItems: 1

required:
  - compatible
  - clocks
  - clock-names
  - "#clock-cells"
  - reg

additionalProperties: false

examples:
  - |
    #include <dt-bindings/clock/s5pv210.h>

    clock-controller@c0900000 {
        compatible = "samsung,s5pv210-audss-clock";
        reg = <0xc0900000 0x1000>;
        #clock-cells = <1>;
        clock-names = "hclk", "xxti", "fout_epll", "sclk_audio0";
        clocks = <&clocks DOUT_HCLKP>, <&xxti>, <&clocks FOUT_EPLL>,
                 <&clocks SCLK_AUDIO0>;
    };
```

## Documentation/devicetree/bindings/clock/samsung,s5pv210-clock.txt
```
* Samsung S5P6442/S5PC110/S5PV210 Clock Controller

Samsung S5P6442, S5PC110 and S5PV210 SoCs contain integrated clock
controller, which generates and supplies clock to various controllers
within the SoC.

Required Properties:

- compatible: should be one of following:
	- "samsung,s5pv210-clock" : for clock controller of Samsung
	  S5PC110/S5PV210 SoCs,
	- "samsung,s5p6442-clock" : for clock controller of Samsung
	  S5P6442 SoC.

- reg: physical base address of the controller and length of memory mapped
  region.

- #clock-cells: should be 1.

All available clocks are defined as preprocessor macros in
dt-bindings/clock/s5pv210.h header and can be used in device tree sources.

External clocks:

There are several clocks that are generated outside the SoC. It is expected
that they are defined using standard clock bindings with following
clock-output-names:
 - "xxti": external crystal oscillator connected to XXTI and XXTO pins of
the SoC,
 - "xusbxti": external crystal oscillator connected to XUSBXTI and XUSBXTO
pins of the SoC,

A subset of above clocks available on given board shall be specified in
board device tree, including the system base clock, as selected by XOM[0]
pin of the SoC. Refer to generic fixed rate clock bindings
documentation[1] for more information how to specify these clocks.

[1] Documentation/devicetree/bindings/clock/fixed-clock.txt

Example: Clock controller node:

	clock: clock-controller@7e00f000 {
		compatible = "samsung,s5pv210-clock";
		reg = <0x7e00f000 0x1000>;
		#clock-cells = <1>;
	};

Example: Required external clocks:

	xxti: clock-xxti {
		compatible = "fixed-clock";
		clock-output-names = "xxti";
		clock-frequency = <24000000>;
		#clock-cells = <0>;
	};

	xusbxti: clock-xusbxti {
		compatible = "fixed-clock";
		clock-output-names = "xusbxti";
		clock-frequency = <24000000>;
		#clock-cells = <0>;
	};

Example: UART controller node that consumes the clock generated by the clock
  controller (refer to the standard clock bindings for information about
  "clocks" and "clock-names" properties):

	uart0: serial@e2900000 {
		compatible = "samsung,s5pv210-uart";
		reg = <0xe2900000 0x400>;
		interrupt-parent = <&vic1>;
		interrupts = <10>;
		clock-names = "uart", "clk_uart_baud0",
				"clk_uart_baud1";
		clocks = <&clocks UART0>, <&clocks UART0>,
				<&clocks SCLK_UART0>;
		status = "disabled";
	};
```

## Documentation/devicetree/bindings/clock/samsung,s5pv210-clock.yaml
```yaml
# SPDX-License-Identifier: (GPL-2.0-only OR BSD-2-Clause)
%YAML 1.2
---
$id: http://devicetree.org/schemas/clock/samsung,s5pv210-clock.yaml#
$schema: http://devicetree.org/meta-schemas/core.yaml#

title: Samsung S5P6442/S5PC110/S5PV210 SoC clock controller

maintainers:
  - Chanwoo Choi <cw00.choi@samsung.com>
  - Krzysztof Kozlowski <krzysztof.kozlowski@canonical.com>
  - Sylwester Nawrocki <s.nawrocki@samsung.com>
  - Tomasz Figa <tomasz.figa@gmail.com>

description: |
  Expected external clocks, defined in DTS as fixed-rate clocks with a matching
  name::
    - "xxti" - external crystal oscillator connected to XXTI and XXTO pins of
      the SoC,
    - "xusbxti" - external crystal oscillator connected to XUSBXTI and XUSBXTO
      pins of the SoC,

  All available clocks are defined as preprocessor macros in
  include/dt-bindings/clock/s5pv210.h header.

properties:
  compatible:
    enum:
      - samsung,s5pv210-clock
      - samsung,s5p6442-clock

  clocks:
    items:
      - description: xxti clock
      - description: xusbxti clock

  clock-names:
    items:
      - const: xxti
      - const: xusbxti

  "#clock-cells":
    const: 1

  reg:
    maxItems: 1

required:
  - compatible
  - "#clock-cells"
  - reg

additionalProperties: false

examples:
  - |
    #include <dt-bindings/clock/s5pv210.h>

    xxti: clock-0 {
        compatible = "fixed-clock";
        clock-frequency = <0>;
        clock-output-names = "xxti";
        #clock-cells = <0>;
    };

    xusbxti: clock-1 {
        compatible = "fixed-clock";
        clock-frequency = <0>;
        clock-output-names = "xusbxti";
        #clock-cells = <0>;
    };

    clock-controller@e0100000 {
        compatible = "samsung,s5pv210-clock";
        reg = <0xe0100000 0x10000>;
        clock-names = "xxti", "xusbxti";
        clocks = <&xxti>, <&xusbxti>;
        #clock-cells = <1>;
    };
```

## Documentation/devicetree/bindings/clock/sifive/fu540-prci.txt
```
SiFive FU540 PRCI bindings

On the FU540 family of SoCs, most system-wide clock and reset integration
is via the PRCI IP block.

Required properties:
- compatible: Should be "sifive,<chip>-prci".  Only one value is
	supported: "sifive,fu540-c000-prci"
- reg: Should describe the PRCI's register target physical address region
- clocks: Should point to the hfclk device tree node and the rtcclk
          device tree node.  The RTC clock here is not a time-of-day clock,
	  but is instead a high-stability clock source for system timers
	  and cycle counters.
- #clock-cells: Should be <1>

The clock consumer should specify the desired clock via the clock ID
macros defined in include/dt-bindings/clock/sifive-fu540-prci.h.
These macros begin with PRCI_CLK_.

The hfclk and rtcclk nodes are required, and represent physical
crystals or resonators located on the PCB.  These nodes should be present
underneath /, rather than /soc.

Examples:

/* under /, in PCB-specific DT data */
hfclk: hfclk {
	#clock-cells = <0>;
	compatible = "fixed-clock";
	clock-frequency = <33333333>;
	clock-output-names = "hfclk";
};
rtcclk: rtcclk {
	#clock-cells = <0>;
	compatible = "fixed-clock";
	clock-frequency = <1000000>;
	clock-output-names = "rtcclk";
};

/* under /soc, in SoC-specific DT data */
prci: clock-controller@10000000 {
	compatible = "sifive,fu540-c000-prci";
	reg = <0x0 0x10000000 0x0 0x1000>;
	clocks = <&hfclk>, <&rtcclk>;
	#clock-cells = <1>;
};
```

## Documentation/devicetree/bindings/clock/sifive/fu540-prci.yaml
```yaml
# SPDX-License-Identifier: (GPL-2.0-only OR BSD-2-Clause)
# Copyright (C) 2020 SiFive, Inc.
%YAML 1.2
---
$id: http://devicetree.org/schemas/clock/sifive/fu540-prci.yaml#
$schema: http://devicetree.org/meta-schemas/core.yaml#

title: SiFive FU540 Power Reset Clock Interrupt Controller (PRCI)

maintainers:
  - Paul Walmsley  <paul.walmsley@sifive.com>

description:
  On the FU540 family of SoCs, most system-wide clock and reset integration
  is via the PRCI IP block.
  The clock consumer should specify the desired clock via the clock ID
  macros defined in include/dt-bindings/clock/sifive-fu540-prci.h.
  These macros begin with PRCI_CLK_.

  The hfclk and rtcclk nodes are required, and represent physical
  crystals or resonators located on the PCB.  These nodes should be present
  underneath /, rather than /soc.

properties:
  compatible:
    const: sifive,fu540-c000-prci

  reg:
    maxItems: 1

  clocks:
    items:
      - description: high frequency clock.
      - description: RTL clock.

  clock-names:
    items:
      - const: hfclk
      - const: rtcclk

  "#clock-cells":
    const: 1

required:
  - compatible
  - reg
  - clocks
  - "#clock-cells"

additionalProperties: false

examples:
  - |
    prci: clock-controller@10000000 {
      compatible = "sifive,fu540-c000-prci";
      reg = <0x10000000 0x1000>;
      clocks = <&hfclk>, <&rtcclk>;
      #clock-cells = <1>;
    };
```

## Documentation/devicetree/bindings/clock/silabs,si514.txt
```
Binding for Silicon Labs 514 programmable I2C clock generator.

Reference
This binding uses the common clock binding[1]. Details about the device can be
found in the datasheet[2].

[1] Documentation/devicetree/bindings/clock/clock-bindings.txt
[2] Si514 datasheet
    https://www.silabs.com/Support%20Documents/TechnicalDocs/si514.pdf

Required properties:
 - compatible: Shall be "silabs,si514"
 - reg: I2C device address.
 - #clock-cells: From common clock bindings: Shall be 0.

Optional properties:
 - clock-output-names: From common clock bindings. Recommended to be "si514".

Example:
	si514: clock-generator@55 {
		reg = <0x55>;
		#clock-cells = <0>;
		compatible = "silabs,si514";
	};
```
