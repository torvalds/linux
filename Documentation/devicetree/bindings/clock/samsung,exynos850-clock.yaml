## Documentation/devicetree/bindings/clock/samsung,exynos850-clock.yaml
```yaml
# SPDX-License-Identifier: (GPL-2.0-only OR BSD-2-Clause)
%YAML 1.2
---
$id: http://devicetree.org/schemas/clock/samsung,exynos850-clock.yaml#
$schema: http://devicetree.org/meta-schemas/core.yaml#

title: Samsung Exynos850 SoC clock controller

maintainers:
  - Sam Protsenko <semen.protsenko@linaro.org>
  - Chanwoo Choi <cw00.choi@samsung.com>
  - Krzysztof Kozlowski <krzk@kernel.org>
  - Sylwester Nawrocki <s.nawrocki@samsung.com>
  - Tomasz Figa <tomasz.figa@gmail.com>

description: |
  Exynos850 clock controller is comprised of several CMU units, generating
  clocks for different domains. Those CMU units are modeled as separate device
  tree nodes, and might depend on each other. Root clocks in that clock tree are
  two external clocks:: OSCCLK (26 MHz) and RTCCLK (32768 Hz). Those external
  clocks must be defined as fixed-rate clocks in dts.

  CMU_TOP is a top-level CMU, where all base clocks are prepared using PLLs and
  dividers; all other leaf clocks (other CMUs) are usually derived from CMU_TOP.

  Each clock is assigned an identifier and client nodes can use this identifier
  to specify the clock which they consume. All clocks available for usage
  in clock consumer nodes are defined as preprocessor macros in
  'dt-bindings/clock/exynos850.h' header.

properties:
  compatible:
    enum:
      - samsung,exynos850-cmu-top
      - samsung,exynos850-cmu-apm
      - samsung,exynos850-cmu-cmgp
      - samsung,exynos850-cmu-core
      - samsung,exynos850-cmu-dpu
      - samsung,exynos850-cmu-hsi
      - samsung,exynos850-cmu-peri

  clocks:
    minItems: 1
    maxItems: 5

  clock-names:
    minItems: 1
    maxItems: 5

  "#clock-cells":
    const: 1

  reg:
    maxItems: 1

allOf:
  - if:
      properties:
        compatible:
          contains:
            const: samsung,exynos850-cmu-top

    then:
      properties:
        clocks:
          items:
            - description: External reference clock (26 MHz)

        clock-names:
          items:
            - const: oscclk

  - if:
      properties:
        compatible:
          contains:
            const: samsung,exynos850-cmu-apm

    then:
      properties:
        clocks:
          items:
            - description: External reference clock (26 MHz)
            - description: CMU_APM bus clock (from CMU_TOP)

        clock-names:
          items:
            - const: oscclk
            - const: dout_clkcmu_apm_bus

  - if:
      properties:
        compatible:
          contains:
            const: samsung,exynos850-cmu-cmgp

    then:
      properties:
        clocks:
          items:
            - description: External reference clock (26 MHz)
            - description: CMU_CMGP bus clock (from CMU_APM)

        clock-names:
          items:
            - const: oscclk
            - const: gout_clkcmu_cmgp_bus

  - if:
      properties:
        compatible:
          contains:
            const: samsung,exynos850-cmu-core

    then:
      properties:
        clocks:
          items:
            - description: External reference clock (26 MHz)
            - description: CMU_CORE bus clock (from CMU_TOP)
            - description: CCI clock (from CMU_TOP)
            - description: eMMC clock (from CMU_TOP)
            - description: SSS clock (from CMU_TOP)

        clock-names:
          items:
            - const: oscclk
            - const: dout_core_bus
            - const: dout_core_cci
            - const: dout_core_mmc_embd
            - const: dout_core_sss

  - if:
      properties:
        compatible:
          contains:
            const: samsung,exynos850-cmu-dpu

    then:
      properties:
        clocks:
          items:
            - description: External reference clock (26 MHz)
            - description: DPU clock (from CMU_TOP)

        clock-names:
          items:
            - const: oscclk
            - const: dout_dpu

  - if:
      properties:
        compatible:
          contains:
            const: samsung,exynos850-cmu-hsi

    then:
      properties:
        clocks:
          items:
            - description: External reference clock (26 MHz)
            - description: External RTC clock (32768 Hz)
            - description: CMU_HSI bus clock (from CMU_TOP)
            - description: SD card clock (from CMU_TOP)
            - description: "USB 2.0 DRD clock (from CMU_TOP)"

        clock-names:
          items:
            - const: oscclk
            - const: rtcclk
            - const: dout_hsi_bus
            - const: dout_hsi_mmc_card
            - const: dout_hsi_usb20drd

  - if:
      properties:
        compatible:
          contains:
            const: samsung,exynos850-cmu-peri

    then:
      properties:
        clocks:
          items:
            - description: External reference clock (26 MHz)
            - description: CMU_PERI bus clock (from CMU_TOP)
            - description: UART clock (from CMU_TOP)
            - description: Parent clock for HSI2C and SPI (from CMU_TOP)

        clock-names:
          items:
            - const: oscclk
            - const: dout_peri_bus
            - const: dout_peri_uart
            - const: dout_peri_ip

required:
  - compatible
  - "#clock-cells"
  - clocks
  - clock-names
  - reg

additionalProperties: false

examples:
  # Clock controller node for CMU_PERI
  - |
    #include <dt-bindings/clock/exynos850.h>

    cmu_peri: clock-controller@10030000 {
        compatible = "samsung,exynos850-cmu-peri";
        reg = <0x10030000 0x8000>;
        #clock-cells = <1>;

        clocks = <&oscclk>, <&cmu_top CLK_DOUT_PERI_BUS>,
                 <&cmu_top CLK_DOUT_PERI_UART>,
                 <&cmu_top CLK_DOUT_PERI_IP>;
        clock-names = "oscclk", "dout_peri_bus",
                      "dout_peri_uart", "dout_peri_ip";
    };

...
```

## Documentation/devicetree/bindings/clock/samsung,exynos8895-clock.yaml
```yaml
# SPDX-License-Identifier: (GPL-2.0-only OR BSD-2-Clause)
%YAML 1.2
---
$id: http://devicetree.org/schemas/clock/samsung,exynos8895-clock.yaml#
$schema: http://devicetree.org/meta-schemas/core.yaml#

title: Samsung Exynos8895 SoC clock controller

maintainers:
  - Ivaylo Ivanov <ivo.ivanov.ivanov1@gmail.com>
  - Chanwoo Choi <cw00.choi@samsung.com>
  - Krzysztof Kozlowski <krzk@kernel.org>

description: |
  Exynos8895 clock controller is comprised of several CMU units, generating
  clocks for different domains. Those CMU units are modeled as separate device
  tree nodes, and might depend on each other. The root clock in that root tree
  is an external clock: OSCCLK (26 MHz). This external clock must be defined
  as a fixed-rate clock in dts.

  CMU_TOP is a top-level CMU, where all base clocks are prepared using PLLs and
  dividers; all other clocks of function blocks (other CMUs) are usually
  derived from CMU_TOP.

  Each clock is assigned an identifier and client nodes can use this identifier
  to specify the clock which they consume. All clocks available for usage
  in clock consumer nodes are defined as preprocessor macros in
  'include/dt-bindings/clock/samsung,exynos8895.h' header.

properties:
  compatible:
    enum:
      - samsung,exynos8895-cmu-fsys0
      - samsung,exynos8895-cmu-fsys1
      - samsung,exynos8895-cmu-peric0
      - samsung,exynos8895-cmu-peric1
      - samsung,exynos8895-cmu-peris
      - samsung,exynos8895-cmu-top

  clocks:
    minItems: 1
    maxItems: 16

  clock-names:
    minItems: 1
    maxItems: 16

  "#clock-cells":
    const: 1

  reg:
    maxItems: 1

required:
  - compatible
  - clocks
  - clock-names
  - reg
  - "#clock-cells"

allOf:
  - if:
      properties:
        compatible:
          contains:
            const: samsung,exynos8895-cmu-fsys0

    then:
      properties:
        clocks:
          items:
            - description: External reference clock (26 MHz)
            - description: CMU_FSYS0 BUS clock (from CMU_TOP)
            - description: CMU_FSYS0 DPGTC clock (from CMU_TOP)
            - description: CMU_FSYS0 MMC_EMBD clock (from CMU_TOP)
            - description: CMU_FSYS0 UFS_EMBD clock (from CMU_TOP)
            - description: CMU_FSYS0 USBDRD30 clock (from CMU_TOP)

        clock-names:
          items:
            - const: oscclk
            - const: bus
            - const: dpgtc
            - const: mmc
            - const: ufs
            - const: usbdrd30

  - if:
      properties:
        compatible:
          contains:
            const: samsung,exynos8895-cmu-fsys1

    then:
      properties:
        clocks:
          items:
            - description: External reference clock (26 MHz)
            - description: CMU_FSYS1 BUS clock (from CMU_TOP)
            - description: CMU_FSYS1 PCIE clock (from CMU_TOP)
            - description: CMU_FSYS1 UFS_CARD clock (from CMU_TOP)
            - description: CMU_FSYS1 MMC_CARD clock (from CMU_TOP)

        clock-names:
          items:
            - const: oscclk
            - const: bus
            - const: pcie
            - const: ufs
            - const: mmc

  - if:
      properties:
        compatible:
          contains:
            const: samsung,exynos8895-cmu-peric0

    then:
      properties:
        clocks:
          items:
            - description: External reference clock (26 MHz)
            - description: CMU_PERIC0 BUS clock (from CMU_TOP)
            - description: CMU_PERIC0 UART_DBG clock (from CMU_TOP)
            - description: CMU_PERIC0 USI00 clock (from CMU_TOP)
            - description: CMU_PERIC0 USI01 clock (from CMU_TOP)
            - description: CMU_PERIC0 USI02 clock (from CMU_TOP)
            - description: CMU_PERIC0 USI03 clock (from CMU_TOP)

        clock-names:
          items:
            - const: oscclk
            - const: bus
            - const: uart
            - const: usi0
            - const: usi1
            - const: usi2
            - const: usi3

  - if:
      properties:
        compatible:
          contains:
            const: samsung,exynos8895-cmu-peric1

    then:
      properties:
        clocks:
          items:
            - description: External reference clock (26 MHz)
            - description: CMU_PERIC1 BUS clock (from CMU_TOP)
            - description: CMU_PERIC1 SPEEDY2 clock (from CMU_TOP)
            - description: CMU_PERIC1 SPI_CAM0 clock (from CMU_TOP)
            - description: CMU_PERIC1 SPI_CAM1 clock (from CMU_TOP)
            - description: CMU_PERIC1 UART_BT clock (from CMU_TOP)
            - description: CMU_PERIC1 USI04 clock (from CMU_TOP)
            - description: CMU_PERIC1 USI05 clock (from CMU_TOP)
            - description: CMU_PERIC1 USI06 clock (from CMU_TOP)
            - description: CMU_PERIC1 USI07 clock (from CMU_TOP)
            - description: CMU_PERIC1 USI08 clock (from CMU_TOP)
            - description: CMU_PERIC1 USI09 clock (from CMU_TOP)
            - description: CMU_PERIC1 USI10 clock (from CMU_TOP)
            - description: CMU_PERIC1 USI11 clock (from CMU_TOP)
            - description: CMU_PERIC1 USI12 clock (from CMU_TOP)
            - description: CMU_PERIC1 USI13 clock (from CMU_TOP)

        clock-names:
          items:
            - const: oscclk
            - const: bus
            - const: speedy
            - const: cam0
            - const: cam1
            - const: uart
            - const: usi4
            - const: usi5
            - const: usi6
            - const: usi7
            - const: usi8
            - const: usi9
            - const: usi10
            - const: usi11
            - const: usi12
            - const: usi13

  - if:
      properties:
        compatible:
          contains:
            const: samsung,exynos8895-cmu-peris

    then:
      properties:
        clocks:
          items:
            - description: External reference clock (26 MHz)
            - description: CMU_PERIS BUS clock (from CMU_TOP)

        clock-names:
          items:
            - const: oscclk
            - const: bus

  - if:
      properties:
        compatible:
          contains:
            const: samsung,exynos8895-cmu-top

    then:
      properties:
        clocks:
          items:
            - description: External reference clock (26 MHz)

        clock-names:
          items:
            - const: oscclk

additionalProperties: false

examples:
  - |
    #include <dt-bindings/clock/samsung,exynos8895.h>

    cmu_fsys1: clock-controller@11400000 {
        compatible = "samsung,exynos8895-cmu-fsys1";
        reg = <0x11400000 0x8000>;
        #clock-cells = <1>;

        clocks = <&oscclk>,
                 <&cmu_top CLK_DOUT_CMU_FSYS1_BUS>,
                 <&cmu_top CLK_DOUT_CMU_FSYS1_PCIE>,
                 <&cmu_top CLK_DOUT_CMU_FSYS1_UFS_CARD>,
                 <&cmu_top CLK_DOUT_CMU_FSYS1_MMC_CARD>;
        clock-names = "oscclk", "bus", "pcie", "ufs", "mmc";
    };

...
```
