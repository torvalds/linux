## Documentation/devicetree/bindings/clock/silabs,si5341.txt
```
Binding for Silicon Labs Si5340, Si5341 Si5342, Si5344 and Si5345 programmable
i2c clock generator.

Reference
[1] Si5341 Data Sheet
    https://www.silabs.com/documents/public/data-sheets/Si5341-40-D-DataSheet.pdf
[2] Si5341 Reference Manual
    https://www.silabs.com/documents/public/reference-manuals/Si5341-40-D-RM.pdf
[3] Si5345 Reference Manual
    https://www.silabs.com/documents/public/reference-manuals/Si5345-44-42-D-RM.pdf

The Si5341 and Si5340 are programmable i2c clock generators with up to 10 output
clocks. The chip contains a PLL that sources 5 (or 4) multisynth clocks, which
in turn can be directed to any of the 10 (or 4) outputs through a divider.
The internal structure of the clock generators can be found in [2].
The Si5345 is similar to the Si5341 with the addition of fractional input
dividers and automatic input selection, as described in [3].
The Si5342 and Si5344 are smaller versions of the Si5345, with 2 or 4 outputs.

The driver can be used in "as is" mode, reading the current settings from the
chip at boot, in case you have a (pre-)programmed device. If the PLL is not
configured when the driver probes, it assumes the driver must fully initialize
it.

The device type, speed grade and revision are determined runtime by probing.

The driver currently does not support any fancy input configurations. They can
still be programmed into the chip and the driver will leave them "as is".

==I2C device node==

Required properties:
- compatible: shall be one of the following:
	"silabs,si5340" - Si5340 A/B/C/D
	"silabs,si5341" - Si5341 A/B/C/D
	"silabs,si5342" - Si5342 A/B/C/D
	"silabs,si5344" - Si5344 A/B/C/D
	"silabs,si5345" - Si5345 A/B/C/D
- reg: i2c device address, usually 0x74
- #clock-cells: from common clock binding; shall be set to 2.
	The first value is "0" for outputs, "1" for synthesizers.
	The second value is the output or synthesizer index.
- clocks: from common clock binding; list of parent clock  handles,
	corresponding to inputs. Use a fixed clock for the "xtal" input.
	At least one must be present.
- clock-names: One of: "xtal", "in0", "in1", "in2"

Optional properties:
- vdd-supply: Regulator node for VDD
- vdda-supply: Regulator node for VDDA
- vdds-supply: Regulator node for VDDS
- silabs,pll-m-num, silabs,pll-m-den: Numerator and denominator for PLL
  feedback divider. Must be such that the PLL output is in the valid range. For
  example, to create 14GHz from a 48MHz xtal, use m-num=14000 and m-den=48. Only
  the fraction matters, using 3500 and 12 will deliver the exact same result.
  If these are not specified, and the PLL is not yet programmed when the driver
  probes, the PLL will be set to 14GHz.
- silabs,reprogram: When present, the driver will always assume the device must
  be initialized, and always performs the soft-reset routine. Since this will
  temporarily stop all output clocks, don't do this if the chip is generating
  the CPU clock for example.
- silabs,xaxb-ext-clk: When present, indicates that the XA/XB pins are used
  in EXTCLK (external reference clock) rather than XTAL (crystal) mode.
- interrupts: Interrupt for INTRb pin.
- silabs,iovdd-33: When present, indicates that the I2C lines are using 3.3V
  rather than 1.8V thresholds.
- vddoX-supply (where X is an output index): Regulator node for VDDO for the
  specified output. The driver selects the output VDD_SEL setting based on this
  voltage.
- #address-cells: shall be set to 1.
- #size-cells: shall be set to 0.


== Child nodes: Outputs ==

The child nodes list the output clocks.

Each of the clock outputs can be overwritten individually by using a child node.
If a child node for a clock output is not set, the configuration remains
unchanged.

Required child node properties:
- reg: number of clock output.

Optional child node properties:
- silabs,format: Output format, one of:
	1 = differential (defaults to LVDS levels)
	2 = low-power (defaults to HCSL levels)
	4 = LVCMOS
- silabs,common-mode: Manually override output common mode, see [2] for values
- silabs,amplitude: Manually override output amplitude, see [2] for values
- silabs,synth-master: boolean. If present, this output is allowed to change the
	multisynth frequency dynamically.
- silabs,silabs,disable-high: boolean. If set, the clock output is driven HIGH
	when disabled, otherwise it's driven LOW.

==Example==

/* 48MHz reference crystal */
ref48: ref48M {
	compatible = "fixed-clock";
	#clock-cells = <0>;
	clock-frequency = <48000000>;
};

i2c-master-node {
	/* Programmable clock (for logic) */
	si5341: clock-generator@74 {
		reg = <0x74>;
		compatible = "silabs,si5341";
		#clock-cells = <2>;
		#address-cells = <1>;
		#size-cells = <0>;
		clocks = <&ref48>;
		clock-names = "xtal";

		silabs,pll-m-num = <14000>; /* PLL at 14.0 GHz */
		silabs,pll-m-den = <48>;
		silabs,reprogram; /* Chips are not programmed, always reset */

		out@0 {
			reg = <0>;
			silabs,format = <1>; /* LVDS 3v3 */
			silabs,common-mode = <3>;
			silabs,amplitude = <3>;
			silabs,synth-master;
		};

		/*
		 * Output 6 configuration:
		 *  LVDS 1v8
		 */
		out@6 {
			reg = <6>;
			silabs,format = <1>; /* LVDS 1v8 */
			silabs,common-mode = <13>;
			silabs,amplitude = <3>;
		};

		/*
		 * Output 8 configuration:
		 *  HCSL 3v3
		 */
		out@8 {
			reg = <8>;
			silabs,format = <2>;
			silabs,common-mode = <11>;
			silabs,amplitude = <3>;
		};
	};
};

some-video-node {
	/* Standard clock bindings */
	clock-names = "pixel";
	clocks = <&si5341 0 7>; /* Output 7 */

	/* Set output 7 to use syntesizer 3 as its parent */
	assigned-clocks = <&si5341 0 7>, <&si5341 1 3>;
	assigned-clock-parents = <&si5341 1 3>;
	/* Set output 7 to 148.5 MHz using a synth frequency of 594 MHz */
	assigned-clock-rates = <148500000>, <594000000>;
};

some-audio-node {
	clock-names = "i2s-clk";
	clocks = <&si5341 0 0>;
	/*
	 * since output 0 is a synth-master, the synth will be automatically set
	 * to an appropriate frequency when the audio driver requests another
	 * frequency. We give control over synth 2 to this output here.
	 */
	assigned-clocks = <&si5341 0 0>;
	assigned-clock-parents = <&si5341 1 2>;
};
```

## Documentation/devicetree/bindings/clock/silabs,si5341.yaml
```yaml
# SPDX-License-Identifier: (GPL-2.0-only OR BSD-2-Clause)
%YAML 1.2
---
$id: http://devicetree.org/schemas/silabs,si5341.yaml#
$schema: http://devicetree.org/meta-schemas/core.yaml#

title: Silicon Labs Si5340/1/2/4/5 programmable i2c clock generator

maintainers:
  - Mike Looijmans <mike.looijmans@topic.nl>

description: >
  Silicon Labs Si5340, Si5341 Si5342, Si5344 and Si5345 programmable i2c clock
  generator.

  Reference
  [1] Si5341 Data Sheet
      https://www.silabs.com/documents/public/data-sheets/Si5341-40-D-DataSheet.pdf
  [2] Si5341 Reference Manual
      https://www.silabs.com/documents/public/reference-manuals/Si5341-40-D-RM.pdf
  [3] Si5345 Reference Manual
      https://www.silabs.com/documents/public/reference-manuals/Si5345-44-42-D-RM.pdf

  The Si5341 and Si5340 are programmable i2c clock generators with up to 10 output
  clocks. The chip contains a PLL that sources 5 (or 4) multisynth clocks, which
  in turn can be directed to any of the 10 (or 4) outputs through a divider.
  The internal structure of the clock generators can be found in [2].
  The Si5345 is similar to the Si5341 with the addition of fractional input
  dividers and automatic input selection, as described in [3].
  The Si5342 and Si5344 are smaller versions of the Si5345, with 2 or 4 outputs.

  The driver can be used in "as is" mode, reading the current settings from the
  chip at boot, in case you have a (pre-)programmed device. If the PLL is not
  configured when the driver probes, it assumes the driver must fully initialize
  it.

  The device type, speed grade and revision are determined runtime by probing.

properties:
  compatible:
    enum:
      - silabs,si5340
      - silabs,si5341
      - silabs,si5342
      - silabs,si5344
      - silabs,si5345

  reg:
    maxItems: 1

  "#clock-cells":
    const: 2
    description: >
      The first value is "0" for outputs, "1" for synthesizers.

      The second value is the output or synthesizer index.

  "#address-cells":
    const: 1

  "#size-cells":
    const: 0

  clocks:
    minItems: 1
    maxItems: 4

  clock-names:
    minItems: 1
    items:
      - const: xtal
      - const: in0
      - const: in1
      - const: in2

  clock-output-names: true

  interrupts:
    maxItems: 1
    description: Interrupt for INTRb pin

  vdd-supply:
    description: Regulator node for VDD

  vdda-supply:
    description: Regulator node for VDDA

  vdds-supply:
    description: Regulator node for VDDS

  silabs,pll-m-num:
    description:
      Numerator for PLL feedback divider. Must be such that the PLL output is in
      the valid range. For example, to create 14GHz from a 48MHz xtal, use
      m-num=14000 and m-den=48. Only the fraction matters, using 3500 and 12
      will deliver the exact same result. If these are not specified, and the
      PLL is not yet programmed when the driver probes, the PLL will be set to
      14GHz.
    $ref: /schemas/types.yaml#/definitions/uint32

  silabs,pll-m-den:
    description: Denominator for PLL feedback divider
    $ref: /schemas/types.yaml#/definitions/uint32

  silabs,reprogram:
    description: Always perform soft-reset and reinitialize PLL
    type: boolean

  silabs,xaxb-ext-clk:
    description: Use XA/XB pins as external reference clock
    type: boolean

  silabs,iovdd-33:
    description: I2C lines use 3.3V thresholds
    type: boolean

patternProperties:
  "^vddo[0-9]-supply$": true

  "^out@[0-9]$":
    description: >
      Output-specific override nodes

      Each of the clock outputs can be overwritten individually by using a child
      node. If a child node for a clock output is not set, the configuration
      remains unchanged.
    type: object
    additionalProperties: false

    properties:
      reg:
        description: Number of clock output
        maximum: 9

      always-on:
        description: Set to keep the clock output always running
        type: boolean

      silabs,format:
        description: Output format
        $ref: /schemas/types.yaml#/definitions/uint32
        enum: [1, 2, 4]

      silabs,common-mode:
        description: Override output common mode
        $ref: /schemas/types.yaml#/definitions/uint32

      silabs,amplitude:
        description: Override output amplitude
        $ref: /schemas/types.yaml#/definitions/uint32

      silabs,synth-master:
        description: Allow dynamic multisynth rate control
        type: boolean

      silabs,disable-high:
        description: Drive output HIGH when disabled
        type: boolean

    required:
      - reg

required:
  - compatible
  - reg
  - "#clock-cells"
  - "#address-cells"
  - "#size-cells"
  - clocks
  - clock-names

additionalProperties: false

examples:
  - |
    i2c {
        #address-cells = <1>;
        #size-cells = <0>;

        clock-generator@74 {
            reg = <0x74>;
            compatible = "silabs,si5341";
            #clock-cells = <2>;
            #address-cells = <1>;
            #size-cells = <0>;
            clocks = <&ref48>;
            clock-names = "xtal";

            silabs,pll-m-num = <14000>; /* PLL at 14.0 GHz */
            silabs,pll-m-den = <48>;
            silabs,reprogram; /* Chips are not programmed, always reset */

            out@0 {
                reg = <0>;
                silabs,format = <1>; /* LVDS 3v3 */
                silabs,common-mode = <3>;
                silabs,amplitude = <3>;
                silabs,synth-master;
            };

            /*
              * Output 6 configuration:
              *  LVDS 1v8
              */
            out@6 {
                reg = <6>;
                silabs,format = <1>; /* LVDS 1v8 */
                silabs,common-mode = <13>;
                silabs,amplitude = <3>;
            };

            /*
              * Output 8 configuration:
              *  HCSL 3v3
              */
            out@8 {
                reg = <8>;
                silabs,format = <2>;
                silabs,common-mode = <11>;
                silabs,amplitude = <3>;
            };
        };
    };
```

## Documentation/devicetree/bindings/clock/silabs,si5351.txt
```
Binding for Silicon Labs Si5351a/b/c programmable i2c clock generator.

Reference
[1] Si5351A/B/C Data Sheet
    http://www.silabs.com/Support%20Documents/TechnicalDocs/Si5351.pdf

The Si5351a/b/c are programmable i2c clock generators with up to 8 output
clocks. Si5351a also has a reduced pin-count package (MSOP10) where only
3 output clocks are accessible. The internal structure of the clock
generators can be found in [1].

==I2C device node==

Required properties:
- compatible: shall be one of "silabs,si5351{a,a-msop,b,c}".
- reg: i2c device address, shall be 0x60 or 0x61.
- #clock-cells: from common clock binding; shall be set to 1.
- clocks: from common clock binding; list of parent clock
  handles, shall be xtal reference clock or xtal and clkin for
  si5351c only.
- #address-cells: shall be set to 1.
- #size-cells: shall be set to 0.

Optional properties:
- silabs,pll-source: pair of (number, source) for each pll. Allows
  to overwrite clock source of pll A (number=0) or B (number=1).

==Child nodes==

Each of the clock outputs can be overwritten individually by
using a child node to the I2C device node. If a child node for a clock
output is not set, the eeprom configuration is not overwritten.

Required child node properties:
- reg: number of clock output.

Optional child node properties:
- silabs,clock-source: source clock of the output divider stage N, shall be
  0 = multisynth N
  1 = multisynth 0 for output clocks 0-3, else multisynth4
  2 = xtal
  3 = clkin (si5351c only)
- silabs,drive-strength: output drive strength in mA, shall be one of {2,4,6,8}.
- silabs,multisynth-source: source pll A(0) or B(1) of corresponding multisynth
  divider.
- silabs,pll-master: boolean, multisynth can change pll frequency.
- silabs,disable-state : clock output disable state, shall be
  0 = clock output is driven LOW when disabled
  1 = clock output is driven HIGH when disabled
  2 = clock output is FLOATING (HIGH-Z) when disabled
  3 = clock output is NEVER disabled

==Example==

/* 25MHz reference crystal */
ref25: ref25M {
	compatible = "fixed-clock";
	#clock-cells = <0>;
	clock-frequency = <25000000>;
};

i2c-master-node {

	/* Si5351a msop10 i2c clock generator */
	si5351a: clock-generator@60 {
		compatible = "silabs,si5351a-msop";
		reg = <0x60>;
		#address-cells = <1>;
		#size-cells = <0>;
		#clock-cells = <1>;

		/* connect xtal input to 25MHz reference */
		clocks = <&ref25>;

		/* connect xtal input as source of pll0 and pll1 */
		silabs,pll-source = <0 0>, <1 0>;

		/*
		 * overwrite clkout0 configuration with:
		 * - 8mA output drive strength
		 * - pll0 as clock source of multisynth0
		 * - multisynth0 as clock source of output divider
		 * - multisynth0 can change pll0
		 * - set initial clock frequency of 74.25MHz
		 */
		clkout0 {
			reg = <0>;
			silabs,drive-strength = <8>;
			silabs,multisynth-source = <0>;
			silabs,clock-source = <0>;
			silabs,pll-master;
			clock-frequency = <74250000>;
		};

		/*
		 * overwrite clkout1 configuration with:
		 * - 4mA output drive strength
		 * - pll1 as clock source of multisynth1
		 * - multisynth1 as clock source of output divider
		 * - multisynth1 can change pll1
		 */
		clkout1 {
			reg = <1>;
			silabs,drive-strength = <4>;
			silabs,multisynth-source = <1>;
			silabs,clock-source = <0>;
			pll-master;
		};

		/*
		 * overwrite clkout2 configuration with:
		 * - xtal as clock source of output divider
		 */
		clkout2 {
			reg = <2>;
			silabs,clock-source = <2>;
		};
	};
};
```
