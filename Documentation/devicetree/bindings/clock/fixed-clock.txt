## Documentation/devicetree/bindings/clock/fsl,imx8-acm.yaml
```yaml
# SPDX-License-Identifier: (GPL-2.0-only OR BSD-2-Clause)
%YAML 1.2
---
$id: http://devicetree.org/schemas/clock/fsl,imx8-acm.yaml#
$schema: http://devicetree.org/meta-schemas/core.yaml#

title: NXP i.MX8 Audio Clock Mux

maintainers:
  - Shengjiu Wang <shengjiu.wang@nxp.com>

description: |
  NXP i.MX8 Audio Clock Mux is dedicated clock muxing IP
  used to control Audio related clock on the SoC.

properties:
  compatible:
    enum:
      - fsl,imx8dxl-acm
      - fsl,imx8qm-acm
      - fsl,imx8qxp-acm

  reg:
    maxItems: 1

  power-domains:
    minItems: 13
    maxItems: 21

  '#clock-cells':
    const: 1
    description:
      The clock consumer should specify the desired clock by having the clock
      ID in its "clocks" phandle cell. See include/dt-bindings/clock/imx8-clock.h
      for the full list of i.MX8 ACM clock IDs.

  clocks:
    minItems: 13
    maxItems: 27

  clock-names:
    minItems: 13
    maxItems: 27

required:
  - compatible
  - reg
  - power-domains
  - '#clock-cells'
  - clocks
  - clock-names

allOf:
  - if:
      properties:
        compatible:
          contains:
            enum:
              - fsl,imx8qxp-acm
    then:
      properties:
        power-domains:
          items:
            - description: power domain of IMX_SC_R_AUDIO_CLK_0
            - description: power domain of IMX_SC_R_AUDIO_CLK_1
            - description: power domain of IMX_SC_R_MCLK_OUT_0
            - description: power domain of IMX_SC_R_MCLK_OUT_1
            - description: power domain of IMX_SC_R_AUDIO_PLL_0
            - description: power domain of IMX_SC_R_AUDIO_PLL_1
            - description: power domain of IMX_SC_R_ASRC_0
            - description: power domain of IMX_SC_R_ASRC_1
            - description: power domain of IMX_SC_R_ESAI_0
            - description: power domain of IMX_SC_R_SAI_0
            - description: power domain of IMX_SC_R_SAI_1
            - description: power domain of IMX_SC_R_SAI_2
            - description: power domain of IMX_SC_R_SAI_3
            - description: power domain of IMX_SC_R_SAI_4
            - description: power domain of IMX_SC_R_SAI_5
            - description: power domain of IMX_SC_R_SPDIF_0
            - description: power domain of IMX_SC_R_MQS_0

        clocks:
          minItems: 18
          maxItems: 18

        clock-names:
          items:
            - const: aud_rec_clk0_lpcg_clk
            - const: aud_rec_clk1_lpcg_clk
            - const: aud_pll_div_clk0_lpcg_clk
            - const: aud_pll_div_clk1_lpcg_clk
            - const: ext_aud_mclk0
            - const: ext_aud_mclk1
            - const: esai0_rx_clk
            - const: esai0_rx_hf_clk
            - const: esai0_tx_clk
            - const: esai0_tx_hf_clk
            - const: spdif0_rx
            - const: sai0_rx_bclk
            - const: sai0_tx_bclk
            - const: sai1_rx_bclk
            - const: sai1_tx_bclk
            - const: sai2_rx_bclk
            - const: sai3_rx_bclk
            - const: sai4_rx_bclk

  - if:
      properties:
        compatible:
          contains:
            enum:
              - fsl,imx8qm-acm
    then:
      properties:
        power-domains:
          items:
            - description: power domain of IMX_SC_R_AUDIO_CLK_0
            - description: power domain of IMX_SC_R_AUDIO_CLK_1
            - description: power domain of IMX_SC_R_MCLK_OUT_0
            - description: power domain of IMX_SC_R_MCLK_OUT_1
            - description: power domain of IMX_SC_R_AUDIO_PLL_0
            - description: power domain of IMX_SC_R_AUDIO_PLL_1
            - description: power domain of IMX_SC_R_ASRC_0
            - description: power domain of IMX_SC_R_ASRC_1
            - description: power domain of IMX_SC_R_ESAI_0
            - description: power domain of IMX_SC_R_ESAI_1
            - description: power domain of IMX_SC_R_SAI_0
            - description: power domain of IMX_SC_R_SAI_1
            - description: power domain of IMX_SC_R_SAI_2
            - description: power domain of IMX_SC_R_SAI_3
            - description: power domain of IMX_SC_R_SAI_4
            - description: power domain of IMX_SC_R_SAI_5
            - description: power domain of IMX_SC_R_SAI_6
            - description: power domain of IMX_SC_R_SAI_7
            - description: power domain of IMX_SC_R_SPDIF_0
            - description: power domain of IMX_SC_R_SPDIF_1
            - description: power domain of IMX_SC_R_MQS_0

        clocks:
          minItems: 27
          maxItems: 27

        clock-names:
          items:
            - const: aud_rec_clk0_lpcg_clk
            - const: aud_rec_clk1_lpcg_clk
            - const: aud_pll_div_clk0_lpcg_clk
            - const: aud_pll_div_clk1_lpcg_clk
            - const: mlb_clk
            - const: hdmi_rx_mclk
            - const: ext_aud_mclk0
            - const: ext_aud_mclk1
            - const: esai0_rx_clk
            - const: esai0_rx_hf_clk
            - const: esai0_tx_clk
            - const: esai0_tx_hf_clk
            - const: esai1_rx_clk
            - const: esai1_rx_hf_clk
            - const: esai1_tx_clk
            - const: esai1_tx_hf_clk
            - const: spdif0_rx
            - const: spdif1_rx
            - const: sai0_rx_bclk
            - const: sai0_tx_bclk
            - const: sai1_rx_bclk
            - const: sai1_tx_bclk
            - const: sai2_rx_bclk
            - const: sai3_rx_bclk
            - const: sai4_rx_bclk
            - const: sai5_tx_bclk
            - const: sai6_rx_bclk

  - if:
      properties:
        compatible:
          contains:
            enum:
              - fsl,imx8dxl-acm
    then:
      properties:
        power-domains:
          items:
            - description: power domain of IMX_SC_R_AUDIO_CLK_0
            - description: power domain of IMX_SC_R_AUDIO_CLK_1
            - description: power domain of IMX_SC_R_MCLK_OUT_0
            - description: power domain of IMX_SC_R_MCLK_OUT_1
            - description: power domain of IMX_SC_R_AUDIO_PLL_0
            - description: power domain of IMX_SC_R_AUDIO_PLL_1
            - description: power domain of IMX_SC_R_ASRC_0
            - description: power domain of IMX_SC_R_SAI_0
            - description: power domain of IMX_SC_R_SAI_1
            - description: power domain of IMX_SC_R_SAI_2
            - description: power domain of IMX_SC_R_SAI_3
            - description: power domain of IMX_SC_R_SPDIF_0
            - description: power domain of IMX_SC_R_MQS_0

        clocks:
          minItems: 13
          maxItems: 13

        clock-names:
          items:
            - const: aud_rec_clk0_lpcg_clk
            - const: aud_rec_clk1_lpcg_clk
            - const: aud_pll_div_clk0_lpcg_clk
            - const: aud_pll_div_clk1_lpcg_clk
            - const: ext_aud_mclk0
            - const: ext_aud_mclk1
            - const: spdif0_rx
            - const: sai0_rx_bclk
            - const: sai0_tx_bclk
            - const: sai1_rx_bclk
            - const: sai1_tx_bclk
            - const: sai2_rx_bclk
            - const: sai3_rx_bclk

additionalProperties: false

examples:
  # Clock Control Module node:
  - |
    #include <dt-bindings/clock/imx8-lpcg.h>
    #include <dt-bindings/firmware/imx/rsrc.h>

    clock-controller@59e00000 {
        compatible = "fsl,imx8qxp-acm";
        reg = <0x59e00000 0x1d0000>;
        #clock-cells = <1>;
        power-domains = <&pd IMX_SC_R_AUDIO_CLK_0>,
                        <&pd IMX_SC_R_AUDIO_CLK_1>,
                        <&pd IMX_SC_R_MCLK_OUT_0>,
                        <&pd IMX_SC_R_MCLK_OUT_1>,
                        <&pd IMX_SC_R_AUDIO_PLL_0>,
                        <&pd IMX_SC_R_AUDIO_PLL_1>,
                        <&pd IMX_SC_R_ASRC_0>,
                        <&pd IMX_SC_R_ASRC_1>,
                        <&pd IMX_SC_R_ESAI_0>,
                        <&pd IMX_SC_R_SAI_0>,
                        <&pd IMX_SC_R_SAI_1>,
                        <&pd IMX_SC_R_SAI_2>,
                        <&pd IMX_SC_R_SAI_3>,
                        <&pd IMX_SC_R_SAI_4>,
                        <&pd IMX_SC_R_SAI_5>,
                        <&pd IMX_SC_R_SPDIF_0>,
                        <&pd IMX_SC_R_MQS_0>;
        clocks = <&aud_rec0_lpcg IMX_LPCG_CLK_0>,
                 <&aud_rec1_lpcg IMX_LPCG_CLK_0>,
                 <&aud_pll_div0_lpcg IMX_LPCG_CLK_0>,
                 <&aud_pll_div1_lpcg IMX_LPCG_CLK_0>,
                 <&clk_ext_aud_mclk0>,
                 <&clk_ext_aud_mclk1>,
                 <&clk_esai0_rx_clk>,
                 <&clk_esai0_rx_hf_clk>,
                 <&clk_esai0_tx_clk>,
                 <&clk_esai0_tx_hf_clk>,
                 <&clk_spdif0_rx>,
                 <&clk_sai0_rx_bclk>,
                 <&clk_sai0_tx_bclk>,
                 <&clk_sai1_rx_bclk>,
                 <&clk_sai1_tx_bclk>,
                 <&clk_sai2_rx_bclk>,
                 <&clk_sai3_rx_bclk>,
                 <&clk_sai4_rx_bclk>;
        clock-names = "aud_rec_clk0_lpcg_clk",
                      "aud_rec_clk1_lpcg_clk",
                      "aud_pll_div_clk0_lpcg_clk",
                      "aud_pll_div_clk1_lpcg_clk",
                      "ext_aud_mclk0",
                      "ext_aud_mclk1",
                      "esai0_rx_clk",
                      "esai0_rx_hf_clk",
                      "esai0_tx_clk",
                      "esai0_tx_hf_clk",
                      "spdif0_rx",
                      "sai0_rx_bclk",
                      "sai0_tx_bclk",
                      "sai1_rx_bclk",
                      "sai1_tx_bclk",
                      "sai2_rx_bclk",
                      "sai3_rx_bclk",
                      "sai4_rx_bclk";
    };
```

## Documentation/devicetree/bindings/clock/fsl,imx8m-anatop.yaml
```yaml
# SPDX-License-Identifier: (GPL-2.0-only OR BSD-2-Clause)
%YAML 1.2
---
$id: http://devicetree.org/schemas/clock/fsl,imx8m-anatop.yaml#
$schema: http://devicetree.org/meta-schemas/core.yaml#

title: NXP i.MX8M Family Anatop Module

maintainers:
  - Peng Fan <peng.fan@nxp.com>

description: |
  NXP i.MX8M Family anatop PLL module which generates PLL to CCM root.

properties:
  compatible:
    oneOf:
      - enum:
          - fsl,imx8mm-anatop
          - fsl,imx8mq-anatop
      - items:
          - enum:
              - fsl,imx8mn-anatop
              - fsl,imx8mp-anatop
          - const: fsl,imx8mm-anatop

  reg:
    maxItems: 1

  interrupts:
    maxItems: 1

  '#clock-cells':
    const: 1

required:
  - compatible
  - reg
  - '#clock-cells'

additionalProperties: false

examples:
  - |
    anatop: clock-controller@30360000 {
        compatible = "fsl,imx8mn-anatop", "fsl,imx8mm-anatop";
        reg = <0x30360000 0x10000>;
        #clock-cells = <1>;
    };

...
```

## Documentation/devicetree/bindings/clock/fsl,imx8ulp-sim-lpav.yaml
```yaml
# SPDX-License-Identifier: (GPL-2.0-only OR BSD-2-Clause)
%YAML 1.2
---
$id: http://devicetree.org/schemas/clock/fsl,imx8ulp-sim-lpav.yaml#
$schema: http://devicetree.org/meta-schemas/core.yaml#

title: NXP i.MX8ULP LPAV System Integration Module (SIM)

maintainers:
  - Laurentiu Mihalcea <laurentiu.mihalcea@nxp.com>

description:
  The i.MX8ULP LPAV subsystem contains a block control module known as
  SIM LPAV, which offers functionalities such as clock gating or reset
  line assertion/de-assertion.

properties:
  compatible:
    const: fsl,imx8ulp-sim-lpav

  reg:
    maxItems: 1

  clocks:
    maxItems: 3

  clock-names:
    items:
      - const: bus
      - const: core
      - const: plat

  '#clock-cells':
    const: 1

  '#reset-cells':
    const: 1

  mux-controller:
    $ref: /schemas/mux/reg-mux.yaml#

required:
  - compatible
  - reg
  - clocks
  - clock-names
  - '#clock-cells'
  - '#reset-cells'
  - mux-controller

additionalProperties: false

examples:
  - |
    #include <dt-bindings/clock/imx8ulp-clock.h>

    clock-controller@2da50000 {
        compatible = "fsl,imx8ulp-sim-lpav";
        reg = <0x2da50000 0x10000>;
        clocks = <&cgc2 IMX8ULP_CLK_LPAV_BUS_DIV>,
                 <&cgc2 IMX8ULP_CLK_HIFI_DIVCORE>,
                 <&cgc2 IMX8ULP_CLK_HIFI_DIVPLAT>;
        clock-names = "bus", "core", "plat";
        #clock-cells = <1>;
        #reset-cells = <1>;

        mux-controller {
            compatible = "reg-mux";
            #mux-control-cells = <1>;
            mux-reg-masks = <0x8 0x00000200>;
        };
    };
```

## Documentation/devicetree/bindings/clock/fsl,imx93-anatop.yaml
```yaml
# SPDX-License-Identifier: (GPL-2.0-only OR BSD-2-Clause)
%YAML 1.2
---
$id: http://devicetree.org/schemas/clock/fsl,imx93-anatop.yaml#
$schema: http://devicetree.org/meta-schemas/core.yaml#

title: NXP i.MX93 ANATOP Clock Module

maintainers:
  - Peng Fan <peng.fan@nxp.com>

description: |
  NXP i.MX93 ANATOP module which contains PLL and OSC to Clock Controller
  Module.

properties:
  compatible:
    items:
      - const: fsl,imx93-anatop

  reg:
    maxItems: 1

  '#clock-cells':
    const: 1

required:
  - compatible
  - reg
  - '#clock-cells'

additionalProperties: false

examples:
  - |
    clock-controller@44480000 {
        compatible = "fsl,imx93-anatop";
        reg = <0x44480000 0x2000>;
        #clock-cells = <1>;
    };

...
```

## Documentation/devicetree/bindings/clock/fsl,plldig.yaml
```yaml
# SPDX-License-Identifier: GPL-2.0
%YAML 1.2
---
$id: http://devicetree.org/schemas/clock/fsl,plldig.yaml#
$schema: http://devicetree.org/meta-schemas/core.yaml#

title: NXP QorIQ Layerscape LS1028A Display PIXEL Clock

maintainers:
  - Wen He <wen.he_1@nxp.com>

description: |
  NXP LS1028A has a clock domain PXLCLK0 used for the Display output
  interface in the display core, as implemented in TSMC CLN28HPM PLL.
  which generate and offers pixel clocks to Display.

properties:
  compatible:
    const: fsl,ls1028a-plldig

  reg:
    maxItems: 1

  clocks:
    maxItems: 1

  '#clock-cells':
    const: 0

  fsl,vco-hz:
    description: Optional for VCO frequency of the PLL in Hertz. The VCO frequency
      of this PLL cannot be changed during runtime only at startup. Therefore,
      the output frequencies are very limited and might not even closely match
      the requested frequency. To work around this restriction the user may specify
      its own desired VCO frequency for the PLL.
    minimum: 650000000
    maximum: 1300000000
    default: 1188000000

required:
  - compatible
  - reg
  - clocks
  - '#clock-cells'

additionalProperties: false

examples:
  # Display PIXEL Clock node:
  - |
    dpclk: clock-display@f1f0000 {
        compatible = "fsl,ls1028a-plldig";
        reg = <0xf1f0000 0xffff>;
        #clock-cells = <0>;
        clocks = <&osc_27m>;
    };

...
```
