## Documentation/devicetree/bindings/clock/fsl,qoriq-clock-legacy.yaml
```yaml
# SPDX-License-Identifier: (GPL-2.0-only OR BSD-2-Clause)
%YAML 1.2
---
$id: http://devicetree.org/schemas/clock/fsl,qoriq-clock-legacy.yaml#
$schema: http://devicetree.org/meta-schemas/core.yaml#

title: Legacy Clock Block on Freescale QorIQ Platforms

maintainers:
  - Frank Li <Frank.Li@nxp.com>

description: |
  These nodes are deprecated.  Kernels should continue to support
  device trees with these nodes, but new device trees should not use them.

  Most of the bindings are from the common clock binding[1].
  [1] Documentation/devicetree/bindings/clock/clock-bindings.txt

properties:
  compatible:
    enum:
      - fsl,qoriq-core-pll-1.0
      - fsl,qoriq-core-pll-2.0
      - fsl,qoriq-core-mux-1.0
      - fsl,qoriq-core-mux-2.0
      - fsl,qoriq-sysclk-1.0
      - fsl,qoriq-sysclk-2.0
      - fsl,qoriq-platform-pll-1.0
      - fsl,qoriq-platform-pll-2.0

  reg:
    maxItems: 1

  clocks:
    minItems: 1
    maxItems: 4

  clock-names:
    minItems: 1
    maxItems: 4

  clock-output-names:
    minItems: 1
    maxItems: 8

  '#clock-cells':
    minimum: 0
    maximum: 1

required:
  - compatible
  - '#clock-cells'

additionalProperties: false

allOf:
  - if:
      properties:
        compatible:
          contains:
            enum:
              - fsl,qoriq-sysclk-1.0
              - fsl,qoriq-sysclk-2.0
    then:
      properties:
        '#clock-cells':
          const: 0

  - if:
      properties:
        compatible:
          contains:
            enum:
              - fsl,qoriq-core-pll-1.0
              - fsl,qoriq-core-pll-2.0
    then:
      properties:
        '#clock-cells':
          const: 1
          description: |
            * 0 - equal to the PLL frequency
            * 1 - equal to the PLL frequency divided by 2
            * 2 - equal to the PLL frequency divided by 4
```

## Documentation/devicetree/bindings/clock/fsl,qoriq-clock.yaml
```yaml
# SPDX-License-Identifier: (GPL-2.0-only OR BSD-2-Clause)
%YAML 1.2
---
$id: http://devicetree.org/schemas/clock/fsl,qoriq-clock.yaml#
$schema: http://devicetree.org/meta-schemas/core.yaml#

title: Clock Block on Freescale QorIQ Platforms

maintainers:
  - Frank Li <Frank.Li@nxp.com>

description: |
  Freescale QorIQ chips take primary clocking input from the external
  SYSCLK signal. The SYSCLK input (frequency) is multiplied using
  multiple phase locked loops (PLL) to create a variety of frequencies
  which can then be passed to a variety of internal logic, including
  cores and peripheral IP blocks.
  Please refer to the Reference Manual for details.

  All references to "1.0" and "2.0" refer to the QorIQ chassis version to
  which the chip complies.

  Chassis Version    Example Chips
  ---------------    -------------
       1.0          p4080, p5020, p5040
       2.0          t4240

  Clock Provider

  The clockgen node should act as a clock provider, though in older device
  trees the children of the clockgen node are the clock providers.

properties:
  compatible:
    oneOf:
      - items:
          - enum:
              - fsl,p2041-clockgen
              - fsl,p3041-clockgen
              - fsl,p4080-clockgen
              - fsl,p5020-clockgen
              - fsl,p5040-clockgen
          - const: fsl,qoriq-clockgen-1.0
      - items:
          - enum:
              - fsl,t1023-clockgen
              - fsl,t1024-clockgen
              - fsl,t1040-clockgen
              - fsl,t1042-clockgen
              - fsl,t2080-clockgen
              - fsl,t2081-clockgen
              - fsl,t4240-clockgen
          - const: fsl,qoriq-clockgen-2.0
      - items:
          - enum:
              - fsl,b4420-clockgen
              - fsl,b4860-clockgen
          - const: fsl,b4-clockgen
      - items:
          - enum:
              - fsl,ls1012a-clockgen
              - fsl,ls1021a-clockgen
              - fsl,ls1028a-clockgen
              - fsl,ls1043a-clockgen
              - fsl,ls1046a-clockgen
              - fsl,ls1088a-clockgen
              - fsl,ls2080a-clockgen
              - fsl,lx2160a-clockgen

  reg:
    maxItems: 1

  ranges: true

  '#address-cells':
    const: 1

  '#size-cells':
    const: 1

  '#clock-cells':
    const: 2
    description: |
      The first cell of the clock specifier is the clock type, and the
      second cell is the clock index for the specified type.

        Type#  Name       Index Cell
        0  sysclk          must be 0
        1  cmux            index (n in CLKCnCSR)
        2  hwaccel         index (n in CLKCGnHWACSR)
        3  fman            0 for fm1, 1 for fm2
        4  platform pll    n=pll/(n+1). For example, when n=1,
                          that means output_freq=PLL_freq/2.
        5  coreclk         must be 0

  clock-frequency:
    description: Input system clock frequency (SYSCLK)

  clocks:
    items:
      - description:
          sysclk may be provided as an input clock.  Either clock-frequency
          or clocks must be provided.
      - description:
          A second input clock, called "coreclk", may be provided if
          core PLLs are based on a different input clock from the
          platform PLL.
    minItems: 1

  clock-names:
    items:
      - const: sysclk
      - const: coreclk

patternProperties:
  '^mux[0-9]@[a-f0-9]+$':
    deprecated: true
    $ref: fsl,qoriq-clock-legacy.yaml

  '^sysclk(-[a-z0-9]+)?$':
    deprecated: true
    $ref: fsl,qoriq-clock-legacy.yaml

  '^pll[0-9]@[a-f0-9]+$':
    deprecated: true
    $ref: fsl,qoriq-clock-legacy.yaml

  '^platform\-pll@[a-f0-9]+$':
    deprecated: true
    $ref: fsl,qoriq-clock-legacy.yaml

required:
  - compatible
  - reg
  - '#clock-cells'

additionalProperties: false

examples:
  - |
    /* clock provider example */
    global-utilities@e1000 {
        compatible = "fsl,p5020-clockgen", "fsl,qoriq-clockgen-1.0";
        reg = <0xe1000 0x1000>;
        clock-frequency = <133333333>;
        #clock-cells = <2>;
    };

  - |
    /* Legacy example */
    global-utilities@e1000 {
        compatible = "fsl,p5020-clockgen", "fsl,qoriq-clockgen-1.0";
        reg = <0xe1000 0x1000>;
        ranges = <0x0 0xe1000 0x1000>;
        clock-frequency = <133333333>;
        #address-cells = <1>;
        #size-cells = <1>;
        #clock-cells = <2>;

        sysclk: sysclk {
            compatible = "fsl,qoriq-sysclk-1.0";
            clock-output-names = "sysclk";
            #clock-cells = <0>;
        };

        pll0: pll0@800 {
            compatible = "fsl,qoriq-core-pll-1.0";
            reg = <0x800 0x4>;
            #clock-cells = <1>;
            clocks = <&sysclk>;
            clock-output-names = "pll0", "pll0-div2";
        };

        pll1: pll1@820 {
            compatible = "fsl,qoriq-core-pll-1.0";
            reg = <0x820 0x4>;
            #clock-cells = <1>;
            clocks = <&sysclk>;
            clock-output-names = "pll1", "pll1-div2";
        };

        mux0: mux0@0 {
            compatible = "fsl,qoriq-core-mux-1.0";
            reg = <0x0 0x4>;
            #clock-cells = <0>;
            clocks = <&pll0 0>, <&pll0 1>, <&pll1 0>, <&pll1 1>;
            clock-names = "pll0", "pll0-div2", "pll1", "pll1-div2";
            clock-output-names = "cmux0";
        };

        mux1: mux1@20 {
            compatible = "fsl,qoriq-core-mux-1.0";
            reg = <0x20 0x4>;
            #clock-cells = <0>;
            clocks = <&pll0 0>, <&pll0 1>, <&pll1 0>, <&pll1 1>;
            clock-names = "pll0", "pll0-div2", "pll1", "pll1-div2";
            clock-output-names = "cmux1";
        };

        platform-pll@c00 {
            #clock-cells = <1>;
            reg = <0xc00 0x4>;
            compatible = "fsl,qoriq-platform-pll-1.0";
            clocks = <&sysclk>;
            clock-output-names = "platform-pll", "platform-pll-div2";
        };
    };
```

## Documentation/devicetree/bindings/clock/fsl,sai-clock.yaml
```yaml
# SPDX-License-Identifier: (GPL-2.0-only OR BSD-2-Clause)
%YAML 1.2
---
$id: http://devicetree.org/schemas/clock/fsl,sai-clock.yaml#
$schema: http://devicetree.org/meta-schemas/core.yaml#

title: Freescale SAI bitclock-as-a-clock

maintainers:
  - Michael Walle <michael@walle.cc>

description: |
  It is possible to use the BCLK pin of a SAI module as a generic clock
  output. Some SoC are very constrained in their pin multiplexer
  configuration. Eg. pins can only be changed groups. For example, on the
  LS1028A SoC you can only enable SAIs in pairs. If you use only one SAI,
  the second pins are wasted. Using this binding it is possible to use the
  clock of the second SAI as a MCLK clock for an audio codec, for example.

  This is a composite of a gated clock and a divider clock.

properties:
  compatible:
    const: fsl,vf610-sai-clock

  reg:
    maxItems: 1

  clocks:
    maxItems: 1

  '#clock-cells':
    const: 0

required:
  - compatible
  - reg
  - clocks
  - '#clock-cells'

additionalProperties: false

examples:
  - |
    soc {
        #address-cells = <2>;
        #size-cells = <2>;

        mclk: clock-mclk@f130080 {
            compatible = "fsl,vf610-sai-clock";
            reg = <0x0 0xf130080 0x0 0x80>;
            #clock-cells = <0>;
            clocks = <&parentclk>;
        };
    };
```

## Documentation/devicetree/bindings/clock/fsl,scu-clk.yaml
```yaml
# SPDX-License-Identifier: (GPL-2.0-only OR BSD-2-Clause)
%YAML 1.2
---
$id: http://devicetree.org/schemas/clock/fsl,scu-clk.yaml#
$schema: http://devicetree.org/meta-schemas/core.yaml#

title: i.MX SCU Client Device Node - Clock bindings based on SCU Message Protocol

maintainers:
  - Abel Vesa <abel.vesa@nxp.com>

description: i.MX SCU Client Device Node
  Client nodes are maintained as children of the relevant IMX-SCU device node.
  This binding uses the common clock binding.
  (Documentation/devicetree/bindings/clock/clock-bindings.txt)
  The clock consumer should specify the desired clock by having the clock
  ID in its "clocks" phandle cell. See the full list of clock IDs from
  include/dt-bindings/clock/imx8qxp-clock.h

properties:
  compatible:
    items:
      - enum:
          - fsl,imx8dxl-clk
          - fsl,imx8qm-clk
          - fsl,imx8qxp-clk
      - const: fsl,scu-clk

  '#clock-cells':
    const: 2

required:
  - compatible
  - '#clock-cells'

additionalProperties: false

examples:
  - |
    clock-controller {
        compatible = "fsl,imx8qxp-clk", "fsl,scu-clk";
        #clock-cells = <2>;
    };
```

## Documentation/devicetree/bindings/clock/fsl,vf610-ccm.yaml
```yaml
# SPDX-License-Identifier: (GPL-2.0-only OR BSD-2-Clause)
%YAML 1.2
---
$id: http://devicetree.org/schemas/clock/fsl,vf610-ccm.yaml#
$schema: http://devicetree.org/meta-schemas/core.yaml#

title: Clock for Freescale Vybrid VF610 SOC

description:
  The clock consumer should specify the desired clock by having the clock
  ID in its "clocks" phandle cell. See include/dt-bindings/clock/vf610-clock.h
  for the full list of VF610 clock IDs

maintainers:
  - Frank Li <Frank.Li@nxp.com>

properties:
  compatible:
    const: fsl,vf610-ccm

  reg:
    maxItems: 1

  '#clock-cells':
    const: 1

  clocks:
    items:
      - description: external crystal oscillator 32KHz, recommended
      - description: external crystal oscillator 24MHz, recommended
      - description: audio
      - description: enet
    minItems: 2

  clock-names:
    items:
      - const: sxosc
      - const: fxosc
      - const: enet_ext
      - const: audio_ext
    minItems: 2

required:
  - compatible
  - reg

additionalProperties: false

examples:
  - |
    clock-controller@4006b000 {
        compatible = "fsl,vf610-ccm";
        reg = <0x4006b000 0x1000>;
        #clock-cells = <1>;
        clocks = <&sxosc>, <&fxosc>;
        clock-names = "sxosc", "fxosc";
    };
```

## Documentation/devicetree/bindings/clock/fujitsu,mb86s70-crg11.txt
```
Fujitsu CRG11 clock driver bindings
-----------------------------------

Required properties :
- compatible : Shall contain "fujitsu,mb86s70-crg11"
- #clock-cells : Shall be 3 {cntrlr domain port}

The consumer specifies the desired clock pointing to its phandle.

Example:

	clock: crg11 {
		compatible = "fujitsu,mb86s70-crg11";
		#clock-cells = <3>;
	};

	mhu: mhu0@2b1f0000 {
		#mbox-cells = <1>;
		compatible = "arm,mhu";
		reg = <0 0x2B1F0000 0x1000>;
		interrupts = <0 36 4>, /* LP Non-Sec */
			     <0 35 4>, /* HP Non-Sec */
			     <0 37 4>; /* Secure */
		clocks = <&clock 0 2 1>; /* Cntrlr:0 Domain:2 Port:1 */
		clock-names = "clk";
	};
```

## Documentation/devicetree/bindings/clock/gated-fixed-clock.yaml
```yaml
# SPDX-License-Identifier: (GPL-2.0-only OR BSD-2-Clause)
%YAML 1.2
---
$id: http://devicetree.org/schemas/clock/gated-fixed-clock.yaml#
$schema: http://devicetree.org/meta-schemas/core.yaml#

title: Gated Fixed clock

maintainers:
  - Heiko Stuebner <heiko@sntech.de>

properties:
  compatible:
    const: gated-fixed-clock

  "#clock-cells":
    const: 0

  clock-frequency: true

  clock-output-names:
    maxItems: 1

  enable-gpios:
    description:
      Contains a single GPIO specifier for the GPIO that enables and disables
      the oscillator.
    maxItems: 1

  vdd-supply:
    description: handle of the regulator that provides the supply voltage

required:
  - compatible
  - "#clock-cells"
  - clock-frequency
  - vdd-supply

additionalProperties: false

examples:
  - |
    clock-1000000000 {
      compatible = "gated-fixed-clock";
      #clock-cells = <0>;
      clock-frequency = <1000000000>;
      vdd-supply = <&reg_vdd>;
    };
...
```
