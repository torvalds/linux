## Documentation/devicetree/bindings/clock/fixed-clock.txt
```
Binding for simple fixed-rate clock sources.

This binding uses the common clock binding[1].

[1] Documentation/devicetree/bindings/clock/clock-bindings.txt

Required properties:
- compatible : shall be "fixed-clock".
- #clock-cells : from common clock binding; shall be set to 0.
- clock-frequency : frequency of clock in Hz. Should be a single cell.

Optional properties:
- clock-accuracy : accuracy of clock in ppb (parts per billion).
		   Should be a single cell.
- clock-output-names : From common clock binding.

Example:
	clock {
		compatible = "fixed-clock";
		#clock-cells = <0>;
		clock-frequency = <1000000000>;
		clock-accuracy = <100>;
	};
```

## Documentation/devicetree/bindings/clock/fixed-clock.yaml
```yaml
# SPDX-License-Identifier: GPL-2.0
%YAML 1.2
---
$id: http://devicetree.org/schemas/clock/fixed-clock.yaml#
$schema: http://devicetree.org/meta-schemas/core.yaml#

title: Binding for simple fixed-rate clock sources

maintainers:
  - Michael Turquette <mturquette@baylibre.com>
  - Stephen Boyd <sboyd@kernel.org>

properties:
  compatible:
    const: fixed-clock

  "#clock-cells":
    const: 0

  clock-frequency: true

  clock-accuracy:
    description: accuracy of clock in ppb (parts per billion).
    $ref: /schemas/types.yaml#/definitions/uint32

  clock-output-names:
    maxItems: 1

required:
  - compatible
  - "#clock-cells"
  - clock-frequency

additionalProperties: false

examples:
  - |
    clock {
      compatible = "fixed-clock";
      #clock-cells = <0>;
      clock-frequency = <1000000000>;
      clock-accuracy = <100>;
    };
...
```

## Documentation/devicetree/bindings/clock/fixed-factor-clock.txt
```
Binding for simple fixed factor rate clock sources.

This binding uses the common clock binding[1].

[1] Documentation/devicetree/bindings/clock/clock-bindings.txt

Required properties:
- compatible : shall be "fixed-factor-clock".
- #clock-cells : from common clock binding; shall be set to 0.
- clock-div: fixed divider.
- clock-mult: fixed multiplier.
- clocks: parent clock.

Optional properties:
- clock-output-names : From common clock binding.

Some clocks that require special treatments are also handled by that
driver, with the compatibles:
  - allwinner,sun4i-a10-pll3-2x-clk

Example:
	clock {
		compatible = "fixed-factor-clock";
		clocks = <&parentclk>;
		#clock-cells = <0>;
		clock-div = <2>;
		clock-mult = <1>;
	};
```

## Documentation/devicetree/bindings/clock/fixed-factor-clock.yaml
```yaml
# SPDX-License-Identifier: GPL-2.0
%YAML 1.2
---
$id: http://devicetree.org/schemas/clock/fixed-factor-clock.yaml#
$schema: http://devicetree.org/meta-schemas/core.yaml#

title: Binding for simple fixed factor rate clock sources

maintainers:
  - Michael Turquette <mturquette@baylibre.com>
  - Stephen Boyd <sboyd@kernel.org>

properties:
  compatible:
    enum:
      - fixed-factor-clock

  "#clock-cells":
    const: 0

  clocks:
    maxItems: 1

  clock-div:
    description: Fixed divider
    $ref: /schemas/types.yaml#/definitions/uint32
    minimum: 1

  clock-mult:
    description: Fixed multiplier
    $ref: /schemas/types.yaml#/definitions/uint32

  clock-output-names:
    maxItems: 1

required:
  - compatible
  - clocks
  - "#clock-cells"
  - clock-div
  - clock-mult

additionalProperties: false

examples:
  - |
    clock {
      compatible = "fixed-factor-clock";
      clocks = <&parentclk>;
      #clock-cells = <0>;
      clock-div = <2>;
      clock-mult = <1>;
    };
...
```

## Documentation/devicetree/bindings/clock/fixed-mmio-clock.txt
```
Binding for simple memory mapped io fixed-rate clock sources.
The driver reads a clock frequency value from a single 32-bit memory mapped
I/O register and registers it as a fixed rate clock.

It was designed for test systems, like FPGA, not for complete, finished SoCs.

This binding uses the common clock binding[1].

[1] Documentation/devicetree/bindings/clock/clock-bindings.txt

Required properties:
- compatible : shall be "fixed-mmio-clock".
- #clock-cells : from common clock binding; shall be set to 0.
- reg : Address and length of the clock value register set.

Optional properties:
- clock-output-names : From common clock binding.

Example:
sysclock: sysclock@fd020004 {
	#clock-cells = <0>;
	compatible = "fixed-mmio-clock";
	reg = <0xfd020004 0x4>;
};
```

## Documentation/devicetree/bindings/clock/fixed-mmio-clock.yaml
```yaml
# SPDX-License-Identifier: GPL-2.0
%YAML 1.2
---
$id: http://devicetree.org/schemas/clock/fixed-mmio-clock.yaml#
$schema: http://devicetree.org/meta-schemas/core.yaml#

title: Binding for simple memory mapped IO fixed-rate clock sources

description:
  This binding describes a fixed-rate clock for which the frequency can
  be read from a single 32-bit memory mapped I/O register.

  It was designed for test systems, like FPGA, not for complete,
  finished SoCs.

maintainers:
  - Jan Kotas <jank@cadence.com>

properties:
  compatible:
    const: fixed-mmio-clock

  reg:
    maxItems: 1

  "#clock-cells":
    const: 0

  clock-output-names:
    maxItems: 1

required:
  - compatible
  - reg
  - "#clock-cells"

additionalProperties: false

examples:
  - |
    sysclock: sysclock@fd020004 {
      compatible = "fixed-mmio-clock";
      #clock-cells = <0>;
      reg = <0xfd020004 0x4>;
      clock-output-names = "sysclk";
    };
...
```

## Documentation/devicetree/bindings/clock/fsl,flexspi-clock.yaml
```yaml
# SPDX-License-Identifier: (GPL-2.0-only OR BSD-2-Clause)
%YAML 1.2
---
$id: http://devicetree.org/schemas/clock/fsl,flexspi-clock.yaml#
$schema: http://devicetree.org/meta-schemas/core.yaml#

title: Freescale FlexSPI clock driver for Layerscape SoCs

maintainers:
  - Michael Walle <michael@walle.cc>

description:
  The Freescale Layerscape SoCs have a special FlexSPI clock which is
  derived from the platform PLL.

properties:
  compatible:
    enum:
      - fsl,ls1028a-flexspi-clk
      - fsl,lx2160a-flexspi-clk

  reg:
    maxItems: 1

  clocks:
    maxItems: 1

  '#clock-cells':
    const: 0

  clock-output-names:
    maxItems: 1

required:
  - compatible
  - reg
  - clocks
  - '#clock-cells'

additionalProperties: false

examples:
  - |
    dcfg {
        #address-cells = <1>;
        #size-cells = <1>;

        fspi_clk: clock-controller@900 {
            compatible = "fsl,ls1028a-flexspi-clk";
            reg = <0x900 0x4>;
            #clock-cells = <0>;
            clocks = <&parentclk>;
            clock-output-names = "fspi_clk";
        };
    };
```
