## Documentation/devicetree/bindings/clock/google,gs101-clock.yaml
```yaml
# SPDX-License-Identifier: (GPL-2.0-only OR BSD-2-Clause)
%YAML 1.2
---
$id: http://devicetree.org/schemas/clock/google,gs101-clock.yaml#
$schema: http://devicetree.org/meta-schemas/core.yaml#

title: Google GS101 SoC clock controller

maintainers:
  - Peter Griffin <peter.griffin@linaro.org>

description: |
  Google GS101 clock controller is comprised of several CMU units, generating
  clocks for different domains. Those CMU units are modeled as separate device
  tree nodes, and might depend on each other. The root clock in that clock tree
  is OSCCLK (24.576 MHz). That external clock must be defined as a fixed-rate
  clock in dts.

  CMU_TOP is a top-level CMU, where all base clocks are prepared using PLLs and
  dividers; all other leaf clocks (other CMUs) are usually derived from CMU_TOP.

  Each clock is assigned an identifier and client nodes can use this identifier
  to specify the clock which they consume. All clocks available for usage
  in clock consumer nodes are defined as preprocessor macros in
  'dt-bindings/clock/gs101.h' header.

properties:
  compatible:
    enum:
      - google,gs101-cmu-top
      - google,gs101-cmu-apm
      - google,gs101-cmu-misc
      - google,gs101-cmu-hsi0
      - google,gs101-cmu-hsi2
      - google,gs101-cmu-peric0
      - google,gs101-cmu-peric1

  clocks:
    minItems: 1
    maxItems: 5

  clock-names:
    minItems: 1
    maxItems: 5

  "#clock-cells":
    const: 1

  reg:
    maxItems: 1

required:
  - compatible
  - "#clock-cells"
  - clocks
  - clock-names
  - reg

allOf:
  - if:
      properties:
        compatible:
          contains:
            enum:
              - google,gs101-cmu-top
              - google,gs101-cmu-apm
    then:
      properties:
        clocks:
          items:
            - description: External reference clock (24.576 MHz)

        clock-names:
          items:
            - const: oscclk

  - if:
      properties:
        compatible:
          contains:
            const: google,gs101-cmu-hsi0

    then:
      properties:
        clocks:
          items:
            - description: External reference clock (24.576 MHz)
            - description: HSI0 bus clock (from CMU_TOP)
            - description: DPGTC (from CMU_TOP)
            - description: USB DRD controller clock (from CMU_TOP)
            - description: USB Display Port debug clock (from CMU_TOP)

        clock-names:
          items:
            - const: oscclk
            - const: bus
            - const: dpgtc
            - const: usb31drd
            - const: usbdpdbg

  - if:
      properties:
        compatible:
          contains:
            enum:
              - google,gs101-cmu-hsi2

    then:
      properties:
        clocks:
          items:
            - description: External reference clock (24.576 MHz)
            - description: High Speed Interface bus clock (from CMU_TOP)
            - description: High Speed Interface pcie clock (from CMU_TOP)
            - description: High Speed Interface ufs clock (from CMU_TOP)
            - description: High Speed Interface mmc clock (from CMU_TOP)

        clock-names:
          items:
            - const: oscclk
            - const: bus
            - const: pcie
            - const: ufs
            - const: mmc

  - if:
      properties:
        compatible:
          contains:
            const: google,gs101-cmu-misc

    then:
      properties:
        clocks:
          items:
            - description: Misc bus clock (from CMU_TOP)
            - description: Misc sss clock (from CMU_TOP)

        clock-names:
          items:
            - const: bus
            - const: sss

  - if:
      properties:
        compatible:
          contains:
            enum:
              - google,gs101-cmu-peric0
              - google,gs101-cmu-peric1

    then:
      properties:
        clocks:
          items:
            - description: External reference clock (24.576 MHz)
            - description: Connectivity Peripheral 0/1 bus clock (from CMU_TOP)
            - description: Connectivity Peripheral 0/1 IP clock (from CMU_TOP)

        clock-names:
          items:
            - const: oscclk
            - const: bus
            - const: ip

additionalProperties: false

examples:
  # Clock controller node for CMU_TOP
  - |
    #include <dt-bindings/clock/google,gs101.h>

    cmu_top: clock-controller@1e080000 {
        compatible = "google,gs101-cmu-top";
        reg = <0x1e080000 0x8000>;
        #clock-cells = <1>;
        clocks = <&ext_24_5m>;
        clock-names = "oscclk";
    };

...
```

## Documentation/devicetree/bindings/clock/gpio-gate-clock.txt
```
Binding for simple gpio gated clock.

This binding uses the common clock binding[1].

[1] Documentation/devicetree/bindings/clock/clock-bindings.txt

Required properties:
- compatible : shall be "gpio-gate-clock".
- #clock-cells : from common clock binding; shall be set to 0.
- enable-gpios : GPIO reference for enabling and disabling the clock.

Optional properties:
- clocks: Maximum of one parent clock is supported.

Example:
	clock {
		compatible = "gpio-gate-clock";
		clocks = <&parentclk>;
		#clock-cells = <0>;
		enable-gpios = <&gpio 1 GPIO_ACTIVE_HIGH>;
	};
```

## Documentation/devicetree/bindings/clock/gpio-gate-clock.yaml
```yaml
# SPDX-License-Identifier: (GPL-2.0-only OR BSD-2-Clause)
%YAML 1.2
---
$id: http://devicetree.org/schemas/clock/gpio-gate-clock.yaml#
$schema: http://devicetree.org/meta-schemas/core.yaml#

title: Simple GPIO clock gate

maintainers:
  - Jyri Sarha <jsarha@ti.com>

properties:
  compatible:
    const: gpio-gate-clock

  clocks:
    maxItems: 1

  '#clock-cells':
    const: 0

  enable-gpios:
    description: GPIO reference for enabling and disabling the clock.
    maxItems: 1

required:
  - compatible
  - '#clock-cells'
  - enable-gpios

additionalProperties: false

examples:
  - |
    #include <dt-bindings/gpio/gpio.h>

    clock {
        compatible = "gpio-gate-clock";
        clocks = <&parentclk>;
        #clock-cells = <0>;
        enable-gpios = <&gpio 1 GPIO_ACTIVE_HIGH>;
    };
```

## Documentation/devicetree/bindings/clock/gpio-mux-clock.txt
```
Binding for simple gpio clock multiplexer.

This binding uses the common clock binding[1].

[1] Documentation/devicetree/bindings/clock/clock-bindings.txt

Required properties:
- compatible : shall be "gpio-mux-clock".
- clocks: list of two references to parent clocks.
- #clock-cells : from common clock binding; shall be set to 0.
- select-gpios : GPIO reference for selecting the parent clock.

Example:
	clock {
		compatible = "gpio-mux-clock";
		clocks = <&parentclk1>, <&parentclk2>;
		#clock-cells = <0>;
		select-gpios = <&gpio 1 GPIO_ACTIVE_HIGH>;
	};
```

## Documentation/devicetree/bindings/clock/gpio-mux-clock.yaml
```yaml
# SPDX-License-Identifier: (GPL-2.0-only OR BSD-2-Clause)
%YAML 1.2
---
$id: http://devicetree.org/schemas/clock/gpio-mux-clock.yaml#
$schema: http://devicetree.org/meta-schemas/core.yaml#

title: Simple GPIO clock multiplexer

maintainers:
  - Sergej Sawazki <ce3a@gmx.de>

properties:
  compatible:
    const: gpio-mux-clock

  clocks:
    items:
      - description: First parent clock
      - description: Second parent clock

  '#clock-cells':
    const: 0

  select-gpios:
    description: GPIO reference for selecting the parent clock.
    maxItems: 1

required:
  - compatible
  - clocks
  - '#clock-cells'
  - select-gpios

additionalProperties: false

examples:
  - |
    #include <dt-bindings/gpio/gpio.h>

    clock {
            compatible = "gpio-mux-clock";
            clocks = <&parentclk1>, <&parentclk2>;
            #clock-cells = <0>;
            select-gpios = <&gpio 1 GPIO_ACTIVE_HIGH>;
    };
```

## Documentation/devicetree/bindings/clock/hi3519-crg.txt
```
* Hisilicon Hi3519 Clock and Reset Generator(CRG)

The Hi3519 CRG module provides clock and reset signals to various
controllers within the SoC.

This binding uses the following bindings:
    Documentation/devicetree/bindings/clock/clock-bindings.txt
    Documentation/devicetree/bindings/reset/reset.txt

Required Properties:

- compatible: should be one of the following.
  - "hisilicon,hi3519-crg" - controller compatible with Hi3519 SoC.

- reg: physical base address of the controller and length of memory mapped
  region.

- #clock-cells: should be 1.

Each clock is assigned an identifier and client nodes use this identifier
to specify the clock which they consume.

All these identifier could be found in <dt-bindings/clock/hi3519-clock.h>.

- #reset-cells: should be 2.

A reset signal can be controlled by writing a bit register in the CRG module.
The reset specifier consists of two cells. The first cell represents the
register offset relative to the base address. The second cell represents the
bit index in the register.

Example: CRG nodes
CRG: clock-reset-controller@12010000 {
	compatible = "hisilicon,hi3519-crg";
	reg = <0x12010000 0x10000>;
	#clock-cells = <1>;
	#reset-cells = <2>;
};

Example: consumer nodes
i2c0: i2c@12110000 {
	compatible = "hisilicon,hi3519-i2c";
	reg = <0x12110000 0x1000>;
	clocks = <&CRG HI3519_I2C0_RST>;
	resets = <&CRG 0xe4 0>;
};
```
