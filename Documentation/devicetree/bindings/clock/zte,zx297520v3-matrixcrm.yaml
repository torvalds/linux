## Documentation/devicetree/bindings/display/hisilicon/hisilicon,hi6220-dsi.yaml
```yaml
# SPDX-License-Identifier: (GPL-2.0-only OR BSD-2-Clause)
%YAML 1.2
---
$id: http://devicetree.org/schemas/display/hisilicon/hisilicon,hi6220-dsi.yaml#
$schema: http://devicetree.org/meta-schemas/core.yaml#

title: HiSilicon DesignWare DSI Host Controller

maintainers:
  - Xinliang Liu <z.liuxinliang@hisilicon.com>

properties:
  compatible:
    const: hisilicon,hi6220-dsi

  reg:
    maxItems: 1

  clocks:
    maxItems: 1

  clock-names:
    items:
      - const: pclk

  ports:
    $ref: /schemas/graph.yaml#/properties/ports

    properties:
      port@0:
        description: Input port, connects to ADE output endpoint.
        $ref: /schemas/graph.yaml#/properties/port

      port@1:
        description: Output port, connects to panel or bridge endpoints.
        $ref: /schemas/graph.yaml#/properties/port

required:
  - compatible
  - reg
  - clocks
  - clock-names
  - ports

additionalProperties: false

examples:
  - |
    #include <dt-bindings/clock/hi6220-clock.h>

    dsi@f4107800 {
        compatible = "hisilicon,hi6220-dsi";
        reg = <0xf4107800 0x100>;
        clocks = <&media_ctrl HI6220_DSI_PCLK>;
        clock-names = "pclk";

        ports {
            #address-cells = <1>;
            #size-cells = <0>;

            port@0 {
                reg = <0>;
                dsi_in: endpoint {
                    remote-endpoint = <&ade_out>;
                };
            };
        };
    };
```

## Documentation/devicetree/bindings/display/panel/ilitek,ili7836a.yaml
```yaml
# SPDX-License-Identifier: GPL-2.0-only OR BSD-2-Clause
%YAML 1.2
---
$id: http://devicetree.org/schemas/display/panel/ilitek,ili7836a.yaml#
$schema: http://devicetree.org/meta-schemas/core.yaml#

title: Ilitek ILI7836A-based OLED panels

maintainers:
  - Neil Armstrong <neil.armstrong@linaro.org>

allOf:
  - $ref: panel-common.yaml#

properties:
  compatible:
    items:
      - const: retroidpocket,nova-panel
      - const: ilitek,ili7836a

  reg:
    maxItems: 1
    description: DSI virtual channel

  vddio-supply: true
  avdd-supply: true

  backlight: true
  port: true
  reset-gpios: true
  rotation: true

required:
  - compatible
  - reg
  - vddio-supply
  - avdd-supply
  - reset-gpios

additionalProperties: false

examples:
  - |
    #include <dt-bindings/gpio/gpio.h>

    dsi {
        #address-cells = <1>;
        #size-cells = <0>;
        panel@0 {
            compatible = "retroidpocket,nova-panel", "ilitek,ili7836a";
            reg = <0>;
            vddio-supply = <&vdd_disp_1v8>;
            avdd-supply = <&vdd_disp2_2v8>;
            reset-gpios = <&tlmm 133 GPIO_ACTIVE_HIGH>;
        };
    };

...
```

## Documentation/devicetree/bindings/display/panel/novatek,nt36532.yaml
```yaml
# SPDX-License-Identifier: GPL-2.0-only OR BSD-2-Clause
%YAML 1.2
---
$id: http://devicetree.org/schemas/display/panel/novatek,nt36532.yaml#
$schema: http://devicetree.org/meta-schemas/core.yaml#

title: Novatek NT36532 based DSI display Panels

maintainers:
  - Junjie Cao <junjie.cao@linux.dev>

description: |
  The NT36532 IC from Novatek is a Driver IC used to drive MIPI-DSI panels.

allOf:
  - $ref: panel-common-dual.yaml#

properties:
  compatible:
    items:
      - enum:
          - csot,ppc100hb1-1
      - const: novatek,nt36532

  reg:
    maxItems: 1

  reset-gpios:
    maxItems: 1
    description: phandle of gpio for reset line - This should be 8mA

  vddio-supply:
    description: regulator that supplies the I/O voltage

  ports: true

required:
  - compatible
  - reg
  - vddio-supply
  - reset-gpios
  - ports

unevaluatedProperties: false

examples:
  - |
    #include <dt-bindings/gpio/gpio.h>

    dsi {
        #address-cells = <1>;
        #size-cells = <0>;

        panel@0 {
            compatible = "csot,ppc100hb1-1", "novatek,nt36532";
            reg = <0>;

            reset-gpios = <&tlmm 133 GPIO_ACTIVE_LOW>;

            vddio-supply = <&vreg_l12b_1p8>;

            ports {
                #address-cells = <1>;
                #size-cells = <0>;

                port@0 {
                    reg = <0>;
                    panel_in_0: endpoint {
                        remote-endpoint = <&dsi0_out>;
                    };
                };

                port@1 {
                    reg = <1>;
                    panel_in_1: endpoint {
                        remote-endpoint = <&dsi1_out>;
                    };
                };
            };
        };
    };

...
```

## Documentation/devicetree/bindings/display/panel/novatek,nt36536.yaml
```yaml
# SPDX-License-Identifier: GPL-2.0-only OR BSD-2-Clause
%YAML 1.2
---
$id: http://devicetree.org/schemas/display/panel/novatek,nt36536.yaml#
$schema: http://devicetree.org/meta-schemas/core.yaml#

title: Novatek NT36536 based DSI display Panels

maintainers:
  - Pengyu Luo <mitltlatltl@gmail.com>

description:
  The Novatek NT36536 is a generic DSI Panel IC used to drive dsi
  panels. Support video mode panels from China Star Optoelectronics
  Technology (CSOT), such as PP8807HB1-1 which is a dual-link 10-bit
  panel.

allOf:
  - $ref: panel-common-dual.yaml#

properties:
  compatible:
    items:
      - enum:
          - csot,pp8807hb1-1
      - const: novatek,nt36536

  reg:
    maxItems: 1

  reset-gpios:
    maxItems: 1

  vddio-supply:
    description: I/O source voltage rail

  vsp-supply:
    description: Positive source voltage rail

  vsn-supply:
    description: Negative source voltage rail

  backlight: true
  ports: true

required:
  - compatible
  - reg
  - vddio-supply
  - reset-gpios
  - ports

additionalProperties: false

examples:
  - |
    #include <dt-bindings/gpio/gpio.h>

    dsi {
        #address-cells = <1>;
        #size-cells = <0>;

        panel@0 {
            compatible = "csot,pp8807hb1-1", "novatek,nt36536";
            reg = <0>;

            vddio-supply = <&vreg_iovdd_1p8>;
            reset-gpios = <&tlmm 98 GPIO_ACTIVE_LOW>;

            ports {
                #address-cells = <1>;
                #size-cells = <0>;

                port@0 {
                    reg = <0>;
                    panel_in_0: endpoint {
                        remote-endpoint = <&dsi0_out>;
                    };
                };

                port@1{
                    reg = <1>;
                    panel_in_1: endpoint {
                        remote-endpoint = <&dsi1_out>;
                    };
                };
            };
        };
    };

...
```

## Documentation/devicetree/bindings/display/panel/novatek,nt51021.yaml
```yaml
# SPDX-License-Identifier: GPL-2.0-only OR BSD-2-Clause
%YAML 1.2
---
$id: http://devicetree.org/schemas/display/panel/novatek,nt51021.yaml#
$schema: http://devicetree.org/meta-schemas/core.yaml#

title: Novatek NT51021 based DSI display Panels

maintainers:
  - Nickolay Goppen <setotau@mainlining.org>

description:
  The NT51021 IC from Novatek is a generic DSI Panel IC used to drive dsi
  panels.
  Right now, support is added only for a BOE WUXGA LCD display panels with a
  resolution of 1200x1920. They are video mode DSI panels.

allOf:
  - $ref: panel-common.yaml#

properties:
  compatible:
    items:
      - enum:
          - boe,tv101wum-nm0
          - boe,tv101wum-nx0
          - boe,tv080wum-nx2
      - const: novatek,nt51021

  reg:
    maxItems: 1

  reset-gpios:
    maxItems: 1
    description: phandle of gpio for reset line - This should be 8mA, gpio
      can be configured using mux, pinctrl, pinctrl-names (active low)

  vdd-supply:
    description: phandle of the regulator that provides the supply voltage
      for digital circuits

  avdd-supply:
    description: phandle of the regulator that provides the supply voltage
      for analog circuits

  havdd-supply:
    description: phandle of the regulator that provides the supply voltage
      for analog circuits

required:
  - compatible
  - reg
  - vdd-supply
  - avdd-supply
  - havdd-supply
  - reset-gpios
  - port

unevaluatedProperties: false

examples:
  - |
    #include <dt-bindings/gpio/gpio.h>

    dsi {
        #address-cells = <1>;
        #size-cells = <0>;

        panel@0 {
            compatible = "boe,tv101wum-nx0", "novatek,nt51021";
            reg = <0>;
            vdd-supply = <&lcd_pwr>;
            avdd-supply = <&lcd_pwr>;
            havdd-supply = <&lcd_pwr>;

            backlight = <&i2c_backlight>;
            reset-gpios = <&tlmm 62 GPIO_ACTIVE_LOW>;

            port {
                panel_in: endpoint {
                    remote-endpoint = <&dsi0_out>;
                };
            };
        };
    };

...
```

## Documentation/devicetree/bindings/display/panel/raydium,rm69220.yaml
```yaml
# SPDX-License-Identifier: (GPL-2.0-only OR BSD-2-Clause)
%YAML 1.2
---
$id: http://devicetree.org/schemas/display/panel/raydium,rm69220.yaml#
$schema: http://devicetree.org/meta-schemas/core.yaml#

title: Raydium RM69220 based MIPI-DSI panels

maintainers:
  - Alexander Koskovich <akoskovich@pm.me>

description:
  The Raydium RM69220 is a generic DSI Panel IC used to control
  AMOLED panels.

allOf:
  - $ref: panel-common.yaml#

properties:
  compatible:
    items:
      - enum:
          - boe,bf068mwm-td0
      - const: raydium,rm69220

  reg:
    maxItems: 1

  dvdd-supply:
    description: Digital voltage rail

  vci-supply:
    description: Analog voltage rail

  vddio-supply:
    description: I/O voltage rail

required:
  - compatible
  - reg
  - dvdd-supply
  - vci-supply
  - vddio-supply
  - reset-gpios
  - port

unevaluatedProperties: false

examples:
  - |
    #include <dt-bindings/gpio/gpio.h>

    dsi {
        #address-cells = <1>;
        #size-cells = <0>;

        panel@0 {
            compatible = "boe,bf068mwm-td0", "raydium,rm69220";
            reg = <0>;

            reset-gpios = <&tlmm 12 GPIO_ACTIVE_LOW>;
            dvdd-supply = <&vreg_oled_dvdd_1p8>;
            vci-supply = <&vreg_l19b>;
            vddio-supply = <&vreg_l9b>;

            port {
                panel_in_0: endpoint {
                    remote-endpoint = <&dsi0_out>;
                };
            };
        };
    };

...
```

## Documentation/devicetree/bindings/display/solomon,ssd1351.yaml
```yaml
# SPDX-License-Identifier: (GPL-2.0-only OR BSD-2-Clause)
%YAML 1.2
---
$id: http://devicetree.org/schemas/display/solomon,ssd1351.yaml#
$schema: http://devicetree.org/meta-schemas/core.yaml#

title: Solomon SSD1351 OLED Display Controller

maintainers:
  - Amit Barzilai <amit.barzilai22@gmail.com>
  - Javier Martinez Canillas <javierm@redhat.com>

allOf:
  - $ref: solomon,ssd-common.yaml#

properties:
  compatible:
    enum:
      - solomon,ssd1351

required:
  - compatible
  - reg

unevaluatedProperties: false

examples:
  - |
    #include <dt-bindings/gpio/gpio.h>

    spi {
        #address-cells = <1>;
        #size-cells = <0>;

        oled@0 {
            compatible = "solomon,ssd1351";
            reg = <0x0>;
            reset-gpios = <&gpio2 7 GPIO_ACTIVE_LOW>;
            dc-gpios = <&gpio2 8 GPIO_ACTIVE_HIGH>;
            spi-max-frequency = <10000000>;
        };
    };
```

## Documentation/devicetree/bindings/dma/amlogic,a9-dma.yaml
```yaml
# SPDX-License-Identifier: GPL-2.0-only OR BSD-2-Clause
%YAML 1.2
---
$id: http://devicetree.org/schemas/dma/amlogic,a9-dma.yaml#
$schema: http://devicetree.org/meta-schemas/core.yaml#

title: Amlogic general DMA controller

description:
  This is a general-purpose peripheral DMA controller. It currently supports
  major peripherals including I2C, I3C, PIO, and CAN-BUS. Transmit and receive
  for the same peripheral use two separate channels, controlled by different
  register sets. I2C and I3C transfer data in 1-byte units, while PIO and
  CAN-BUS transfer data in 4-byte units. From the controller’s perspective,
  there is no significant difference.

maintainers:
  - Xianwei Zhao <xianwei.zhao@amlogic.com>

properties:
  compatible:
    const: amlogic,a9-dma

  reg:
    maxItems: 1

  interrupts:
    maxItems: 1

  clocks:
    maxItems: 1

  clock-names:
    const: sys

  '#dma-cells':
    const: 2
    description:
      The first cell is the DMA channel type(AMLOGIC_A9_DMA_TX or AMLOGIC_A9_DMA_RX).
      The second cell is the DMA channel index.

  dma-channels:
    maximum: 64

required:
  - compatible
  - reg
  - interrupts
  - clocks
  - '#dma-cells'
  - dma-channels

allOf:
  - $ref: dma-controller.yaml#

unevaluatedProperties: false

examples:
  - |
    #include <dt-bindings/interrupt-controller/arm-gic.h>
    dma-controller@fe400000 {
        compatible = "amlogic,a9-dma";
        reg = <0xfe400000 0x4000>;
        interrupts = <GIC_SPI 35 IRQ_TYPE_EDGE_RISING>;
        clocks = <&clkc 45>;
        #dma-cells = <2>;
        dma-channels = <28>;
    };
```

## Documentation/devicetree/bindings/dma/hisilicon,k3-dma-1.0.yaml
```yaml
# SPDX-License-Identifier: (GPL-2.0-only OR BSD-2-Clause)
%YAML 1.2
---
$id: http://devicetree.org/schemas/dma/hisilicon,k3-dma-1.0.yaml#
$schema: http://devicetree.org/meta-schemas/core.yaml#

title: Hisilicon K3 DMA controller

maintainers:
  - Wei Xu <xuwei5@hisilicon.com>

properties:
  compatible:
    items:
      - enum:
          - hisilicon,k3-dma-1.0
          - hisilicon,hisi-pcm-asp-dma-1.0

  reg:
    maxItems: 1

  clocks:
    maxItems: 1

  interrupts:
    maxItems: 1

  '#dma-cells':
    const: 1

  dma-channels:
    description: Number of physical DMA channels supported.
    maximum: 32

  dma-requests:
    description: Number of virtual DMA request lines supported.
    maximum: 32

  dma-channel-mask:
    description: Bitmask of usable DMA channels.

  dma-no-cci:
    type: boolean
    description: DMA is not coherent with the CCI.

  dma-type:
    $ref: /schemas/types.yaml#/definitions/string
    description: SoC-specific DMA type name.
    enum:
      - hi3660_dma
      - hi6220_dma

  interrupt-names:
    maxItems: 1

required:
  - compatible
  - reg
  - interrupts
  - '#dma-cells'
  - dma-channels
  - dma-requests

allOf:
  - $ref: dma-controller.yaml#
  - if:
      properties:
        compatible:
          contains:
            const: hisilicon,k3-dma-1.0
    then:
      required:
        - clocks

additionalProperties: false

examples:
  - |
    dma-controller@fcd02000 {
        compatible = "hisilicon,k3-dma-1.0";
        reg = <0xfcd02000 0x1000>;
        #dma-cells = <1>;
        dma-channels = <16>;
        dma-requests = <27>;
        interrupts = <0 12 4>;
        clocks = <&pclk>;
    };
```
