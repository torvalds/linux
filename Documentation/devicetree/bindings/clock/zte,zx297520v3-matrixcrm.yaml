## Documentation/devicetree/bindings/clock/zte,zx297520v3-matrixcrm.yaml
```yaml
# SPDX-License-Identifier: (GPL-2.0-only OR BSD-2-Clause)
%YAML 1.2
---
$id: http://devicetree.org/schemas/clock/zte,zx297520v3-matrixcrm.yaml#
$schema: http://devicetree.org/meta-schemas/core.yaml#

title: ZTE zx297520v3 SoC matrix clock and reset controller

maintainers:
  - Stefan Dösinger <stefandoesinger@gmail.com>

description: |
  This controller contains clock and reset controls for high speed devices on
  the zx297520v3 board: The CPU, RAM, SDIO and Ethernet clocks and resets are
  found here. This controller requires PLL-generated clocks from Topcrm as well
  as the fixed 26 MHz and 32 kHz oscillators found on this board.

  This controller also contains hardware mutex registers for synchronization
  with different processors on this board.

  An additional curiosity are registers that allow setting (but not reading) the
  ARM architected timer's CNTVAL. This is not exposed in the binding because
  there shouldn't be a need to access it.

  All available clocks are defined as preprocessor macros in the
  "include/dt-bindings/clock/zte,zx297520v3-clk.h" header. Resets are defined in
  the "include/dt-bindings/reset/zte,zx297520v3-reset.h" header.

properties:
  compatible:
    const: zte,zx297520v3-matrixcrm

  reg:
    maxItems: 1

  clocks:
    items:
      - description: 26 MHz external oscillator
      - description: 32 kHz external oscillator
      - description: AHB clock from topcrm
      - description: Main PLL output from topcrm (usually 624 MHz)
      - description: Main PLL subdivision factor 5
      - description: Dpll output from topcrm (usually 491.52 MHz)
      - description: Gpll output from topcrm (usually 200 MHz)
      - description: Gpll subdivision factor 2
      - description: osc26m work clock from topcrm

  clock-names:
    items:
      - const: osc26m
      - const: osc32k
      - const: ahb
      - const: mpll
      - const: mpll-d5
      - const: dpll
      - const: gpll
      - const: gpll-d2
      - const: wclk-osc26m

  "#clock-cells":
    const: 1

  "#hwlock-cells":
    const: 1

  "#reset-cells":
    const: 1

required:
  - compatible
  - reg
  - clocks
  - clock-names
  - "#clock-cells"
  - "#hwlock-cells"
  - "#reset-cells"

additionalProperties: false

examples:
  - |
    #include <dt-bindings/clock/zte,zx297520v3-clk.h>
    #include <dt-bindings/reset/zte,zx297520v3-reset.h>

    clock-controller@1306000 {
        compatible = "zte,zx297520v3-matrixcrm";
        reg = <0x01306000 0x400>;
        #clock-cells = <1>;
        clocks = <&osc26m>, <&osc32k>, <&topcrm ZX297520V3_AHB_PCLK>,
                 <&topcrm ZX297520V3_MPLL>, <&topcrm ZX297520V3_MPLL_D5>,
                 <&topcrm ZX297520V3_DPLL>, <&topcrm ZX297520V3_GPLL>,
                 <&topcrm ZX297520V3_GPLL_D2>,
                 <&topcrm ZX297520V3_GATED_OSC26M>;
        clock-names = "osc26m", "osc32k", "ahb", "mpll", "mpll-d5", "dpll",
                      "gpll", "gpll-d2", "wclk-osc26m";
        #hwlock-cells = <1>;
        #reset-cells = <1>;
    };
```

## Documentation/devicetree/bindings/clock/zte,zx297520v3-topcrm.yaml
```yaml
# SPDX-License-Identifier: (GPL-2.0-only OR BSD-2-Clause)
%YAML 1.2
---
$id: http://devicetree.org/schemas/clock/zte,zx297520v3-topcrm.yaml#
$schema: http://devicetree.org/meta-schemas/core.yaml#

title: ZTE zx297520v3 SoC top clock and reset controller

maintainers:
  - Stefan Dösinger <stefandoesinger@gmail.com>

description: |
  The zx297520v3 top clock and reset controller generates clocks for core
  devices on the board like the main bus, USB and timers. In addition to clocks
  it has reset controls for peripherals, a global board reset, watchdog reset
  controls and a USB status register.

  The controller has two clock inputs: a 26 MHz and a 32 kHz external
  oscillator. They need to be provided as input clocks. The controller provides
  PLL output frequencies to downstream clock controllers.

  The USB PHY is exposed as two PHYs, one for USB and another for HSIC. Note
  that while the controls for both PHYs are always present, the PHYs themselves
  may be absent. If this is the case the controller never signals that the
  missing PHY is ready.

  All available clocks are defined as preprocessor macros in the
  "include/dt-bindings/clock/zte,zx297520v3-clk.h" header. The resets are
  defined in the "include/dt-bindings/reset/zte,zx297520v3-reset.h" header. PHY
  defines are found in "include/dt-bindings/phy/zte,zx297520v3-topcrm.h".

properties:
  compatible:
    items:
      - const: zte,zx297520v3-topcrm
      - const: syscon

  reg:
    maxItems: 1

  clocks:
    items:
      - description: 26 MHz external oscillator
      - description: 32 kHz external oscillator

  clock-names:
    items:
      - const: osc26m
      - const: osc32k

  interrupts:
    items:
      - description: IRQ reporting USB connection
      - description: IRQ reporting USB disconnection
      - description: IRQ reporting HSIC connection
      - description: IRQ reporting HSIC disconnection

  interrupt-names:
    items:
      - const: usb-up
      - const: usb-down
      - const: hsic-up
      - const: hsic-down

  "#clock-cells":
    const: 1

  "#phy-cells":
    const: 1

  "#reset-cells":
    const: 1

  reboot:
    type: object
    $ref: /schemas/power/reset/syscon-reboot.yaml#
    unevaluatedProperties: false
    description:
      Reboot method for the SoC.

required:
  - compatible
  - reg
  - clocks
  - clock-names
  - interrupts
  - interrupt-names
  - reboot
  - "#clock-cells"
  - "#phy-cells"
  - "#reset-cells"

additionalProperties: false

examples:
  - |
    #include <dt-bindings/interrupt-controller/arm-gic.h>
    #include <dt-bindings/reset/zte,zx297520v3-reset.h>
    #include <dt-bindings/phy/zte,zx297520v3-topcrm.h>
    #include <dt-bindings/clock/zte,zx297520v3-clk.h>

    clock-controller@13b000 {
        compatible = "zte,zx297520v3-topcrm", "syscon";
        reg = <0x0013b000 0x400>;
        #clock-cells = <1>;
        clocks = <&osc26m>, <&osc32k>;
        clock-names = "osc26m", "osc32k";
        interrupts = <GIC_SPI 42 IRQ_TYPE_EDGE_RISING>,
                     <GIC_SPI 43 IRQ_TYPE_EDGE_RISING>,
                     <GIC_SPI 45 IRQ_TYPE_EDGE_RISING>,
                     <GIC_SPI 46 IRQ_TYPE_EDGE_RISING>;
        interrupt-names = "usb-up", "usb-down", "hsic-up", "hsic-down";
        #phy-cells = <1>;
        #reset-cells = <1>;

        reboot {
          compatible = "syscon-reboot";
          mask = <0x1>;
          offset = <0x0>;
          value = <0x1>;
        };
    };
```

## Documentation/devicetree/bindings/display/bridge/analogix,dp.yaml
```yaml
# SPDX-License-Identifier: GPL-2.0
%YAML 1.2
---
$id: http://devicetree.org/schemas/display/bridge/analogix,dp.yaml#
$schema: http://devicetree.org/meta-schemas/core.yaml#

title: Analogix Display Port bridge

maintainers:
  - Rob Herring <robh@kernel.org>

properties:
  reg:
    maxItems: 1

  interrupts:
    maxItems: 1

  clocks: true

  clock-names: true

  phys: true

  phy-names:
    const: dp

  force-hpd:
    type: boolean
    description:
      Indicate driver need force hpd when hpd detect failed, this
      is used for some eDP screen which don not have a hpd signal.

  hpd-gpios:
    description:
      Hotplug detect GPIO.
      Indicates which GPIO should be used for hotplug detection

  ports:
    $ref: /schemas/graph.yaml#/properties/ports

    properties:
      port@0:
        $ref: /schemas/graph.yaml#/properties/port
        description: Input node to receive pixel data.

      port@1:
        $ref: /schemas/graph.yaml#/$defs/port-base
        unevaluatedProperties: false
        description: Port node with one endpoint connected to sink device node.
        properties:
          endpoint:
            $ref: /schemas/media/video-interfaces.yaml#
            unevaluatedProperties: false
            properties:
              data-lanes:
                minItems: 1
                maxItems: 4
                items:
                  enum: [ 0, 1, 2, 3 ]

    required:
      - port@0
      - port@1

required:
  - reg
  - interrupts
  - clock-names
  - clocks
  - ports

additionalProperties: true
```

## Documentation/devicetree/bindings/display/bridge/renesas,r8a779g0-dsc.yaml
```yaml
# SPDX-License-Identifier: (GPL-2.0-only OR BSD-2-Clause)
%YAML 1.2
---
$id: http://devicetree.org/schemas/display/bridge/renesas,r8a779g0-dsc.yaml#
$schema: http://devicetree.org/meta-schemas/core.yaml#

title: Renesas R-Car DSC Display Stream Compression

maintainers:
  - Marek Vasut <marek.vasut+renesas@mailbox.org>

description: |
  This binding describes the VESA DSC Display Stream Compression encoder
  embedded in the Renesas R-Car V4H SoC. The encoder supports all DSC1.1
  encoding mechanisms, configurable bits-per-pixel, resolution up to 8k.

properties:
  compatible:
    const: renesas,r8a779g0-dsc

  reg:
    maxItems: 1

  clocks:
    maxItems: 1

  interrupts:
    maxItems: 1

  power-domains:
    maxItems: 1

  resets:
    maxItems: 1

  ports:
    $ref: /schemas/graph.yaml#/properties/ports

    properties:
      port@0:
        $ref: /schemas/graph.yaml#/properties/port
        description: R-Car DU input port

      port@1:
        $ref: /schemas/graph.yaml#/properties/port
        description: R-Car DSI output port

    required:
      - port@0
      - port@1

required:
  - compatible
  - reg
  - clocks
  - interrupts
  - power-domains
  - resets
  - ports

unevaluatedProperties: false

examples:
  - |
    #include <dt-bindings/clock/r8a779g0-cpg-mssr.h>
    #include <dt-bindings/interrupt-controller/arm-gic.h>
    #include <dt-bindings/power/r8a779g0-sysc.h>

    bridge@feb8d000 {
        compatible = "renesas,r8a779g0-dsc";
        reg = <0xfeb8d000 0x400>;
        interrupts = <GIC_SPI 559 IRQ_TYPE_LEVEL_HIGH>;
        clocks = <&cpg CPG_MOD 2819>;
        power-domains = <&sysc R8A779G0_PD_ALWAYS_ON>;
        resets = <&cpg 2819>;

        ports {
            #address-cells = <1>;
            #size-cells = <0>;

            port@0 {
                reg = <0>;
                dsc_in_dsi1: endpoint {
                    remote-endpoint = <&du_out_dsi1>;
                };
            };

            port@1 {
                reg = <1>;
                dsc_out_dsi1: endpoint {
                    remote-endpoint = <&dsi1_in>;
                };
            };
        };
    };
...
```

## Documentation/devicetree/bindings/display/bridge/renesas,r9a08g046-lvds.yaml
```yaml
# SPDX-License-Identifier: (GPL-2.0-only OR BSD-2-Clause)
%YAML 1.2
---
$id: http://devicetree.org/schemas/display/bridge/renesas,r9a08g046-lvds.yaml#
$schema: http://devicetree.org/meta-schemas/core.yaml#

title: Renesas RZ/G3L LVDS Encoder

maintainers:
  - Biju Das <biju.das.jz@bp.renesas.com>
  - Tommaso Merciai <tommaso.merciai.xr@bp.renesas.com>

description: |
  This binding describes the LVDS encoder embedded in the Renesas RZ/G3L
  SoC. The encoder can operate in LVDS Single-link mode with 4 lanes
  (Data) + 1 lane (Clock).

properties:
  compatible:
    const: renesas,r9a08g046-lvds

  reg:
    maxItems: 1

  clocks:
    items:
      - description: Peripheral clock
      - description: PHY clock
      - description: Dot clock

  clock-names:
    items:
      - const: pclk
      - const: phyclk
      - const: dotclk

  resets:
    items:
      - description: LVDS_RESET_N
      - description: MIPI_DSI_PRESET_N
      - description: MIPI_DSI_CMN_RSTB
      - description: MIPI_DSI_ARESET_N

  reset-names:
    items:
      - const: lvdrst
      - const: prst
      - const: rst
      - const: arst

  power-domains:
    maxItems: 1

  ports:
    $ref: /schemas/graph.yaml#/properties/ports

    properties:
      port@0:
        $ref: /schemas/graph.yaml#/properties/port
        description: Input channel, directly connected to the Display Unit.

      port@1:
        $ref: /schemas/graph.yaml#/properties/port
        description: |
          Output channel, directly connected to the LVDS panel or bridge.

    required:
      - port@0
      - port@1

required:
  - compatible
  - reg
  - clocks
  - clock-names
  - resets
  - reset-names
  - power-domains
  - ports

additionalProperties: false

examples:
  - |
    #include <dt-bindings/clock/renesas,r9a08g046-cpg.h>

    lvds@108a0000 {
        compatible = "renesas,r9a08g046-lvds";
        reg = <0x108a0000 0x10000>;
        clocks = <&cpg CPG_MOD R9A08G046_MIPI_DSI_PCLK>,
                 <&cpg CPG_MOD R9A08G046_LVDS_PLLCLK>,
                 <&cpg CPG_MOD R9A08G046_LVDS_CLK_DOT0>;
        clock-names = "pclk", "phyclk", "dotclk";
        resets = <&cpg R9A08G046_LVDS_RESET_N>,
                 <&cpg R9A08G046_MIPI_DSI_PRESET_N>,
                 <&cpg R9A08G046_MIPI_DSI_CMN_RSTB>,
                 <&cpg R9A08G046_MIPI_DSI_ARESET_N>;
        reset-names = "lvdrst", "prst", "rst", "arst";
        power-domains = <&cpg>;

        ports {
            #address-cells = <1>;
            #size-cells = <0>;

            port@0 {
                reg = <0>;
                lvds0_in: endpoint {
                    remote-endpoint = <&du_out_lvds0>;
                };
            };

            port@1 {
                reg = <1>;
                lvds0_out: endpoint {
                    remote-endpoint = <&panel_in>;
                };
            };
        };
    };
...
```

## Documentation/devicetree/bindings/display/hisilicon/hisilicon,hi6220-ade.yaml
```yaml
# SPDX-License-Identifier: (GPL-2.0-only OR BSD-2-Clause)
%YAML 1.2
---
$id: http://devicetree.org/schemas/display/hisilicon/hisilicon,hi6220-ade.yaml#
$schema: http://devicetree.org/meta-schemas/core.yaml#

title: Hisilicon ADE Display Controller

maintainers:
  - Xinliang Liu <z.liuxinliang@hisilicon.com>

description:
  ADE (Advanced Display Engine) is the display controller which grab image
  data from memory, do composition, do post image processing, generate RGB
  timing stream and transfer to DSI.

properties:
  compatible:
    const: hisilicon,hi6220-ade

  reg:
    maxItems: 1

  reg-names:
    items:
      - const: ade_base

  clocks:
    maxItems: 3

  clock-names:
    items:
      - const: clk_ade_core
      - const: clk_codec_jpeg
      - const: clk_ade_pix

  dma-coherent: true

  interrupts:
    items:
      - description: LDI vblank interrupt specifier.

  resets:
    maxItems: 1

  hisilicon,noc-syscon:
    description: ADE NOC QoS syscon.
    $ref: /schemas/types.yaml#/definitions/phandle

  port:
    $ref: /schemas/graph.yaml#/properties/port
    description: Output port containing an endpoint subnode.

required:
  - compatible
  - reg
  - reg-names
  - clocks
  - clock-names
  - interrupts
  - resets
  - hisilicon,noc-syscon
  - port

additionalProperties: false

examples:
  - |
    #include <dt-bindings/clock/hi6220-clock.h>
    #include <dt-bindings/reset/hisi,hi6220-resets.h>

    bus {
        #address-cells = <2>;
        #size-cells = <2>;

        ade@f4100000 {
            compatible = "hisilicon,hi6220-ade";
            reg = <0x0 0xf4100000 0x0 0x7800>;
            reg-names = "ade_base";
            clocks = <&media_ctrl HI6220_ADE_CORE>,
                     <&media_ctrl HI6220_CODEC_JPEG>,
                     <&media_ctrl HI6220_ADE_PIX_SRC>;
            clock-names = "clk_ade_core", "clk_codec_jpeg", "clk_ade_pix";
            dma-coherent;
            interrupts = <0 115 4>;
            resets = <&media_ctrl MEDIA_ADE>;
            hisilicon,noc-syscon = <&medianoc_ade>;

            port {
                endpoint {
                    remote-endpoint = <&dsi_in>;
                };
            };
        };
    };
```
