## Documentation/devicetree/bindings/dma/ti,dra7-dma-crossbar.yaml
```yaml
# SPDX-License-Identifier: (GPL-2.0-only OR BSD-2-Clause)
%YAML 1.2
---
$id: http://devicetree.org/schemas/dma/ti,dra7-dma-crossbar.yaml#
$schema: http://devicetree.org/meta-schemas/core.yaml#

title: Texas Instruments DMA Crossbar (DMA request router)

maintainers:
  - Vignesh Raghavendra <vigneshr@ti.com>
  - Bhargav Joshi <j.bhargav.u@gmail.com>

description:
  When requesting channel via ti,dra7-dma-crossbar, the DMA client must request
  the DMA event number as crossbar ID (input to the DMA crossbar). For
  ti,am335x-edma-crossbar the meaning of parameters of dmas for clients dmas =
  <&edma_xbar 12 0 1>; where <12> is the DMA request number, <0> is the TC the
  event should be assigned and <1> is the mux selection for in the crossbar.
  When mux 0 is used the DMA channel can be requested directly from edma node.

properties:
  compatible:
    enum:
      - ti,dra7-dma-crossbar
      - ti,am335x-edma-crossbar

  reg:
    maxItems: 1

  "#dma-cells":
    minimum: 1
    maximum: 3

  dma-requests:
    minimum: 1
    maximum: 256

  dma-masters:
    maxItems: 1

  ti,dma-safe-map:
    $ref: /schemas/types.yaml#/definitions/uint32
    description: Safe routing value for unused request lines

  ti,reserved-dma-request-ranges:
    $ref: /schemas/types.yaml#/definitions/uint32-matrix
    description:
      DMA request ranges which should not be used when mapping xbar input to
      DMA request, they are either allocated to be used by for example the DSP
      or they are used as memcpy channels in eDMA.
    items:
      items:
        - description: starting DMA request line number
        - description: number of consecutive lines to reserve

required:
  - compatible
  - reg
  - "#dma-cells"
  - dma-requests
  - dma-masters

allOf:
  - $ref: dma-router.yaml#

  - if:
      properties:
        compatible:
          contains:
            const: ti,am335x-edma-crossbar
    then:
      properties:
        "#dma-cells":
          const: 3

    else:
      properties:
        "#dma-cells":
          enum: [1, 2]

unevaluatedProperties: false

examples:
  - |
    dma-router@4a002b78 {
        compatible = "ti,dra7-dma-crossbar";
        reg = <0x4a002b78 0xfc>;
        #dma-cells = <1>;
        dma-requests = <205>;
        ti,dma-safe-map = <0>;
        /* Protect the sDMA request ranges: 10-14 and 100-126 */
        ti,reserved-dma-request-ranges = <10 5>, <100 27>;
        dma-masters = <&sdma>;
    };
```

## Documentation/devicetree/bindings/dma/ti/ti,cppi41.yaml
```yaml
# SPDX-License-Identifier: (GPL-2.0-only OR BSD-2-Clause)
%YAML 1.2
---
$id: http://devicetree.org/schemas/dma/ti/ti,cppi41.yaml#
$schema: http://devicetree.org/meta-schemas/core.yaml#

title: TI CPPI41 DMA Controller

maintainers:
  - Sebastian Andrzej Siewior <bigeasy@linutronix.de>

properties:
  compatible:
    enum:
      - ti,am3359-cppi41
      - ti,da830-cppi41

  reg:
    minItems: 3
    maxItems: 4

  reg-names:
    minItems: 3
    maxItems: 4

  interrupts:
    maxItems: 1

  interrupt-names:
    const: glue

  "#dma-cells":
    const: 2

  dma-channels:
    description: Number of DMA channels supported.
    $ref: /schemas/types.yaml#/definitions/uint32

  dma-requests:
    description: Number of DMA requests supported.
    $ref: /schemas/types.yaml#/definitions/uint32

  power-domains:
    maxItems: 1

  "#dma-channels":
    description: Deprecated, use dma-channels instead.
    deprecated: true

  "#dma-requests":
    description: Deprecated, use dma-requests instead.
    deprecated: true

required:
  - compatible
  - reg
  - reg-names
  - "#dma-cells"
  - dma-channels

allOf:
  - $ref: /schemas/dma/dma-controller.yaml#
  - if:
      properties:
        compatible:
          contains:
            const: ti,am3359-cppi41
    then:
      properties:
        reg:
          minItems: 4
        reg-names:
          items:
            - const: glue
            - const: controller
            - const: scheduler
            - const: queuemgr
        power-domains: false
      required:
        - interrupt-names
        - interrupts
        - dma-requests
    else:
      properties:
        reg:
          maxItems: 3
        reg-names:
          items:
            - const: controller
            - const: scheduler
            - const: queuemgr

unevaluatedProperties: false

examples:
  - |
    dma-controller@7402000 {
        compatible = "ti,am3359-cppi41";
        reg = <0x47400000 0x1000>,
              <0x47402000 0x1000>,
              <0x47403000 0x1000>,
              <0x47404000 0x4000>;
        reg-names = "glue", "controller", "scheduler", "queuemgr";
        interrupts = <17>;
        interrupt-names = "glue";
        #dma-cells = <2>;
        dma-channels = <30>;
        dma-requests = <256>;
    };
```

## Documentation/devicetree/bindings/gpio/axiado,ax3005-sgpio.yaml
```yaml
# SPDX-License-Identifier: (GPL-2.0-only OR BSD-2-Clause)
%YAML 1.2
---
$id: http://devicetree.org/schemas/gpio/axiado,ax3005-sgpio.yaml#
$schema: http://devicetree.org/meta-schemas/core.yaml#

title: Axiado AX3005 SGPIO Controller

maintainers:
  - Petar Stepanovic <pstepanovic@axiado.com>
  - SriNavmani A <srinavmani@axiado.com>
  - Prasad Bolisetty <pbolisetty@axiado.com>

description: |
  The Axiado SGPIO controller provides a serial GPIO expansion interface
  that multiplexes multiple GPIO signals over a small set of physical lines.

  The controller serializes output values on a data output line (DOUT) and
  samples input values from a data input line (DIN) in synchronization with
  a shift clock (SCLK). A latch signal (LATCH) updates the output states
  after each transfer cycle.

  SGPIO positions are organized in banks of 32, with registers controlling
  output values, input sampling, and interrupt status. The number of SGPIO
  positions supported depends on the controller configuration.

  The controller detects changes on input GPIOs. Interrupt events are
  aggregated and signaled through a single interrupt line to the parent
  interrupt controller.

  Register access is performed over the APB bus. The SGPIO shift clock is
  derived from the APB clock using a programmable divider.

  Each SGPIO position provides one input and one output, and both are
  exposed as GPIO lines. Position N is described by two consecutive lines:
  line 2 * N is the input and line 2 * N + 1 is the output. Directions are
  fixed by the hardware, so even lines are always inputs and odd lines are
  always outputs.

  Only input lines can generate interrupts. Rising, falling, and both-edge
  interrupts are supported.

properties:
  compatible:
    const: axiado,ax3005-sgpio

  reg:
    maxItems: 1

  clocks:
    description: APB interface clock
    maxItems: 1

  bus-frequency:
    description: Desired SGPIO shift clock frequency in Hz
    minimum: 1

  gpio-controller: true

  '#gpio-cells':
    const: 2

  interrupt-controller: true

  '#interrupt-cells':
    const: 2

  interrupts:
    maxItems: 1

  ngpios:
    description: |
      Total number of GPIO lines provided by the controller. Each SGPIO
      position wired up on the board contributes one input and one output
      line, so this is twice the number of positions and must be even. It
      may be lower than the maximum supported by the hardware.
    minimum: 2
    maximum: 1024
    multipleOf: 2

required:
  - compatible
  - reg
  - clocks
  - bus-frequency
  - gpio-controller
  - '#gpio-cells'
  - interrupts
  - interrupt-controller
  - '#interrupt-cells'
  - ngpios

additionalProperties: false

examples:
  - |
    #include <dt-bindings/interrupt-controller/arm-gic.h>
    #include <dt-bindings/interrupt-controller/irq.h>

    gpio@33201c00 {
        compatible = "axiado,ax3005-sgpio";
        reg = <0x33201c00 0x400>;
        clocks = <&apb_clk>;
        bus-frequency = <1000000>;
        gpio-controller;
        #gpio-cells = <2>;
        interrupt-controller;
        #interrupt-cells = <2>;
        interrupt-parent = <&gic500>;
        interrupts = <GIC_SPI 125 IRQ_TYPE_LEVEL_HIGH>;
        ngpios = <256>;
    };
```

## Documentation/devicetree/bindings/gpio/fsl,mpc8323-qe-pario-bank.yaml
```yaml
# SPDX-License-Identifier: (GPL-2.0-only OR BSD-2-Clause)
%YAML 1.2
---
$id: http://devicetree.org/schemas/gpio/fsl,mpc8323-qe-pario-bank.yaml#
$schema: http://devicetree.org/meta-schemas/core.yaml#

title: Freescale QUICC Engine Parallel I/O (QE PARIO) GPIO Bank

maintainers:
  - Christophe Leroy <christophe.leroy@csgroup.eu>

properties:
  compatible:
    oneOf:
      - items:
          - enum:
              - fsl,mpc8360-qe-pario-bank
              - fsl,mpc8569-qe-pario-bank
          - const: fsl,mpc8323-qe-pario-bank
      - const: fsl,mpc8323-qe-pario-bank

  reg:
    maxItems: 1

  gpio-controller: true

  "#gpio-cells":
    const: 2

  "#address-cells":
    const: 0

  "#interrupt-cells":
    const: 2

  interrupt-map:
    description: |
      Specifies the mapping of GPIO lines to the parent interrupt controller, as the
      GPIO controller does not do interrupt handling itself.

required:
  - compatible
  - reg
  - gpio-controller
  - "#gpio-cells"

additionalProperties: false

examples:
  - |
    #include <dt-bindings/interrupt-controller/irq.h>

    gpio-controller@1400 {
        compatible = "fsl,mpc8360-qe-pario-bank", "fsl,mpc8323-qe-pario-bank";
        reg = <0x1400 0x18>;
        gpio-controller;
        #gpio-cells = <2>;
    };

    gpio-controller@1418 {
        compatible = "fsl,mpc8323-qe-pario-bank";
        reg = <0x1418 0x18>;
        gpio-controller;
        #gpio-cells = <2>;
        #address-cells = <0>;
        #interrupt-cells = <2>;
        interrupt-map = <
          7 IRQ_TYPE_EDGE_FALLING  &pic 4 IRQ_TYPE_EDGE_FALLING
          7 IRQ_TYPE_EDGE_BOTH     &pic 4 IRQ_TYPE_EDGE_BOTH
          7 0                      &pic 4 IRQ_TYPE_NONE

          9 IRQ_TYPE_EDGE_FALLING  &pic 5 IRQ_TYPE_EDGE_FALLING
          9 IRQ_TYPE_EDGE_BOTH     &pic 5 IRQ_TYPE_EDGE_BOTH
          9 0                      &pic 5 IRQ_TYPE_NONE

          25 IRQ_TYPE_EDGE_FALLING &pic 6 IRQ_TYPE_EDGE_FALLING
          25 IRQ_TYPE_EDGE_BOTH    &pic 6 IRQ_TYPE_EDGE_BOTH
          25 0                     &pic 6 IRQ_TYPE_NONE

          27 IRQ_TYPE_EDGE_FALLING &pic 7 IRQ_TYPE_EDGE_FALLING
          27 IRQ_TYPE_EDGE_BOTH    &pic 7 IRQ_TYPE_EDGE_BOTH
          27 0                     &pic 7 IRQ_TYPE_NONE
        >;
    };
```

## Documentation/devicetree/bindings/hwmon/adi,adt7470.yaml
```yaml
# SPDX-License-Identifier: (GPL-2.0 OR BSD-2-Clause)
%YAML 1.2
---
$id: http://devicetree.org/schemas/hwmon/adi,adt7470.yaml#
$schema: http://devicetree.org/meta-schemas/core.yaml#

title: Analog Devices ADT7470 hwmon sensor

maintainers:
  - Luiz Angelo Daros de Luca <luizluca@gmail.com>

description:
  Multi-channel temperature monitor and PWM fan controller.
  It supports monitoring up to 10 external temperature sensors and
  controlling up to 4 fans. The fan control lines are modeled
  as standard PWM channels.

properties:
  compatible:
    const: adi,adt7470

  reg:
    maxItems: 1

  "#pwm-cells":
    const: 3

  "#thermal-sensor-cells":
    const: 1
    description:
      Valid index values are 0 to 9, corresponding to temp1 through temp10.

required:
  - compatible
  - reg

allOf:
  - if:
      required:
        - "#thermal-sensor-cells"
    then:
      $ref: /schemas/thermal/thermal-sensor.yaml#

unevaluatedProperties: false

examples:
  - |
    i2c {
        #address-cells = <1>;
        #size-cells = <0>;

        hwmon@2f {
            compatible = "adi,adt7470";
            reg = <0x2f>;
            #pwm-cells = <3>;
            #thermal-sensor-cells = <1>;
        };
    };
```

## Documentation/devicetree/bindings/hwmon/axiado,ax3000-pwm-fan.yaml
```yaml
# SPDX-License-Identifier: (GPL-2.0-only OR BSD-2-Clause)
%YAML 1.2
---
$id: http://devicetree.org/schemas/hwmon/axiado,ax3000-pwm-fan.yaml#
$schema: http://devicetree.org/meta-schemas/core.yaml#

title: Axiado AX3000 and AX3005 PWM Fan Controller

maintainers:
  - Petar Stepanovic <pstepanovic@axiado.com>
  - Akhila Kavi <akavi@axiado.com>
  - Prasad Bolisetty <pbolisetty@axiado.com>

description:
  The Axiado AX3000 and AX3005 fan controllers use a hardware tachometer
  block to measure fan speed. Fan speed is controlled through a PWM signal
  supplied by an external PWM controller.

properties:
  compatible:
    oneOf:
      - const: axiado,ax3000-pwm-fan
      - items:
          - const: axiado,ax3005-pwm-fan
          - const: axiado,ax3000-pwm-fan

  reg:
    maxItems: 1

  interrupts:
    maxItems: 1

  clocks:
    maxItems: 1

  fan:
    type: object
    $ref: fan-common.yaml#
    unevaluatedProperties: false
    properties:
      pulses-per-revolution:
        minimum: 1
        default: 2

    required:
      - pwms

required:
  - compatible
  - reg
  - interrupts
  - clocks
  - fan

additionalProperties: false

examples:
  - |
    #include <dt-bindings/interrupt-controller/arm-gic.h>

    fan-controller@33001400 {
        compatible = "axiado,ax3000-pwm-fan";
        reg = <0x33001400 0x400>;
        interrupts = <GIC_SPI 150 IRQ_TYPE_LEVEL_HIGH>;
        clocks = <&clk>;

        fan {
            pwms = <&pwm0 0 400>;
            pulses-per-revolution = <2>;
        };
    };
...
```

## Documentation/devicetree/bindings/hwmon/axiado,ax3000-tsadc.yaml
```yaml
# SPDX-License-Identifier: (GPL-2.0-only OR BSD-2-Clause)
%YAML 1.2
---
$id: http://devicetree.org/schemas/hwmon/axiado,ax3000-tsadc.yaml#
$schema: http://devicetree.org/meta-schemas/core.yaml#

title: Axiado AX3000 and AX3005 TSADC

maintainers:
  - Petar Stepanovic <pstepanovic@axiado.com>
  - Akhila Kavi <akavi@axiado.com>
  - Prasad Bolisetty <pbolisetty@axiado.com>

description: |
  The Axiado AX3000 and AX3005 Temperature Sensor ADC (TSADC) controllers
  monitor the on-die temperature of the SoC.

properties:
  compatible:
    oneOf:
      - const: axiado,ax3000-tsadc
      - items:
          - const: axiado,ax3005-tsadc
          - const: axiado,ax3000-tsadc

  reg:
    maxItems: 1

  clocks:
    maxItems: 1

required:
  - compatible
  - reg
  - clocks

additionalProperties: false

examples:
  - |
    temperature-sensor@33021000 {
        compatible = "axiado,ax3000-tsadc";
        reg = <0x33021000 0x100>;
        clocks = <&refclk>;
    };
```

## Documentation/devicetree/bindings/hwmon/hpe,gxp-fan-ctrl.yaml
```yaml
# SPDX-License-Identifier: (GPL-2.0-only OR BSD-2-Clause)
%YAML 1.2
---
$id: http://devicetree.org/schemas/hwmon/hpe,gxp-fan-ctrl.yaml#
$schema: http://devicetree.org/meta-schemas/core.yaml#

title: HPE GXP Fan Controller

maintainers:
  - Nick Hawkins <nick.hawkins@hpe.com>

description: |
  The HPE GXP fan controller controls the fans through an external CPLD
  device that connects to the fans.

properties:
  compatible:
    const: hpe,gxp-fan-ctrl

  reg:
    description: Fan controller PWM
    maxItems: 1

required:
  - compatible
  - reg

additionalProperties: false

examples:
  - |
    fan-controller@1000c00 {
      compatible = "hpe,gxp-fan-ctrl";
      reg = <0x1000c00 0x200>;
    };
```
