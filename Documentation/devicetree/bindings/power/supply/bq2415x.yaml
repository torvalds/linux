## Documentation/devicetree/bindings/power/supply/bq27xxx.yaml
```yaml
# SPDX-License-Identifier: GPL-2.0
# Copyright (C) 2020 Texas Instruments Incorporated
%YAML 1.2
---
$id: http://devicetree.org/schemas/power/supply/bq27xxx.yaml#
$schema: http://devicetree.org/meta-schemas/core.yaml#

title: TI BQ27XXX fuel gauge family

maintainers:
  - Pali Rohár <pali@kernel.org>
  - Andrew F. Davis <afd@ti.com>
  - Sebastian Reichel <sre@kernel.org>

description: |
  Support various Texas Instruments fuel gauge devices that share similar
  register maps and power supply properties

allOf:
  - $ref: power-supply.yaml#

properties:
  compatible:
    enum:
      - ti,bq27200
      - ti,bq27210
      - ti,bq27500 # deprecated, use revision specific property below
      - ti,bq27510 # deprecated, use revision specific property below
      - ti,bq27520 # deprecated, use revision specific property below
      - ti,bq27500-1
      - ti,bq27510g1
      - ti,bq27510g2
      - ti,bq27510g3
      - ti,bq27520g1
      - ti,bq27520g2
      - ti,bq27520g3
      - ti,bq27520g4
      - ti,bq27521
      - ti,bq27530
      - ti,bq27531
      - ti,bq27541
      - ti,bq27542
      - ti,bq27546
      - ti,bq27742
      - ti,bq27545
      - ti,bq27411
      - ti,bq27421
      - ti,bq27425
      - ti,bq27426
      - ti,bq27441
      - ti,bq27621
      - ti,bq27z561
      - ti,bq28z610
      - ti,bq34z100
      - ti,bq78z100

  reg:
    maxItems: 1
    description: integer, I2C address of the fuel gauge.

  monitored-battery:
    description: |
       The fuel gauge uses the following battery properties:
       - energy-full-design-microwatt-hours
       - charge-full-design-microamp-hours
       - voltage-min-design-microvolt
       Both or neither of the *-full-design-*-hours properties must be set.

  power-supplies: true

required:
  - compatible
  - reg
additionalProperties: false

examples:
  - |
    i2c0 {
      #address-cells = <1>;
      #size-cells = <0>;
      bat: battery {
        compatible = "simple-battery";
        voltage-min-design-microvolt = <3200000>;
        energy-full-design-microwatt-hours = <5290000>;
        charge-full-design-microamp-hours = <1430000>;
      };

      bq27510g3: fuel-gauge@55 {
        compatible = "ti,bq27510g3";
        reg = <0x55>;
        monitored-battery = <&bat>;
      };
    };
```

## Documentation/devicetree/bindings/power/supply/charger-manager.txt
```
charger-manager bindings
~~~~~~~~~~~~~~~~~~~~~~~~

Required properties :
 - compatible : "charger-manager"
 - <>-supply : for regulator consumer, named according to cm-regulator-name
 - cm-chargers : name of chargers
 - cm-fuel-gauge : name of battery fuel gauge
 - subnode <regulator> :
	- cm-regulator-name : name of charger regulator
	- subnode <cable> :
		- cm-cable-name : name of charger cable - one of USB, USB-HOST,
			SDP, DCP, CDP, ACA, FAST-CHARGER, SLOW-CHARGER, WPT,
			PD, DOCK, JIG, or MECHANICAL
		- cm-cable-extcon : name of extcon dev
(optional)	- cm-cable-min : minimum current of cable
(optional)	- cm-cable-max : maximum current of cable

Optional properties :
 - cm-name : charger manager's name (default : "battery")
 - cm-poll-mode : polling mode - 0 for disabled, 1 for always, 2 for when
	external power is connected, or 3 for when charging.  If not present,
	then polling is disabled
 - cm-poll-interval : polling interval (in ms)
 - cm-battery-stat : battery status - 0 for battery always present, 1 for no
	battery, 2 to check presence via fuel gauge, or 3 to check presence
	via charger
 - cm-fullbatt-vchkdrop-volt : voltage drop (in uV) before restarting charging
 - cm-fullbatt-voltage : voltage (in uV) of full battery
 - cm-fullbatt-soc : state of charge to consider as full battery
 - cm-fullbatt-capacity : capcity (in uAh) to consider as full battery
 - cm-thermal-zone : name of external thermometer's thermal zone
 - cm-battery-* : threshold battery temperature for charging
	-cold : critical cold temperature of battery for charging
	-cold-in-minus : flag that cold temperature is in minus degrees
	-hot : critical hot temperature of battery for charging
	-temp-diff : temperature difference to allow recharging
 - cm-dis/charging-max = limits of charging duration

Deprecated properties:
 - cm-num-chargers
 - cm-fullbatt-vchkdrop-ms

Example :
	charger-manager@0 {
		compatible = "charger-manager";
		chg-reg-supply = <&charger_regulator>;

		cm-name = "battery";
		/* Always polling ON : 30s */
		cm-poll-mode = <1>;
		cm-poll-interval = <30000>;

		cm-fullbatt-vchkdrop-volt = <150000>;
		cm-fullbatt-soc = <100>;

		cm-battery-stat = <3>;

		cm-chargers = "charger0", "charger1", "charger2";

		cm-fuel-gauge = "fuelgauge0";

		cm-thermal-zone = "thermal_zone.1"
		/* in deci centigrade */
		cm-battery-cold = <50>;
		cm-battery-cold-in-minus;
		cm-battery-hot = <800>;
		cm-battery-temp-diff = <100>;

		/* Allow charging for 5hr */
		cm-charging-max = <18000000>;
		/* Allow discharging for 2hr */
		cm-discharging-max = <7200000>;

		regulator@0 {
			cm-regulator-name = "chg-reg";
			cable@0 {
				cm-cable-name = "USB";
				cm-cable-extcon = "extcon-dev.0";
				cm-cable-min = <475000>;
				cm-cable-max = <500000>;
			};
			cable@1 {
				cm-cable-name = "SDP";
				cm-cable-extcon = "extcon-dev.0";
				cm-cable-min = <650000>;
				cm-cable-max = <675000>;
			};
		};

	};
```

## Documentation/devicetree/bindings/power/supply/charger-manager.yaml
```yaml
# SPDX-License-Identifier: GPL-2.0
%YAML 1.2
---
$id: http://devicetree.org/schemas/power/supply/charger-manager.yaml#
$schema: http://devicetree.org/meta-schemas/core.yaml#

title: Charger Manager

maintainers:
  - Sebastian Reichel <sre@kernel.org>

description: |
  Binding for the legacy charger manager driver.
  Please do not use for new products.

properties:
  compatible:
    const: charger-manager

  cm-chargers:
    description: name of chargers
    $ref: /schemas/types.yaml#/definitions/string-array

  cm-num-chargers:
    $ref: /schemas/types.yaml#/definitions/uint32
    deprecated: true

  cm-fuel-gauge:
    description: name of battery fuel gauge
    $ref: /schemas/types.yaml#/definitions/string

  cm-name:
    description: name of the charger manager
    default: battery
    $ref: /schemas/types.yaml#/definitions/string

  cm-poll-mode:
    description: polling mode
    default: 0
    enum:
      - 0 # disabled
      - 1 # always
      - 2 # when external power is connected
      - 3 # when charging

  cm-poll-interval:
    description: polling interval (in ms)
    $ref: /schemas/types.yaml#/definitions/uint32

  cm-battery-stat:
    description: battery status
    enum:
      - 0 # battery always present
      - 1 # no battery
      - 2 # check presence via fuel gauge
      - 3 # check presence via charger

  cm-fullbatt-vchkdrop-volt:
    description: voltage drop before restarting charging in uV
    $ref: /schemas/types.yaml#/definitions/uint32

  cm-fullbatt-vchkdrop-ms:
    deprecated: true

  cm-fullbatt-voltage:
    description: voltage of full battery in uV
    $ref: /schemas/types.yaml#/definitions/uint32

  cm-fullbatt-soc:
    description: state of charge to consider as full battery in %
    $ref: /schemas/types.yaml#/definitions/uint32

  cm-fullbatt-capacity:
    description: capcity to consider as full battery in uAh
    $ref: /schemas/types.yaml#/definitions/uint32

  cm-thermal-zone:
    description: name of external thermometer's thermal zone
    $ref: /schemas/types.yaml#/definitions/string

  cm-discharging-max:
    description: limits of discharging duration in ms
    $ref: /schemas/types.yaml#/definitions/uint32

  cm-charging-max:
    description: limits of charging duration in ms
    $ref: /schemas/types.yaml#/definitions/uint32

  cm-battery-cold:
    description: critical cold temperature of battery for charging in deci-degree celsius
    $ref: /schemas/types.yaml#/definitions/uint32

  cm-battery-cold-in-minus:
    description: if set cm-battery-cold temperature is in minus degrees
    type: boolean

  cm-battery-hot:
    description: critical hot temperature of battery for charging in deci-degree celsius
    $ref: /schemas/types.yaml#/definitions/uint32

  cm-battery-temp-diff:
    description: temperature difference to allow recharging in deci-degree celsius
    $ref: /schemas/types.yaml#/definitions/uint32

patternProperties:
  "-supply$":
    description: regulator consumer, named according to cm-regulator-name
    $ref: /schemas/types.yaml#/definitions/phandle

  "^regulator[@-][0-9]$":
    type: object
    properties:
      cm-regulator-name:
        description: name of charger regulator
        $ref: /schemas/types.yaml#/definitions/string

    required:
      - cm-regulator-name

    additionalProperties: false

    patternProperties:
      "^cable[@-][0-9]$":
        type: object
        properties:
          cm-cable-name:
            description: name of charger cable
            enum:
              - USB
              - USB-HOST
              - SDP
              - DCP
              - CDP
              - ACA
              - FAST-CHARGER
              - SLOW-CHARGER
              - WPT
              - PD
              - DOCK
              - JIG
              - MECHANICAL

          cm-cable-extcon:
            description: name of extcon dev
            $ref: /schemas/types.yaml#/definitions/string

          cm-cable-min:
            description: minimum current of cable in uA
            $ref: /schemas/types.yaml#/definitions/uint32

          cm-cable-max:
            description: maximum current of cable in uA
            $ref: /schemas/types.yaml#/definitions/uint32

        required:
          - cm-cable-name
          - cm-cable-extcon

        additionalProperties: false

required:
  - compatible
  - cm-chargers
  - cm-fuel-gauge

additionalProperties: false

examples:
  - |
    charger-manager {
        compatible = "charger-manager";
        chg-reg-supply = <&charger_regulator>;

        cm-name = "battery";
        /* Always polling ON : 30s */
        cm-poll-mode = <1>;
        cm-poll-interval = <30000>;

        cm-fullbatt-vchkdrop-volt = <150000>;
        cm-fullbatt-soc = <100>;

        cm-battery-stat = <3>;

        cm-chargers = "charger0", "charger1", "charger2";

        cm-fuel-gauge = "fuelgauge0";

        cm-thermal-zone = "thermal_zone.1";
        /* in deci centigrade */
        cm-battery-cold = <50>;
        cm-battery-cold-in-minus;
        cm-battery-hot = <800>;
        cm-battery-temp-diff = <100>;

        /* Allow charging for 5hr */
        cm-charging-max = <18000000>;
        /* Allow discharging for 2hr */
        cm-discharging-max = <7200000>;

        regulator-0 {
            cm-regulator-name = "chg-reg";
            cable-0 {
                cm-cable-name = "USB";
                cm-cable-extcon = "extcon-dev.0";
                cm-cable-min = <475000>;
                cm-cable-max = <500000>;
            };
            cable-1 {
                cm-cable-name = "SDP";
                cm-cable-extcon = "extcon-dev.0";
                cm-cable-min = <650000>;
                cm-cable-max = <675000>;
            };
        };
    };
```

## Documentation/devicetree/bindings/power/supply/cpcap-battery.txt
```
Motorola CPCAP PMIC battery driver binding

Required properties:
- compatible: Shall be "motorola,cpcap-battery"
- interrupts: Interrupt specifier for each name in interrupt-names
- interrupt-names: Should contain the following entries:
		   "lowbph", "lowbpl", "chrgcurr1", "battdetb"
- io-channels: IIO ADC channel specifier for each name in io-channel-names
- io-channel-names: Should contain the following entries:
		    "battdetb", "battp", "chg_isense", "batti"

Example:

cpcap_battery: battery {
	compatible = "motorola,cpcap-battery";
	interrupts-extended = <
		&cpcap 5 0 &cpcap 3 0
		&cpcap 20 0 &cpcap 54 0
	>;
	interrupt-names =
		"lowbph", "lowbpl",
		"chrgcurr1", "battdetb";
	io-channels = <&cpcap_adc 0 &cpcap_adc 1
		       &cpcap_adc 5 &cpcap_adc 6>;
	io-channel-names = "battdetb", "battp",
			   "chg_isense", "batti";
};
```

## Documentation/devicetree/bindings/power/supply/cpcap-battery.yaml
```yaml
# SPDX-License-Identifier: GPL-2.0
# Copyright (C) 2021 Sebastian Reichel
%YAML 1.2
---
$id: http://devicetree.org/schemas/power/supply/cpcap-battery.yaml#
$schema: http://devicetree.org/meta-schemas/core.yaml#

title: Motorola CPCAP PMIC battery

maintainers:
  - Tony Lindgren <tony@atomide.com>
  - Sebastian Reichel <sre@kernel.org>

description: |
  Motorola CPCAP is a PMIC found in some mobile phones, e.g.
  the Droid 4. This binding describes its battery fuel gauge
  sub-function.

allOf:
  - $ref: power-supply.yaml#

properties:
  compatible:
    const: motorola,cpcap-battery

  interrupts:
    items:
      - description: eol interrupt
      - description: low battery percentage interrupt
      - description: critical battery percentage interrupt
      - description: charger detect interrupt
      - description: battery detect interrupt
      - description: coulomb counter calibration interrupt

  interrupt-names:
    items:
      - const: eol
      - const: lowbph
      - const: lowbpl
      - const: chrgcurr1
      - const: battdetb
      - const: cccal

  io-channels:
    items:
      - description: battery temperature
      - description: battery voltage
      - description: battery charge current
      - description: battery current

  io-channel-names:
    items:
      - const: battdetb
      - const: battp
      - const: chg_isense
      - const: batti

  power-supplies: true

required:
  - compatible
  - interrupts
  - interrupt-names
  - io-channels
  - io-channel-names
  - power-supplies

additionalProperties: false

examples:
  - |
    cpcap {
      battery {
        compatible = "motorola,cpcap-battery";
        interrupts-extended =
                <&cpcap 6 0>, <&cpcap 5 0>, <&cpcap 3 0>,
                <&cpcap 20 0>, <&cpcap 54 0>, <&cpcap 57 0>;
        interrupt-names =
                "eol", "lowbph", "lowbpl",
                "chrgcurr1", "battdetb", "cccal";
        io-channels = <&cpcap_adc 0>, <&cpcap_adc 1>,
                      <&cpcap_adc 5>, <&cpcap_adc 6>;
        io-channel-names = "battdetb", "battp",
                           "chg_isense", "batti";
        power-supplies = <&cpcap_charger>;
      };
    };
```

## Documentation/devicetree/bindings/power/supply/cpcap-charger.txt
```
Motorola CPCAP PMIC battery charger binding

Required properties:
- compatible: Shall be "motorola,mapphone-cpcap-charger"
- interrupts: Interrupt specifier for each name in interrupt-names
- interrupt-names: Should contain the following entries:
		   "chrg_det", "rvrs_chrg", "chrg_se1b", "se0conn",
		   "rvrs_mode", "chrgcurr2", "chrgcurr1", "vbusvld",
		   "battdetb"
- io-channels: IIO ADC channel specifier for each name in io-channel-names
- io-channel-names: Should contain the following entries:
		    "battdetb", "battp", "vbus", "chg_isense", "batti"

Optional properties:
- mode-gpios: Optionally CPCAP charger can have a companion wireless
	      charge controller that is controlled with two GPIOs
	      that are active low.

Example:

cpcap_charger: charger {
	compatible = "motorola,mapphone-cpcap-charger";
	interrupts-extended = <
		&cpcap 13 0 &cpcap 12 0 &cpcap 29 0 &cpcap 28 0
		&cpcap 22 0 &cpcap 21 0 &cpcap 20 0 &cpcap 19 0
		&cpcap 54 0
	>;
	interrupt-names =
		"chrg_det", "rvrs_chrg", "chrg_se1b", "se0conn",
		"rvrs_mode", "chrgcurr2", "chrgcurr1", "vbusvld",
		"battdetb";
	mode-gpios = <&gpio3 29 GPIO_ACTIVE_LOW
		      &gpio3 23 GPIO_ACTIVE_LOW>;
	io-channels = <&cpcap_adc 0 &cpcap_adc 1
		       &cpcap_adc 2 &cpcap_adc 5
		       &cpcap_adc 6>;
	io-channel-names = "battdetb", "battp",
			   "vbus", "chg_isense",
			   "batti";
};
```
