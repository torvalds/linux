## Documentation/devicetree/bindings/power/supply/bq2415x.yaml
```yaml
# SPDX-License-Identifier: GPL-2.0
# Copyright (C) 2021 Sebastian Reichel
%YAML 1.2
---
$id: http://devicetree.org/schemas/power/supply/bq2415x.yaml#
$schema: http://devicetree.org/meta-schemas/core.yaml#

title: Binding for TI bq2415x Li-Ion Charger

maintainers:
  - Sebastian Reichel <sre@kernel.org>

allOf:
  - $ref: power-supply.yaml#

properties:
  compatible:
    enum:
      - ti,bq24150
      - ti,bq24150a
      - ti,bq24151
      - ti,bq24151a
      - ti,bq24152
      - ti,bq24153
      - ti,bq24153a
      - ti,bq24155
      - ti,bq24156
      - ti,bq24156a
      - ti,bq24158

  reg:
    maxItems: 1

  ti,current-limit:
    $ref: /schemas/types.yaml#/definitions/uint32
    description: initial maximum current charger can pull from power supply in mA.

  ti,weak-battery-voltage:
    $ref: /schemas/types.yaml#/definitions/uint32
    description: |
      weak battery voltage threshold in mV.
      The chip will use slow precharge if battery voltage is below this value.

  ti,battery-regulation-voltage:
    $ref: /schemas/types.yaml#/definitions/uint32
    description: maximum charging voltage in mV.

  ti,charge-current:
    $ref: /schemas/types.yaml#/definitions/uint32
    description: maximum charging current in mA.

  ti,termination-current:
    $ref: /schemas/types.yaml#/definitions/uint32
    description: |
      charge will be terminated when current in constant-voltage phase drops
      below this value (in mA).

  ti,resistor-sense:
    $ref: /schemas/types.yaml#/definitions/uint32
    description: value of sensing resistor in milliohm.

  ti,usb-charger-detection:
    $ref: /schemas/types.yaml#/definitions/phandle
    description: phandle to usb charger detection device (required for auto mode)

required:
  - compatible
  - reg
  - ti,current-limit
  - ti,weak-battery-voltage
  - ti,battery-regulation-voltage
  - ti,charge-current
  - ti,termination-current
  - ti,resistor-sense

additionalProperties: false

examples:
  - |
    i2c0 {
      #address-cells = <1>;
      #size-cells = <0>;

      charger@6b {
        compatible = "ti,bq24150a";
        reg = <0x6b>;

        ti,current-limit = <100>;
        ti,weak-battery-voltage = <3400>;
        ti,battery-regulation-voltage = <4200>;
        ti,charge-current = <650>;
        ti,termination-current = <100>;
        ti,resistor-sense = <68>;

        ti,usb-charger-detection = <&isp1704>;
      };
    };
```

## Documentation/devicetree/bindings/power/supply/bq24190.txt
```
TI BQ24190 Li-Ion Battery Charger

Required properties:
- compatible: contains one of the following:
    * "ti,bq24190"
    * "ti,bq24192"
    * "ti,bq24192i"
    * "ti,bq24196"
- reg: integer, I2C address of the charger.
- interrupts[-extended]: configuration for charger INT pin.

Optional properties:
- monitored-battery: phandle of battery characteristics devicetree node
  The charger uses the following battery properties:
    + precharge-current-microamp: maximum charge current during precharge
      phase (typically 20% of battery capacity).
    + charge-term-current-microamp: a charge cycle terminates when the
      battery voltage is above recharge threshold, and the current is below
      this setting (typically 10% of battery capacity).
  See also Documentation/devicetree/bindings/power/supply/battery.txt
- ti,system-minimum-microvolt: when power is connected and the battery is below
  minimum system voltage, the system will be regulated above this setting.

child nodes:
- usb-otg-vbus:
  Usage: optional
  Description: Regulator that is used to control the VBUS voltage direction for
               either USB host mode or for charging on the OTG port.

Notes:
- Some circuit boards wire the chip's "OTG" pin high (enabling 500mA default
  charge current on USB SDP ports, among other features). To simulate this on
  boards that wire the pin to a GPIO, set a gpio-hog.

Example:

	bat: battery {
		compatible = "simple-battery";
		precharge-current-microamp = <256000>;
		charge-term-current-microamp = <128000>;
		// etc.
	};

	bq24190: charger@6a {
		compatible = "ti,bq24190";
		reg = <0x6a>;
		interrupts-extended = <&gpiochip 10 IRQ_TYPE_EDGE_FALLING>;
		monitored-battery = <&bat>;
		ti,system-minimum-microvolt = <3200000>;

		usb_otg_vbus: usb-otg-vbus { };
	};

	&twl_gpio {
		otg {
			gpio-hog;
			gpios = <6 0>;
			output-high;
			line-name = "otg-gpio";
		};
	};
```

## Documentation/devicetree/bindings/power/supply/bq24190.yaml
```yaml
# SPDX-License-Identifier: GPL-2.0
# Copyright (C) 2021 Sebastian Reichel
%YAML 1.2
---
$id: "http://devicetree.org/schemas/power/supply/bq24190.yaml#"
$schema: "http://devicetree.org/meta-schemas/core.yaml#"

title: Binding for TI BQ2419x Li-Ion Battery Charger

maintainers:
  - Sebastian Reichel <sre@kernel.org>

allOf:
  - $ref: power-supply.yaml#

properties:
  compatible:
    enum:
      - ti,bq24190
      - ti,bq24192
      - ti,bq24192i
      - ti,bq24196

  reg:
    maxItems: 1

  interrupts:
    maxItems: 1

  usb-otg-vbus:
    type: object
    description: |
      Regulator that is used to control the VBUS voltage direction for
      either USB host mode or for charging on the OTG port

  ti,system-minimum-microvolt:
    description: |
      when power is connected and the battery is below minimum system voltage,
      the system will be regulated above this setting.

  omit-battery-class:
    type: boolean
    description: |
      If this property is set, the operating system does not try to create a
      battery device.

  monitored-battery:
    $ref: /schemas/types.yaml#/definitions/phandle
    description: |
      phandle to a "simple-battery" compatible node.

      This property must be a phandle to a node using the format described
      in battery.yaml, with the following properties being required:
      - precharge-current-microamp: maximum charge current during precharge phase
                                    (typically 20% of battery capacity).
      - charge-term-current-microamp: a charge cycle terminates when the battery voltage is
                                      above recharge threshold, and the current is below this
                                      setting (typically 10% of battery capacity).

required:
  - compatible
  - reg
  - interrupts

additionalProperties: false

examples:
  - |
    #include <dt-bindings/gpio/gpio.h>
    #include <dt-bindings/interrupt-controller/irq.h>

    bat: battery {
      compatible = "simple-battery";
      precharge-current-microamp = <256000>;
      charge-term-current-microamp = <128000>;
    };

    i2c0 {
      #address-cells = <1>;
      #size-cells = <0>;

      charger@6a {
        compatible = "ti,bq24190";
        reg = <0x6a>;
        interrupt-parent = <&gpiochip>;
        interrupts = <10 IRQ_TYPE_EDGE_FALLING>;
        monitored-battery = <&bat>;
        ti,system-minimum-microvolt = <3200000>;

        usb_otg_vbus: usb-otg-vbus { };
      };
    };
```

## Documentation/devicetree/bindings/power/supply/bq24257.yaml
```yaml
# SPDX-License-Identifier: GPL-2.0
# Copyright (C) 2021 Sebastian Reichel
%YAML 1.2
---
$id: "http://devicetree.org/schemas/power/supply/bq24257.yaml#"
$schema: "http://devicetree.org/meta-schemas/core.yaml#"

title: Binding for bq24250, bq24251 and bq24257 Li-Ion Charger

maintainers:
  - Sebastian Reichel <sre@kernel.org>

allOf:
  - $ref: power-supply.yaml#

properties:
  compatible:
    enum:
      - ti,bq24250
      - ti,bq24251
      - ti,bq24257

  reg:
    maxItems: 1

  interrupts:
    maxItems: 1

  ti,battery-regulation-voltage:
    $ref: /schemas/types.yaml#/definitions/uint32
    description: maximum charging voltage in uV

  ti,charge-current:
    $ref: /schemas/types.yaml#/definitions/uint32
    description: maximum charging current in uA

  ti,termination-current:
    $ref: /schemas/types.yaml#/definitions/uint32
    description: |
      charge will be terminated when current in constant-voltage phase
      drops below this value (in uA)

  pg-gpios:
    description: |
      GPIO used for connecting the bq2425x device PG (Power Good) pin.
      This pin is not available on all devices however it should be used if
      possible as this is the recommended way to obtain the charger's input PG
      state. If this pin is not specified a software-based approach for PG
      detection is used.
    maxItems: 1

  ti,current-limit:
    $ref: /schemas/types.yaml#/definitions/uint32
    description: |
      The maximum current to be drawn from the charger's input (in uA).
      If this property is not specified, the input limit current is set
      automatically using USB D+/D- signal based charger type detection.
      If the hardware does not support the D+/D- based detection, a default
      of 500,000 is used (=500mA) instead.

  ti,ovp-voltage:
    $ref: /schemas/types.yaml#/definitions/uint32
    description: |
      Configures the over voltage protection voltage (in uV).
      If not specified a default of 6,5000,000 (=6.5V) is used.

  ti,in-dpm-voltage:
    $ref: /schemas/types.yaml#/definitions/uint32
    description: |
      Configures the threshold input voltage for the dynamic power path management (in uV).
      If not specified a default of 4,360,000 (=4.36V) is used.

required:
  - compatible
  - reg
  - interrupts
  - ti,battery-regulation-voltage
  - ti,charge-current
  - ti,termination-current

additionalProperties: false

examples:
  - |
    #include <dt-bindings/gpio/gpio.h>
    #include <dt-bindings/interrupt-controller/irq.h>
    i2c0 {
      #address-cells = <1>;
      #size-cells = <0>;

      charger@6a {
        compatible = "ti,bq24257";
        reg = <0x6a>;
        interrupt-parent = <&gpio1>;
        interrupts = <16 IRQ_TYPE_EDGE_BOTH>;

        pg-gpios = <&gpio1 28 GPIO_ACTIVE_HIGH>;

        ti,battery-regulation-voltage = <4200000>;
        ti,charge-current = <1000000>;
        ti,termination-current = <50000>;
      };
    };
  - |
    #include <dt-bindings/gpio/gpio.h>
    #include <dt-bindings/interrupt-controller/irq.h>
    i2c0 {
      #address-cells = <1>;
      #size-cells = <0>;

      charger@6a {
        compatible = "ti,bq24250";
        reg = <0x6a>;
        interrupt-parent = <&gpio1>;
        interrupts = <16 IRQ_TYPE_EDGE_BOTH>;

        ti,battery-regulation-voltage = <4200000>;
        ti,charge-current = <500000>;
        ti,termination-current = <50000>;
        ti,current-limit = <900000>;
        ti,ovp-voltage = <9500000>;
        ti,in-dpm-voltage = <4440000>;
      };
    };
```

## Documentation/devicetree/bindings/power/supply/bq24735.yaml
```yaml
# SPDX-License-Identifier: GPL-2.0
# Copyright (C) 2021 Sebastian Reichel
%YAML 1.2
---
$id: "http://devicetree.org/schemas/power/supply/bq24735.yaml#"
$schema: "http://devicetree.org/meta-schemas/core.yaml#"

title: Binding for TI BQ24735 Li-Ion Battery Charger

maintainers:
  - Sebastian Reichel <sre@kernel.org>

allOf:
  - $ref: power-supply.yaml#

properties:
  compatible:
    const: ti,bq24735

  reg:
    maxItems: 1

  interrupts:
    description: AC adapter plug event interrupt
    maxItems: 1

  ti,ac-detect-gpios:
    maxItems: 1
    description: |
      This GPIO is optionally used to read the AC adapter status. This is a Host GPIO
      that is configured as an input and connected to the ACOK pin on the bq24735.
      Note: for backwards compatibility reasons, the GPIO must be active on AC adapter
      absence despite ACOK being active (high) on AC adapter presence.

  ti,charge-current:
    $ref: /schemas/types.yaml#/definitions/uint32
    description: |
      Used to control and set the charging current.
      This value must be between 128mA and 8.128A with a 64mA step resolution.
      The POR value is 0x0000h. This number is in mA (e.g. 8192).
      See spec for more information about the ChargeCurrent (0x14h) register.

  ti,charge-voltage:
    $ref: /schemas/types.yaml#/definitions/uint32
    description: |
      Used to control and set the charging voltage.
      This value must be between 1.024V and 19.2V with a 16mV step resolution.
      The POR value is 0x0000h. This number is in mV (e.g. 19200).
      See spec for more information about the ChargeVoltage (0x15h) register.

  ti,input-current:
    $ref: /schemas/types.yaml#/definitions/uint32
    description: |
      Used to control and set the charger input current.
      This value must be between 128mA and 8.064A with a 128mA step resolution.
      The POR value is 0x1000h. This number is in mA (e.g. 8064).
      See the spec for more information about the InputCurrent (0x3fh) register.

  ti,external-control:
    type: boolean
    description: |
      Indicates that the charger is configured externally and that the host should not
      attempt to enable/disable charging or set the charge voltage/current.

  poll-interval:
    $ref: /schemas/types.yaml#/definitions/uint32
    description: |
      If 'interrupts' is not specified, poll AC adapter presence with this interval (milliseconds).

required:
  - compatible
  - reg

additionalProperties: false

examples:
  - |
    #include <dt-bindings/gpio/gpio.h>

    i2c0 {
      #address-cells = <1>;
      #size-cells = <0>;

      charger@9 {
        compatible = "ti,bq24735";
        reg = <0x9>;
        ti,ac-detect-gpios = <&gpio 72 0x1>;
      };
    };
```

## Documentation/devicetree/bindings/power/supply/bq2515x.yaml
```yaml
# SPDX-License-Identifier: (GPL-2.0 OR BSD-2-Clause)
# Copyright (C) 2020 Texas Instruments Incorporated
%YAML 1.2
---
$id: "http://devicetree.org/schemas/power/supply/bq2515x.yaml#"
$schema: "http://devicetree.org/meta-schemas/core.yaml#"

title: TI bq2515x 500-mA Linear charger family

maintainers:
  - Dan Murphy <dmurphy@ti.com>
  - Ricardo Rivera-Matos <r-rivera-matos@ti.com>

description: |
  The BQ2515x family is a highly integrated battery charge management IC that
  integrates the most common functions for wearable devices, namely a charger,
  an output voltage rail, ADC for battery and system monitoring, and
  push-button controller.

  Specifications about the charger can be found at:
    http://www.ti.com/lit/ds/symlink/bq25150.pdf
    http://www.ti.com/lit/ds/symlink/bq25155.pdf

properties:
  compatible:
    enum:
      - ti,bq25150
      - ti,bq25155

  reg:
    maxItems: 1
    description: I2C address of the charger.

  ac-detect-gpios:
    description: |
       GPIO used for connecting the bq2515x device PG (AC Detect)
       pin.
    maxItems: 1

  reset-gpios:
    description: GPIO used for hardware reset.
    maxItems: 1

  powerdown-gpios:
    description: GPIO used for low power mode of IC.
    maxItems: 1

  charge-enable-gpios:
    description: GPIO used to turn on and off charging.
    maxItems: 1

  input-current-limit-microamp:
    $ref: /schemas/types.yaml#/definitions/uint32
    description: Maximum input current in micro Amps.
    minimum: 50000
    maximum: 500000

  monitored-battery:
    $ref: /schemas/types.yaml#/definitions/phandle
    description: phandle to the battery node being monitored

required:
  - compatible
  - reg
  - monitored-battery

additionalProperties: false

examples:
  - |
    bat: battery {
      compatible = "simple-battery";
      constant-charge-current-max-microamp = <50000>;
      precharge-current-microamp = <2500>;
      constant-charge-voltage-max-microvolt = <4000000>;
    };
    #include <dt-bindings/gpio/gpio.h>
    i2c0 {
      #address-cells = <1>;
      #size-cells = <0>;

      bq25150: charger@6b {
        compatible = "ti,bq25150";
        reg = <0x6b>;
        monitored-battery = <&bat>;
        input-current-limit-microamp = <100000>;

        ac-detect-gpios = <&gpio1 28 GPIO_ACTIVE_HIGH>;
        reset-gpios = <&gpio0 14 GPIO_ACTIVE_HIGH>;
        powerdown-gpios = <&gpio0 15 GPIO_ACTIVE_HIGH>;
        charge-enable-gpios = <&gpio0 13 GPIO_ACTIVE_LOW>;
      };
    };
```
