## Documentation/devicetree/bindings/power/supply/bq256xx.yaml
```yaml
# SPDX-License-Identifier: (GPL-2.0-only or BSD-2-Clause)
# Copyright (C) 2020 Texas Instruments Incorporated
%YAML 1.2
---
$id: http://devicetree.org/schemas/power/supply/bq256xx.yaml#
$schema: http://devicetree.org/meta-schemas/core.yaml#

title: TI bq256xx Switch Mode Buck Charger

maintainers:
  - Andrew Davis <afd@ti.com>

description: |
  The bq256xx devices are a family of highly-integrated battery charge
  management and system power management ICs for single cell Li-ion and Li-
  polymer batteries.

  Datasheets:
    - https://www.ti.com/lit/ds/symlink/bq25600.pdf
    - https://www.ti.com/lit/ds/symlink/bq25601.pdf
    - https://www.ti.com/lit/ds/symlink/bq25600d.pdf
    - https://www.ti.com/lit/ds/symlink/bq25601d.pdf
    - https://www.ti.com/lit/ds/symlink/bq25611d.pdf
    - https://www.ti.com/lit/ds/symlink/bq25618.pdf
    - https://www.ti.com/lit/ds/symlink/bq25619.pdf

properties:
  compatible:
    enum:
      - ti,bq25600
      - ti,bq25601
      - ti,bq25600d
      - ti,bq25601d
      - ti,bq25611d
      - ti,bq25618
      - ti,bq25619

  reg:
    maxItems: 1

  ti,watchdog-timeout-ms:
    default: 0
    description: |
      Watchdog timer in ms. 0 (default) disables the watchdog
    minimum: 0
    maximum: 160000
    enum: [ 0, 40000, 80000, 160000]

  input-voltage-limit-microvolt:
    description: |
       Minimum input voltage limit in µV with a 100000 µV step
    minimum: 3900000
    maximum: 5400000

  input-current-limit-microamp:
    description: |
       Maximum input current limit in µA with a 100000 µA step
    minimum: 100000
    maximum: 3200000

  monitored-battery:
    $ref: /schemas/types.yaml#/definitions/phandle
    description: phandle to the battery node being monitored

  interrupts:
    maxItems: 1
    description: |
      Interrupt sends an active low, 256 μs pulse to host to report the charger
      device status and faults.

  ti,no-thermistor:
    type: boolean
    description: Indicates that no thermistor is connected to the TS pin

required:
  - compatible
  - reg
  - monitored-battery

allOf:
  - if:
      properties:
        compatible:
          contains:
            enum:
              - ti,bq25600
              - ti,bq25601
              - ti,bq25600d
              - ti,bq25601d
    then:
      properties:
        ti,no-thermistor: false

additionalProperties: false

examples:
  - |
    bat: battery {
      compatible = "simple-battery";
      constant-charge-current-max-microamp = <2040000>;
      constant-charge-voltage-max-microvolt = <4352000>;
      precharge-current-microamp = <180000>;
      charge-term-current-microamp = <180000>;
    };
    #include <dt-bindings/gpio/gpio.h>
    #include <dt-bindings/interrupt-controller/irq.h>
    i2c {

      clock-frequency = <400000>;

      #address-cells = <1>;
      #size-cells = <0>;

      charger@6b {
        compatible = "ti,bq25601";
        reg = <0x6b>;
        monitored-battery = <&bat>;

        interrupt-parent = <&gpio1>;
        interrupts = <16 IRQ_TYPE_EDGE_FALLING>;
        ti,watchdog-timeout-ms = <40000>;

        input-voltage-limit-microvolt = <4500000>;
        input-current-limit-microamp = <2400000>;
       };
    };
...
```

## Documentation/devicetree/bindings/power/supply/bq25890.txt
```
Binding for TI bq25890 Li-Ion Charger

This driver will support the bq25896 and the bq25890. There are other ICs
in the same family but those have not been tested.

Required properties:
- compatible: Should contain one of the following:
    * "ti,bq25890"
- reg: integer, i2c address of the device.
- ti,battery-regulation-voltage: integer, maximum charging voltage (in uV);
- ti,charge-current: integer, maximum charging current (in uA);
- ti,termination-current: integer, charge will be terminated when current in
    constant-voltage phase drops below this value (in uA);
- ti,precharge-current: integer, maximum charge current during precharge
    phase (in uA);
- ti,minimum-sys-voltage: integer, when battery is charging and it is below
    minimum system voltage, the system will be regulated above
    minimum-sys-voltage setting (in uV);
- ti,boost-voltage: integer, VBUS voltage level in boost mode (in uV);
- ti,boost-max-current: integer, maximum allowed current draw in boost mode
    (in uA).

Optional properties:
- ti,boost-low-freq: boolean, if present boost mode frequency will be 500kHz,
    otherwise 1.5MHz;
- ti,use-ilim-pin: boolean, if present the ILIM resistor will be used and the
    input current will be the lower between the resistor setting and the IINLIM
    register setting;
- ti,thermal-regulation-threshold: integer, temperature above which the charge
    current is lowered, to avoid overheating (in degrees Celsius). If omitted,
    the default setting will be used (120 degrees);

Example:

bq25890 {
        compatible = "ti,bq25890";
        reg = <0x6a>;

        ti,battery-regulation-voltage = <4200000>;
        ti,charge-current = <1000000>;
        ti,termination-current = <50000>;
        ti,precharge-current = <128000>;
        ti,minimum-sys-voltage = <3600000>;
        ti,boost-voltage = <5000000>;
        ti,boost-max-current = <1000000>;

        ti,use-ilim-pin;
        ti,thermal-regulation-threshold = <120>;
};
```

## Documentation/devicetree/bindings/power/supply/bq25890.yaml
```yaml
# SPDX-License-Identifier: GPL-2.0
# Copyright (C) 2021 Sebastian Reichel
%YAML 1.2
---
$id: http://devicetree.org/schemas/power/supply/bq25890.yaml#
$schema: http://devicetree.org/meta-schemas/core.yaml#

title: Bq25890, bq25892, bq25895 and bq25896 Li-Ion Charger

maintainers:
  - Sebastian Reichel <sre@kernel.org>

allOf:
  - $ref: power-supply.yaml#

properties:
  compatible:
    oneOf:
      - enum:
          - ti,bq25890
      - items:
          - enum:
              - ti,bq25892
              - ti,bq25895
              - ti,bq25896
          - const: ti,bq25890

  reg:
    maxItems: 1

  interrupts:
    maxItems: 1

  ti,battery-regulation-voltage:
    $ref: /schemas/types.yaml#/definitions/uint32
    description: maximum charging voltage (in uV)

  ti,charge-current:
    $ref: /schemas/types.yaml#/definitions/uint32
    description: maximum charging current (in uA)

  ti,termination-current:
    $ref: /schemas/types.yaml#/definitions/uint32
    description: |
      charge will be terminated when current in constant-voltage phase
      drops below this value (in uA)

  ti,precharge-current:
    $ref: /schemas/types.yaml#/definitions/uint32
    description: maximum charge current during precharge phase (in uA)

  ti,minimum-sys-voltage:
    $ref: /schemas/types.yaml#/definitions/uint32
    description: |
      when battery is charging and it is below minimum system voltage,
      the system will be regulated above minimum-sys-voltage setting (in uV)

  ti,boost-voltage:
    $ref: /schemas/types.yaml#/definitions/uint32
    description: VBUS voltage level in boost mode (in uV)

  ti,boost-max-current:
    $ref: /schemas/types.yaml#/definitions/uint32
    description: maximum allowed current draw in boost mode (in uA)

  ti,boost-low-freq:
    description: boost mode frequency will be 500kHz, otherwise 1.5MHz
    type: boolean

  ti,use-ilim-pin:
    description: |
      ILIM resistor will be used and the input current will be the lower
      between the resistor setting and the IINLIM register setting
    type: boolean

  ti,thermal-regulation-threshold:
    $ref: /schemas/types.yaml#/definitions/uint32
    description: |
      temperature above which the charge current is lowered, to avoid overheating
      (in degrees Celsius). If omitted, the default setting will be used (120 degrees)

  ti,ibatcomp-micro-ohms:
    description: value of a resistor in series with the battery (in Micro Ohms)

  ti,ibatcomp-clamp-microvolt:
    description: max. charging voltage adjustment due to expected voltage drop on in-series resistor

required:
  - compatible
  - reg
  - interrupts
  - ti,battery-regulation-voltage
  - ti,charge-current
  - ti,termination-current
  - ti,precharge-current
  - ti,minimum-sys-voltage
  - ti,boost-voltage
  - ti,boost-max-current

unevaluatedProperties: false

examples:
  - |
    #include <dt-bindings/interrupt-controller/irq.h>
    i2c0 {
      #address-cells = <1>;
      #size-cells = <0>;

      charger@6a {
        compatible = "ti,bq25890";
        reg = <0x6a>;

        interrupt-parent = <&gpio1>;
        interrupts = <16 IRQ_TYPE_EDGE_FALLING>;

        ti,battery-regulation-voltage = <4200000>;
        ti,charge-current = <1000000>;
        ti,termination-current = <50000>;
        ti,precharge-current = <128000>;
        ti,minimum-sys-voltage = <3600000>;
        ti,boost-voltage = <5000000>;
        ti,boost-max-current = <1000000>;

        ti,use-ilim-pin;
        ti,thermal-regulation-threshold = <120>;
      };
    };
```

## Documentation/devicetree/bindings/power/supply/bq25980.yaml
```yaml
# SPDX-License-Identifier: (GPL-2.0-only OR BSD-2-Clause)
# Copyright (C) 2020 Texas Instruments Incorporated
%YAML 1.2
---
$id: "http://devicetree.org/schemas/power/supply/bq25980.yaml#"
$schema: "http://devicetree.org/meta-schemas/core.yaml#"

title: TI BQ25980 Flash Charger

maintainers:
  - Dan Murphy <dmurphy@ti.com>
  - Ricardo Rivera-Matos <r-rivera-matos@ti.com>

description: |
  The BQ25980, BQ25975, and BQ25960 are a series of flash chargers intended
  for use in high-power density portable electronics. These inductorless
  switching chargers can provide over 97% efficiency by making use of the
  switched capacitor architecture.

allOf:
  - $ref: power-supply.yaml#

properties:
  compatible:
    enum:
      - ti,bq25980
      - ti,bq25975
      - ti,bq25960

  reg:
    maxItems: 1

  ti,watchdog-timeout-ms:
    description: |
      Watchdog timer in milli seconds. 0 disables the watchdog.
    default: 0
    minimum: 0
    maximum: 300000
    enum: [ 0, 5000, 10000, 50000, 300000]

  ti,sc-ovp-limit-microvolt:
    description: |
      Minimum input voltage limit in micro volts with a when the charger is in
      switch cap mode. 100000 micro volt step.
    default: 17800000
    minimum: 14000000
    maximum: 22000000

  ti,sc-ocp-limit-microamp:
    description: |
      Maximum input current limit in micro amps with a 100000 micro amp step.
    minimum: 100000
    maximum: 3300000

  ti,bypass-ovp-limit-microvolt:
    description: |
      Minimum input voltage limit in micro volts with a when the charger is in
      switch cap mode. 50000 micro volt step.
    minimum: 7000000
    maximum: 12750000

  ti,bypass-ocp-limit-microamp:
    description: |
      Maximum input current limit in micro amps with a 100000 micro amp step.
    minimum: 100000
    maximum: 3300000

  ti,bypass-enable:
    type: boolean
    description: Enables bypass mode at boot time

  interrupts:
    maxItems: 1
    description: |
      Indicates that the device state has changed.

  monitored-battery:
    $ref: /schemas/types.yaml#/definitions/phandle
    description: phandle to the battery node being monitored

required:
  - compatible
  - reg
  - monitored-battery

unevaluatedProperties: false

examples:
  - |
    bat: battery {
      compatible = "simple-battery";
      constant-charge-current-max-microamp = <4000000>;
      constant-charge-voltage-max-microvolt = <8400000>;
      precharge-current-microamp = <160000>;
      charge-term-current-microamp = <160000>;
    };
    #include <dt-bindings/gpio/gpio.h>
    #include <dt-bindings/interrupt-controller/irq.h>
    i2c0 {
      #address-cells = <1>;
      #size-cells = <0>;

      bq25980: charger@65 {
          compatible = "ti,bq25980";
          reg = <0x65>;
          interrupt-parent = <&gpio1>;
          interrupts = <16 IRQ_TYPE_EDGE_FALLING>;
          ti,watchdog-timer = <0>;
          ti,sc-ocp-limit-microamp = <2000000>;
          ti,sc-ovp-limit-microvolt = <17800000>;
          monitored-battery = <&bat>;
      };
    };

...
```

## Documentation/devicetree/bindings/power/supply/bq27xxx.txt
```
TI BQ27XXX fuel gauge family

Required properties:
- compatible: contains one of the following:
 * "ti,bq27200" - BQ27200
 * "ti,bq27210" - BQ27210
 * "ti,bq27500" - deprecated, use revision specific property below
 * "ti,bq27510" - deprecated, use revision specific property below
 * "ti,bq27520" - deprecated, use revision specific property below
 * "ti,bq27500-1" - BQ27500/1
 * "ti,bq27510g1" - BQ27510-g1
 * "ti,bq27510g2" - BQ27510-g2
 * "ti,bq27510g3" - BQ27510-g3
 * "ti,bq27520g1" - BQ27520-g1
 * "ti,bq27520g2" - BQ27520-g2
 * "ti,bq27520g3" - BQ27520-g3
 * "ti,bq27520g4" - BQ27520-g4
 * "ti,bq27521" - BQ27521
 * "ti,bq27530" - BQ27530
 * "ti,bq27531" - BQ27531
 * "ti,bq27541" - BQ27541
 * "ti,bq27542" - BQ27542
 * "ti,bq27546" - BQ27546
 * "ti,bq27742" - BQ27742
 * "ti,bq27545" - BQ27545
 * "ti,bq27421" - BQ27421
 * "ti,bq27425" - BQ27425
 * "ti,bq27426" - BQ27426
 * "ti,bq27441" - BQ27441
 * "ti,bq27621" - BQ27621
- reg: integer, I2C address of the fuel gauge.

Optional properties:
- monitored-battery: phandle of battery characteristics node
    The fuel gauge uses the following battery properties:
    + energy-full-design-microwatt-hours
    + charge-full-design-microamp-hours
    + voltage-min-design-microvolt
  Both or neither of the *-full-design-*-hours properties must be set.
  See Documentation/devicetree/bindings/power/supply/battery.txt

Example:

	bat: battery {
		compatible = "simple-battery";
		voltage-min-design-microvolt = <3200000>;
		energy-full-design-microwatt-hours = <5290000>;
		charge-full-design-microamp-hours = <1430000>;
	};

	bq27510g3: fuel-gauge@55 {
		compatible = "ti,bq27510g3";
		reg = <0x55>;
		monitored-battery = <&bat>;
	};
```
