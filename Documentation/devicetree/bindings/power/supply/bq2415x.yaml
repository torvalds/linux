## Documentation/devicetree/bindings/power/supply/cpcap-charger.yaml
```yaml
# SPDX-License-Identifier: GPL-2.0
# Copyright (C) 2021 Sebastian Reichel
%YAML 1.2
---
$id: http://devicetree.org/schemas/power/supply/cpcap-charger.yaml#
$schema: http://devicetree.org/meta-schemas/core.yaml#

title: Motorola CPCAP PMIC charger

maintainers:
  - Tony Lindgren <tony@atomide.com>
  - Sebastian Reichel <sre@kernel.org>

description: |
  Motorola CPCAP is a PMIC found in some mobile phones, e.g.
  the Droid 4. This binding describes its battery charger
  sub-function.

allOf:
  - $ref: power-supply.yaml#

properties:
  compatible:
    const: motorola,mapphone-cpcap-charger

  interrupts:
    items:
      - description: charger detection interrupt
      - description: reverse charge interrupt
      - description: SE1 charger detection interrupt
      - description: SE0 charger detection interrupt
      - description: reverse mode interrupt
      - description: charge current 2 interrupt
      - description: charge current 1 interrupt
      - description: VBUS valid interrupt
      - description: battery detect interrupt

  interrupt-names:
    items:
      - const: chrg_det
      - const: rvrs_chrg
      - const: chrg_se1b
      - const: se0conn
      - const: rvrs_mode
      - const: chrgcurr2
      - const: chrgcurr1
      - const: vbusvld
      - const: battdetb

  io-channels:
    items:
      - description: battery temperature
      - description: battery voltage
      - description: VBUS voltage
      - description: battery charge current
      - description: battery current

  io-channel-names:
    items:
      - const: battdetb
      - const: battp
      - const: vbus
      - const: chg_isense
      - const: batti

  mode-gpios:
    description: |
      Optionally CPCAP charger can have a companion wireless
      charge controller that is controlled with two GPIOs
      that are active low.
    minItems: 2
    maxItems: 2

required:
  - compatible
  - interrupts
  - interrupt-names
  - io-channels
  - io-channel-names

additionalProperties: false

examples:
  - |
    #include <dt-bindings/gpio/gpio.h>
    cpcap {
      charger {
        compatible = "motorola,mapphone-cpcap-charger";
        interrupts-extended =
                <&cpcap 13 0>, <&cpcap 12 0>, <&cpcap 29 0>, <&cpcap 28 0>,
                <&cpcap 22 0>, <&cpcap 21 0>, <&cpcap 20 0>, <&cpcap 19 0>,
                <&cpcap 54 0>;
        interrupt-names =
                "chrg_det", "rvrs_chrg", "chrg_se1b", "se0conn",
                "rvrs_mode", "chrgcurr2", "chrgcurr1", "vbusvld",
                "battdetb";
        mode-gpios = <&gpio3 29 GPIO_ACTIVE_LOW>,
                     <&gpio3 23 GPIO_ACTIVE_LOW>;
        io-channels = <&cpcap_adc 0>, <&cpcap_adc 1>,
                      <&cpcap_adc 2>, <&cpcap_adc 5>,
                      <&cpcap_adc 6>;
        io-channel-names = "battdetb", "battp",
                           "vbus", "chg_isense",
                           "batti";
      };
    };
```

## Documentation/devicetree/bindings/power/supply/cw2015_battery.yaml
```yaml
# SPDX-License-Identifier: (GPL-2.0-only OR BSD-2-Clause)
%YAML 1.2
---
$id: http://devicetree.org/schemas/power/supply/cw2015_battery.yaml#
$schema: http://devicetree.org/meta-schemas/core.yaml#

title: Battery driver for CW2015 shuntless fuel gauge by CellWise.

maintainers:
  - Tobias Schramm <t.schramm@manjaro.org>

description: |
  The driver can utilize information from a simple-battery linked via a
  phandle in monitored-battery. If specified the driver uses the
  charge-full-design-microamp-hours property of the battery.

properties:
  compatible:
    const: cellwise,cw2015

  reg:
    maxItems: 1

  cellwise,battery-profile:
    description: |
      This property specifies characteristics of the battery used. The format
      of this binary blob is kept secret by CellWise. The only way to obtain
      it is to mail two batteries to a test facility of CellWise and receive
      back a test report with the binary blob.
    $ref: /schemas/types.yaml#/definitions/uint8-array
    minItems: 64
    maxItems: 64

  cellwise,monitor-interval-ms:
    description:
      Specifies the interval in milliseconds gauge values are polled at
    minimum: 250

  power-supplies:
    description:
      Specifies supplies used for charging the battery connected to this gauge
    $ref: /schemas/types.yaml#/definitions/phandle-array
    minItems: 1
    maxItems: 8 # Should be enough

  monitored-battery:
    description:
      Specifies the phandle of a simple-battery connected to this gauge
    $ref: /schemas/types.yaml#/definitions/phandle

required:
  - compatible
  - reg

additionalProperties: false

examples:
  - |
    i2c {
        #address-cells = <1>;
        #size-cells = <0>;

        cw2015@62 {
            compatible = "cellwise,cw2015";
            reg = <0x62>;
            cellwise,battery-profile = /bits/ 8 <
                0x17 0x67 0x80 0x73 0x6E 0x6C 0x6B 0x63
                0x77 0x51 0x5C 0x58 0x50 0x4C 0x48 0x36
                0x15 0x0C 0x0C 0x19 0x5B 0x7D 0x6F 0x69
                0x69 0x5B 0x0C 0x29 0x20 0x40 0x52 0x59
                0x57 0x56 0x54 0x4F 0x3B 0x1F 0x7F 0x17
                0x06 0x1A 0x30 0x5A 0x85 0x93 0x96 0x2D
                0x48 0x77 0x9C 0xB3 0x80 0x52 0x94 0xCB
                0x2F 0x00 0x64 0xA5 0xB5 0x11 0xF0 0x11
           >;
           cellwise,monitor-interval-ms = <5000>;
           monitored-battery = <&bat>;
           power-supplies = <&mains_charger>, <&usb_charger>;
       };
    };
```

## Documentation/devicetree/bindings/power/supply/da9150-fg.txt
```
Dialog Semiconductor DA9150 Fuel-Gauge Power Supply bindings

Required properties:
- compatible: "dlg,da9150-fuel-gauge" for DA9150 Fuel-Gauge Power Supply

Optional properties:
- dlg,update-interval: Interval time (milliseconds) between battery level checks.
- dlg,warn-soc-level: Battery discharge level (%) where warning event raised.
      [1 - 100]
- dlg,crit-soc-level: Battery discharge level (%) where critical event raised.
  This value should be lower than the warning level.
      [1 - 100]


Example:

	fuel-gauge {
		compatible = "dlg,da9150-fuel-gauge";

		dlg,update-interval = <10000>;
		dlg,warn-soc-level = /bits/ 8 <15>;
		dlg,crit-soc-level = /bits/ 8 <5>;
	};
```

## Documentation/devicetree/bindings/power/supply/dlg,da9150-charger.yaml
```yaml
# SPDX-License-Identifier: GPL-2.0
%YAML 1.2
---
$id: http://devicetree.org/schemas/power/supply/dlg,da9150-charger.yaml#
$schema: http://devicetree.org/meta-schemas/core.yaml#

title: Dialog Semiconductor DA9150 Charger Power Supply bindings

maintainers:
  - Sebastian Reichel <sre@kernel.org>

allOf:
  - $ref: power-supply.yaml#

properties:
  compatible:
    const: dlg,da9150-charger

  io-channels:
    items:
      - description: ADC channel for current
      - description: ADC channel for bus voltage
      - description: ADC channel for junction temperature
      - description: ADC channel for battery voltage

  io-channel-names:
    items:
      - const: CHAN_IBUS
      - const: CHAN_VBUS
      - const: CHAN_TJUNC
      - const: CHAN_VBAT

required:
  - compatible

additionalProperties: false

examples:
  - |
    pmic {
      charger {
        compatible = "dlg,da9150-charger";
        io-channels = <&gpadc 0>,
                      <&gpadc 2>,
                      <&gpadc 8>,
                      <&gpadc 5>;
        io-channel-names = "CHAN_IBUS",
                           "CHAN_VBUS",
                           "CHAN_TJUNC",
                           "CHAN_VBAT";
      };
    };
```

## Documentation/devicetree/bindings/power/supply/dlg,da9150-fuel-gauge.yaml
```yaml
# SPDX-License-Identifier: GPL-2.0
%YAML 1.2
---
$id: "http://devicetree.org/schemas/power/supply/dlg,da9150-fuel-gauge.yaml#"
$schema: "http://devicetree.org/meta-schemas/core.yaml#"

title: Dialog Semiconductor DA9150 Fuel-Gauge Power Supply bindings

maintainers:
  - Sebastian Reichel <sre@kernel.org>

allOf:
  - $ref: power-supply.yaml#

properties:
  compatible:
    const: dlg,da9150-fuel-gauge

  dlg,update-interval:
    $ref: /schemas/types.yaml#/definitions/uint32
    description: Interval time (milliseconds) between battery level checks.

  dlg,warn-soc-level:
    $ref: /schemas/types.yaml#/definitions/uint8
    minimum: 1
    maximum: 100
    description: Battery discharge level (%) where warning event raised.

  dlg,crit-soc-level:
    $ref: /schemas/types.yaml#/definitions/uint8
    minimum: 1
    maximum: 100
    description: |
      Battery discharge level (%) where critical event raised.
      This value should be lower than the warning level.

required:
  - compatible

additionalProperties: false

examples:
  - |
    pmic {
      battery {
        compatible = "dlg,da9150-fuel-gauge";
        dlg,update-interval = <10000>;
        dlg,warn-soc-level = /bits/ 8 <15>;
        dlg,crit-soc-level = /bits/ 8 <5>;
      };
    };
```

## Documentation/devicetree/bindings/power/supply/google,goldfish-battery.yaml
```yaml
# SPDX-License-Identifier: (GPL-2.0-only OR BSD-2-Clause)
%YAML 1.2
---
$id: http://devicetree.org/schemas/power/supply/google,goldfish-battery.yaml#
$schema: http://devicetree.org/meta-schemas/core.yaml#

title: Android Goldfish Battery

maintainers:
  - Kuan-Wei Chiu <visitorckw@gmail.com>

allOf:
  - $ref: power-supply.yaml#

description:
  Android goldfish battery device generated by Android emulator.

properties:
  compatible:
    const: google,goldfish-battery

  reg:
    maxItems: 1

  interrupts:
    maxItems: 1

required:
  - compatible
  - reg
  - interrupts

unevaluatedProperties: false

examples:
  - |
    battery@9020000 {
        compatible = "google,goldfish-battery";
        reg = <0x9020000 0x1000>;
        interrupts = <3>;
    };
```

## Documentation/devicetree/bindings/power/supply/gpio-charger.txt
```
gpio-charger

Required properties :
 - compatible : "gpio-charger"
 - gpios : GPIO indicating the charger presence.
   See GPIO binding in bindings/gpio/gpio.txt .
 - charger-type : power supply type, one of
     unknown
     battery
     ups
     mains
     usb-sdp (USB standard downstream port)
     usb-dcp (USB dedicated charging port)
     usb-cdp (USB charging downstream port)
     usb-aca (USB accessory charger adapter)

Optional properties:
 - charge-status-gpios: GPIO indicating whether a battery is charging.

Example:

	usb_charger: charger {
		compatible = "gpio-charger";
		charger-type = "usb-sdp";
		gpios = <&gpd 28 GPIO_ACTIVE_LOW>;
		charge-status-gpios = <&gpc 27 GPIO_ACTIVE_LOW>;
	};

	battery {
		power-supplies = <&usb_charger>;
	};
```

## Documentation/devicetree/bindings/power/supply/gpio-charger.yaml
```yaml
# SPDX-License-Identifier: GPL-2.0
%YAML 1.2
---
$id: http://devicetree.org/schemas/power/supply/gpio-charger.yaml#
$schema: http://devicetree.org/meta-schemas/core.yaml#

title: simple battery chargers only communicating through GPIOs

maintainers:
  - Sebastian Reichel <sre@kernel.org>

description:
  This binding is for all chargers, which are working more or less
  autonomously, only providing some status GPIOs and possibly some
  GPIOs for limited control over the charging process.

properties:
  compatible:
    const: gpio-charger

  charger-type:
    enum:
      - unknown
      - battery
      - ups
      - mains
      - usb-sdp                   # USB standard downstream port
      - usb-dcp                   # USB dedicated charging port
      - usb-cdp                   # USB charging downstream port
      - usb-aca                   # USB accessory charger adapter
    description:
      Type of the charger, e.g. "mains" for a wall charger.

  gpios:
    maxItems: 1
    description: GPIO indicating the charger presence

  charge-status-gpios:
    maxItems: 1
    description: GPIO indicating the charging status

  charge-current-limit-gpios:
    minItems: 1
    maxItems: 32
    description: GPIOs used for current limiting

  charge-current-limit-mapping:
    description: List of tuples with current in uA and a GPIO bitmap (in
      this order). The tuples must be provided in descending order of the
      current limit.
    $ref: /schemas/types.yaml#/definitions/uint32-matrix
    items:
      items:
        - description:
            Current limit in uA
        - description:
            Encoded GPIO setting. Bit 0 represents last GPIO from the
            charge-current-limit-gpios property. Bit 1 second to last
            GPIO and so on.

required:
  - compatible

anyOf:
  - required:
      - gpios
  - required:
      - charge-status-gpios
  - required:
      - charge-current-limit-gpios

dependencies:
  charge-current-limit-gpios: [ charge-current-limit-mapping ]
  charge-current-limit-mapping: [ charge-current-limit-gpios ]

additionalProperties: false

examples:
  - |
    #include <dt-bindings/gpio/gpio.h>

    charger {
      compatible = "gpio-charger";
      charger-type = "usb-sdp";

      gpios = <&gpd 28 GPIO_ACTIVE_LOW>;
      charge-status-gpios = <&gpc 27 GPIO_ACTIVE_LOW>;

      charge-current-limit-gpios = <&gpioA 11 GPIO_ACTIVE_HIGH>,
                                   <&gpioA 12 GPIO_ACTIVE_HIGH>;
      charge-current-limit-mapping = <2500000 0x00>, // 2.5 A => both GPIOs low
                                     <700000 0x01>, // 700 mA => GPIO A.12 high
                                     <0 0x02>; // 0 mA => GPIO A.11 high
    };
```
