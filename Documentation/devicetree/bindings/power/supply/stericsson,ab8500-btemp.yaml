## Documentation/devicetree/bindings/power/twl-charger.txt
```
TWL BCI (Battery Charger Interface)

Required properties:
- compatible:
  - "ti,twl4030-bci"
- interrupts: two interrupt lines from the TWL SIH (secondary
  interrupt handler) - interrupts 9 and 2.

Optional properties:
- ti,bb-uvolt: microvolts for charging the backup battery.
- ti,bb-uamp: microamps for charging the backup battery.

Examples:

bci {
   compatible = "ti,twl4030-bci";
   interrupts = <9>, <2>;
   ti,bb-uvolt = <3200000>;
   ti,bb-uamp = <150>;
};
```

## Documentation/devicetree/bindings/power/universal_charger.txt
```
Binding for UNIVERSAL Charger

Required properties:
- compatible: Should contain one of the following:
    * "universal-charger"
- extcon: extcon specifier for the Charger.
- dc-det-gpio: gpio for dc detect.

Example:

	universal_charger {
		status = "okay";
		compatible = "universal-charger";
		extcon = <&u2phy0>;
		dc-det-gpio = <&gpio3 1 GPIO_ACTIVE_HIGH>;
	};
```

## Documentation/devicetree/bindings/power/wakeup-source.txt
```
Specifying wakeup capability for devices
============================================

Any device nodes
----------------
Nodes that describe devices which have wakeup capability may contain a
"wakeup-source" boolean property.

If the device is marked as a wakeup-source, interrupt wake capability depends
on the device specific "interrupt-names" property. If no interrupts are labeled
as wake capable, then it is up to the device to determine which interrupts can
wake the system.

However if a device has a dedicated interrupt as the wakeup source, then it
needs to specify/identify it using a device specific interrupt name. In such
cases only that interrupt can be used as a wakeup interrupt.

While various legacy interrupt names exist, new devices should use "wakeup" as
the canonical interrupt name.

List of legacy properties and respective binding document
---------------------------------------------------------

1. "gpio-key,wakeup"		Documentation/devicetree/bindings/input/gpio-keys{,-polled}.txt
2. "has-tpo"			Documentation/devicetree/bindings/rtc/rtc-opal.txt
3. "linux,wakeup"		Documentation/devicetree/bindings/input/gpio-matrix-keypad.txt
				Documentation/devicetree/bindings/mfd/tc3589x.txt
				Documentation/devicetree/bindings/input/touchscreen/ads7846.txt
4. "linux,keypad-wakeup"	Documentation/devicetree/bindings/input/qcom,pm8xxx-keypad.txt
5. "linux,input-wakeup"		Documentation/devicetree/bindings/input/samsung,s3c6410-keypad.yaml
6. "nvidia,wakeup-source"	Documentation/devicetree/bindings/input/nvidia,tegra20-kbc.txt

Examples
--------

1. With "wakeup" interrupt name

	device@10000 {
		compatible	= "vendor,device-id";
		reg		= <0x10000 0x1000>;
		interrupts	= <0 19 4>, <0 21 4>, <0 22 4>;
		interrupt-names	= "ack", "err", "wakeup";
		wakeup-source;
	};

2. Without "wakeup" interrupt name

	embedded-controller {
		compatible = "google,cros-ec-i2c";
		reg = <0x1e>;
		interrupts = <6 0>;
		interrupt-parent = <&gpx1>;
		pinctrl-names = "default";
		pinctrl-0 = <&ec_irq>;
		wakeup-source;
	};

3. Without interrupts

	gpio_keys {
		compatible = "gpio-keys";
		#address-cells = <1>;
		#size-cells = <0>;

		button@1 {
			debounce-interval = <50>;
			wakeup-source;
			linux,code = <116>;
			label = "POWER";
			gpios = <&iofpga_gpio0 0 0x4>;
		};
		[....]
	};
```

## Documentation/devicetree/bindings/power_supply/ab8500/fg.txt
```
=== AB8500 Fuel Gauge Driver ===

AB8500 is a mixed signal multimedia and power management
device comprising: power and energy-management-module,
wall-charger, usb-charger, audio codec, general purpose adc,
tvout, clock management and sim card interface.

Fuelgauge support is part of energy-management-modules, other
components of this module are:
main-charger, usb-combo-charger and battery-temperature-monitoring.

The properties below describes the node for fuelgauge driver.

Required Properties:
- compatible = This shall be: "stericsson,ab8500-fg"
- battery = Shall be battery specific information
	Example:
	ab8500_fg {
		compatible = "stericsson,ab8500-fg";
		battery	   = <&ab8500_battery>;
	};

dependent node:
	ab8500_battery: ab8500_battery {
	};
	This node will provide information on 'thermistor interface' and
	'battery technology type' used.

Properties of this node are:
thermistor-on-batctrl:
	A boolean value indicating thermistor interface	to battery

	Note:
	'btemp' and 'batctrl' are the pins interfaced for battery temperature
	measurement, 'btemp' signal is used when NTC(negative temperature
	coefficient) resister is interfaced external to battery whereas
	'batctrl' pin is used when NTC resister is internal to battery.

	Example:
	ab8500_battery: ab8500_battery {
		thermistor-on-batctrl;
	};
	indicates: NTC resister is internal to battery, 'batctrl' is used
		for thermal measurement.

	The absence of property 'thermal-on-batctrl' indicates
	NTC resister is external to battery and  'btemp' signal is used
	for thermal measurement.

battery-type:
	This shall be the battery manufacturing technology type,
	allowed types are:
		"UNKNOWN" "NiMH" "LION" "LIPO" "LiFe" "NiCd" "LiMn"
	Example:
	ab8500_battery: ab8500_battery {
		stericsson,battery-type = "LIPO";
	}
```

## Documentation/devicetree/bindings/power_supply/axxia-reset.txt
```
Axxia Restart Driver

This driver can do reset of the Axxia SoC. It uses the registers in the syscon
block to initiate a chip reset.

Required Properties:
  -compatible: "lsi,axm55xx-reset"
  -syscon: phandle to the syscon node.

Example:

	syscon: syscon@2010030000 {
		compatible = "lsi,axxia-syscon", "syscon";
		reg = <0x20 0x10030000 0 0x2000>;
	};

	reset: reset@2010031000 {
		compatible = "lsi,axm55xx-reset";
		syscon = <&syscon>;
	};
```
