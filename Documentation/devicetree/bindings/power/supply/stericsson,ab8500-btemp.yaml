## Documentation/devicetree/bindings/power/supply/ti,lp8727.yaml
```yaml
# SPDX-License-Identifier: GPL-2.0
%YAML 1.2
---
$id: http://devicetree.org/schemas/power/supply/ti,lp8727.yaml#
$schema: http://devicetree.org/meta-schemas/core.yaml#

title: TI/National Semiconductor LP8727 Charger

maintainers:
  - Sebastian Reichel <sre@kernel.org>

allOf:
  - $ref: power-supply.yaml#

properties:
  compatible:
    const: ti,lp8727

  reg:
    const: 0x27

  interrupts:
    maxItems: 1

  debounce-ms:
    description: interrupt debounce time in ms

patternProperties:
  '^(ac|usb)$':
    type: object
    description: USB/AC charging parameters
    properties:
      charger-type:
        enum:
          - ac
          - usb

      eoc-level:
        $ref: /schemas/types.yaml#/definitions/uint8
        minimum: 0
        maximum: 6
        description: |
          End of Charge Percentage with the following mapping:
          0 = 5%, 1 = 10%, 2 = 16%, 3 = 20%, 4 = 25%, 5 = 33%, 6 = 50%

      charging-current:
        $ref: /schemas/types.yaml#/definitions/uint8
        minimum: 0
        maximum: 9
        description: |
          Charging current with the following mapping:
          0 = 90mA, 1 = 100mA, 2 = 400mA, 3 = 450mA, 4 = 500mA, 5 = 600mA,
          6 = 700mA, 7 = 800mA, 8 = 900mA, 9 = 1000mA

required:
  - compatible
  - reg

additionalProperties: false

examples:
  - |
    #include <dt-bindings/interrupt-controller/irq.h>
    i2c0 {
      #address-cells = <1>;
      #size-cells = <0>;

      lp8727: charger@27 {
        compatible = "ti,lp8727";
        reg = <0x27>;
        interrupt-parent = <&gpio5>;
        interrupts = <6 IRQ_TYPE_EDGE_FALLING>;
        debounce-ms = <300>;

        /* AC charger: 5% EOC and 500mA charging current */
        ac {
          charger-type = "ac";
          eoc-level = /bits/ 8 <0>;
          charging-current = /bits/ 8 <4>;
        };

        /* USB charger: 10% EOC and 400mA charging current */
        usb {
          charger-type = "usb";
          eoc-level = /bits/ 8 <1>;
          charging-current = /bits/ 8 <2>;
        };
      };
    };
```

## Documentation/devicetree/bindings/power/supply/ti,twl6030-charger.yaml
```yaml
# SPDX-License-Identifier: GPL-2.0-only OR BSD-2-Clause
%YAML 1.2
---
$id: http://devicetree.org/schemas/power/supply/ti,twl6030-charger.yaml#
$schema: http://devicetree.org/meta-schemas/core.yaml#

title: TWL6030/32 BCI (Battery Charger Interface)

description:
  The battery charger needs to be configured to do any charging besides of
  precharging. The GPADC in the PMIC has to be used to get the related
  voltages.

maintainers:
  - Andreas Kemnade <andreas@kemnade.info>

allOf:
  - $ref: power-supply.yaml#

properties:
  compatible:
    oneOf:
      - const: ti,twl6030-charger
      - items:
          - const: ti,twl6032-charger
          - const: ti,twl6030-charger

  interrupts:
    items:
      - description: Charger Control Interrupt
      - description: Charger Fault Interrupt

  io-channels:
    items:
      - description: VBUS Voltage Channel

  io-channel-names:
    items:
      - const: vusb

  monitored-battery: true

required:
  - compatible
  - interrupts
  - monitored-battery

additionalProperties: false
```

## Documentation/devicetree/bindings/power/supply/tps65090-charger.yaml
```yaml
# SPDX-License-Identifier: GPL-2.0
%YAML 1.2
---
$id: http://devicetree.org/schemas/power/supply/tps65090-charger.yaml#
$schema: http://devicetree.org/meta-schemas/core.yaml#

title: TPS65090 Frontend PMU with Switchmode Charger

maintainers:
  - Sebastian Reichel <sre@kernel.org>

allOf:
  - $ref: power-supply.yaml#

properties:
  compatible:
    const: ti,tps65090-charger

  ti,enable-low-current-chrg:
    type: boolean
    description: |
      Enables charging when a low current is detected while the default logic is to stop charging.

required:
  - compatible

additionalProperties: false

examples:
  - |
    pmic {
      charger {
        compatible = "ti,tps65090-charger";
        ti,enable-low-current-chrg;
      };
    };
```

## Documentation/devicetree/bindings/power/supply/tps65090.txt
```
TPS65090 Frontend PMU with Switchmode Charger

Required Properties:
-compatible: "ti,tps65090-charger"

Optional Properties:
-ti,enable-low-current-chrg: Enables charging when a low current is detected
 while the default logic is to stop charging.

This yesde is a subyesde of the tps65090 PMIC.

Example:

	tps65090-charger {
		compatible = "ti,tps65090-charger";
		ti,enable-low-current-chrg;
	};
```

## Documentation/devicetree/bindings/power/supply/tps65217-charger.yaml
```yaml
# SPDX-License-Identifier: GPL-2.0
%YAML 1.2
---
$id: http://devicetree.org/schemas/power/supply/tps65217-charger.yaml#
$schema: http://devicetree.org/meta-schemas/core.yaml#

title: TPS65217 Charger

maintainers:
  - Sebastian Reichel <sre@kernel.org>

allOf:
  - $ref: power-supply.yaml#

properties:
  compatible:
    const: ti,tps65217-charger

  interrupts:
    minItems: 2
    maxItems: 2

  interrupt-names:
    items:
      - const: USB
      - const: AC

required:
  - compatible
  - interrupts
  - interrupt-names

additionalProperties: false

examples:
  - |
    pmic {
      charger {
        compatible = "ti,tps65217-charger";
        interrupts = <0>, <1>;
        interrupt-names = "USB", "AC";
      };
    };
```

## Documentation/devicetree/bindings/power/supply/tps65217_charger.txt
```
TPS65217 Charger

Required Properties:
-compatible: "ti,tps65217-charger"
-interrupts: TPS65217 interrupt numbers for the AC and USB charger input change.
             Should be <0> for the USB charger and <1> for the AC adapter.
-interrupt-names: Should be "USB" and "AC"

This node is a subnode of the tps65217 PMIC.

Example:

	tps65217-charger {
		compatible = "ti,tps65217-charger";
		interrupts = <0>, <1>;
		interrupt-names = "USB", "AC";
	};
```

## Documentation/devicetree/bindings/power/supply/twl-charger.txt
```
TWL BCI (Battery Charger Interface)

The battery charger needs to interact with the USB phy in order
to know when charging is permissible, and when there is a connection
or disconnection.

The choice of phy cannot be configured at a hardware level, so there
is no value in explicit configuration in device-tree.  Rather
if there is a sibling of the BCI node which is compatible with
"ti,twl4030-usb", then that is used to determine when and how
use USB power for charging.

Required properties:
- compatible:
  - "ti,twl4030-bci"
- interrupts: two interrupt lines from the TWL SIH (secondary
  interrupt handler) - interrupts 9 and 2.

Optional properties:
- ti,bb-uvolt: microvolts for charging the backup battery.
- ti,bb-uamp: microamps for charging the backup battery.

Examples:

bci {
   compatible = "ti,twl4030-bci";
   interrupts = <9>, <2>;
   ti,bb-uvolt = <3200000>;
   ti,bb-uamp = <150>;
};
```

## Documentation/devicetree/bindings/power/supply/twl4030-charger.yaml
```yaml
# SPDX-License-Identifier: GPL-2.0
%YAML 1.2
---
$id: http://devicetree.org/schemas/power/supply/twl4030-charger.yaml#
$schema: http://devicetree.org/meta-schemas/core.yaml#

title: TWL4030 BCI (Battery Charger Interface)

description: |
  The battery charger needs to interact with the USB phy in order to know when
  charging is permissible, and when there is a connection or disconnection.

  The choice of phy cannot be configured at a hardware level, so there is no
  value in explicit configuration in device-tree. Rather if there is a sibling
  of the BCI node which is compatible with "ti,twl4030-usb", then that is used
  to determine when and how use USB power for charging.

maintainers:
  - Sebastian Reichel <sre@kernel.org>

allOf:
  - $ref: power-supply.yaml#

properties:
  compatible:
    const: ti,twl4030-bci

  interrupts:
    minItems: 2
    maxItems: 2

  ti,bb-uvolt:
    $ref: /schemas/types.yaml#/definitions/uint32
    description: microvolts for charging the backup battery

  ti,bb-uamp:
    $ref: /schemas/types.yaml#/definitions/uint32
    description: microamps for charging the backup battery

  io-channels:
    items:
      - description: Accessory Charger Voltage Channel

  io-channel-names:
    items:
      - const: vac

  bci3v1-supply:
    description: 3.1V USB regulator

required:
  - compatible
  - interrupts

additionalProperties: false

examples:
  - |
    pmic {
      charger {
        compatible = "ti,twl4030-bci";
        interrupts = <9>, <2>;
        ti,bb-uvolt = <3200000>;
        ti,bb-uamp = <150>;
        io-channels = <&twl_madc 11>;
        io-channel-names = "vac";
      };
    };
```

## Documentation/devicetree/bindings/power/supply/x-powers,axp20x-ac-power-supply.yaml
```yaml
# SPDX-License-Identifier: GPL-2.0
%YAML 1.2
---
$id: "http://devicetree.org/schemas/power/supply/x-powers,axp20x-ac-power-supply.yaml#"
$schema: "http://devicetree.org/meta-schemas/core.yaml#"

title: AXP20x AC power-supply

description: |
  The AXP20X can read the current current and voltage supplied by AC by
  reading ADC channels from the AXP20X ADC. The AXP22X is only able to
  tell if an AC power supply is present and usable. AXP813/AXP803 are
  able to limit current and supply voltage

maintainers:
  - Chen-Yu Tsai <wens@csie.org>
  - Sebastian Reichel <sre@kernel.org>

allOf:
  - $ref: power-supply.yaml#

properties:
  compatible:
    oneOf:
      - const: x-powers,axp202-ac-power-supply
      - const: x-powers,axp221-ac-power-supply
      - items:
          - const: x-powers,axp803-ac-power-supply
          - const: x-powers,axp813-ac-power-supply
      - const: x-powers,axp813-ac-power-supply

required:
  - compatible

additionalProperties: false
```

## Documentation/devicetree/bindings/power/supply/x-powers,axp20x-battery-power-supply.yaml
```yaml
# SPDX-License-Identifier: GPL-2.0
%YAML 1.2
---
$id: http://devicetree.org/schemas/power/supply/x-powers,axp20x-battery-power-supply.yaml#
$schema: http://devicetree.org/meta-schemas/core.yaml#

title: AXP20x Battery power-supply

description: |
  The supported devices can read the battery voltage, charge and discharge
  currents of the battery by reading ADC channels from the ADC.

maintainers:
  - Chen-Yu Tsai <wens@csie.org>
  - Sebastian Reichel <sre@kernel.org>

properties:
  compatible:
    oneOf:
      - const: x-powers,axp202-battery-power-supply
      - const: x-powers,axp209-battery-power-supply
      - const: x-powers,axp221-battery-power-supply
      - const: x-powers,axp717-battery-power-supply
      - items:
          - const: x-powers,axp803-battery-power-supply
          - const: x-powers,axp813-battery-power-supply
      - const: x-powers,axp813-battery-power-supply

  monitored-battery:
    description:
      Specifies the phandle of an optional simple-battery connected to
      this gauge.
    $ref: /schemas/types.yaml#/definitions/phandle

  x-powers,no-thermistor:
    type: boolean
    description: Indicates that no thermistor is connected to the TS pin

required:
  - compatible

allOf:
  - $ref: power-supply.yaml#
  - if:
      not:
        properties:
          compatible:
            contains:
              enum:
                - x-powers,axp717-battery-power-supply
    then:
      properties:
        x-powers,no-thermistor: false

additionalProperties: false
```

## Documentation/devicetree/bindings/power/supply/x-powers,axp20x-usb-power-supply.yaml
```yaml
# SPDX-License-Identifier: GPL-2.0
%YAML 1.2
---
$id: http://devicetree.org/schemas/power/supply/x-powers,axp20x-usb-power-supply.yaml#
$schema: http://devicetree.org/meta-schemas/core.yaml#

title: AXP20x USB power-supply

description: |
  The AXP223 PMIC shares most of its behaviour with the AXP221 but has slight
  variations such as the former being able to set the VBUS power supply max
  current to 100mA, unlike the latter.

maintainers:
  - Chen-Yu Tsai <wens@csie.org>
  - Sebastian Reichel <sre@kernel.org>

properties:
  compatible:
    oneOf:
      - enum:
          - x-powers,axp192-usb-power-supply
          - x-powers,axp202-usb-power-supply
          - x-powers,axp221-usb-power-supply
          - x-powers,axp223-usb-power-supply
          - x-powers,axp717-usb-power-supply
          - x-powers,axp813-usb-power-supply
      - items:
          - const: x-powers,axp803-usb-power-supply
          - const: x-powers,axp813-usb-power-supply

  input-current-limit-microamp:
    description:
      Optional value to clamp the maximum input current limit to for
      the device. If omitted, the programmed value from the EFUSE will
      be used.
    minimum: 100000
    maximum: 4000000

required:
  - compatible

allOf:
  - $ref: power-supply.yaml#
  - if:
      properties:
        compatible:
          contains:
            enum:
              - x-powers,axp192-usb-power-supply
    then:
      properties:
        input-current-limit-microamp:
          enum: [100000, 500000]

  - if:
      properties:
        compatible:
          contains:
            enum:
              - x-powers,axp202-usb-power-supply
              - x-powers,axp223-usb-power-supply
    then:
      properties:
        input-current-limit-microamp:
          enum: [100000, 500000, 900000]

  - if:
      properties:
        compatible:
          contains:
            enum:
              - x-powers,axp221-usb-power-supply
    then:
      properties:
        input-current-limit-microamp:
          enum: [500000, 900000]

  - if:
      properties:
        compatible:
          contains:
            enum:
              - x-powers,axp717-usb-power-supply
    then:
      properties:
        input-current-limit-microamp:
          description: Maximum input current in increments of 50000 uA.
          minimum: 100000
          maximum: 3250000

  - if:
      properties:
        compatible:
          contains:
            enum:
              - x-powers,axp813-usb-power-supply
    then:
      properties:
        input-current-limit-microamp:
          enum: [100000, 500000, 900000, 1500000, 2000000, 2500000,
                 3000000, 3500000, 4000000]

additionalProperties: false
```

## Documentation/devicetree/bindings/power/sy6982c-charger.txt
```
Binding for sy6982c Charger

Required properties:
- compatible: Should contain one of the following:
    * "sy6982c-charger"
- extcon: extcon specifier for the Charger.

Example:

	sy6982c {
		status = "okay";
		compatible = "sy6982c-charger";
		extcon = <&u2phy0>;
	};
```

## Documentation/devicetree/bindings/power/ti-smartreflex.txt
```
Texas Instruments SmartReflex binding

SmartReflex is used to set and adjust the SoC operating points.


Required properties:

compatible: Shall be one of the following:
	    "ti,omap3-smartreflex-core"
	    "ti,omap3-smartreflex-iva"
	    "ti,omap4-smartreflex-core"
	    "ti,omap4-smartreflex-mpu"
	    "ti,omap4-smartreflex-iva"

reg: Shall contain the device instance IO range

interrupts: Shall contain the device instance interrupt


Optional properties:

ti,hwmods: Shall contain the TI interconnect module name if needed
	   by the SoC


Example:

	smartreflex_iva: smartreflex@4a0db000 {
		compatible = "ti,omap4-smartreflex-iva";
		reg = <0x4a0db000 0x80>;
		interrupts = <GIC_SPI 102 IRQ_TYPE_LEVEL_HIGH>;
		ti,hwmods = "smartreflex_iva";
	};

	smartreflex_core: smartreflex@4a0dd000 {
		compatible = "ti,omap4-smartreflex-core";
		reg = <0x4a0dd000 0x80>;
		interrupts = <GIC_SPI 19 IRQ_TYPE_LEVEL_HIGH>;
		ti,hwmods = "smartreflex_core";
	};

	smartreflex_mpu: smartreflex@4a0d9000 {
		compatible = "ti,omap4-smartreflex-mpu";
		reg = <0x4a0d9000 0x80>;
		interrupts = <GIC_SPI 18 IRQ_TYPE_LEVEL_HIGH>;
		ti,hwmods = "smartreflex_mpu";
	};
```
