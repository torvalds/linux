## Documentation/devicetree/bindings/power/supply/stericsson,ab8500-btemp.yaml
```yaml
# SPDX-License-Identifier: GPL-2.0
# Copyright (C) 2021 Sebastian Reichel
%YAML 1.2
---
$id: http://devicetree.org/schemas/power/supply/stericsson,ab8500-btemp.yaml#
$schema: http://devicetree.org/meta-schemas/core.yaml#

title: AB8500 Battery Temperature Monitor

maintainers:
  - Sebastian Reichel <sre@kernel.org>

allOf:
  - $ref: power-supply.yaml#

properties:
  compatible:
    const: stericsson,ab8500-btemp

  monitored-battery: true

  battery:
    $ref: /schemas/types.yaml#/definitions/phandle
    deprecated: true

  interrupts:
    maxItems: 5

  interrupt-names:
    items:
      - const: BAT_CTRL_INDB
      - const: BTEMP_LOW
      - const: BTEMP_HIGH
      - const: BTEMP_LOW_MEDIUM
      - const: BTEMP_MEDIUM_HIGH

  io-channels:
    maxItems: 2

  io-channel-names:
    items:
      - const: btemp_ball
      - const: bat_ctrl

required:
  - compatible
  - monitored-battery
  - interrupts
  - interrupt-names
  - io-channels
  - io-channel-names

additionalProperties: false

examples:
  - |
    #include <dt-bindings/interrupt-controller/irq.h>
    pmic {
      battery-temperature {
        compatible = "stericsson,ab8500-btemp";
        monitored-battery = <&battery>;
        interrupts = <20 IRQ_TYPE_LEVEL_HIGH>,
                     <80 IRQ_TYPE_LEVEL_HIGH>,
                     <83 IRQ_TYPE_LEVEL_HIGH>,
                     <81 IRQ_TYPE_LEVEL_HIGH>,
                     <82 IRQ_TYPE_LEVEL_HIGH>;
        interrupt-names = "BAT_CTRL_INDB",
                          "BTEMP_LOW",
                          "BTEMP_HIGH",
                          "BTEMP_LOW_MEDIUM",
                          "BTEMP_MEDIUM_HIGH";
        io-channels = <&gpadc 0x02>, <&gpadc 0x01>;
        io-channel-names = "btemp_ball", "bat_ctrl";
      };
    };
```

## Documentation/devicetree/bindings/power/supply/stericsson,ab8500-chargalg.yaml
```yaml
# SPDX-License-Identifier: GPL-2.0
# Copyright (C) 2021 Sebastian Reichel
%YAML 1.2
---
$id: "http://devicetree.org/schemas/power/supply/stericsson,ab8500-chargalg.yaml#"
$schema: "http://devicetree.org/meta-schemas/core.yaml#"

title: AB8500 Charging Algorithm

maintainers:
  - Sebastian Reichel <sre@kernel.org>

allOf:
  - $ref: power-supply.yaml#

properties:
  compatible:
    const: stericsson,ab8500-chargalg

  monitored-battery:
    $ref: /schemas/types.yaml#/definitions/phandle
    description: phandle to battery node

  battery:
    $ref: /schemas/types.yaml#/definitions/phandle
    deprecated: true

required:
  - compatible
  - monitored-battery

additionalProperties: false

examples:
  - |
    pmic {
      charging-algorithm {
        compatible = "stericsson,ab8500-chargalg";
        monitored-battery = <&ab8500_battery>;
      };
    };
```

## Documentation/devicetree/bindings/power/supply/stericsson,ab8500-charger.yaml
```yaml
# SPDX-License-Identifier: GPL-2.0
# Copyright (C) 2021 Sebastian Reichel
%YAML 1.2
---
$id: http://devicetree.org/schemas/power/supply/stericsson,ab8500-charger.yaml#
$schema: http://devicetree.org/meta-schemas/core.yaml#

title: AB8500 Charger

maintainers:
  - Sebastian Reichel <sre@kernel.org>

allOf:
  - $ref: power-supply.yaml#

properties:
  compatible:
    const: stericsson,ab8500-charger

  monitored-battery:
    $ref: /schemas/types.yaml#/definitions/phandle
    description: phandle to battery node

  battery:
    $ref: /schemas/types.yaml#/definitions/phandle
    deprecated: true

  vddadc-supply:
    description: Supply for USB and Main charger

  autopower_cfg:
    type: boolean
    description: automatic poweron after powerloss

  interrupts:
    maxItems: 14

  interrupt-names:
    items:
      - const: MAIN_CH_UNPLUG_DET
      - const: MAIN_CHARGE_PLUG_DET
      - const: MAIN_EXT_CH_NOT_OK
      - const: MAIN_CH_TH_PROT_R
      - const: MAIN_CH_TH_PROT_F
      - const: VBUS_DET_F
      - const: VBUS_DET_R
      - const: USB_LINK_STATUS
      - const: USB_CH_TH_PROT_R
      - const: USB_CH_TH_PROT_F
      - const: USB_CHARGER_NOT_OKR
      - const: VBUS_OVV
      - const: CH_WD_EXP
      - const: VBUS_CH_DROP_END

  io-channels:
    minItems: 2
    maxItems: 4

  io-channel-names:
    oneOf:
      - items:
          - const: main_charger_v
          - const: main_charger_c
          - const: vbus_v
          - const: usb_charger_c
      - items:
          - const: vbus_v
          - const: usb_charger_c


required:
  - compatible
  - monitored-battery
  - vddadc-supply
  - interrupts
  - interrupt-names
  - io-channels
  - io-channel-names

additionalProperties: false

examples:
  - |
    #include <dt-bindings/interrupt-controller/irq.h>
    pmic {
      charger {
        compatible = "stericsson,ab8500-charger";
        monitored-battery = <&battery>;
        vddadc-supply = <&ab8500_ldo_tvout_reg>;
        interrupts = <10 IRQ_TYPE_LEVEL_HIGH>,
                     <11 IRQ_TYPE_LEVEL_HIGH>,
                     <0 IRQ_TYPE_LEVEL_HIGH>,
                     <107 IRQ_TYPE_LEVEL_HIGH>,
                     <106 IRQ_TYPE_LEVEL_HIGH>,
                     <14 IRQ_TYPE_LEVEL_HIGH>,
                     <15 IRQ_TYPE_LEVEL_HIGH>,
                     <79 IRQ_TYPE_LEVEL_HIGH>,
                     <105 IRQ_TYPE_LEVEL_HIGH>,
                     <104 IRQ_TYPE_LEVEL_HIGH>,
                     <89 IRQ_TYPE_LEVEL_HIGH>,
                     <22 IRQ_TYPE_LEVEL_HIGH>,
                     <21 IRQ_TYPE_LEVEL_HIGH>,
                     <16 IRQ_TYPE_LEVEL_HIGH>;
        interrupt-names = "MAIN_CH_UNPLUG_DET",
                          "MAIN_CHARGE_PLUG_DET",
                          "MAIN_EXT_CH_NOT_OK",
                          "MAIN_CH_TH_PROT_R",
                          "MAIN_CH_TH_PROT_F",
                          "VBUS_DET_F",
                          "VBUS_DET_R",
                          "USB_LINK_STATUS",
                          "USB_CH_TH_PROT_R",
                          "USB_CH_TH_PROT_F",
                          "USB_CHARGER_NOT_OKR",
                          "VBUS_OVV",
                          "CH_WD_EXP",
                          "VBUS_CH_DROP_END";
        io-channels = <&gpadc 0x03>,
                      <&gpadc 0x0a>,
                      <&gpadc 0x09>,
                      <&gpadc 0x0b>;
        io-channel-names = "main_charger_v",
                           "main_charger_c",
                           "vbus_v",
                           "usb_charger_c";
      };
    };
```

## Documentation/devicetree/bindings/power/supply/stericsson,ab8500-fg.yaml
```yaml
# SPDX-License-Identifier: GPL-2.0
# Copyright (C) 2021 Sebastian Reichel
%YAML 1.2
---
$id: "http://devicetree.org/schemas/power/supply/stericsson,ab8500-fg.yaml#"
$schema: "http://devicetree.org/meta-schemas/core.yaml#"

title: AB8500 Fuel Gauge

maintainers:
  - Sebastian Reichel <sre@kernel.org>

allOf:
  - $ref: power-supply.yaml#

properties:
  compatible:
    const: stericsson,ab8500-fg

  monitored-battery:
    $ref: /schemas/types.yaml#/definitions/phandle
    description: phandle to battery node

  battery:
    $ref: /schemas/types.yaml#/definitions/phandle
    deprecated: true

  interrupts:
    maxItems: 5

  interrupt-names:
    items:
      - const: NCONV_ACCU
      - const: BATT_OVV
      - const: LOW_BAT_F
      - const: CC_INT_CALIB
      - const: CCEOC

  io-channels:
    maxItems: 1

  io-channel-names:
    items:
      - const: main_bat_v

required:
  - compatible
  - monitored-battery
  - interrupts
  - interrupt-names
  - io-channels
  - io-channel-names

additionalProperties: false

examples:
  - |
    #include <dt-bindings/interrupt-controller/irq.h>
    pmic {
      fuel-gauge {
        compatible = "stericsson,ab8500-fg";
        monitored-battery = <&battery>;
        interrupts = <24 IRQ_TYPE_LEVEL_HIGH>,
                     <8 IRQ_TYPE_LEVEL_HIGH>,
                     <28 IRQ_TYPE_LEVEL_HIGH>,
                     <27 IRQ_TYPE_LEVEL_HIGH>,
                     <26 IRQ_TYPE_LEVEL_HIGH>;
        interrupt-names = "NCONV_ACCU",
                          "BATT_OVV",
                          "LOW_BAT_F",
                          "CC_INT_CALIB",
                          "CCEOC";
        io-channels = <&gpadc 0x08>;
        io-channel-names = "main_bat_v";
      };
    };
```

## Documentation/devicetree/bindings/power/supply/summit,smb347-charger.yaml
```yaml
# SPDX-License-Identifier: (GPL-2.0-only OR BSD-2-Clause)
%YAML 1.2
---
$id: http://devicetree.org/schemas/power/supply/summit,smb347-charger.yaml#
$schema: http://devicetree.org/meta-schemas/core.yaml#

title: Battery charger driver for SMB345, SMB347 and SMB358

maintainers:
  - David Heidelberg <david@ixit.cz>
  - Dmitry Osipenko <digetx@gmail.com>

properties:
  compatible:
    enum:
      - summit,smb345
      - summit,smb347
      - summit,smb358

  reg:
    maxItems: 1

  interrupts:
    maxItems: 1

  monitored-battery: true

  summit,enable-usb-charging:
    type: boolean
    description: Enable charging through USB.

  summit,enable-otg-charging:
    type: boolean
    description: Provide power for USB OTG

  summit,enable-mains-charging:
    type: boolean
    description: Enable charging through mains

  summit,enable-charge-control:
    description: Enable charging control
    $ref: /schemas/types.yaml#/definitions/uint32
    enum:
      - 0 # SMB3XX_CHG_ENABLE_SW SW (I2C interface)
      - 1 # SMB3XX_CHG_ENABLE_PIN_ACTIVE_LOW Pin control (Active Low)
      - 2 # SMB3XX_CHG_ENABLE_PIN_ACTIVE_HIGH Pin control (Active High)

  summit,fast-voltage-threshold-microvolt:
    description: Voltage threshold to transit to fast charge mode (in uV)
    minimum: 2400000
    maximum: 3000000

  summit,mains-current-limit-microamp:
    description: Maximum input current from AC/DC input (in uA)

  summit,usb-current-limit-microamp:
    description: Maximum input current from USB input (in uA)

  summit,charge-current-compensation-microamp:
    description: Charge current compensation (in uA)

  summit,chip-temperature-threshold-celsius:
    description: Chip temperature for thermal regulation in °C.
    enum: [100, 110, 120, 130]

  summit,soft-compensation-method:
    description: Soft temperature limit compensation method
    $ref: /schemas/types.yaml#/definitions/uint32
    enum:
      - 0 # SMB3XX_SOFT_TEMP_COMPENSATE_NONE Compensation none
      - 1 # SMB3XX_SOFT_TEMP_COMPENSATE_CURRENT Current compensation
      - 2 # SMB3XX_SOFT_TEMP_COMPENSATE_VOLTAGE Voltage compensation

  summit,inok-polarity:
    description: |
      Polarity of INOK signal indicating presence of external power supply.
    $ref: /schemas/types.yaml#/definitions/uint32
    enum:
      - 0 # SMB3XX_SYSOK_INOK_ACTIVE_LOW
      - 1 # SMB3XX_SYSOK_INOK_ACTIVE_HIGH

  usb-vbus:
    $ref: /schemas/regulator/regulator.yaml#
    type: object

    properties:
      summit,needs-inok-toggle:
        type: boolean
        description: INOK signal is fixed and polarity needs to be toggled
                     in order to enable/disable output mode.

    unevaluatedProperties: false

allOf:
  - $ref: power-supply.yaml#
  - if:
      properties:
        compatible:
          enum:
            - summit,smb345
            - summit,smb358

    then:
      properties:
        summit,mains-current-limit-microamp:
          enum: [ 300000, 500000, 700000, 1000000,
                  1500000, 1800000, 2000000]

        summit,usb-current-limit-microamp:
          enum: [ 300000, 500000, 700000, 1000000,
                  1500000, 1800000, 2000000]

        summit,charge-current-compensation-microamp:
          enum: [200000, 450000, 600000, 900000]

    else:
      properties:
        summit,mains-current-limit-microamp:
          enum: [ 300000, 500000, 700000, 900000, 1200000,
                  1500000, 1800000, 2000000, 2200000, 2500000]

        summit,usb-current-limit-microamp:
          enum: [ 300000, 500000, 700000, 900000, 1200000,
                  1500000, 1800000, 2000000, 2200000, 2500000]

        summit,charge-current-compensation-microamp:
          enum: [250000, 700000, 900000, 1200000]

required:
  - compatible
  - reg

anyOf:
  - required:
      - summit,enable-usb-charging
  - required:
      - summit,enable-otg-charging
  - required:
      - summit,enable-mains-charging

additionalProperties: false

examples:
  - |
    #include <dt-bindings/power/summit,smb347-charger.h>

    i2c {
        #address-cells = <1>;
        #size-cells = <0>;

        charger@7f {
            compatible = "summit,smb347";
            reg = <0x7f>;

            summit,enable-charge-control = <SMB3XX_CHG_ENABLE_PIN_ACTIVE_HIGH>;
            summit,inok-polarity = <SMB3XX_SYSOK_INOK_ACTIVE_LOW>;
            summit,chip-temperature-threshold-celsius = <110>;
            summit,mains-current-limit-microamp = <2000000>;
            summit,usb-current-limit-microamp = <500000>;
            summit,enable-usb-charging;
            summit,enable-mains-charging;

            monitored-battery = <&battery>;

            usb-vbus {
                regulator-name = "usb_vbus";
                regulator-min-microvolt = <5000000>;
                regulator-max-microvolt = <5000000>;
                regulator-min-microamp = <750000>;
                regulator-max-microamp = <750000>;
                summit,needs-inok-toggle;
            };
        };
    };

    battery: battery-cell {
        compatible = "simple-battery";
        constant-charge-current-max-microamp = <1800000>;
        operating-range-celsius = <0 45>;
        alert-celsius = <3 42>;
    };
```

## Documentation/devicetree/bindings/power/supply/ti,bq24735.txt
```
TI BQ24735 Charge Controller
~~~~~~~~~~

Required properties :
 - compatible : "ti,bq24735"

Optional properties :
 - interrupts : Specify the interrupt to be used to trigger when the AC
   adapter is either plugged in or removed.
 - ti,ac-detect-gpios : This GPIO is optionally used to read the AC adapter
   status. This is a Host GPIO that is configured as an input and connected
   to the ACOK pin on the bq24735. Note: for backwards compatibility reasons,
   the GPIO must be active on AC adapter absence despite ACOK being active
   (high) on AC adapter presence.
 - ti,charge-current : Used to control and set the charging current. This value
   must be between 128mA and 8.128A with a 64mA step resolution. The POR value
   is 0x0000h. This number is in mA (e.g. 8192), see spec for more information
   about the ChargeCurrent (0x14h) register.
 - ti,charge-voltage : Used to control and set the charging voltage. This value
   must be between 1.024V and 19.2V with a 16mV step resolution. The POR value
   is 0x0000h. This number is in mV (e.g. 19200), see spec for more information
   about the ChargeVoltage (0x15h) register.
 - ti,input-current : Used to control and set the charger input current. This
   value must be between 128mA and 8.064A with a 128mA step resolution. The
   POR value is 0x1000h. This number is in mA (e.g. 8064), see the spec for
   more information about the InputCurrent (0x3fh) register.
 - ti,external-control : Indicates that the charger is configured externally
   and that the host should not attempt to enable/disable charging or set the
   charge voltage/current.
 - poll-interval : In case 'interrupts' is not specified, poll AC adapter
   presence with this interval (milliseconds).

Example:

	bq24735@9 {
		compatible = "ti,bq24735";
		reg = <0x9>;
		ti,ac-detect-gpios = <&gpio 72 0x1>;
	}
```
