## Documentation/devicetree/bindings/power/supply/qcom,pm8941-coincell.yaml
```yaml
# SPDX-License-Identifier: GPL-2.0
%YAML 1.2
---
$id: http://devicetree.org/schemas/power/supply/qcom,pm8941-coincell.yaml#
$schema: http://devicetree.org/meta-schemas/core.yaml#

title: Qualcomm Coincell Charger

description: |
  The hardware block controls charging for a coincell or capacitor that is
  used to provide power backup for certain features of the power management
  IC (PMIC)

maintainers:
  - Sebastian Reichel <sre@kernel.org>

properties:
  compatible:
    oneOf:
      - items:
          - enum:
              - qcom,pm8998-coincell
          - const: qcom,pm8941-coincell

      - const: qcom,pm8941-coincell

  reg:
    maxItems: 1

  qcom,rset-ohms:
    description: |
      Resistance (in ohms) for current-limiting resistor. If unspecified,
      inherit the previous configuration (e.g. from bootloader or hardware
      default value).
    enum: [ 800, 1200, 1700, 2100 ]

  qcom,vset-millivolts:
    $ref: /schemas/types.yaml#/definitions/uint32
    description: |
      Voltage (in millivolts) to apply for charging. If unspecified, inherit
      the previous configuration (e.g. from bootloader or hardware default
      value).
    enum: [ 2500, 3000, 3100, 3200 ]

  qcom,charger-disable:
    type: boolean
    description: defining this property disables charging

required:
  - compatible
  - reg

additionalProperties: false

examples:
  - |
    pmic {
      #address-cells = <1>;
      #size-cells = <0>;

      charger@2800 {
        compatible = "qcom,pm8941-coincell";
        reg = <0x2800>;
        qcom,rset-ohms = <2100>;
        qcom,vset-millivolts = <3000>;
      };
    };
```

## Documentation/devicetree/bindings/power/supply/qcom,pmi8998-charger.yaml
```yaml
# SPDX-License-Identifier: GPL-2.0 OR BSD-2-Clause
%YAML 1.2
---
$id: http://devicetree.org/schemas/power/supply/qcom,pmi8998-charger.yaml#
$schema: http://devicetree.org/meta-schemas/core.yaml#

title: Qualcomm PMI8998/PM660 Switch-Mode Battery Charger "2"

maintainers:
  - Caleb Connolly <caleb.connolly@linaro.org>

properties:
  compatible:
    enum:
      - qcom,pmi8998-charger
      - qcom,pm660-charger

  reg:
    maxItems: 1

  interrupts:
    maxItems: 4

  interrupt-names:
    items:
      - const: usb-plugin
      - const: bat-ov
      - const: wdog-bark
      - const: usbin-icl-change

  io-channels:
    items:
      - description: USB in current in uA
      - description: USB in voltage in uV

  io-channel-names:
    items:
      - const: usbin_i
      - const: usbin_v

  monitored-battery:
    description: phandle to the simple-battery node
    $ref: /schemas/types.yaml#/definitions/phandle

required:
  - compatible
  - reg
  - interrupts
  - interrupt-names
  - io-channels
  - io-channel-names
  - monitored-battery

additionalProperties: false

examples:
  - |
    #include <dt-bindings/interrupt-controller/irq.h>

    pmic {
      #address-cells = <1>;
      #size-cells = <0>;
      #interrupt-cells = <4>;

      charger@1000 {
        compatible = "qcom,pmi8998-charger";
        reg = <0x1000>;

        interrupts = <0x2 0x12 0x2 IRQ_TYPE_EDGE_BOTH>,
                     <0x2 0x13 0x4 IRQ_TYPE_EDGE_BOTH>,
                     <0x2 0x13 0x6 IRQ_TYPE_EDGE_RISING>,
                     <0x2 0x16 0x1 IRQ_TYPE_EDGE_RISING>;
        interrupt-names = "usb-plugin", "bat-ov", "wdog-bark", "usbin-icl-change";

        io-channels = <&pmi8998_rradc 3>,
                      <&pmi8998_rradc 4>;
        io-channel-names = "usbin_i",
                           "usbin_v";

        monitored-battery = <&battery>;
      };
    };
```

## Documentation/devicetree/bindings/power/supply/qcom,smbchg.yaml
```yaml
# SPDX-License-Identifier: (GPL-2.0-only or BSD-2-Clause)
%YAML 1.2
---
$id: http://devicetree.org/schemas/power/supply/qcom,smbchg.yaml#
$schema: http://devicetree.org/meta-schemas/core.yaml#

title: Qualcomm PMIC Switch-Mode Battery Charger

maintainers:
  - Yassine Oudjana <y.oudjana@protonmail.com>
  - Alejandro Tafalla <atafalla@dnyon.com>

properties:
  compatible:
    enum:
      - qcom,pmi8994-smbchg
      - qcom,pmi8996-smbchg

  reg:
    maxItems: 1

  monitored-battery:
    description: |
      phandle of battery characteristics node.
      The charger uses the following properties:
      - charge-term-current-microamp
      - constant-charge-current-max-microamp
      - voltage-max-design-microvolt
      The constant-charge-current-max-microamp and voltage-max-design-microvolt
      properties must be set.
      See Documentation/devicetree/bindings/power/supply/battery.yaml

  interrupts:
    items:
      - description: Charger error
      - description: Charger inhibited
      - description: Charger precharge safety timer timeout
      - description: Charger charge safety timer timeout
      - description: Charger pre to fast charging switch threshold reached
      - description: Charger recharge threshold reached
      - description: Charger taper threshold reached
      - description: Charger charge termination threshold reached
      - description: Battery hot
      - description: Battery warm
      - description: Battery cold
      - description: Battery cool
      - description: Battery overvoltage
      - description: Battery low
      - description: Battery missing
      - description: Battery thermistor missing # unconfirmed
      - description: USB input undervolt
      - description: USB input overvolt
      - description: USB input source detected
      - description: OTG regulator failure
      - description: OTG regulator overcurrent
      - description: Automatic input current limiting done
      - description: USB ID pin changed
      - description: DC input undervolt
      - description: DC input overvolt
      - description: Power OK
      - description: Temperature shutdown
      - description: Watchdog timeout
      - description: Flash failure
      - description: OTST2 # unknown
      - description: OTST3 # unknown

  interrupt-names:
    items:
      - const: chg-error
      - const: chg-inhibit
      - const: chg-prechg-sft
      - const: chg-complete-chg-sft
      - const: chg-p2f-thr
      - const: chg-rechg-thr
      - const: chg-taper-thr
      - const: chg-tcc-thr
      - const: batt-hot
      - const: batt-warm
      - const: batt-cold
      - const: batt-cool
      - const: batt-ov
      - const: batt-low
      - const: batt-missing
      - const: batt-term-missing
      - const: usbin-uv
      - const: usbin-ov
      - const: usbin-src-det
      - const: otg-fail
      - const: otg-oc
      - const: aicl-done
      - const: usbid-change
      - const: dcin-uv
      - const: dcin-ov
      - const: power-ok
      - const: temp-shutdown
      - const: wdog-timeout
      - const: flash-fail
      - const: otst2
      - const: otst3

  otg-vbus:
    type: object

    description:
      OTG regulator subnode.

required:
  - compatible
  - reg
  - monitored-battery
  - interrupts
  - interrupt-names
  - otg-vbus

additionalProperties: false

examples:
  - |
    #include <dt-bindings/interrupt-controller/irq.h>

    battery: battery {
        compatible = "simple-battery";

        charge-full-design-microamp-hours = <4070000>;
        charge-term-current-microamp = <100000>;
        voltage-min-design-microvolt = <3400000>;
        voltage-max-design-microvolt = <4400000>;
    };

    pmic {
        #address-cells = <1>;
        #size-cells = <0>;

        charger@1000 {
            compatible = "qcom,pmi8996-smbchg";
            reg = <0x1000>;

            interrupts = <0x2 0x10 0x0 IRQ_TYPE_EDGE_BOTH>,
                         <0x2 0x10 0x1 IRQ_TYPE_EDGE_BOTH>,
                         <0x2 0x10 0x2 IRQ_TYPE_EDGE_BOTH>,
                         <0x2 0x10 0x3 IRQ_TYPE_EDGE_BOTH>,
                         <0x2 0x10 0x4 IRQ_TYPE_EDGE_BOTH>,
                         <0x2 0x10 0x5 IRQ_TYPE_EDGE_BOTH>,
                         <0x2 0x10 0x6 IRQ_TYPE_EDGE_RISING>,
                         <0x2 0x10 0x7 IRQ_TYPE_EDGE_RISING>,
                         <0x2 0x12 0x0 IRQ_TYPE_EDGE_BOTH>,
                         <0x2 0x12 0x1 IRQ_TYPE_EDGE_BOTH>,
                         <0x2 0x12 0x2 IRQ_TYPE_EDGE_BOTH>,
                         <0x2 0x12 0x3 IRQ_TYPE_EDGE_BOTH>,
                         <0x2 0x12 0x4 IRQ_TYPE_EDGE_BOTH>,
                         <0x2 0x12 0x5 IRQ_TYPE_EDGE_BOTH>,
                         <0x2 0x12 0x6 IRQ_TYPE_EDGE_BOTH>,
                         <0x2 0x12 0x7 IRQ_TYPE_EDGE_BOTH>,
                         <0x2 0x13 0x0 IRQ_TYPE_EDGE_BOTH>,
                         <0x2 0x13 0x1 IRQ_TYPE_EDGE_BOTH>,
                         <0x2 0x13 0x2 IRQ_TYPE_EDGE_BOTH>,
                         <0x2 0x13 0x3 IRQ_TYPE_EDGE_BOTH>,
                         <0x2 0x13 0x4 IRQ_TYPE_EDGE_RISING>,
                         <0x2 0x13 0x5 IRQ_TYPE_EDGE_RISING>,
                         <0x2 0x13 0x6 IRQ_TYPE_EDGE_FALLING>,
                         <0x2 0x14 0x0 IRQ_TYPE_EDGE_BOTH>,
                         <0x2 0x14 0x1 IRQ_TYPE_EDGE_BOTH>,
                         <0x2 0x16 0x0 IRQ_TYPE_EDGE_BOTH>,
                         <0x2 0x16 0x1 IRQ_TYPE_EDGE_BOTH>,
                         <0x2 0x16 0x2 IRQ_TYPE_EDGE_BOTH>,
                         <0x2 0x16 0x3 IRQ_TYPE_EDGE_BOTH>,
                         <0x2 0x16 0x4 IRQ_TYPE_EDGE_BOTH>,
                         <0x2 0x16 0x5 IRQ_TYPE_EDGE_BOTH>;
            interrupt-names = "chg-error",
                              "chg-inhibit",
                              "chg-prechg-sft",
                              "chg-complete-chg-sft",
                              "chg-p2f-thr",
                              "chg-rechg-thr",
                              "chg-taper-thr",
                              "chg-tcc-thr",
                              "batt-hot",
                              "batt-warm",
                              "batt-cold",
                              "batt-cool",
                              "batt-ov",
                              "batt-low",
                              "batt-missing",
                              "batt-term-missing",
                              "usbin-uv",
                              "usbin-ov",
                              "usbin-src-det",
                              "otg-fail",
                              "otg-oc",
                              "aicl-done",
                              "usbid-change",
                              "dcin-uv",
                              "dcin-ov",
                              "power-ok",
                              "temp-shutdown",
                              "wdog-timeout",
                              "flash-fail",
                              "otst2",
                              "otst3";

            monitored-battery = <&battery>;

            otg-vbus { };
        };
    };
```
