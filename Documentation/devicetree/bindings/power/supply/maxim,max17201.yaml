## Documentation/devicetree/bindings/power/supply/maxim,max17201.yaml
```yaml
# SPDX-License-Identifier: GPL-2.0-only OR BSD-2-Clause
%YAML 1.2
---
$id: http://devicetree.org/schemas/power/supply/maxim,max17201.yaml#
$schema: http://devicetree.org/meta-schemas/core.yaml#

title: Maxim MAX17201 fuel gauge

maintainers:
  - Dimitri Fedrau <dima.fedrau@gmail.com>

allOf:
  - $ref: power-supply.yaml#

properties:
  compatible:
    oneOf:
      - const: maxim,max17201
      - items:
          - enum:
              - maxim,max17205
          - const: maxim,max17201

  reg:
    items:
      - description: ModelGauge m5 registers
      - description: Nonvolatile registers

  reg-names:
    items:
      - const: m5
      - const: nvmem

  interrupts:
    maxItems: 1

required:
  - compatible
  - reg
  - reg-names

unevaluatedProperties: false

examples:
  - |
    #include <dt-bindings/interrupt-controller/irq.h>
    i2c {
      #address-cells = <1>;
      #size-cells = <0>;

      fuel-gauge@36 {
        compatible = "maxim,max17201";
        reg = <0x36>, <0xb>;
        reg-names = "m5", "nvmem";
        interrupt-parent = <&gpio0>;
        interrupts = <31 IRQ_TYPE_LEVEL_LOW>;
      };
    };
```

## Documentation/devicetree/bindings/power/supply/maxim,max77693.yaml
```yaml
# SPDX-License-Identifier: GPL-2.0-only OR BSD-2-Clause
%YAML 1.2
---
$id: http://devicetree.org/schemas/power/supply/maxim,max77693.yaml#
$schema: http://devicetree.org/meta-schemas/core.yaml#

title: Maxim MAX77693 MicroUSB and Companion Power Management IC Charger

maintainers:
  - Krzysztof Kozlowski <krzk@kernel.org>

description: |
  This is a part of device tree bindings for Maxim MAX77693 MicroUSB Integrated
  Circuit (MUIC).

  See also Documentation/devicetree/bindings/mfd/maxim,max77693.yaml for
  additional information and example.

properties:
  compatible:
    const: maxim,max77693-charger

  maxim,constant-microvolt:
    description: |
      Battery constant voltage in uV. The charger will operate in fast
      charge constant current mode till battery voltage reaches this level.
      Then the charger will switch to fast charge constant voltage mode.
      Also vsys (system voltage) will be set to this value when DC power is
      supplied but charger is not enabled.
      Valid values: 3650000 - 4400000, step by 25000 (rounded down)
    minimum: 3650000
    maximum: 4400000
    default: 4200000

  maxim,min-system-microvolt:
    description: |
      Minimal system voltage in uV.
    enum: [3000000, 3100000, 3200000, 3300000, 3400000, 3500000,
           3600000, 3700000]
    default: 3600000

  maxim,thermal-regulation-celsius:
    description: |
      Temperature in Celsius for entering high temperature charging mode.
      If die temperature exceeds this value the charging current will be
      reduced by 105 mA/Celsius.
    enum: [70, 85, 100, 115]
    default: 100

  maxim,battery-overcurrent-microamp:
    description: |
      Overcurrent protection threshold in uA (current from battery to
      system).
      Valid values: 2000000 - 3500000, step by 250000 (rounded down)
    minimum: 2000000
    maximum: 3500000
    default: 3500000

  maxim,charge-input-threshold-microvolt:
    description: |
      Threshold voltage in uV for triggering input voltage regulation loop.
      If input voltage decreases below this value, the input current will
      be reduced to reach the threshold voltage.
    enum: [4300000, 4700000, 4800000, 4900000]
    default: 4300000

required:
  - compatible

additionalProperties: false
```

## Documentation/devicetree/bindings/power/supply/maxim,max77705.yaml
```yaml
# SPDX-License-Identifier: GPL-2.0-only OR BSD-2-Clause
%YAML 1.2
---
$id: http://devicetree.org/schemas/power/supply/maxim,max77705.yaml#
$schema: http://devicetree.org/meta-schemas/core.yaml#

title: Maxim MAX777705 charger

maintainers:
  - Dzmitry Sankouski <dsankouski@gmail.com>

description: |
  This is a device tree bindings for charger found in Maxim MAX77705 chip.

allOf:
  - $ref: power-supply.yaml#

properties:
  compatible:
    const: maxim,max77705-charger

  interrupts:
    maxItems: 1

  reg:
    maxItems: 1

required:
  - compatible
  - reg
  - monitored-battery

unevaluatedProperties: false

examples:
  - |
    #include <dt-bindings/interrupt-controller/irq.h>

    i2c {
      #address-cells = <1>;
      #size-cells = <0>;

        charger@69 {
            compatible = "maxim,max77705-charger";
            reg = <0x69>;
            monitored-battery = <&battery>;
            interrupt-parent = <&pm8998_gpios>;
            interrupts = <11 IRQ_TYPE_LEVEL_LOW>;
        };
    };
```

## Documentation/devicetree/bindings/power/supply/maxim,max77976.yaml
```yaml
# SPDX-License-Identifier: (GPL-2.0 OR BSD-2-Clause)
%YAML 1.2
---
$id: http://devicetree.org/schemas/power/supply/maxim,max77976.yaml#
$schema: http://devicetree.org/meta-schemas/core.yaml#

title: Maxim Integrated MAX77976 Battery charger

maintainers:
  - Luca Ceresoli <luca@lucaceresoli.net>

description: |
  The Maxim MAX77976 is a 19Vin / 5.5A, 1-Cell Li+ battery charger
  configured via I2C.

allOf:
  - $ref: power-supply.yaml#

properties:
  compatible:
    const: maxim,max77976

  reg:
    maxItems: 1

required:
  - compatible
  - reg

unevaluatedProperties: false

examples:
  - |
    i2c {
      #address-cells = <1>;
      #size-cells = <0>;

      charger@6b {
        compatible = "maxim,max77976";
        reg = <0x6b>;
      };
    };

...
```

## Documentation/devicetree/bindings/power/supply/maxim,max8971.yaml
```yaml
# SPDX-License-Identifier: (GPL-2.0-only OR BSD-2-Clause)
%YAML 1.2
---
$id: http://devicetree.org/schemas/power/supply/maxim,max8971.yaml#
$schema: http://devicetree.org/meta-schemas/core.yaml#

title: Maxim MAX8971 IC charger

maintainers:
  - Svyatoslav Ryhel <clamor95@gmail.com>

description:
  The MAX8971 is a compact, high-frequency, high-efficiency switch-mode charger
  for a one-cell lithium-ion (Li+) battery.

allOf:
  - $ref: power-supply.yaml#

properties:
  compatible:
    const: maxim,max8971

  reg:
    maxItems: 1

  interrupts:
    maxItems: 1

  monitored-battery: true

  port:
    description:
      An optional port node to link the extcon device to detect type of plug.
    $ref: /schemas/graph.yaml#/properties/port

required:
  - compatible
  - reg
  - interrupts

unevaluatedProperties: false

examples:
  - |
    #include <dt-bindings/gpio/gpio.h>
    #include <dt-bindings/interrupt-controller/irq.h>

    i2c {
        #address-cells = <1>;
        #size-cells = <0>;

        charger@35 {
            compatible = "maxim,max8971";
            reg = <0x35>;

            interrupt-parent = <&gpio>;
            interrupts = <74 IRQ_TYPE_LEVEL_LOW>;

            monitored-battery = <&battery>;

            port {
                charger_input: endpoint {
                    remote-endpoint = <&extcon_output>;
                };
            };
        };
    };
...
```

## Documentation/devicetree/bindings/power/supply/mediatek,mt6370-charger.yaml
```yaml
# SPDX-License-Identifier: (GPL-2.0-only OR BSD-2-Clause)
%YAML 1.2
---
$id: http://devicetree.org/schemas/power/supply/mediatek,mt6370-charger.yaml#
$schema: http://devicetree.org/meta-schemas/core.yaml#

title: MediaTek MT6370 Battery Charger

maintainers:
  - ChiaEn Wu <chiaen_wu@richtek.com>

description: |
  This module is part of the MT6370 MFD device.
  Provides Battery Charger, Boost for OTG devices and BC1.2 detection.

properties:
  compatible:
    const: mediatek,mt6370-charger

  interrupts:
    description: |
      Specify what irqs are needed to be handled by MT6370 Charger driver.
      We need to use the IRQ "MT6370_IRQ_OVPCTRL_UVP_D" to know when USB
      is plugged in, and then the driver will enable BC1.2 detection.
      After the hardware of MT6370 completes the BC1.2 detection,
      IRQ "MT6370_IRQ_ATTACH" will be triggered, and the driver will know
      the result of BC1.2 detection.
      When the IRQ "MT6370_IRQ_CHG_MIVR" is triggered, it means that the
      hardware enters the "Minimum Input Voltage Regulation loop" and
      a workaround needs to be applied at this time.
      In summary, "MT6370_IRQ_OVPCTRL_UVP_D", "MT6370_IRQ_ATTACH" and
      "MT6370_IRQ_CHG_MIVR" are required in this charger driver.
    items:
      - description: irq of "USB is plugged in"
      - description: irq of "BC1.2 is done"
      - description: irq of "Minimum Input Voltage Regulation loop is active"

  interrupt-names:
    items:
      - const: uvp_d_evt
      - const: attach_i
      - const: mivr

  io-channels:
    description: |
      Use ADC channel to read VBUS, IBUS, IBAT, etc., info.
    minItems: 1
    items:
      - description: |
          VBUS voltage with lower accuracy (+-75mV) but higher measure
          range (1~22V)
      - description: |
          VBUS voltage with higher accuracy (+-30mV) but lower measure
          range (1~9.76V)
      - description: the main system input voltage
      - description: battery voltage
      - description: battery temperature-sense input voltage
      - description: IBUS current (required)
      - description: battery current
      - description: |
          regulated output voltage to supply for the PWM low-side gate driver
          and the bootstrap capacitor
      - description: IC junction temperature

  io-channel-names:
    minItems: 1
    items:
      - const: vbusdiv5
      - const: vbusdiv2
      - const: vsys
      - const: vbat
      - const: ts_bat
      - const: ibus
      - const: ibat
      - const: chg_vddp
      - const: temp_jc

  usb-otg-vbus-regulator:
    type: object
    description: OTG boost regulator.
    unevaluatedProperties: false
    $ref: /schemas/regulator/regulator.yaml#

    properties:
      enable-gpios:
        maxItems: 1

required:
  - compatible
  - interrupts
  - interrupt-names
  - io-channels

additionalProperties: false

...
```

## Documentation/devicetree/bindings/power/supply/microchip,ucs1002.txt
```
Microchip UCS1002 USB Port Power Controller

Required properties:
- compatible		: Should be "microchip,ucs1002";
- reg			: I2C slave address

Optional properties:
- interrupts		: A list of interrupts lines present (could be either
			  corresponding to A_DET# pin, ALERT# pin, or both)
- interrupt-names	: A list of interrupt names. Should contain (if
			  present):
			  - "a_det" for line connected to A_DET# pin
			  - "alert" for line connected to ALERT# pin
			  Both are expected to be IRQ_TYPE_EDGE_BOTH
Example:

&i2c3 {
	charger@32 {
		compatible = "microchip,ucs1002";
		pinctrl-names = "default";
		pinctrl-0 = <&pinctrl_ucs1002_pins>;
		reg = <0x32>;
		interrupts-extended = <&gpio5 2 IRQ_TYPE_EDGE_BOTH>,
				      <&gpio3 21 IRQ_TYPE_EDGE_BOTH>;
		interrupt-names = "a_det", "alert";
	};
};
```

## Documentation/devicetree/bindings/power/supply/microchip,ucs1002.yaml
```yaml
# SPDX-License-Identifier: GPL-2.0
%YAML 1.2
---
$id: http://devicetree.org/schemas/power/supply/microchip,ucs1002.yaml#
$schema: http://devicetree.org/meta-schemas/core.yaml#

title: Microchip UCS1002 USB Port Power Controller

maintainers:
  - Sebastian Reichel <sre@kernel.org>

properties:
  compatible:
    const: microchip,ucs1002

  reg:
    maxItems: 1

  interrupts:
    maxItems: 2

  interrupt-names:
    oneOf:
      - items:
          - const: a_det
          - const: alert
      - const: a_det
      - const: alert

required:
  - compatible
  - reg

additionalProperties: false

examples:
  - |
    #include <dt-bindings/interrupt-controller/irq.h>

    i2c {
        #address-cells = <1>;
        #size-cells = <0>;

        charger@32 {
            compatible = "microchip,ucs1002";
            reg = <0x32>;
            interrupts-extended = <&gpio5 2 IRQ_TYPE_EDGE_BOTH>,
                                  <&gpio3 21 IRQ_TYPE_EDGE_BOTH>;
            interrupt-names = "a_det", "alert";
       };
    };
```

## Documentation/devicetree/bindings/power/supply/mitsumi,mm8013.yaml
```yaml
# SPDX-License-Identifier: GPL-2.0-only OR BSD-2-Clause
%YAML 1.2
---
$id: http://devicetree.org/schemas/power/supply/mitsumi,mm8013.yaml#
$schema: http://devicetree.org/meta-schemas/core.yaml#

title: Mitsumi MM8013 fuel gauge

maintainers:
  - Konrad Dybcio <konradybcio@kernel.org>

allOf:
  - $ref: power-supply.yaml#

properties:
  compatible:
    const: mitsumi,mm8013

  reg:
    maxItems: 1

required:
  - compatible
  - reg

additionalProperties: false

examples:
  - |
    i2c {
      #address-cells = <1>;
      #size-cells = <0>;

      fuel-gauge@55 {
        compatible = "mitsumi,mm8013";
        reg = <0x55>;
      };
    };
```

## Documentation/devicetree/bindings/power/supply/mt6360_charger.yaml
```yaml
# SPDX-License-Identifier: (GPL-2.0-only OR BSD-2-Clause)
%YAML 1.2
---
$id: http://devicetree.org/schemas/power/supply/mt6360_charger.yaml#
$schema: http://devicetree.org/meta-schemas/core.yaml#

title: Battery charger driver for MT6360 PMIC from MediaTek Integrated.

maintainers:
  - Gene Chen <gene_chen@richtek.com>

description: |
  This module is part of the MT6360 MFD device.
  Provides Battery Charger, Boost for OTG devices and BC1.2 detection.

properties:
  compatible:
    const: mediatek,mt6360-chg

  richtek,vinovp-microvolt:
    description: Maximum CHGIN regulation voltage in uV.
    enum: [ 5500000, 6500000, 11000000, 14500000 ]


  usb-otg-vbus-regulator:
    type: object
    description: OTG boost regulator.
    $ref: /schemas/regulator/regulator.yaml#
    unevaluatedProperties: false

required:
  - compatible

additionalProperties: false

examples:
  - |
    mt6360_charger: charger {
      compatible = "mediatek,mt6360-chg";
      richtek,vinovp-microvolt = <14500000>;

      otg_vbus_regulator: usb-otg-vbus-regulator {
        regulator-name = "usb-otg-vbus";
        regulator-min-microvolt = <4425000>;
        regulator-max-microvolt = <5825000>;
      };
    };
...
```

## Documentation/devicetree/bindings/power/supply/nokia,n900-battery.yaml
```yaml
# SPDX-License-Identifier: GPL-2.0
%YAML 1.2
---
$id: http://devicetree.org/schemas/power/supply/nokia,n900-battery.yaml#
$schema: http://devicetree.org/meta-schemas/core.yaml#

title: Nokia N900 battery

maintainers:
  - Pali Rohár <pali@kernel.org>
  - Sebastian Reichel <sre@kernel.org>

allOf:
  - $ref: power-supply.yaml#

properties:
  compatible:
    const: nokia,n900-battery

  io-channels:
    items:
      - description: ADC channel for temperature reading
      - description: ADC channel for battery size identification
      - description: ADC channel to measure the battery voltage

  io-channel-names:
    items:
      - const: temp
      - const: bsi
      - const: vbat

required:
  - compatible
  - io-channels
  - io-channel-names

additionalProperties: false

examples:
  - |
    battery {
      compatible = "nokia,n900-battery";
      io-channels = <&twl4030_madc 0>,
                    <&twl4030_madc 4>,
                    <&twl4030_madc 12>;
      io-channel-names = "temp",
                         "bsi",
                         "vbat";
    };
```

## Documentation/devicetree/bindings/power/supply/olpc-battery.yaml
```yaml
# SPDX-License-Identifier: GPL-2.0
%YAML 1.2
---
$id: http://devicetree.org/schemas/power/supply/olpc-battery.yaml#
$schema: http://devicetree.org/meta-schemas/core.yaml#

title: OLPC Battery

maintainers:
  - Sebastian Reichel <sre@kernel.org>

allOf:
  - $ref: power-supply.yaml#

properties:
  compatible:
    oneOf:
      - items:
          - const: olpc,xo1.5-battery
          - const: olpc,xo1-battery
      - items:
          - const: olpc,xo1-battery

required:
  - compatible

additionalProperties: false
```

## Documentation/devicetree/bindings/power/supply/olpc_battery.txt
```
OLPC battery
~~~~~~~~~~~~

Required properties:
  - compatible : "olpc,xo1-battery" or "olpc,xo1.5-battery"
```
