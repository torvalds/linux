## Documentation/devicetree/bindings/power/supply/pegatron,chagall-ec.yaml
```yaml
# SPDX-License-Identifier: GPL-2.0-only OR BSD-2-Clause
%YAML 1.2
---
$id: http://devicetree.org/schemas/power/supply/pegatron,chagall-ec.yaml#
$schema: http://devicetree.org/meta-schemas/core.yaml#

title: Pegatron Chagall EC

maintainers:
  - Svyatoslav Ryhel <clamor95@gmail.com>

description:
  Pegatron Chagall EC is based on an 8-bit programmable microcontroller from
  Infineon/Cypress Semiconductor, it communicates over I2C and is used in the
  Pegatron Chagall tablet for fuel gauge and battery control functions.

$ref: /schemas/power/supply/power-supply.yaml

properties:
  compatible:
    const: pegatron,chagall-ec

  reg:
    maxItems: 1

  monitored-battery: true
  power-supplies: true

required:
  - compatible
  - reg

unevaluatedProperties: false

examples:
  - |
    i2c {
        #address-cells = <1>;
        #size-cells = <0>;

        embedded-controller@10 {
            compatible = "pegatron,chagall-ec";
            reg = <0x10>;

            monitored-battery = <&battery>;
            power-supplies = <&mains>;
        };
    };
...
```

## Documentation/devicetree/bindings/power/supply/power-supply.yaml
```yaml
# SPDX-License-Identifier: GPL-2.0
%YAML 1.2
---
$id: "http://devicetree.org/schemas/power/supply/power-supply.yaml#"
$schema: "http://devicetree.org/meta-schemas/core.yaml#"

title: Power Supply Core Support

maintainers:
  - Sebastian Reichel <sre@kernel.org>

properties:
  power-supplies:
    $ref: /schemas/types.yaml#/definitions/phandle-array
    description:
      This property is added to a supply in order to list the devices which
      supply it power, referenced by their phandles.

additionalProperties: true
```

## Documentation/devicetree/bindings/power/supply/qcom,fg.yaml
```yaml
# SPDX-License-Identifier: (GPL-2.0-only or BSD-3-Clause)
%YAML 1.2
---
$id: http://devicetree.org/schemas/power/supply/qcom,fg.yaml#
$schema: http://devicetree.org/meta-schemas/core.yaml#

title: Qualcomm PMIC Fuel Gauge

maintainers:
  - Caleb Connolly <caleb@connolly.tech>
  - Joel Selvaraj <jo@jsfamily.in>
  - Yassine Oudjana <y.oudjana@protonmail.com>

properties:
  compatible:
    enum:
      - qcom,pm8994-fg
      - qcom,pm8998-fg

  reg:
    maxItems: 1

  monitored-battery:
    description: |
       phandle of battery characteristics node.
       The fuel gauge uses the following battery properties:
       - charge-full-design-microamp-hours
       - voltage-min-design-microvolt
       - voltage-max-design-microvolt
       See Documentation/devicetree/bindings/power/supply/battery.yaml

allOf:
  - if:
      properties:
        compatible:
          enum:
            - qcom,pm8994-fg

    then:
      properties:
        interrupts:
          items:
            - description: State of charge change interrupt
            - description: SRAM availability change interrupt

        interrupt-names:
          items:
            - const: soc-delta
            - const: mem-avail

  - if:
      properties:
        compatible:
          enum:
            - qcom,pm8998-fg

    then:
      properties:
        interrupts:
          items:
            - description: State of charge change interrupt

        interrupt-names:
          items:
            - const: soc-delta

required:
  - compatible
  - reg
  - monitored-battery
  - interrupts
  - interrupt-names

additionalProperties: false

examples:
  - |
    #include <dt-bindings/interrupt-controller/irq.h>

    battery: battery {
      compatible = "simple-battery";

      charge-full-design-microamp-hours = <4070000>;
      voltage-min-design-microvolt = <3400000>;
      voltage-max-design-microvolt = <4400000>;
    };

    pmic {
      #address-cells = <1>;
      #size-cells = <0>;

      fuel-gauge@4000 {
        compatible = "qcom,pmi8994-fg";
        reg = <0x4000>;

        interrupts = <0x2 0x40 0x4 IRQ_TYPE_EDGE_RISING>,
                     <0x2 0x44 0x0 IRQ_TYPE_EDGE_BOTH>;
        interrupt-names = "soc-delta", "mem-avail";

        monitored-battery = <&battery>;
      };
    };
```

## Documentation/devicetree/bindings/power/supply/qcom,pm8916-bms-vm.yaml
```yaml
# SPDX-License-Identifier: (GPL-2.0-only OR BSD-2-Clause)
%YAML 1.2
---
$id: http://devicetree.org/schemas/power/supply/qcom,pm8916-bms-vm.yaml#
$schema: http://devicetree.org/meta-schemas/core.yaml#

title: Qualcomm Voltage Mode BMS

maintainers:
  - Nikita Travkin <nikita@trvn.ru>

description:
  Voltage Mode BMS is a hardware block found in some Qualcomm PMICs
  such as pm8916. This block performs battery voltage monitoring.

allOf:
  - $ref: power-supply.yaml#

properties:
  compatible:
    const: qcom,pm8916-bms-vm

  reg:
    maxItems: 1

  interrupts:
    items:
      - description: BMS FSM left S3 mode
      - description: BMS FSM entered S2 mode
      - description: OCV measured in S3 mode
      - description: OCV below threshold
      - description: FIFO update done
      - description: BMS FSM switched state

  interrupt-names:
    items:
      - const: cv_leave
      - const: cv_enter
      - const: ocv_good
      - const: ocv_thr
      - const: fifo
      - const: state_chg

  monitored-battery: true

  power-supplies: true

required:
  - compatible
  - reg
  - interrupts
  - interrupt-names
  - monitored-battery

additionalProperties: false

examples:
  - |
    #include <dt-bindings/interrupt-controller/irq.h>
    pmic {
      #address-cells = <1>;
      #size-cells = <0>;

      battery@4000 {
        compatible = "qcom,pm8916-bms-vm";
        reg = <0x4000>;
        interrupts = <0x0 0x40 0 IRQ_TYPE_EDGE_RISING>,
                     <0x0 0x40 1 IRQ_TYPE_EDGE_RISING>,
                     <0x0 0x40 2 IRQ_TYPE_EDGE_RISING>,
                     <0x0 0x40 3 IRQ_TYPE_EDGE_RISING>,
                     <0x0 0x40 4 IRQ_TYPE_EDGE_RISING>,
                     <0x0 0x40 5 IRQ_TYPE_EDGE_RISING>;
        interrupt-names = "cv_leave",
                          "cv_enter",
                          "ocv_good",
                          "ocv_thr",
                          "fifo",
                          "state_chg";

        monitored-battery = <&battery>;
        power-supplies = <&pm8916_charger>;
      };
    };
```

## Documentation/devicetree/bindings/power/supply/qcom,pm8916-lbc.yaml
```yaml
# SPDX-License-Identifier: (GPL-2.0-only OR BSD-2-Clause)
%YAML 1.2
---
$id: http://devicetree.org/schemas/power/supply/qcom,pm8916-lbc.yaml#
$schema: http://devicetree.org/meta-schemas/core.yaml#

title: Qualcomm Linear Battery Charger

maintainers:
  - Nikita Travkin <nikita@trvn.ru>

description:
  Linear Battery Charger hardware block, found in some Qualcomm PMICs
  such as pm8916. Implements a simple, autonomous CC/CV charger.

allOf:
  - $ref: power-supply.yaml#

properties:
  compatible:
    const: qcom,pm8916-lbc

  reg:
    items:
      - description: Charger
      - description: Battery
      - description: USB
      - description: MISC

  reg-names:
    items:
      - const: chgr
      - const: bat_if
      - const: usb
      - const: misc

  interrupts:
    items:
      - description: Battery detection
      - description: Fast charging
      - description: Charging failed
      - description: Charging done
      - description: Battery present
      - description: Battery temperature OK
      - description: USB coarse detection
      - description: USB IN valid
      - description: Charger gone
      - description: Overtemperature

  interrupt-names:
    items:
      - const: vbat_det
      - const: fast_chg
      - const: chg_fail
      - const: chg_done
      - const: bat_pres
      - const: temp_ok
      - const: coarse_det
      - const: usb_vbus
      - const: chg_gone
      - const: overtemp

  qcom,fast-charge-safe-voltage:
    $ref: /schemas/types.yaml#/definitions/uint32
    minimum: 4000000
    maximum: 4775000
    description:
      Maximum safe battery voltage in uV; May be pre-set by bootloader,
      in which case, setting this will harmlessly fail.

  qcom,fast-charge-safe-current:
    $ref: /schemas/types.yaml#/definitions/uint32
    minimum: 90000
    maximum: 1440000
    description:
      Maximum safe battery charge current in uA; May be pre-set by
      bootloader, in which case setting this will harmlessly fail.

  monitored-battery: true

required:
  - compatible
  - reg
  - interrupts
  - interrupt-names
  - qcom,fast-charge-safe-voltage
  - qcom,fast-charge-safe-current

additionalProperties: false

examples:
  - |
    #include <dt-bindings/interrupt-controller/irq.h>
    pmic {
      #address-cells = <1>;
      #size-cells = <0>;

      charger@1000 {
        compatible = "qcom,pm8916-lbc";
        reg = <0x1000>, <0x1200>, <0x1300>, <0x1600>;
        reg-names = "chgr", "bat_if", "usb", "misc";

        interrupts = <0x0 0x10 0 IRQ_TYPE_EDGE_BOTH>,
                     <0x0 0x10 5 IRQ_TYPE_EDGE_BOTH>,
                     <0x0 0x10 6 IRQ_TYPE_EDGE_BOTH>,
                     <0x0 0x10 7 IRQ_TYPE_EDGE_BOTH>,
                     <0x0 0x12 0 IRQ_TYPE_EDGE_BOTH>,
                     <0x0 0x12 1 IRQ_TYPE_EDGE_BOTH>,
                     <0x0 0x13 0 IRQ_TYPE_EDGE_BOTH>,
                     <0x0 0x13 1 IRQ_TYPE_EDGE_BOTH>,
                     <0x0 0x13 2 IRQ_TYPE_EDGE_BOTH>,
                     <0x0 0x13 4 IRQ_TYPE_EDGE_BOTH>;
        interrupt-names = "vbat_det",
                          "fast_chg",
                          "chg_fail",
                          "chg_done",
                          "bat_pres",
                          "temp_ok",
                          "coarse_det",
                          "usb_vbus",
                          "chg_gone",
                          "overtemp";
        monitored-battery = <&battery>;

        qcom,fast-charge-safe-current = <900000>;
        qcom,fast-charge-safe-voltage = <4300000>;
      };
    };
```

## Documentation/devicetree/bindings/power/supply/qcom,pm8941-charger.yaml
```yaml
# SPDX-License-Identifier: GPL-2.0
%YAML 1.2
---
$id: http://devicetree.org/schemas/power/supply/qcom,pm8941-charger.yaml#
$schema: http://devicetree.org/meta-schemas/core.yaml#

title: Qualcomm Switch-Mode Battery Charger and Boost

maintainers:
  - Sebastian Reichel <sre@kernel.org>

properties:
  compatible:
    enum:
      - qcom,pm8226-charger
      - qcom,pm8941-charger

  reg:
    maxItems: 1

  interrupts:
    items:
      - description: charge done
      - description: charge fast mode
      - description: charge trickle mode
      - description: battery temperature ok
      - description: battery present
      - description: charger disconnected
      - description: USB-in valid
      - description: DC-in valid

  interrupt-names:
    items:
      - const: chg-done
      - const: chg-fast
      - const: chg-trkl
      - const: bat-temp-ok
      - const: bat-present
      - const: chg-gone
      - const: usb-valid
      - const: dc-valid

  qcom,fast-charge-current-limit:
    $ref: /schemas/types.yaml#/definitions/uint32
    minimum: 100000
    maximum: 3000000
    description: Maximum charge current in uA; May be clamped to safety limits; Defaults to 1A

  qcom,fast-charge-low-threshold-voltage:
    $ref: /schemas/types.yaml#/definitions/uint32
    minimum: 2100000
    maximum: 3600000
    description: |
      Battery voltage limit in uV above which fast charging may operate; Defaults to 3.2V
      Below this value linear or switch-mode auto-trickle-charging will operate.

  qcom,fast-charge-high-threshold-voltage:
    $ref: /schemas/types.yaml#/definitions/uint32
    minimum: 3240000
    maximum: 5000000
    description: |
      Battery voltage limit in uV below which fast charging may operate; Defaults to 4.2V
      The fast charger will attempt to charge the battery to this voltage.
      May be clamped to safety limits.

  qcom,fast-charge-safe-voltage:
    $ref: /schemas/types.yaml#/definitions/uint32
    minimum: 3240000
    maximum: 5000000
    description: |
      Maximum safe battery voltage in uV; May be pre-set by bootloader, in which case,
      setting this will harmlessly fail. The property 'fast-charge-high-watermark' will
      be clamped by this value. Defaults to 4.2V.

  qcom,fast-charge-safe-current:
    $ref: /schemas/types.yaml#/definitions/uint32
    minimum: 100000
    maximum: 3000000
    description: |
      Maximum safe battery charge current in uA; May pre-set by bootloader, in which case,
      setting this will harmlessly fail. The property 'qcom,fast-charge-current-limit'
      will be clamped by this value. Defaults to 1A.

  qcom,auto-recharge-threshold-voltage:
    $ref: /schemas/types.yaml#/definitions/uint32
    minimum: 3240000
    maximum: 5000000
    description: |
      Battery voltage limit in uV below which auto-recharge functionality will restart charging
      after end-of-charge; The high cutoff limit for auto-recharge is 5% above this value.
      Defaults to 4.1V.

  qcom,minimum-input-voltage:
    $ref: /schemas/types.yaml#/definitions/uint32
    minimum: 4200000
    maximum: 9600000
    description: |
      Input voltage level in uV above which charging may operate. Defaults to 4.3V.

  qcom,dc-current-limit:
    $ref: /schemas/types.yaml#/definitions/uint32
    minimum: 100000
    maximum: 2500000
    description: |
      Default DC charge current limit in uA. Defaults to 100mA.

  qcom,disable-dc:
    type: boolean
    description: Disable DC charger

  qcom,jeita-extended-temp-range:
    type: boolean
    description: |
      Enable JEITA extended temperature range;  This does *not* adjust the maximum charge
      voltage or current in the extended temperature range. It only allows charging when
      the battery is in the extended temperature range. Voltage/current regulation must
      be done externally to fully comply with the JEITA safety guidelines if this flag
      is set.

  usb-otg-in-supply:
    description: Reference to the regulator supplying power to the USB_OTG_IN pin.

  otg-vbus:
    type: object
    description: |
      This node defines a regulator used to control the direction of VBUS voltage.
      Specifically whether to supply voltage to VBUS for host mode operation of the OTG port,
      or allow input voltage from external VBUS for charging. In the hardware, the supply for
      this regulator comes from usb_otg_in-supply.

required:
  - compatible
  - reg
  - interrupts
  - interrupt-names

additionalProperties: false

examples:
  - |
    #include <dt-bindings/interrupt-controller/irq.h>
    pmic {
      #address-cells = <1>;
      #size-cells = <0>;

      charger@1000 {
        compatible = "qcom,pm8941-charger";
        reg = <0x1000>;
        interrupts = <0x0 0x10 7 IRQ_TYPE_EDGE_BOTH>,
                     <0x0 0x10 5 IRQ_TYPE_EDGE_BOTH>,
                     <0x0 0x10 4 IRQ_TYPE_EDGE_BOTH>,
                     <0x0 0x12 1 IRQ_TYPE_EDGE_BOTH>,
                     <0x0 0x12 0 IRQ_TYPE_EDGE_BOTH>,
                     <0x0 0x13 2 IRQ_TYPE_EDGE_BOTH>,
                     <0x0 0x13 1 IRQ_TYPE_EDGE_BOTH>,
                     <0x0 0x14 1 IRQ_TYPE_EDGE_BOTH>;
        interrupt-names = "chg-done",
                          "chg-fast",
                          "chg-trkl",
                          "bat-temp-ok",
                          "bat-present",
                          "chg-gone",
                          "usb-valid",
                          "dc-valid";
        qcom,fast-charge-current-limit = <1000000>;
        qcom,dc-current-limit = <1000000>;
        usb-otg-in-supply = <&pm8941_5vs1>;

        otg-vbus {};
      };
    };
```
