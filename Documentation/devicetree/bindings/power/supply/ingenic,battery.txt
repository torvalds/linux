## Documentation/devicetree/bindings/power/supply/ingenic,battery.txt
```
* Ingenic JZ47xx battery bindings

Required properties:

- compatible: Must be "ingenic,jz4740-battery".
- io-channels: phandle and IIO specifier pair to the IIO device.
  Format described in iio-bindings.txt.
- monitored-battery: phandle to a "simple-battery" compatible node.

The "monitored-battery" property must be a phandle to a node using the format
described in battery.txt, with the following properties being required:

- voltage-min-design-microvolt: Drained battery voltage.
- voltage-max-design-microvolt: Fully charged battery voltage.

Example:

#include <dt-bindings/iio/adc/ingenic,adc.h>

simple_battery: battery {
	compatible = "simple-battery";
	voltage-min-design-microvolt = <3600000>;
	voltage-max-design-microvolt = <4200000>;
};

ingenic_battery {
	compatible = "ingenic,jz4740-battery";
	io-channels = <&adc INGENIC_ADC_BATTERY>;
	io-channel-names = "battery";
	monitored-battery = <&simple_battery>;
};
```

## Documentation/devicetree/bindings/power/supply/ingenic,battery.yaml
```yaml
# SPDX-License-Identifier: (GPL-2.0 OR BSD-2-Clause)
# Copyright 2019-2020 Artur Rojek
%YAML 1.2
---
$id: "http://devicetree.org/schemas/power/supply/ingenic,battery.yaml#"
$schema: "http://devicetree.org/meta-schemas/core.yaml#"

title: Ingenic JZ47xx battery bindings

maintainers:
  - Artur Rojek <contact@artur-rojek.eu>

properties:
  compatible:
    oneOf:
      - const: ingenic,jz4740-battery
      - items:
          - enum:
              - ingenic,jz4725b-battery
              - ingenic,jz4770-battery
          - const: ingenic,jz4740-battery

  io-channels:
    maxItems: 1

  io-channel-names:
    const: battery

  monitored-battery:
    description: >
      phandle to a "simple-battery" compatible node.

      This property must be a phandle to a node using the format described
      in battery.yaml, with the following properties being required:
      - voltage-min-design-microvolt: drained battery voltage,
      - voltage-max-design-microvolt: fully charged battery voltage.

required:
  - compatible
  - io-channels
  - io-channel-names
  - monitored-battery

additionalProperties: false

examples:
  - |
    #include <dt-bindings/iio/adc/ingenic,adc.h>

    simple_battery: battery {
            compatible = "simple-battery";
            voltage-min-design-microvolt = <3600000>;
            voltage-max-design-microvolt = <4200000>;
    };

    ingenic-battery {
            compatible = "ingenic,jz4740-battery";
            io-channels = <&adc INGENIC_ADC_BATTERY>;
            io-channel-names = "battery";
            monitored-battery = <&simple_battery>;
    };
```

## Documentation/devicetree/bindings/power/supply/isp1704.txt
```
Binding for NXP ISP1704 USB Charger Detection

Required properties:
- compatible: Should contain one of the following:
 * "nxp,isp1704"
- nxp,enable-gpio: Should contain a phandle + gpio-specifier
  to the GPIO pin connected to the chip's enable pin.
- usb-phy: Should contain a phandle to the USB PHY
  the ISP1704 is connected to.

Example:

isp1704 {
	compatible = "nxp,isp1704";
	nxp,enable-gpio = <&gpio3 3 GPIO_ACTIVE_LOW>;
	usb-phy = <&usb2_phy>;
};
```

## Documentation/devicetree/bindings/power/supply/isp1704.yaml
```yaml
# SPDX-License-Identifier: GPL-2.0
# Copyright (C) 2021 Sebastian Reichel
%YAML 1.2
---
$id: "http://devicetree.org/schemas/power/supply/isp1704.yaml#"
$schema: "http://devicetree.org/meta-schemas/core.yaml#"

title: Binding for NXP ISP1704 USB Charger Detection

maintainers:
  - Sebastian Reichel <sre@kernel.org>

allOf:
  - $ref: power-supply.yaml#

properties:
  compatible:
    const: nxp,isp1704

  nxp,enable-gpio:
    maxItems: 1
    description: GPIO connected to the chip's enable pin

  usb-phy:
    $ref: /schemas/types.yaml#/definitions/phandle
    description: USB PHY the ISP1704 is connected to

required:
  - compatible
  - nxp,enable-gpio
  - usb-phy

additionalProperties: false

examples:
  - |
    #include <dt-bindings/gpio/gpio.h>
    charger-detect {
      compatible = "nxp,isp1704";
      nxp,enable-gpio = <&gpio3 3 GPIO_ACTIVE_LOW>;
      usb-phy = <&usb2_phy>;
    };
```

## Documentation/devicetree/bindings/power/supply/lego,ev3-battery.yaml
```yaml
# SPDX-License-Identifier: GPL-2.0
%YAML 1.2
---
$id: "http://devicetree.org/schemas/power/supply/lego,ev3-battery.yaml#"
$schema: "http://devicetree.org/meta-schemas/core.yaml#"

title: LEGO MINDSTORMS EV3 Battery

maintainers:
  - David Lechner <david@lechnology.com>
  - Sebastian Reichel <sre@kernel.org>

description: |
  LEGO MINDSTORMS EV3 has some built-in capability for monitoring the battery.
  It uses 6 AA batteries or a special Li-ion rechargeable battery pack that is
  detected by a key switch in the battery compartment.

allOf:
  - $ref: power-supply.yaml#

properties:
  compatible:
    const: lego,ev3-battery

  io-channels:
    items:
      - description: ADC channel for battery voltage
      - description: ADC channel for battery current

  io-channel-names:
    items:
      - const: voltage
      - const: current

  rechargeable-gpios:
    maxItems: 1
    description: Rechargeable battery indication gpio

required:
  - compatible
  - io-channels
  - io-channel-names
  - rechargeable-gpios

additionalProperties: false

examples:
  - |
    #include <dt-bindings/gpio/gpio.h>
    battery {
      compatible = "lego,ev3-battery";
      io-channels = <&adc 4>, <&adc 3>;
      io-channel-names = "voltage", "current";
      rechargeable-gpios = <&gpio 136 GPIO_ACTIVE_LOW>;
    };
```

## Documentation/devicetree/bindings/power/supply/lego_ev3_battery.txt
```
LEGO MINDSTORMS EV3 Battery
~~~~~~~~~~~~~~~~~~~~~~~~~~~

LEGO MINDSTORMS EV3 has some built-in capability for monitoring the battery.
It uses 6 AA batteries or a special Li-ion rechargeable battery pack that is
detected by a key switch in the battery compartment.

Required properties:
 - compatible: Must be "lego,ev3-battery"
 - io-channels: phandles to analog inputs for reading voltage and current
 - io-channel-names: Must be "voltage", "current"
 - rechargeable-gpios: phandle to the rechargeable battery indication gpio

Example:

	battery {
		compatible = "lego,ev3-battery";
		io-channels = <&adc 4>, <&adc 3>;
		io-channel-names = "voltage", "current";
		rechargeable-gpios = <&gpio 136 GPIO_ACTIVE_LOW>;
	};
```

## Documentation/devicetree/bindings/power/supply/lltc,lt3651-charger.yaml
```yaml
# SPDX-License-Identifier: GPL-2.0
%YAML 1.2
---
$id: http://devicetree.org/schemas/power/supply/lltc,lt3651-charger.yaml#
$schema: http://devicetree.org/meta-schemas/core.yaml#

title: Analog Devices LT3651 Charger Power Supply

maintainers:
  - Sebastian Reichel <sre@kernel.org>

allOf:
  - $ref: power-supply.yaml#

properties:
  compatible:
    enum:
      - lltc,lt3651-charger
      - lltc,ltc3651-charger  # deprecated, use lltc,lt3651-charger

  lltc,acpr-gpios:
    maxItems: 1

  lltc,fault-gpios:
    maxItems: 1

  lltc,chrg-gpios:
    maxItems: 1

required:
  - compatible
  - lltc,acpr-gpios

additionalProperties: false

examples:
  - |
    #include <dt-bindings/gpio/gpio.h>
    charger {
      compatible = "lltc,lt3651-charger";
      lltc,acpr-gpios = <&gpio0 68 GPIO_ACTIVE_LOW>;
      lltc,fault-gpios = <&gpio0 64 GPIO_ACTIVE_LOW>;
      lltc,chrg-gpios = <&gpio0 63 GPIO_ACTIVE_LOW>;
    };
```

## Documentation/devicetree/bindings/power/supply/lltc,ltc294x.yaml
```yaml
# SPDX-License-Identifier: GPL-2.0
%YAML 1.2
---
$id: http://devicetree.org/schemas/power/supply/lltc,ltc294x.yaml#
$schema: http://devicetree.org/meta-schemas/core.yaml#

title: Binding for LTC2941, LTC2942, LTC2943 and LTC2944 battery fuel gauges

description: |
  All chips measure battery capacity.
  The LTC2942 is pin compatible with the LTC2941, it adds voltage and
  temperature monitoring, and is runtime detected. LTC2943 and LTC2944
  are software compatible, uses a slightly different conversion formula
  for the charge counter and adds voltage, current and temperature monitoring.

maintainers:
  - Sebastian Reichel <sre@kernel.org>

allOf:
  - $ref: power-supply.yaml#

properties:
  compatible:
    enum:
      - lltc,ltc2941
      - lltc,ltc2942
      - lltc,ltc2943
      - lltc,ltc2944

  reg:
    maxItems: 1

  lltc,resistor-sense:
    $ref: /schemas/types.yaml#/definitions/int32
    description: |
      Sense resistor value in milli-ohms.
      Can be negative value when the battery has been connected to the wrong end of the resistor.

  lltc,prescaler-exponent:
    $ref: /schemas/types.yaml#/definitions/uint32
    description: |
      The prescaler exponent as explained in the datasheet.
      This determines the range and accuracy of the gauge.
      The value is programmed into the chip only if it differs from the current setting.
      The setting is lost when the battery is disconnected.

required:
  - compatible
  - reg
  - lltc,resistor-sense
  - lltc,prescaler-exponent

additionalProperties: false

examples:
  - |
    i2c0 {
      #address-cells = <1>;
      #size-cells = <0>;
      battery@64 {
        compatible = "lltc,ltc2943";
        reg = <0x64>;
        lltc,resistor-sense = <15>;
        lltc,prescaler-exponent = <5>; /* 2^(2*5) = 1024 */
      };
    };
```

## Documentation/devicetree/bindings/power/supply/lp8727_charger.txt
```
Binding for TI/National Semiconductor LP8727 Charger

Required properties:
- compatible: "ti,lp8727"
- reg: I2C slave address 27h

Optional properties:
- interrupts: interrupt specifier (see interrupt binding[0])
- debounce-ms: interrupt debounce time. (u32)

AC and USB charging parameters
- charger-type: "ac" or "usb" (string)
- eoc-level: value of 'enum lp8727_eoc_level' (u8)
- charging-current: value of 'enum lp8727_ichg' (u8)

[0]: Documentation/devicetree/bindings/interrupt-controller/interrupts.txt

Example)

lp8727@27 {
	compatible = "ti,lp8727";
	reg = <0x27>;

	/* GPIO 134 is used for LP8728 interrupt pin */
	interrupt-parent = <&gpio5>; 	/* base = 128 */
	interrupts = <6 0x2>;		/* offset = 6, falling edge type */

	debounce-ms = <300>;

	/* AC charger: 5% EOC and 500mA charging current */
	ac {
		charger-type = "ac";
		eoc-level = /bits/ 8 <0>;
		charging-current = /bits/ 8 <4>;
	};

	/* USB charger: 10% EOC and 400mA charging current */
	usb {
		charger-type = "usb";
		eoc-level = /bits/ 8 <1>;
		charging-current = /bits/ 8 <2>;
	};
};
```

## Documentation/devicetree/bindings/power/supply/ltc2941.txt
```
binding for LTC2941, LTC2942 and LTC2943 battery gauges

All chips measure battery capacity.
The LTC2942 is pin compatible with the LTC2941, it adds voltage and
temperature monitoring, and is runtime detected. LTC2943 is software
compatible, uses a slightly different conversion formula for the
charge counter and adds voltage, current and temperature monitoring.

Required properties:
- compatible: Should contain "lltc,ltc2941", "lltc,ltc2942" or "lltc,ltc2943"
    which also indicates the type of I2C chip attached.
- reg: The 7-bit I2C address.
- lltc,resistor-sense: The sense resistor value in milli-ohms. Can be a 32-bit
    negative value when the battery has been connected to the wrong end of the
    resistor.
- lltc,prescaler-exponent: The prescaler exponent as explained in the datasheet.
    This determines the range and accuracy of the gauge. The value is programmed
    into the chip only if it differs from the current setting. The setting is
    lost when the battery is disconnected.

Example from the Topic Miami Florida board:

	fuelgauge: ltc2943@64 {
		compatible = "lltc,ltc2943";
		reg = <0x64>;
		lltc,resistor-sense = <15>;
		lltc,prescaler-exponent = <5>; /* 2^(2*5) = 1024 */
	};
```

## Documentation/devicetree/bindings/power/supply/ltc3651-charger.txt
```
ltc3651-charger

Required properties:
 - compatible: "lltc,ltc3651-charger"
 - lltc,acpr-gpios: Connect to ACPR output. See remark below.

Optional properties:
 - lltc,fault-gpios: Connect to FAULT output. See remark below.
 - lltc,chrg-gpios: Connect to CHRG output. See remark below.

The ltc3651 outputs are open-drain type and active low. The driver assumes the
GPIO reports "active" when the output is asserted, so if the pins have been
connected directly, the GPIO flags should be set to active low also.

The driver will attempt to aquire interrupts for all GPIOs to detect changes in
line state. If the system is not capabale of providing interrupts, the driver
cannot report changes and userspace will need to periodically read the sysfs
attributes to detect changes.

Example:

	charger: battery-charger {
		compatible = "lltc,ltc3651-charger";
		lltc,acpr-gpios = <&gpio0 68 GPIO_ACTIVE_LOW>;
		lltc,fault-gpios = <&gpio0 64 GPIO_ACTIVE_LOW>;
		lltc,chrg-gpios = <&gpio0 63 GPIO_ACTIVE_LOW>;
	};
```

## Documentation/devicetree/bindings/power/supply/ltc4162-l.yaml
```yaml
# SPDX-License-Identifier: (GPL-2.0 OR BSD-2-Clause)
# Copyright (C) 2020 Topic Embedded Products
%YAML 1.2
---
$id: http://devicetree.org/schemas/power/supply/ltc4162-l.yaml#
$schema: http://devicetree.org/meta-schemas/core.yaml#

title: Linear Technology (Analog Devices) LTC4162-L Charger

maintainers:
  - Mike Looijmans <mike.looijmans@topic.nl>

description: |
  The LTC ® 4162-L is an advanced monolithic synchronous step-down switching
  battery charger and PowerPath (TM) manager that seamlessly manages power
  distribution between input sources such as wall adapters, backplanes, solar
  panels, etc., and a rechargeable Lithium-Ion/Polymer battery.

  Specifications about the charger can be found at:
    https://www.analog.com/en/products/ltc4162-s.html

properties:
  compatible:
    enum:
      - lltc,ltc4162-l

  reg:
    maxItems: 1
    description: I2C address of the charger.

  lltc,rsnsb-micro-ohms:
    description: Battery sense resistor in microohm.
    minimum: 1000

  lltc,rsnsi-micro-ohms:
    description: Input current sense resistor in microohm.
    minimum: 1000

  lltc,cell-count:
    $ref: /schemas/types.yaml#/definitions/uint32
    description: |
      Number of battery cells. If not provided, will be obtained from the chip
      once the external power is applied. Omit this when the number of cells
      is somewhat dynamic. Without it, several measurements will return 0 until
      the charger is connected to an external supply.

required:
  - compatible
  - reg
  - lltc,rsnsb-micro-ohms
  - lltc,rsnsi-micro-ohms

additionalProperties: false

examples:
  - |
    i2c {
      #address-cells = <1>;
      #size-cells = <0>;
      charger: battery-charger@68 {
              compatible = "lltc,ltc4162-l";
              reg = <0x68>;
              lltc,rsnsb-micro-ohms = <10000>;
              lltc,rsnsi-micro-ohms = <16000>;
              lltc,cell-count = <2>;
      };
    };
```
