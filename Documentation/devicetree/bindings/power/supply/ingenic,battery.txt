## Documentation/devicetree/bindings/power/supply/max17040_battery.txt
```
max17040_battery
~~~~~~~~~~~~~~~~

Required properties :
 - compatible : "maxim,max17040", "maxim,max17041", "maxim,max17043",
		"maxim,max17044", "maxim,max17048", "maxim,max17049",
		"maxim,max17058", "maxim,max17059" or "maxim,max77836-battery"
 - reg: i2c slave address

Optional properties :
- maxim,alert-low-soc-level :	The alert threshold that sets the state of
				charge level (%) where an interrupt is
				generated. Can be configured from 1 up to 32
				(%). If skipped the power up default value of
				4 (%) will be used.
- maxim,double-soc : 		Certain devices return double the capacity.
				Specify this boolean property to divide the
				reported value in 2 and thus normalize it.
				SOC == State of Charge == Capacity.
- maxim,rcomp :			A value to compensate readings for various
				battery chemistries and operating temperatures.
				max17040,41 have 2 byte rcomp, default to
				0x97 0x00. All other devices have one byte
				rcomp, default to 0x97.
- interrupts : 			Interrupt line see Documentation/devicetree/
				bindings/interrupt-controller/interrupts.txt
- wakeup-source :		This device has wakeup capabilities. Use this
				property to use alert low SOC level interrupt
				as wake up source.

Optional properties support interrupt functionality for alert low state of
charge level, present in some ICs in the same family, and should be used with
compatible "maxim,max77836-battery".

Example:

	battery-fuel-gauge@36 {
		compatible = "maxim,max77836-battery";
		reg = <0x36>;
		maxim,alert-low-soc-level = <10>;
		interrupt-parent = <&gpio7>;
		interrupts = <2 IRQ_TYPE_EDGE_FALLING>;
		wakeup-source;
	};

	battery-fuel-gauge@36 {
		compatible = "maxim,max17048";
		reg = <0x36>;
		maxim,rcomp = /bits/ 8 <0x56>;
		maxim,alert-low-soc-level = <10>;
		maxim,double-soc;
	};
```

## Documentation/devicetree/bindings/power/supply/max17042_battery.txt
```
max17042_battery
~~~~~~~~~~~~~~~~

Required properties :
 - compatible : one of the following
 * "maxim,max17042"
 * "maxim,max17047"
 * "maxim,max17050"
 * "maxim,max17055"

Optional properties :
 - maxim,rsns-microohm : Resistance of rsns resistor in micro Ohms
                         (datasheet-recommended value is 10000).
   Defining this property enables current-sense functionality.

Optional threshold properties :
 If skipped the condition won't be reported.
 - maxim,cold-temp :      Temperature threshold to report battery
                          as cold (in tenths of degree Celsius).
 - maxim,over-heat-temp : Temperature threshold to report battery
                          as over heated (in tenths of degree Celsius).
 - maxim,dead-volt :      Voltage threshold to report battery
                          as dead (in mV).
 - maxim,over-volt :      Voltage threshold to report battery
                          as over voltage (in mV).

Example:

	battery-charger@36 {
		compatible = "maxim,max17042";
		reg = <0x36>;
		maxim,rsns-microohm = <10000>;
		maxim,over-heat-temp = <600>;
		maxim,over-volt = <4300>;
	};
```

## Documentation/devicetree/bindings/power/supply/max77650-charger.txt
```
Battery charger driver for MAX77650 PMIC from Maxim Integrated.

This module is part of the MAX77650 MFD device. For more details
see Documentation/devicetree/bindings/mfd/max77650.txt.

The charger is represented as a sub-node of the PMIC node on the device tree.

Required properties:
--------------------
- compatible:		Must be "maxim,max77650-charger"

Optional properties:
--------------------
- input-voltage-min-microvolt:	Minimum CHGIN regulation voltage. Must be one
				of: 4000000, 4100000, 4200000, 4300000,
				4400000, 4500000, 4600000, 4700000.
- input-current-limit-microamp:	CHGIN input current limit (in microamps). Must
				be one of: 95000, 190000, 285000, 380000,
				475000.

Example:
--------

	charger {
		compatible = "maxim,max77650-charger";
		input-voltage-min-microvolt = <4200000>;
		input-current-limit-microamp = <285000>;
	};
```

## Documentation/devicetree/bindings/power/supply/max77650-charger.yaml
```yaml
# SPDX-License-Identifier: GPL-2.0
%YAML 1.2
---
$id: http://devicetree.org/schemas/power/supply/max77650-charger.yaml#
$schema: http://devicetree.org/meta-schemas/core.yaml#

title: Battery charger driver for MAX77650 PMIC from Maxim Integrated.

maintainers:
  - Bartosz Golaszewski <bgolaszewski@baylibre.com>

description: |
  This module is part of the MAX77650 MFD device. For more details
  see Documentation/devicetree/bindings/mfd/max77650.yaml.

  The charger is represented as a sub-node of the PMIC node on the device tree.

properties:
  compatible:
    const: maxim,max77650-charger

  input-voltage-min-microvolt:
    description:
      Minimum CHGIN regulation voltage.
    enum: [ 4000000, 4100000, 4200000, 4300000,
            4400000, 4500000, 4600000, 4700000 ]

  input-current-limit-microamp:
    description:
      CHGIN input current limit (in microamps).
    enum: [ 95000, 190000, 285000, 380000, 475000 ]

required:
  - compatible
additionalProperties: false

...
```

## Documentation/devicetree/bindings/power/supply/max8903-charger.txt
```
Maxim Semiconductor MAX8903 Battery Charger bindings

Required properties:
- compatible: "maxim,max8903" for MAX8903 Battery Charger
- dok-gpios: Valid DC power has been detected (active low, input), optional if uok-gpios is provided
- uok-gpios: Valid USB power has been detected (active low, input), optional if dok-gpios is provided

Optional properties:
- cen-gpios: Charge enable pin (active low, output)
- chg-gpios: Charger status pin (active low, input)
- flt-gpios: Fault pin (active low, output)
- dcm-gpios: Current limit mode setting (DC=1 or USB=0, output)
- usus-gpios: USB suspend pin (active high, output)


Example:

	max8903-charger {
		compatible = "maxim,max8903";
		dok-gpios = <&gpio2 3 GPIO_ACTIVE_LOW>;
		flt-gpios = <&gpio2 2 GPIO_ACTIVE_LOW>;
		chg-gpios = <&gpio3 15 GPIO_ACTIVE_LOW>;
		cen-gpios = <&gpio2 5 GPIO_ACTIVE_LOW>;
		status = "okay";
	};
```

## Documentation/devicetree/bindings/power/supply/max8925_battery.txt
```
max8925-battery bindings
~~~~~~~~~~~~~~~~

Optional properties :
 - batt-detect: whether support battery detect
 - topoff-threshold: set charging current in topoff mode
 - fast-charge: set charging current in fast mode
 - yes-temp-support: whether support temperature protection detect
 - yes-insert-detect: whether support insert detect

Example:
	charger {
		batt-detect = <0>;
		topoff-threshold = <1>;
		fast-charge = <7>;
		yes-temp-support = <0>;
		yes-insert-detect = <0>;
	};
```

## Documentation/devicetree/bindings/power/supply/maxim,ds2760.txt
```
Devicetree bindings for Maxim DS2760
====================================

The ds2760 is a w1 slave device and must hence have its sub-node in DT
under a w1 bus master node.

The device exposes a power supply, so the details described in
Documentation/devicetree/bindings/power/supply/power_supply.txt apply.

Required properties:
- compatible: must be "maxim,ds2760"

Optional properties:
- power-supplies:	Refers to one or more power supplies connected to
			this battery.
- maxim,pmod-enabled:	This boolean property enables the DS2760 to enter
			sleep mode when the DQ line goes low for greater
			than 2 seconds and leave sleep Mode when the DQ
			line goes high.
- maxim,cache-time-ms:	Time im milliseconds to cache the data for. When
			this time expires, the values are read again from
			the hardware. Defaults to 1000.
- rated-capacity-microamp-hours:
			The rated capacity of the battery, in mAh.
			If not specified, the value stored in the
			non-volatile chip memory is used.
```

## Documentation/devicetree/bindings/power/supply/maxim,ds2760.yaml
```yaml
# SPDX-License-Identifier: GPL-2.0
%YAML 1.2
---
$id: http://devicetree.org/schemas/power/supply/maxim,ds2760.yaml#
$schema: http://devicetree.org/meta-schemas/core.yaml#

title: Maxim DS2760

maintainers:
  - Sebastian Reichel <sre@kernel.org>

description: |
  The ds2760 is a w1 slave device and must hence have its sub-node in
  DT under a w1 bus master node.

allOf:
  - $ref: power-supply.yaml#

properties:
  compatible:
    const: maxim,ds2760

  maxim,pmod-enabled:
    description: |
      Allow the DS2760 to enter sleep mode when the DQ line goes low for more than 2 seconds
      and leave sleep Mode when the DQ line goes high.
    type: boolean

  maxim,cache-time-ms:
    description: |
      Time im milliseconds to cache the data for.
      When this time expires, the values are read again from the hardware.
      Defaults to 1000.

  rated-capacity-microamp-hours:
    description: |
      The rated capacity of the battery, in mAh.
      If not specified, the value stored in the non-volatile chip memory is used.

required:
  - compatible

unevaluatedProperties: false
```

## Documentation/devicetree/bindings/power/supply/maxim,max14577.yaml
```yaml
# SPDX-License-Identifier: GPL-2.0-only OR BSD-2-Clause
%YAML 1.2
---
$id: http://devicetree.org/schemas/power/supply/maxim,max14577.yaml#
$schema: http://devicetree.org/meta-schemas/core.yaml#

title: Maxim MAX14577/MAX77836 MicroUSB and Companion Power Management IC Charger

maintainers:
  - Krzysztof Kozlowski <krzk@kernel.org>

description: |
  This is a part of device tree bindings for Maxim MAX14577/MAX77836 MicroUSB
  Integrated Circuit (MUIC).

  See also Documentation/devicetree/bindings/mfd/maxim,max14577.yaml for
  additional information and example.

properties:
  compatible:
    enum:
      - maxim,max14577-charger
      - maxim,max77836-charger

  maxim,constant-uvolt:
    description:
      Battery Constant Voltage in uV
    $ref: /schemas/types.yaml#/definitions/uint32
    minimum: 4000000
    maximum: 4350000

  maxim,eoc-uamp:
    description: |
      Current in uA for End-Of-Charge mode.
      MAX14577: 50000-20000
      MAX77836: 5000-100000
    $ref: /schemas/types.yaml#/definitions/uint32

  maxim,fast-charge-uamp:
    description: |
      Current in uA for Fast Charge
      MAX14577: 90000-950000
      MAX77836: 45000-475000
    $ref: /schemas/types.yaml#/definitions/uint32

  maxim,ovp-uvolt:
    description:
      OverVoltage Protection Threshold in uV; In an overvoltage condition, INT
      asserts and charging stops.
    $ref: /schemas/types.yaml#/definitions/uint32
    enum: [6000000, 6500000, 7000000, 7500000]

required:
  - compatible
  - maxim,constant-uvolt
  - maxim,eoc-uamp
  - maxim,fast-charge-uamp
  - maxim,ovp-uvolt

allOf:
  - if:
      properties:
        compatible:
          contains:
            const: maxim,max14577-charger
    then:
      properties:
        maxim,eoc-uamp:
          minimum: 50000
          maximum: 200000
        maxim,fast-charge-uamp:
          minimum: 90000
          maximum: 950000
    else:
      # max77836
      properties:
        maxim,eoc-uamp:
          minimum: 5000
          maximum: 100000
        maxim,fast-charge-uamp:
          minimum: 45000
          maximum: 475000

additionalProperties: false
```

## Documentation/devicetree/bindings/power/supply/maxim,max14656.txt
```
Maxim MAX14656 / AL32 USB Charger Detector

Required properties :
- compatible : "maxim,max14656";
- reg: i2c slave address
- interrupt-parent: the phandle for the interrupt controller
- interrupts: interrupt line

Example:

&i2c2 {
	clock-frequency = <50000>;
	pinctrl-names = "default";
	pinctrl-0 = <&pinctrl_i2c2>;
	status = "okay";

	max14656@35 {
		compatible = "maxim,max14656";
		reg = <0x35>;
		pinctrl-names = "default";
		pinctrl-0 = <&pinctrl_charger_detect>;
		interrupt-parent = <&gpio6>;
		interrupts = <26 IRQ_TYPE_LEVEL_HIGH>;
	};
};
```

## Documentation/devicetree/bindings/power/supply/maxim,max14656.yaml
```yaml
# SPDX-License-Identifier: GPL-2.0
%YAML 1.2
---
$id: http://devicetree.org/schemas/power/supply/maxim,max14656.yaml#
$schema: http://devicetree.org/meta-schemas/core.yaml#

title: Maxim MAX14656

maintainers:
  - Sebastian Reichel <sre@kernel.org>

allOf:
  - $ref: power-supply.yaml#

properties:
  compatible:
    const: maxim,max14656

  reg:
    maxItems: 1

  interrupts:
    maxItems: 1

required:
  - compatible
  - reg
  - interrupts

additionalProperties: false

examples:
  - |
    #include <dt-bindings/interrupt-controller/irq.h>
    i2c0 {
      #address-cells = <1>;
      #size-cells = <0>;

      charger-detector@35 {
        compatible = "maxim,max14656";
        reg = <0x35>;
        interrupt-parent = <&gpio6>;
        interrupts = <26 IRQ_TYPE_LEVEL_HIGH>;
      };
    };
```

## Documentation/devicetree/bindings/power/supply/maxim,max17040.yaml
```yaml
# SPDX-License-Identifier: GPL-2.0
%YAML 1.2
---
$id: "http://devicetree.org/schemas/power/supply/maxim,max17040.yaml#"
$schema: "http://devicetree.org/meta-schemas/core.yaml#"

title: Maxim 17040 fuel gauge series

maintainers:
  - Sebastian Reichel <sre@kernel.org>

allOf:
  - $ref: power-supply.yaml#

properties:
  compatible:
    enum:
      - maxim,max17040
      - maxim,max17041
      - maxim,max17043
      - maxim,max17044
      - maxim,max17048
      - maxim,max17049
      - maxim,max17058
      - maxim,max17059
      - maxim,max77836-battery

  reg:
    maxItems: 1

  maxim,alert-low-soc-level:
    $ref: /schemas/types.yaml#/definitions/uint32
    minimum: 1
    maximum: 32
    description: |
      The alert threshold that sets the state of charge level (%) where an interrupt is generated.
      If skipped the power up default value of 4 (%) will be used.

  maxim,double-soc:
    type: boolean
    description: |
      Certain devices return double the capacity.
      Specify this to divide the reported value in 2 and thus normalize it.
      SoC == State of Charge == Capacity.

  maxim,rcomp:
    $ref: /schemas/types.yaml#/definitions/uint8-array
    minItems: 1
    maxItems: 2
    description: |
      A value to compensate readings for various battery chemistries and operating temperatures.
      max17040,41 have 2 byte rcomp, default to 0x97 0x00.
      All other devices have one byte rcomp, default to 0x97.

  interrupts:
    maxItems: 1

  wakeup-source:
    type: boolean
    description: |
      Use this property to use alert low SoC level interrupt as wake up source.

required:
  - compatible
  - reg

unevaluatedProperties: false

examples:
  - |
    i2c0 {
      #address-cells = <1>;
      #size-cells = <0>;

      battery@36 {
        compatible = "maxim,max17048";
        reg = <0x36>;
        maxim,rcomp = /bits/ 8 <0x56>;
        maxim,alert-low-soc-level = <10>;
        maxim,double-soc;
      };
    };
  - |
    #include <dt-bindings/interrupt-controller/irq.h>
    i2c0 {
      #address-cells = <1>;
      #size-cells = <0>;

      battery@36 {
        compatible = "maxim,max77836-battery";
        reg = <0x36>;
        maxim,alert-low-soc-level = <10>;
        interrupt-parent = <&gpio7>;
        interrupts = <2 IRQ_TYPE_LEVEL_LOW>;
        wakeup-source;
      };
    };
```
