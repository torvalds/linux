## Documentation/devicetree/bindings/power/supply/sbs,sbs-manager.yaml
```yaml
# SPDX-License-Identifier: GPL-2.0
%YAML 1.2
---
$id: http://devicetree.org/schemas/power/supply/sbs,sbs-manager.yaml#
$schema: http://devicetree.org/meta-schemas/core.yaml#

title: SBS compliant manger

maintainers:
  - Sebastian Reichel <sre@kernel.org>

allOf:
  - $ref: power-supply.yaml#

properties:
  compatible:
    oneOf:
      - items:
          - enum:
              - lltc,ltc1760
          - enum:
              - sbs,sbs-manager
      - items:
          - const: sbs,sbs-manager

  reg:
    const: 0xa

  "#address-cells":
    const: 1

  "#size-cells":
    const: 0

  gpio-controller: true

  "#gpio-cells":
    const: 2

required:
  - compatible
  - reg

additionalProperties: false

patternProperties:
  "^i2c@[1-4]$":
    type: object
    $ref: /schemas/i2c/i2c-controller.yaml#

examples:
  - |
    #include <dt-bindings/interrupt-controller/irq.h>
    #include <dt-bindings/gpio/gpio.h>

    i2c {
      #address-cells = <1>;
      #size-cells = <0>;

      batman: battery-manager@a {
        compatible = "lltc,ltc1760", "sbs,sbs-manager";
        reg = <0x0a>;
        #address-cells = <1>;
        #size-cells = <0>;

        gpio-controller;
        #gpio-cells = <2>;

        i2c@1 {
          #address-cells = <1>;
          #size-cells = <0>;
          reg = <1>;

          battery@b {
            compatible = "ti,bq20z65", "sbs,sbs-battery";
            reg = <0x0b>;
            sbs,battery-detect-gpios = <&batman 1 1>;
          };
        };

        i2c@2 {
          #address-cells = <1>;
          #size-cells = <0>;
          reg = <2>;

          battery@b {
            compatible = "ti,bq20z65", "sbs,sbs-battery";
            reg = <0x0b>;
            sbs,battery-detect-gpios = <&batman 2 1>;
          };
        };

        i2c@3 {
          #address-cells = <1>;
          #size-cells = <0>;
          reg = <3>;

          battery@b {
            compatible = "ti,bq20z65", "sbs,sbs-battery";
            reg = <0x0b>;
            sbs,battery-detect-gpios = <&batman 3 1>;
          };
        };
      };
    };
```

## Documentation/devicetree/bindings/power/supply/sbs_sbs-battery.txt
```
SBS sbs-battery
~~~~~~~~~~

Required properties :
 - compatible: "<vendor>,<part-number>", "sbs,sbs-battery" as fallback. The
     part number compatible string might be used in order to take care of
     vendor specific registers.
     Known <vendor>,<part-number>:
       ti,bq20z75

Optional properties :
 - sbs,i2c-retry-count : The number of times to retry i2c transactions on i2c
   IO failure.
 - sbs,poll-retry-count : The number of times to try looking for new status
   after an external change notification.
 - sbs,battery-detect-gpios : The gpio which signals battery detection and
   a flag specifying its polarity.

Example:

	battery@b {
		compatible = "ti,bq20z75", "sbs,sbs-battery";
		reg = <0xb>;
		sbs,i2c-retry-count = <2>;
		sbs,poll-retry-count = <10>;
		sbs,battery-detect-gpios = <&gpio-controller 122 1>;
	}
```

## Documentation/devicetree/bindings/power/supply/sbs_sbs-charger.txt
```
SBS sbs-charger
~~~~~~~~~~

Required properties:
 - compatible: "<vendor>,<part-number>", "sbs,sbs-charger" as fallback. The part
     number compatible string might be used in order to take care of vendor
     specific registers.

Optional properties:
- interrupts: Interrupt mapping for GPIO IRQ. Use in conjunction with
    "interrupt-parent". If an interrupt is not provided the driver will switch
    automatically to polling.

Example:

	ltc4100@9 {
		compatible = "lltc,ltc4100", "sbs,sbs-charger";
		reg = <0x9>;
		interrupt-parent = <&gpio6>;
		interrupts = <7 IRQ_TYPE_LEVEL_LOW>;
	};
```

## Documentation/devicetree/bindings/power/supply/sc2731-charger.yaml
```yaml
# SPDX-License-Identifier: GPL-2.0
%YAML 1.2
---
$id: http://devicetree.org/schemas/power/supply/sc2731-charger.yaml#
$schema: http://devicetree.org/meta-schemas/core.yaml#

title: Spreadtrum SC2731 PMICs battery charger

maintainers:
  - Sebastian Reichel <sre@kernel.org>

allOf:
  - $ref: power-supply.yaml#

properties:
  compatible:
    const: sprd,sc2731-charger

  reg:
    maxItems: 1

  phys:
    maxItems: 1
    description: phandle to the USB phy

  monitored-battery:
    description: |
      The charger uses the following battery properties
      - charge-term-current-microamp: current for charge termination phase.
      - constant-charge-voltage-max-microvolt: maximum constant input voltage.

additionalProperties: false
...
```

## Documentation/devicetree/bindings/power/supply/sc2731_charger.txt
```
Spreadtrum SC2731 PMIC battery charger binding

Required properties:
 - compatible: Should be "sprd,sc2731-charger".
 - reg: Address offset of charger register.
 - phys: Contains a phandle to the USB phy.

Optional Properties:
- monitored-battery: phandle of battery characteristics devicetree node.
  The charger uses the following battery properties:
- charge-term-current-microamp: current for charge termination phase.
- constant-charge-voltage-max-microvolt: maximum constant input voltage.
  See Documentation/devicetree/bindings/power/supply/battery.txt

Example:

	bat: battery {
		compatible = "simple-battery";
		charge-term-current-microamp = <120000>;
		constant-charge-voltage-max-microvolt = <4350000>;
		......
	};

	sc2731_pmic: pmic@0 {
		compatible = "sprd,sc2731";
		reg = <0>;
		spi-max-frequency = <26000000>;
		interrupts = <GIC_SPI 31 IRQ_TYPE_LEVEL_HIGH>;
		interrupt-controller;
		#interrupt-cells = <2>;
		#address-cells = <1>;
		#size-cells = <0>;

		charger@0 {
			compatible = "sprd,sc2731-charger";
			reg = <0x0>;
			phys = <&ssphy>;
			monitored-battery = <&bat>;
		};
	};
```

## Documentation/devicetree/bindings/power/supply/sc27xx-fg.txt
```
Spreadtrum SC27XX PMICs Fuel Gauge Unit Power Supply Bindings

Required properties:
- compatible: Should be one of the following:
  "sprd,sc2720-fgu",
  "sprd,sc2721-fgu",
  "sprd,sc2723-fgu",
  "sprd,sc2730-fgu",
  "sprd,sc2731-fgu".
- reg: The address offset of fuel gauge unit.
- battery-detect-gpios: GPIO for battery detection.
- io-channels: Specify the IIO ADC channels to get temperature and charge voltage.
- io-channel-names: Should be "bat-temp" or "charge-vol".
- nvmem-cells: A phandle to the calibration cells provided by eFuse device.
- nvmem-cell-names: Should be "fgu_calib".
- sprd,calib-resistance-micro-ohms: Specify the real resistance of coulomb counter
  chip in micro Ohms.
- monitored-battery: Phandle of battery characteristics devicetree node.
  See Documentation/devicetree/bindings/power/supply/battery.txt

Example:

	bat: battery {
		compatible = "simple-battery";
		charge-full-design-microamp-hours = <1900000>;
		constant-charge-voltage-max-microvolt = <4350000>;
		ocv-capacity-celsius = <20>;
		ocv-capacity-table-0 = <4185000 100>, <4113000 95>, <4066000 90>,
					<4022000 85>, <3983000 80>, <3949000 75>,
					<3917000 70>, <3889000 65>, <3864000 60>,
					<3835000 55>, <3805000 50>, <3787000 45>,
					<3777000 40>, <3773000 35>, <3770000 30>,
					<3765000 25>, <3752000 20>, <3724000 15>,
					<3680000 10>, <3605000 5>, <3400000 0>;
		......
	};

	sc2731_pmic: pmic@0 {
		compatible = "sprd,sc2731";
		reg = <0>;
		spi-max-frequency = <26000000>;
		interrupts = <GIC_SPI 31 IRQ_TYPE_LEVEL_HIGH>;
		interrupt-controller;
		#interrupt-cells = <2>;
		#address-cells = <1>;
		#size-cells = <0>;

		fgu@a00 {
			compatible = "sprd,sc2731-fgu";
			reg = <0xa00>;
			battery-detect-gpios = <&pmic_eic 9 GPIO_ACTIVE_HIGH>;
			io-channels = <&pmic_adc 5>, <&pmic_adc 14>;
			io-channel-names = "bat-temp", "charge-vol";
			nvmem-cells = <&fgu_calib>;
			nvmem-cell-names = "fgu_calib";
			monitored-battery = <&bat>;
			sprd,calib-resistance-micro-ohms = <21500>;
		};
	};
```

## Documentation/devicetree/bindings/power/supply/sc27xx-fg.yaml
```yaml
# SPDX-License-Identifier: GPL-2.0
%YAML 1.2
---
$id: http://devicetree.org/schemas/power/supply/sc27xx-fg.yaml#
$schema: http://devicetree.org/meta-schemas/core.yaml#

title: Spreadtrum SC27XX PMICs Fuel Gauge Unit Power Supply

maintainers:
  - Sebastian Reichel <sre@kernel.org>

allOf:
  - $ref: power-supply.yaml#

properties:
  compatible:
    enum:
      - sprd,sc2720-fgu
      - sprd,sc2721-fgu
      - sprd,sc2723-fgu
      - sprd,sc2730-fgu
      - sprd,sc2731-fgu

  reg:
    maxItems: 1

  battery-detect-gpios:
    maxItems: 1

  interrupts:
    maxItems: 1

  io-channels:
    items:
      - description: Battery Temperature ADC
      - description: Battery Charge Voltage ADC

  io-channel-names:
    items:
      - const: bat-temp
      - const: charge-vol

  nvmem-cells:
    maxItems: 1
    description: Calibration cells provided by eFuse device

  nvmem-cell-names:
    const: fgu_calib

  sprd,calib-resistance-micro-ohms:
    description: real resistance of coulomb counter chip in micro Ohms

  monitored-battery: true

required:
  - compatible
  - reg
  - battery-detect-gpios
  - interrupts
  - io-channels
  - io-channel-names
  - nvmem-cells
  - nvmem-cell-names
  - sprd,calib-resistance-micro-ohms
  - monitored-battery

additionalProperties: false
...
```

## Documentation/devicetree/bindings/power/supply/sc8551_charger.txt
```
Binding for sc8551 battery charger

Required properties:
- compatible: "sc,sc8551-standalone" for sc8551 Charger Power Supply
- monitored-battery: phandle of battery characteristics devicetree node
- interrupts: Interrupt mapping for GPIO IRQ. Use in conjunction with
    "interrupt-parent". If an interrupt is not provided the driver will switch
     automatically to polling.

- input-voltage-limit-microvolt: integer, input voltage level in uV, used to
				 decrease voltage level when the over current
				 of the input power source occurs.
- input-current-limit-microamp: integer, input current value in uA drained by the
				charger from the power source.Default: 500000 uA (500mA)

- sc,sc8551,bat-ovp-disable: enable the battery over voltage protection
- sc,sc8551,bat-ocp-disable: enable the battery over current protection
- sc,sc8551,bus-ocp-disable: enable the bus over voltage protection
- sc,sc8551,bat-ovp-threshold: Configures the battery over voltage protection voltage (in uV).
- sc,sc8551,bat-ocp-threshold: Configures the battery over current protection voltage (in uA).
- sc,sc8551,bus-ovp-threshold: Configures the bus over voltage protection voltage (in uV).
- sc,sc8551,bus-ocp-threshold: Configures the bus over current protection voltage (in uA).
- sc,sc8551,ac-ovp-threshold: Configures the AC voltage protection voltage (in uV).
- sc,sc8551,sense-resistor-mohm: integer, value of a resistor in series with the battery;

Example:
c8551: sc8551@66 {
	compatible = "sc,sc8551-standalone";
	reg = <0x66>;
	interrupt-parent = <&gpio4>;
	interrupts = <RK_PB5 IRQ_TYPE_EDGE_FALLING>;

	sc,sc8551,bat-ovp-disable = <0>;
	sc,sc8551,bat-ocp-disable = <0>;
	sc,sc8551,bus-ocp-disable = <0>;

	sc,sc8551,bat-ovp-threshold = <4500>;
	sc,sc8551,bat-ocp-threshold = <4500>;

	sc,sc8551,bus-ovp-threshold = <12000>;
	sc,sc8551,bus-ocp-threshold = <4000>;

	sc,sc8551,ac-ovp-threshold = <17>;
	sc,sc8551,sense-resistor-mohm = <2>;
};
```

## Documentation/devicetree/bindings/power/supply/sc89890-charger.txt
```
Binding for sc8990 Li-Ion Charger

This driver will support the sc89890. There are
other ICs in the same family but those have not been tested.

Required properties:
- compatible: "sc,sc89890"
- reg: integer, i2c address of the device.
- interrupts: interrupt line;
- sc,battery-regulation-voltage: integer, maximum charging voltage (in uV);
- sc,charge-current: integer, maximum charging current (in uA);
- sc,termination-current: integer, charge will be terminated when current in
    constant-voltage phase drops below this value (in uA);
- sc,precharge-current: integer, maximum charge current during precharge
    phase (in uA);
- sc,minimum-sys-voltage: integer, when battery is charging and it is below
    minimum system voltage, the system will be regulated above
    minimum-sys-voltage setting (in uV);
- sc,boost-voltage: integer, VBUS voltage level in boost mode (in uV);
- sc,boost-max-current: integer, maximum allowed current draw in boost mode
    (in uA).

Example:

sc89890 {
	compatible = "sc,sc89890";
	reg = <0x6a>;

	interrupt-parent = <&gpio0>;
	interrupts = <RK_PD5 IRQ_TYPE_EDGE_FALLING>;

	sc,battery-regulation-voltage = <4200000>;
	sc,charge-current = <1000000>;
	sc,termination-current = <50000>;
	sc,precharge-current = <128000>;
	sc,minimum-sys-voltage = <3600000>;
	sc,boost-voltage = <5000000>;
	sc,boost-max-current = <1000000>;
	sc,ibatcomp-micro-ohms = <10>;
};
```

## Documentation/devicetree/bindings/power/supply/sgm41542_charger.txt
```
Binding for sgm41542 battery charger

Required properties:
- compatible: "sgm,sgm41542" for sgm41542 Charger Power Supply
- monitored-battery: phandle of battery characteristics devicetree node
- input-voltage-limit-microvolt: integer, input voltage level in uV, used to
				 decrease voltage level when the over current
				 of the input power source occurs.
- input-current-limit-microamp: integer, input current value in uA drained by the
				charger from the power source.Default: 500000 uA (500mA)

child nodes:
- vbus5v0_typec:
  Usage: optional
  Description: Regulator that is used to control the VBUS voltage direction for
               either USB host mode or for charging on the OTG port.

Example:

sgm41542: sgm41542@3b {
                compatible = "sgm,sgm41542";
                reg = <0x3b>;
                input-voltage-limit-microvolt = <4500000>;
                input-current-limit-microamp = <3000000>;
                monitored-battery = <&bat>;
                regulators {
                        vbus5v0_typec: vbus5v0-typec {
                                regulator-compatible = "otg-vbus";
                                regulator-name = "vbus5v0_typec";
                        };
                };
        };
```

## Documentation/devicetree/bindings/power/supply/st,stc3117.yaml
```yaml
# SPDX-License-Identifier: (GPL-2.0-only OR BSD-2-Clause)
%YAML 1.2
---
$id: http://devicetree.org/schemas/power/supply/st,stc3117.yaml#
$schema: http://devicetree.org/meta-schemas/core.yaml#

title: STMicroelectronics STC3117 Fuel Gauge Unit Power Supply

maintainers:
  - Hardevsinh Palaniya <hardevsinh.palaniya@siliconsignals.io>
  - Bhavin Sharma <bhavin.sharma@siliconsignals.io>

description: |
  The STC3117 includes the STMicroelectronics OptimGauge algorithm.
  It provides accurate battery state-of-charge (SOC) monitoring, tracks
  battery parameter changes with operation conditions, temperature,
  and aging, and allows the application to get a battery state-of-health
  (SOH) indication.

  An alarm output signals low SOC or low voltage conditions and also
  indicates fault conditions like a missing or swapped battery.

  Datasheet is available at
  https://www.st.com/resource/en/datasheet/stc3117.pdf

allOf:
  - $ref: power-supply.yaml#

properties:
  compatible:
    enum:
      - st,stc3117

  reg:
    maxItems: 1

  monitored-battery:
    description: |
      The fuel gauge uses the following battery properties:
      - charge-full-design-microamp-hours
      - voltage-min-design-microvolt
      - voltage-max-design-microvolt

  shunt-resistor-micro-ohms:
    description: Current sense resistor

  interrupts:
    maxItems: 1

required:
  - compatible
  - reg
  - monitored-battery
  - shunt-resistor-micro-ohms

unevaluatedProperties: false

examples:
  - |
    #include <dt-bindings/interrupt-controller/irq.h>

    i2c {
      #address-cells = <1>;
      #size-cells = <0>;

      battery@70 {
        compatible = "st,stc3117";
        reg = <0x70>;
        interrupt-parent = <&gpio0>;
        interrupts = <31 IRQ_TYPE_LEVEL_LOW>;
        monitored-battery = <&bat>;
        shunt-resistor-micro-ohms = <10000>;
      };
    };
```
