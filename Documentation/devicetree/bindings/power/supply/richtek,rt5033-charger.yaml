## Documentation/devicetree/bindings/power/supply/rohm,bd99954.yaml
```yaml
# SPDX-License-Identifier: GPL-2.0-only OR BSD-2-Clause
%YAML 1.2
---
$id: http://devicetree.org/schemas/power/supply/rohm,bd99954.yaml#
$schema: http://devicetree.org/meta-schemas/core.yaml#

title: ROHM BD99954 Battery charger

maintainers:
  - Matti Vaittinen <mazziesaccount@gmail.com>
  - Markus Laine <markus.laine@fi.rohmeurope.com>
  - Mikko Mutanen <mikko.mutanen@fi.rohmeurope.com>

description: |
  The ROHM BD99954 is a Battery Management LSI for 1-4 cell Lithium-Ion
  secondary battery intended to be used in space-constraint equipment such
  as Low profile Notebook PC, Tablets and other applications. BD99954
  provides a Dual-source Battery Charger, two port BC1.2 detection and a
  Battery Monitor.

$ref: power-supply.yaml#

properties:
  compatible:
    const: rohm,bd99954
#
#    The battery charging profile of BD99954.
#
#    Curve (1) represents charging current.
#    Curve (2) represents battery voltage.
#
#    The BD99954 data sheet divides charging to three phases.
#    a) Trickle-charge with constant current (8).
#    b) pre-charge with constant current (6)
#    c) fast-charge with:
#       First a constant current (5) phase (CC)
#       Then constant voltage (CV) phase (after the battery voltage has reached
#       target level - until charging current has dropped to termination
#       level (7)
#
#     V ^                                                        ^ I
#       .                                                        .
#       .                                                        .
# (4)- -.- - - - - - - - - - - - - -  +++++++++++++++++++++++++++.
#       .                            /                           .
#       .                     ++++++/++ - - - - - - - - - - - - -.- - (5)
#       .                     +    /  +                          .
#       .                     +   -   --                         .
#       .                     +  -     +                         .
#       .                     +.-      -:                        .
#       .                    .+         +`                       .
#       .                  .- +       | `/                       .
#       .               .."   +          .:                      .
#       .             -"      +           --                     .
#       .    (2)  ..."        +       |    :-                    .
#       .    ...""            +             -:                   .
# (3)- -.-.""- - - - -+++++++++ - - - - - - -.:- - - - - - - - - .- - (6)
#       .             +                       `:.                .
#       .             +               |         -:               .
#       .             +                           -:             .
#       .             +                             ..           .
#       .   (1)       +               |               "+++- - - -.- - (7)
#       -++++++++++++++- - - - - - - - - - - - - - - - - + - - - .- - (8)
#       .                                                +       -
#       -------------------------------------------------+++++++++-->
#       |             |       |   CC   |      CV         |
#       | --trickle-- | -pre- | ---------fast----------- |
#
#   The charger uses the following battery properties
# - trickle-charge-current-microamp:
#     Current used at trickle-charge phase (8 in above chart)
#     minimum: 64000
#     maximum: 1024000
#     multipleOf: 64000
# - precharge-current-microamp:
#     Current used at pre-charge phase (6 in above chart)
#     minimum: 64000
#     maximum: 1024000
#     multipleOf: 64000
# - constant-charge-current-max-microamp
#     Current used at fast charge constant current phase (5 in above chart)
#     minimum: 64000
#     maximum: 1024000
#     multipleOf: 64000
# - constant-charge-voltage-max-microvolt
#     The constant voltage used in fast charging phase (4 in above chart)
#     minimum: 2560000
#     maximum: 19200000
#     multipleOf: 16000
# - precharge-upper-limit-microvolt
#     charging mode is changed from trickle charging to pre-charging
#     when battery voltage exceeds this limit voltage (3 in above chart)
#     minimum: 2048000
#     maximum: 19200000
#     multipleOf: 64000
# - re-charge-voltage-microvolt
#     minimum: 2560000
#     maximum: 19200000
#     multipleOf: 16000
#     re-charging is automatically started when battry has been discharging
#     to the point where the battery voltage drops below this limit
# - over-voltage-threshold-microvolt
#     battery is expected to be faulty if battery voltage exceeds this limit.
#     Charger will then enter to a "battery faulty" -state
#     minimum: 2560000
#     maximum: 19200000
#     multipleOf: 16000
# - charge-term-current-microamp
#     minimum: 0
#     maximum: 1024000
#     multipleOf: 64000
#     a charge cycle terminates when the battery voltage is above recharge
#     threshold, and the current is below this setting (7 in above chart)
#   See also Documentation/devicetree/bindings/power/supply/battery.yaml

  reg:
    maxItems: 1

  interrupts:
    maxItems: 1

  monitored-battery:
    description:
      phandle of battery characteristics devicetree node

  rohm,vsys-regulation-microvolt:
    description: system specific lower limit for system voltage.
    minimum: 2560000
    maximum: 19200000
    multipleOf: 64000

  rohm,vbus-input-current-limit-microamp:
    description: system specific VBUS input current limit (in microamps).
    minimum: 32000
    maximum: 16352000
    multipleOf: 32000

  rohm,vcc-input-current-limit-microamp:
    description: system specific VCC/VACP input current limit (in microamps).
    minimum: 32000
    maximum: 16352000
    multipleOf: 32000

required:
  - compatible

additionalProperties: false

examples:
  - |
    i2c {
        #address-cells = <1>;
        #size-cells = <0>;
        charger@9 {
            compatible = "rohm,bd99954";
            monitored-battery = <&battery>;
            reg = <0x9>;
            interrupt-parent = <&gpio1>;
            interrupts = <29 8>;
            rohm,vsys-regulation-microvolt = <8960000>;
            rohm,vbus-input-current-limit-microamp = <1472000>;
            rohm,vcc-input-current-limit-microamp = <1472000>;
        };
    };
```

## Documentation/devicetree/bindings/power/supply/rx51-battery.txt
```
Binding for Nokia N900 battery

The Nokia N900 battery status can be read via the TWL4030's A/D converter.

Required properties:
- compatible: Should contain one of the following:
 * "nokia,n900-battery"
- io-channels: Should contain IIO channel specifiers
               for each element in io-channel-names.
- io-channel-names: Should contain the following values:
 * "temp" - The ADC channel for temperature reading
 * "bsi"  - The ADC channel for battery size identification
 * "vbat" - The ADC channel to measure the battery voltage

Example from Nokia N900:

battery: n900-battery {
	compatible = "nokia,n900-battery";
	io-channels = <&twl4030_madc 0>,
		      <&twl4030_madc 4>,
		      <&twl4030_madc 12>;
	io-channel-names = "temp",
			   "bsi",
			   "vbat";
};
```

## Documentation/devicetree/bindings/power/supply/samsung,battery.yaml
```yaml
# SPDX-License-Identifier: (GPL-2.0-only OR BSD-2-Clause)
%YAML 1.2
---
$id: http://devicetree.org/schemas/power/supply/samsung,battery.yaml#
$schema: http://devicetree.org/meta-schemas/core.yaml#

title: Samsung SDI Batteries

maintainers:
  - Linus Walleij <linus.walleij@linaro.org>

description: |
  Samsung SDI (Samsung Digital Interface) batteries are all different versions
  of lithium ion chemistry devices used for mobile phones, laptops and other
  portable electronics. The batteries are adapted to a specific product and
  the physical restrictions make it impossible to use another battery with the
  product, so product device trees can specify these batteries. Operating
  systems should determine hardware characteristics of the batteries from the
  compatible string.

properties:
  compatible:
    oneOf:
      - const: samsung,eb-l1m7flu
        description: 3.8V 1500 mAh battery used in Samsung GT-I8190
      - const: samsung,eb425161la
        description: 3.8V 1500 mAh battery used in Samsung SGH-T599 and SGH-I407
      - const: samsung,eb425161lu
        description: 3.8V 1500 mAh battery used in Samsung GT-I8160
      - const: samsung,eb485159lu
        description: 3.8V 1700 mAh battery used in Samsung GT-S7710
      - const: samsung,eb535151vu
        description: 3.8V 1500 mAh battery used in Samsung GT-I9070
      - const: samsung,eb585157lu
        description: 3.8V 2000 mAh battery used in Samsung GT-I8530

required:
  - compatible

additionalProperties: false

examples:
  - |
    power {
      #address-cells = <1>;
      #size-cells = <0>;

      battery: battery {
        compatible = "samsung,eb425161la";
      };

      charger@11 {
        reg = <0x11>;
        monitored-battery = <&battery>;
      };
    };
```

## Documentation/devicetree/bindings/power/supply/samsung,s2mu005-fuel-gauge.yaml
```yaml
# SPDX-License-Identifier: (GPL-2.0-only OR BSD-2-Clause)
%YAML 1.2
---
$id: http://devicetree.org/schemas/power/supply/samsung,s2mu005-fuel-gauge.yaml#
$schema: http://devicetree.org/meta-schemas/core.yaml#

title: Battery Fuel Gauge for Samsung S2M series PMICs

maintainers:
  - Kaustabh Chakraborty <kauschluss@disroot.org>

allOf:
  - $ref: power-supply.yaml#

properties:
  compatible:
    enum:
      - samsung,s2mu005-fuel-gauge

  reg:
    maxItems: 1

  interrupts:
    maxItems: 1

required:
  - compatible
  - reg

unevaluatedProperties: false

examples:
  - |
    #include <dt-bindings/interrupt-controller/irq.h>

    i2c {
      #address-cells = <1>;
      #size-cells = <0>;

      fuel-gauge@3b {
        compatible = "samsung,s2mu005-fuel-gauge";
        reg = <0x3b>;

        interrupt-parent = <&gpa0>;
        interrupts = <3 IRQ_TYPE_EDGE_BOTH>;

        monitored-battery = <&battery>;
      };
    };
```

## Documentation/devicetree/bindings/power/supply/sbs,sbs-battery.yaml
```yaml
# SPDX-License-Identifier: GPL-2.0
%YAML 1.2
---
$id: http://devicetree.org/schemas/power/supply/sbs,sbs-battery.yaml#
$schema: http://devicetree.org/meta-schemas/core.yaml#

title: SBS compliant battery

maintainers:
  - Sebastian Reichel <sre@kernel.org>

description: |
  Battery compatible with the smart battery system specifications

allOf:
  - $ref: power-supply.yaml#

properties:
  compatible:
    oneOf:
      - items:
          - enum:
              - ti,bq20z45
              - ti,bq20z65
              - ti,bq20z75
          - enum:
              - sbs,sbs-battery
      - items:
          - const: sbs,sbs-battery

  reg:
    maxItems: 1

  sbs,i2c-retry-count:
    description:
      The number of times to retry I2C transactions on I2C IO failure.
    default: 0
    $ref: /schemas/types.yaml#/definitions/uint32

  sbs,poll-retry-count:
    description:
      The number of times to try looking for new status after an external
      change notification.
    default: 0
    $ref: /schemas/types.yaml#/definitions/uint32

  sbs,battery-detect-gpios:
    description:
      GPIO which signals battery detection. If this is not supplied, the bus
      needs to be polled to detect the battery.
    maxItems: 1

  sbs,disable-charger-broadcasts:
    description:
      SBS batteries by default send broadcast messages to SBS compliant chargers to
      configure max. charge current/voltage. If your hardware does not have an SBS
      compliant charger it should be disabled via this property to avoid blocking
      the bus. Also some SBS battery fuel gauges are known to have a buggy multi-
      master implementation.
    type: boolean

required:
  - compatible
  - reg

unevaluatedProperties: false

examples:
  - |
    #include <dt-bindings/gpio/gpio.h>

    i2c {
        #address-cells = <1>;
        #size-cells = <0>;

        battery@b {
            compatible = "ti,bq20z75", "sbs,sbs-battery";
            reg = <0xb>;
            sbs,i2c-retry-count = <2>;
            sbs,poll-retry-count = <10>;
            sbs,battery-detect-gpios = <&gpio 122 GPIO_ACTIVE_HIGH>;
            sbs,disable-charger-broadcasts;
       };
    };
```

## Documentation/devicetree/bindings/power/supply/sbs,sbs-charger.yaml
```yaml
# SPDX-License-Identifier: GPL-2.0
%YAML 1.2
---
$id: http://devicetree.org/schemas/power/supply/sbs,sbs-charger.yaml#
$schema: http://devicetree.org/meta-schemas/core.yaml#

title: SBS compliant charger

maintainers:
  - Sebastian Reichel <sre@kernel.org>

description: |
  Charger compatible with the smart battery system specifications

allOf:
  - $ref: power-supply.yaml#

properties:
  compatible:
    oneOf:
      - items:
          - enum:
              - lltc,ltc4100
          - enum:
              - sbs,sbs-charger
      - items:
          - const: sbs,sbs-charger

  reg:
    maxItems: 1

  interrupts:
    maxItems: 1

required:
  - compatible
  - reg

additionalProperties: false

examples:
  - |
    #include <dt-bindings/interrupt-controller/irq.h>

    i2c {
        #address-cells = <1>;
        #size-cells = <0>;

        charger@9 {
            compatible = "lltc,ltc4100", "sbs,sbs-charger";
            reg = <0x9>;
            interrupt-parent = <&gpio6>;
            interrupts = <7 IRQ_TYPE_LEVEL_LOW>;
       };
    };
```

## Documentation/devicetree/bindings/power/supply/sbs,sbs-manager.txt
```
Binding for sbs-manager

Required properties:
- compatible: "<vendor>,<part-number>", "sbs,sbs-charger" as fallback. The part
  number compatible string might be used in order to take care of vendor
  specific registers.
- reg: integer, i2c address of the device. Should be <0xa>.
Optional properties:
- gpio-controller: Marks the port as GPIO controller.
  See "gpio-specifier" in .../devicetree/bindings/gpio/gpio.txt.
- #gpio-cells: Should be <2>. The first cell is the pin number, the second cell
  is used to specify optional parameters:
  See "gpio-specifier" in .../devicetree/bindings/gpio/gpio.txt.

From OS view the device is basically an i2c-mux used to communicate with up to
four smart battery devices at address 0xb. The driver actually implements this
behaviour. So standard i2c-mux nodes can be used to register up to four slave
batteries. Channels will be numerated starting from 1 to 4.

Example:

batman@a {
    compatible = "lltc,ltc1760", "sbs,sbs-manager";
    reg = <0x0a>;
    #address-cells = <1>;
    #size-cells = <0>;

    gpio-controller;
    #gpio-cells = <2>;

    i2c@1 {
        #address-cells = <1>;
        #size-cells = <0>;
        reg = <1>;

        battery@b {
            compatible = "ti,bq2060", "sbs,sbs-battery";
            reg = <0x0b>;
            sbs,battery-detect-gpios = <&batman 1 1>;
        };
    };

    i2c@2 {
        #address-cells = <1>;
        #size-cells = <0>;
        reg = <2>;

        battery@b {
            compatible = "ti,bq2060", "sbs,sbs-battery";
            reg = <0x0b>;
            sbs,battery-detect-gpios = <&batman 2 1>;
        };
    };

    i2c@3 {
        #address-cells = <1>;
        #size-cells = <0>;
        reg = <3>;

        battery@b {
            compatible = "ti,bq2060", "sbs,sbs-battery";
            reg = <0x0b>;
            sbs,battery-detect-gpios = <&batman 3 1>;
        };
    };
};
```
