## Documentation/devicetree/bindings/power/supply/richtek,rt5033-charger.yaml
```yaml
# SPDX-License-Identifier: (GPL-2.0 OR BSD-2-Clause)
%YAML 1.2
---
$id: http://devicetree.org/schemas/power/supply/richtek,rt5033-charger.yaml#
$schema: http://devicetree.org/meta-schemas/core.yaml#

title: Richtek RT5033 PMIC Battery Charger

maintainers:
  - Jakob Hauser <jahau@rocketmail.com>

description:
  The battery charger of the multifunction device RT5033 has to be instantiated
  under sub-node named "charger" using the following format.

properties:
  compatible:
    const: richtek,rt5033-charger

  monitored-battery:
    $ref: /schemas/types.yaml#/definitions/phandle
    description: |
      Phandle to the monitored battery according to battery.yaml. The battery
      node needs to contain five parameters.

      precharge-current-microamp:
      Current of pre-charge mode. The pre-charge current levels are 350 mA
      to 650 mA programmed by I2C per 100 mA.

      constant-charge-current-max-microamp:
      Current of fast-charge mode. The fast-charge current levels are 700 mA
      to 2000 mA programmed by I2C per 100 mA.

      charge-term-current-microamp:
      This property is end of charge current. Its level ranges from 150 mA
      to 600 mA. Between 150 mA and 300 mA in 50 mA steps, between 300 mA and
      600 mA in 100 mA steps.

      precharge-upper-limit-microvolt:
      Voltage of pre-charge mode. If the battery voltage is below the pre-charge
      threshold voltage, the charger is in pre-charge mode with pre-charge
      current. Its levels are 2.3 V to 3.8 V programmed by I2C per 0.1 V.

      constant-charge-voltage-max-microvolt:
      Battery regulation voltage of constant voltage mode. This voltage levels
      from 3.65 V to 4.4 V by I2C per 0.025 V.

  richtek,usb-connector:
    $ref: /schemas/types.yaml#/definitions/phandle
    description:
      Phandle to a USB connector according to usb-connector.yaml. The connector
      should be a child of the extcon device.

required:
  - monitored-battery

additionalProperties: false

examples:
  - |
    charger {
        compatible = "richtek,rt5033-charger";
        monitored-battery = <&battery>;
        richtek,usb-connector = <&usb_con>;
    };
```

## Documentation/devicetree/bindings/power/supply/richtek,rt9455.yaml
```yaml
# SPDX-License-Identifier: GPL-2.0
%YAML 1.2
---
$id: http://devicetree.org/schemas/power/supply/richtek,rt9455.yaml#
$schema: http://devicetree.org/meta-schemas/core.yaml#

title: Binding for Richtek rt9455 battery charger

maintainers:
  - Sebastian Reichel <sre@kernel.org>

allOf:
  - $ref: power-supply.yaml#

properties:
  compatible:
    const: richtek,rt9455

  reg:
    maxItems: 1

  interrupts:
    maxItems: 1

  richtek,output-charge-current:
    $ref: /schemas/types.yaml#/definitions/uint32
    description: output current from the charger to the battery, in uA.

  richtek,end-of-charge-percentage:
    $ref: /schemas/types.yaml#/definitions/uint32
    description: |
      percent of the output charge current. When the current in constant-voltage phase drops
      below output_charge_current x end-of-charge-percentage, charge is terminated.

  richtek,battery-regulation-voltage:
    $ref: /schemas/types.yaml#/definitions/uint32
    description: maximum battery voltage in uV.

  richtek,boost-output-voltage:
    $ref: /schemas/types.yaml#/definitions/uint32
    description: |
      maximum voltage provided to consumer devices, when the charger is in boost mode, in uV.

  richtek,min-input-voltage-regulation:
    $ref: /schemas/types.yaml#/definitions/uint32
    description: |
      input voltage level in uV, used to decrease voltage level when the over current of the
      input power source occurs. This prevents input voltage drop due to insufficient
      current provided by the power source. Defaults to 4500000 uV (4.5V).

  richtek,avg-input-current-regulation:
    $ref: /schemas/types.yaml#/definitions/uint32
    description: |
      input current value in uA drained by the charger from the power source.
      Defaults to 500000 uA (500mA).

required:
  - compatible
  - reg
  - interrupts
  - richtek,output-charge-current
  - richtek,end-of-charge-percentage
  - richtek,battery-regulation-voltage
  - richtek,boost-output-voltage

additionalProperties: false

examples:
  - |
    #include <dt-bindings/interrupt-controller/irq.h>
    i2c0 {
      #address-cells = <1>;
      #size-cells = <0>;

      charger@22 {
        compatible = "richtek,rt9455";
        reg = <0x22>;

        interrupt-parent = <&gpio1>;
        interrupts = <0 IRQ_TYPE_LEVEL_LOW>;

        richtek,output-charge-current	    = <500000>;
        richtek,end-of-charge-percentage    = <10>;
        richtek,battery-regulation-voltage  = <4200000>;
        richtek,boost-output-voltage	    = <5050000>;

        richtek,min-input-voltage-regulation = <4500000>;
        richtek,avg-input-current-regulation = <500000>;
      };
    };
```

## Documentation/devicetree/bindings/power/supply/richtek,rt9467-charger.yaml
```yaml
# SPDX-License-Identifier: (GPL-2.0-only OR BSD-2-Clause)
%YAML 1.2
---
$id: http://devicetree.org/schemas/power/supply/richtek,rt9467-charger.yaml#
$schema: http://devicetree.org/meta-schemas/core.yaml#

title: Richtek RT9467 Switching Battery Charger with Power Path Management

maintainers:
  - ChiYuan Huang <cy_huang@richtek.com>
  - ChiaEn Wu <chiaen_wu@richtek.com>

description: |
  RT9467 is a switch-mode single cell Li-Ion/Li-Polymer battery charger for
  portable applications. It integrates a synchronous PWM controller, power
  MOSFETs, input current sensing and regulation, high-accuracy voltage
  regulation, and charge termination. The charge current is regulated through
  integrated sensing resistors.

  The RT9467 also features USB On-The-Go (OTG) support. It also integrates
  D+/D- pin for USB host/charging port detection.

  Datasheet is available at
  https://www.richtek.com/assets/product_file/RT9467/DS9467-01.pdf

properties:
  compatible:
    const: richtek,rt9467-charger

  reg:
    maxItems: 1

  wakeup-source: true

  interrupts:
    maxItems: 1

  charge-enable-gpios:
    description: GPIO is used to turn on and off charging.
    maxItems: 1

  usb-otg-vbus-regulator:
    type: object
    description: OTG boost regulator.
    unevaluatedProperties: false
    $ref: /schemas/regulator/regulator.yaml#

    properties:
      enable-gpios: true

required:
  - compatible
  - reg
  - wakeup-source
  - interrupts

additionalProperties: false

examples:
  - |
    #include <dt-bindings/interrupt-controller/irq.h>
    #include <dt-bindings/gpio/gpio.h>
    i2c {
      #address-cells = <1>;
      #size-cells = <0>;

      charger@5b {
        compatible = "richtek,rt9467-charger";
        reg = <0x5b>;
        wakeup-source;
        interrupts-extended = <&gpio_intc 32 IRQ_TYPE_LEVEL_LOW>;
        charge-enable-gpios = <&gpio26 1 GPIO_ACTIVE_LOW>;

        rt9467_otg_vbus: usb-otg-vbus-regulator {
          regulator-name = "rt9467-usb-otg-vbus";
          regulator-min-microvolt = <4425000>;
          regulator-max-microvolt = <5825000>;
          regulator-min-microamp = <500000>;
          regulator-max-microamp = <3000000>;
        };
      };
    };
```

## Documentation/devicetree/bindings/power/supply/richtek,rt9471.yaml
```yaml
# SPDX-License-Identifier: (GPL-2.0-only OR BSD-2-Clause)
%YAML 1.2
---
$id: http://devicetree.org/schemas/power/supply/richtek,rt9471.yaml#
$schema: http://devicetree.org/meta-schemas/core.yaml#

title: Richtek RT9471 3A Single Cell Switching Battery charger

maintainers:
  - Alina Yu <alina_yu@richtek.com>
  - ChiYuan Huang <cy_huang@richtek.com>

description: |
  RT9471 is a switch-mode single cell Li-Ion/Li-Polymer battery charger for
  portable applications. It supports USB BC1.2 port detection, current and
  voltage regulations in both charging and boost mode.

  Datasheet is available at
  https://www.richtek.com/assets/product_file/RT9471=RT9471D/DS9471D-02.pdf

properties:
  compatible:
    const: richtek,rt9471

  reg:
    maxItems: 1

  charge-enable-gpios:
    description: GPIO used to turn on and off charging.
    maxItems: 1

  wakeup-source: true

  interrupts:
    maxItems: 1

  usb-otg-vbus-regulator:
    type: object
    $ref: /schemas/regulator/regulator.yaml#
    unevaluatedProperties: false

required:
  - compatible
  - reg
  - wakeup-source
  - interrupts

additionalProperties: false

examples:
  - |
    #include <dt-bindings/interrupt-controller/irq.h>
    #include <dt-bindings/gpio/gpio.h>
    i2c {
      #address-cells = <1>;
      #size-cells = <0>;

      charger@53 {
        compatible = "richtek,rt9471";
        reg = <0x53>;
        charge-enable-gpios = <&gpio26 1 GPIO_ACTIVE_LOW>;
        wakeup-source;
        interrupts-extended = <&gpio_intc 32 IRQ_TYPE_EDGE_FALLING>;

        usb-otg-vbus-regulator {
          regulator-name = "usb-otg-vbus";
          regulator-min-microvolt = <4850000>;
          regulator-max-microvolt = <5300000>;
          regulator-min-microamp = <500000>;
          regulator-max-microamp = <1200000>;
        };
      };
    };
```

## Documentation/devicetree/bindings/power/supply/richtek,rt9756.yaml
```yaml
# SPDX-License-Identifier: GPL-2.0-only OR BSD-2-Clause
%YAML 1.2
---
$id: http://devicetree.org/schemas/power/supply/richtek,rt9756.yaml#
$schema: http://devicetree.org/meta-schemas/core.yaml#

title: Richtek RT9756 Smart Cap Divider Charger

maintainers:
  - ChiYuan Huang <cy_huang@richtek.com>

description: |
  The RT9756/RT9757 is a high efficiency and high charge current charger.

  The efficiency is up to 98.2% when VBAT = 4V, IBAT = 2A in DIV2 mode and 99.1%
  when VBAT=4V, IBAT=1A in bypass mode. The maximum charger current is up to 8A
  in DIV2 mode and 5A in bypass mode. The device integrates smart cap divider
  topology, direct charging mode, external over-voltage protection control, an
  input reverse blocking NFET and 2-way regulation, a dual phase charge pump
  core, 8-Channel high speed ADCs and USB BC 1.2 detection.

  RT9770 is almost the same with RT9756/57, only BC 1.2 detection function is
  removed to shrink the die size.

allOf:
  - $ref: power-supply.yaml#

properties:
  compatible:
    oneOf:
      - enum:
          - richtek,rt9756
          - richtek,rt9770
      - items:
          - enum:
              - richtek,rt9757
          - const: richtek,rt9756

  reg:
    maxItems: 1

  wakeup-source: true

  interrupts:
    maxItems: 1

  shunt-resistor-micro-ohms:
    description: Battery current sense resistor mounted.
    default: 2000

required:
  - compatible
  - reg
  - interrupts

unevaluatedProperties: false

examples:
  - |
    #include <dt-bindings/interrupt-controller/irq.h>
    i2c {
      #address-cells = <1>;
      #size-cells = <0>;

      charger@6f {
        compatible = "richtek,rt9756";
        reg = <0x6f>;
        wakeup-source;
        interrupts-extended = <&gpio_intc 32 IRQ_TYPE_EDGE_FALLING>;
        shunt-resistor-micro-ohms = <5000>;
      };
    };
```

## Documentation/devicetree/bindings/power/supply/rockchip-charger-manager.txt
```
rockchip-charger-manager bindings
~~~~~~~~~~~~~~~~~~~~~~~~

Required properties :
 - compatible : "rockchip-charger-manager"
 - cm-chargers : name of charger
 - cm-fuel-gauge : name of battery fuel gauge
 - cm-charge-pump : name of battery charge pump

Optional properties :
 - cm-poll-mode : polling mode - 0 for disabled, 1 for always, 2 for when
	external power is connected, or 3 for when charging.  If not present,
	then polling is disabled
 - cm-poll-interval : polling interval (in ms)

Example :
	charger-manager {
		compatible = "rockchip-charger-manager";
		cm-poll-mode = <2>;
		cm-poll-interval = <5000>;

		cm-chargers = "sgm4154x-charger";
		cm-charge-pump = "sc8551-standalone";
		cm-chargers-phandle = <&usbc0>;
		cm-fuel-gauge = "test_battery";
		monitored-battery = <&bat>;
		extcon = <&u2phy0>;
	};
```
