## Documentation/devicetree/bindings/power/supply/stericsson,ab8500-battery.txt
```
AB85000 PMIC contains a node, which contains shared
information about the battery connected to the PMIC.
The node has no compatible property.

Properties of this node are:

thermistor-on-batctrl:
	A boolean value indicating thermistor interface	to battery

	Note:
	'btemp' and 'batctrl' are the pins interfaced for battery temperature
	measurement, 'btemp' signal is used when NTC(negative temperature
	coefficient) resister is interfaced external to battery whereas
	'batctrl' pin is used when NTC resister is internal to battery.

	Example:
	ab8500_battery: ab8500_battery {
		thermistor-on-batctrl;
	};
	indicates: NTC resister is internal to battery, 'batctrl' is used
		for thermal measurement.

	The absence of property 'thermal-on-batctrl' indicates
	NTC resister is external to battery and  'btemp' signal is used
	for thermal measurement.

battery-type:
	This shall be the battery manufacturing technology type,
	allowed types are:
		"UNKNOWN" "NiMH" "LION" "LIPO" "LiFe" "NiCd" "LiMn"
	Example:
	ab8500_battery: ab8500_battery {
		stericsson,battery-type = "LIPO";
	}
```
