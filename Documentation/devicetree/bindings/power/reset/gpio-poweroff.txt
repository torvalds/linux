## Documentation/devicetree/bindings/power/reset/qcom,pon.yaml
```yaml
# SPDX-License-Identifier: (GPL-2.0 OR BSD-2-Clause)
%YAML 1.2
---
$id: http://devicetree.org/schemas/power/reset/qcom,pon.yaml#
$schema: http://devicetree.org/meta-schemas/core.yaml#

title: Qualcomm PON Device

maintainers:
  - Vinod Koul <vkoul@kernel.org>

description: |
  The Power On device for Qualcomm PM8xxx is MFD supporting pwrkey
  and resin along with the Android reboot-mode.

  This DT node has pwrkey and resin as sub nodes.

properties:
  compatible:
    enum:
      - qcom,pm8916-pon
      - qcom,pm8941-pon
      - qcom,pms405-pon
      - qcom,pm8998-pon
      - qcom,pmk8350-pon

  reg:
    description: |
      Specifies the SPMI base address for the PON (power-on) peripheral.  For
      PMICs that have the PON peripheral (GEN3) split into PON_HLOS and PON_PBS
      (e.g. PMK8350), this can hold addresses of both PON_HLOS and PON_PBS
      peripherals.  In that case, the PON_PBS address needs to be specified to
      facilitate software debouncing on some PMIC.
    minItems: 1
    maxItems: 2

  reg-names:
    minItems: 1
    maxItems: 2

  pwrkey:
    type: object
    $ref: /schemas/input/qcom,pm8941-pwrkey.yaml#

  resin:
    type: object
    $ref: /schemas/input/qcom,pm8941-pwrkey.yaml#

  watchdog:
    type: object
    $ref: /schemas/watchdog/qcom,pm8916-wdt.yaml

required:
  - compatible
  - reg

patternProperties:
  "^mode-.*$":
    maxItems: 1

unevaluatedProperties: false

allOf:
  - if:
      properties:
        compatible:
          contains:
            enum:
              - qcom,pm8916-pon
              - qcom,pms405-pon
              - qcom,pm8998-pon
    then:
      allOf:
        - $ref: reboot-mode.yaml#

      properties:
        reg:
          maxItems: 1
        reg-names:
          items:
            - const: pon
    else:
      patternProperties:
        "^mode-.*$": false

    # Special case for pm8941, which doesn't store reset mode
  - if:
      properties:
        compatible:
          contains:
            const: qcom,pm8941-pon
    then:
      properties:
        reg:
          maxItems: 1
        reg-names:
          items:
            - const: pon

  - if:
      properties:
        compatible:
          contains:
            const: qcom,pmk8350-pon
    then:
      properties:
        reg:
          minItems: 1
          maxItems: 2
        reg-names:
          minItems: 1
          items:
            - const: hlos
            - const: pbs

examples:
  - |
   #include <dt-bindings/interrupt-controller/irq.h>
   #include <dt-bindings/input/linux-event-codes.h>
   #include <dt-bindings/spmi/spmi.h>

   spmi@c440000 {
     reg = <0x0c440000 0x1100>;
     #address-cells = <2>;
     #size-cells = <0>;

     pmic@0 {
       reg = <0x0 SPMI_USID>;
       #address-cells = <1>;
       #size-cells = <0>;

       pon@800 {
         compatible = "qcom,pm8998-pon";
         reg = <0x800>;

         pwrkey {
            compatible = "qcom,pm8941-pwrkey";
            interrupts = <0x0 0x8 0 IRQ_TYPE_EDGE_BOTH>;
            debounce = <15625>;
            bias-pull-up;
            linux,code = <KEY_POWER>;
         };

         resin {
            compatible = "qcom,pm8941-resin";
            interrupts = <0x0 0x8 1 IRQ_TYPE_EDGE_BOTH>;
            debounce = <15625>;
            bias-pull-up;
            linux,code = <KEY_VOLUMEDOWN>;
         };
       };
     };
   };
...
```

## Documentation/devicetree/bindings/power/reset/qcom,pshold.yaml
```yaml
# SPDX-License-Identifier: GPL-2.0-only OR BSD-2-Clause
%YAML 1.2
---
$id: http://devicetree.org/schemas/power/reset/qcom,pshold.yaml#
$schema: http://devicetree.org/meta-schemas/core.yaml#

title: Qualcomm SoC restart and power off

maintainers:
  - Bjorn Andersson <bjorn.andersson@linaro.org>

description:
  A power supply hold (ps-hold) bit is set to power the Qualcomm chipsets.
  Clearing that bit allows us to restart/power off. The difference between
  power off and restart is determined by unique power manager IC settings.

properties:
  compatible:
    const: qcom,pshold

  reg:
    maxItems: 1

required:
  - compatible
  - reg

additionalProperties: false

examples:
  - |
    reset-controller@fc4ab000 {
        compatible = "qcom,pshold";
        reg = <0xfc4ab000 0x4>;
    };
```

## Documentation/devicetree/bindings/power/reset/qnap-poweroff.txt
```
* QNAP Power Off

QNAP NAS devices have a microcontroller controlling the main power
supply. This microcontroller is connected to UART1 of the Kirkwood and
Orion5x SoCs. Sending the character 'A', at 19200 baud, tells the
microcontroller to turn the power off.

Synology NAS devices use a similar scheme, but a different baud rate,
9600, and a different character, '1'.

Required Properties:
- compatible: Should be "qnap,power-off" or "synology,power-off"

- reg: Address and length of the register set for UART1
- clocks: tclk clock
```

## Documentation/devicetree/bindings/power/reset/reboot-mode.txt
```
Generic reboot mode core map driver

This driver get reboot mode arguments and call the write
interface to store the magic value in special register
or ram. Then the bootloader can read it and take different
action according to the argument stored.

All mode properties are vendor specific, it is a indication to tell
the bootloader what to do when the system reboots, and should be named
as mode-xxx = <magic> (xxx is mode name, magic should be a none-zero value).

For example modes common on Android platform:
- mode-normal: Normal reboot mode, system reboot with command "reboot".
- mode-recovery: Android Recovery mode, it is a mode to format the device or update a new image.
- mode-bootloader: Android fastboot mode, it's a mode to re-flash partitions on the Android based device.
- mode-loader: A bootloader mode, it's a mode used to download image on Rockchip platform,
	       usually used in development.

Example:
	reboot-mode {
		mode-normal = <BOOT_NORMAL>;
		mode-recovery = <BOOT_RECOVERY>;
		mode-bootloader = <BOOT_FASTBOOT>;
		mode-loader = <BOOT_BL_DOWNLOAD>;
	}
```

## Documentation/devicetree/bindings/power/reset/reboot-mode.yaml
```yaml
# SPDX-License-Identifier: (GPL-2.0-only OR BSD-2-Clause)
%YAML 1.2
---
$id: http://devicetree.org/schemas/power/reset/reboot-mode.yaml#
$schema: http://devicetree.org/meta-schemas/core.yaml#

title: Generic reboot mode core map

maintainers:
  - Andy Yan <andy.yan@rock-chips.com>

description: |
  This driver get reboot mode arguments and call the write
  interface to store the magic value in special register
  or ram. Then the bootloader can read it and take different
  action according to the argument stored.

  All mode properties are vendor specific, it is a indication to tell
  the bootloader what to do when the system reboots, and should be named
  as mode-xxx = <magic> (xxx is mode name, magic should be a non-zero value).

  For example, modes common Android platform are:
    - normal: Normal reboot mode, system reboot with command "reboot".
    - recovery: Android Recovery mode, it is a mode to format the device or update a new image.
    - bootloader: Android fastboot mode, it's a mode to re-flash partitions on the Android based device.
    - loader: A bootloader mode, it's a mode used to download image on Rockchip platform,
              usually used in development.

properties:
  mode-normal:
    $ref: /schemas/types.yaml#/definitions/uint32
    description:
      Default value to set on a reboot if no command was provided.

patternProperties:
  "^mode-.*$":
    $ref: /schemas/types.yaml#/definitions/uint32

additionalProperties: true

examples:
  - |
    reboot-mode {
      mode-normal = <0>;
      mode-recovery = <1>;
      mode-bootloader = <2>;
      mode-loader = <3>;
    };
...
```

## Documentation/devicetree/bindings/power/reset/regulator-poweroff.yaml
```yaml
# SPDX-License-Identifier: (GPL-2.0-only OR BSD-2-Clause)
%YAML 1.2
---
$id: http://devicetree.org/schemas/power/reset/regulator-poweroff.yaml#
$schema: http://devicetree.org/meta-schemas/core.yaml#

title: Force-disable power regulator to turn the power off.

maintainers:
  - Michael Klein <michael@fossekall.de>

description: |
  When the power-off handler is called, a power regulator is disabled by
  calling regulator_force_disable(). If the power is still on and the
  CPU still running after a 3000ms delay, a warning is emitted.

properties:
  compatible:
    const: regulator-poweroff

  cpu-supply:
    description:
      regulator to disable on power-down

required:
  - compatible
  - cpu-supply

additionalProperties: false

examples:
  - |
    regulator-poweroff {
        compatible = "regulator-poweroff";
        cpu-supply = <&reg_vcc1v2>;
    };
...
```

## Documentation/devicetree/bindings/power/reset/restart-handler.yaml
```yaml
# SPDX-License-Identifier: GPL-2.0-only or BSD-2-Clause
%YAML 1.2
---
$id: http://devicetree.org/schemas/power/reset/restart-handler.yaml#
$schema: http://devicetree.org/meta-schemas/core.yaml#

title: Restart and shutdown handler Common Properties

maintainers:
  - Sebastian Reichel <sre@kernel.org>

description:
  Restart and shutdown handler device is responsible for powering off the
  system, e.g. my cutting off the power.  System might have several restart
  handlers, which usually are tried from most precise to last resort.

properties:
  priority:
    $ref: /schemas/types.yaml#/definitions/uint32
    description: |
      A priority ranging from 0 to 255 according to the following guidelines::
        0::   Restart handler of last resort, with limited restart capabilities.
        128:: Typical, default restart handler; use if no other restart handler
              is expected to be available, and/or if restart functionality is
              sufficient to restart the entire system.
        255:: Highest priority restart handler, will preempt all other restart handlers.
    minimum: 0
    maximum: 255

additionalProperties: true
```

## Documentation/devicetree/bindings/power/reset/restart-poweroff.txt
```
* Restart Power Off

Buffalo Linkstation LS-XHL and LS-CHLv2, and other devices power off
by restarting and letting u-boot keep hold of the machine until the
user presses a button.

Required Properties:
- compatible: Should be "restart-poweroff"
```

## Documentation/devicetree/bindings/power/reset/st-reset.txt
```
*Device-Tree bindings for ST SW reset functionality

Required properties:
- compatible: should be "stih407-restart".
- st,syscfg: should be a phandle of the syscfg node.

Example node:
	restart {
		compatible = "st,stih407-restart";
		st,syscfg = <&syscfg_sbc_reg>;
		status = "okay";
	};
```

## Documentation/devicetree/bindings/power/reset/syscon-poweroff.txt
```
Generic SYSCON mapped register poweroff driver

This is a generic poweroff driver using syscon to map the poweroff register.
The poweroff is generally performed with a write to the poweroff register
defined by the register map pointed by syscon reference plus the offset
with the value and mask defined in the poweroff node.

Required properties:
- compatible: should contain "syscon-poweroff"
- regmap: this is phandle to the register map node
- offset: offset in the register map for the poweroff register (in bytes)
- value: the poweroff value written to the poweroff register (32 bit access)

Optional properties:
- mask: update only the register bits defined by the mask (32 bit)

Legacy usage:
If a node doesn't contain a value property but contains a mask property, the
mask property is used as the value.

Default will be little endian mode, 32 bit access only.

Examples:

	poweroff {
	   compatible = "syscon-poweroff";
	   regmap = <&regmapnode>;
	   offset = <0x0>;
	   mask = <0x7a>;
	};
```

## Documentation/devicetree/bindings/power/reset/syscon-poweroff.yaml
```yaml
# SPDX-License-Identifier: GPL-2.0
%YAML 1.2
---
$id: http://devicetree.org/schemas/power/reset/syscon-poweroff.yaml#
$schema: http://devicetree.org/meta-schemas/core.yaml#

title: Generic SYSCON mapped register poweroff driver

maintainers:
  - Sebastian Reichel <sre@kernel.org>

description: |+
  This is a generic poweroff driver using syscon to map the poweroff register.
  The poweroff is generally performed with a write to the poweroff register
  defined by the register map pointed by syscon reference plus the offset
  with the value and mask defined in the poweroff node.
  Default will be little endian mode, 32 bit access only.
  The SYSCON register map is normally retrieved from the parental dt-node. So
  the SYSCON poweroff node should be represented as a sub-node of a "syscon",
  "simple-mfd" node.

properties:
  compatible:
    const: syscon-poweroff

  mask:
    $ref: /schemas/types.yaml#/definitions/uint32
    description: Update only the register bits defined by the mask (32 bit).

  offset:
    $ref: /schemas/types.yaml#/definitions/uint32
    description: Offset in the register map for the poweroff register (in bytes).

  regmap:
    $ref: /schemas/types.yaml#/definitions/phandle
    deprecated: true
    description:
      Phandle to the register map node. This property is deprecated in favor of
      the syscon-poweroff node being a child of a system controller node.

  value:
    $ref: /schemas/types.yaml#/definitions/uint32
    description: The poweroff value written to the poweroff register (32 bit access).

required:
  - compatible
  - offset

additionalProperties: false

allOf:
  - if:
      not:
        required:
          - mask
    then:
      required:
        - value

examples:
  - |
    poweroff {
        compatible = "syscon-poweroff";
        offset = <0x0>;
        mask = <0x7a>;
    };
```

## Documentation/devicetree/bindings/power/reset/syscon-reboot-mode.txt
```
SYSCON reboot mode driver

This driver get reboot mode magic value form reboot-mode driver
and stores it in a SYSCON mapped register. Then the bootloader
can read it and take different action according to the magic
value stored.

This DT node should be represented as a sub-node of a "syscon", "simple-mfd"
node.

Required properties:
- compatible: should be "syscon-reboot-mode"
- offset: offset in the register map for the storage register (in bytes)

Optional properity:
- mask: the mask bits of the mode magic value, default set to 0xffffffff if missing.

The rest of the properties should follow the generic reboot-mode discription
found in reboot-mode.txt

Example:
	pmu: pmu@20004000 {
		compatible = "rockchip,rk3066-pmu", "syscon", "simple-mfd";
		reg = <0x20004000 0x100>;

		reboot-mode {
			compatible = "syscon-reboot-mode";
			offset = <0x40>;
			mode-normal = <BOOT_NORMAL>;
			mode-recovery = <BOOT_RECOVERY>;
			mode-fastboot = <BOOT_FASTBOOT>;
			mode-loader = <BOOT_LOADER>;
		};
	};
```
