## Documentation/devicetree/bindings/power/reset/gpio-poweroff.txt
```
Driver a GPIO line that can be used to turn the power off.

The driver supports both level triggered and edge triggered power off.
At driver load time, the driver will request the given gpio line and
install a handler to power off the system. If the optional properties
'input' is not found, the GPIO line will be driven in the inactive
state. Otherwise its configured as an input.

When the power-off handler is called, the gpio is configured as an
output, and drive active, so triggering a level triggered power off
condition. This will also cause an inactive->active edge condition, so
triggering positive edge triggered power off. After a delay of 100ms,
the GPIO is set to inactive, thus causing an active->inactive edge,
triggering negative edge triggered power off. After another 100ms
delay the GPIO is driver active again. If the power is still on and
the CPU still running after a 3000ms delay, a WARN_ON(1) is emitted.

Required properties:
- compatible : should be "gpio-poweroff".
- gpios : The GPIO to set high/low, see "gpios property" in
  Documentation/devicetree/bindings/gpio/gpio.txt. If the pin should be
  low to power down the board set it to "Active Low", otherwise set
  gpio to "Active High".

Optional properties:
- input : Initially configure the GPIO line as an input. Only reconfigure
  it to an output when the power-off handler is called. If this optional
  property is not specified, the GPIO is initialized as an output in its
  inactive state.
- active-delay-ms: Delay (default 100) to wait after driving gpio active
- inactive-delay-ms: Delay (default 100) to wait after driving gpio inactive
- timeout-ms: Time to wait before asserting a WARN_ON(1). If nothing is
              specified, 3000 ms is used.

Examples:

gpio-poweroff {
	compatible = "gpio-poweroff";
	gpios = <&gpio 4 0>;
	timeout-ms = <3000>;
};
```

## Documentation/devicetree/bindings/power/reset/gpio-poweroff.yaml
```yaml
# SPDX-License-Identifier: (GPL-2.0-only or BSD-2-Clause)
%YAML 1.2
---
$id: http://devicetree.org/schemas/power/reset/gpio-poweroff.yaml#
$schema: http://devicetree.org/meta-schemas/core.yaml#

title: GPIO controlled power off

maintainers:
  - Sebastian Reichel <sre@kernel.org>

description: >
  System power off support via a GPIO line. When a shutdown is
  executed the operating system is expected to switch the GPIO
  from inactive to active. After a delay (active-delay-ms) it
  is expected to be switched back to inactive. After another
  delay (inactive-delay-ms) it is configured as active again.
  Finally the operating system assumes the power off failed if
  the system is still running after waiting some time (timeout-ms).

properties:
  compatible:
    const: gpio-poweroff

  gpios:
    maxItems: 1

  input:
    type: boolean
    description: >
      Initially configure the GPIO line as an input. Only reconfigure
      it to an output when the power-off sequence is initiated. If this optional
      property is not specified, the GPIO is initialized as an output in its inactive state.

  active-delay-ms:
    default: 100
    description: Delay to wait after driving gpio active

  inactive-delay-ms:
    default: 100
    description: Delay to wait after driving gpio inactive

  timeout-ms:
    default: 3000
    description: Time to wait before assuming the power off sequence failed.

required:
  - compatible
  - gpios

additionalProperties: false

examples:
  - |
    gpio-poweroff {
        compatible = "gpio-poweroff";
        gpios = <&gpio 4 0>;
        timeout-ms = <3000>;
    };
```

## Documentation/devicetree/bindings/power/reset/gpio-restart.yaml
```yaml
# SPDX-License-Identifier: (GPL-2.0-only OR BSD-2-Clause)
%YAML 1.2
---
$id: http://devicetree.org/schemas/power/reset/gpio-restart.yaml#
$schema: http://devicetree.org/meta-schemas/core.yaml#

title: GPIO controlled reset

maintainers:
  - Sebastian Reichel <sre@kernel.org>

description: >
  Drive a GPIO line that can be used to restart the system from a restart handler.

  This binding supports level and edge triggered reset.  At driver load time, the driver will
  request the given gpio line and install a restart handler. If the optional properties
  'open-source' is not found, the GPIO line will be driven in the inactive state.  Otherwise its
  not driven until the restart is initiated.

  When the system is restarted, the restart handler will be invoked in priority order.  The GPIO
  is configured as an output, and driven active, triggering a level triggered reset condition.
  This will also cause an inactive->active edge condition, triggering positive edge triggered
  reset. After a delay specified by active-delay, the GPIO is set to inactive, thus causing an
  active->inactive edge, triggering negative edge triggered reset. After a delay specified by
  inactive-delay, the GPIO is driven active again.  After a delay specified by wait-delay, the
  restart handler completes allowing other restart handlers to be attempted.

allOf:
  - $ref: restart-handler.yaml#

properties:
  compatible:
    const: gpio-restart

  gpios:
    description: The GPIO to set high/low, see "gpios property" in
      Documentation/devicetree/bindings/gpio/gpio.txt. If the pin should be low to reset the board
      set it to "Active Low", otherwise set GPIO to "Active High".

  open-source:
    $ref: /schemas/types.yaml#/definitions/flag
    description: Treat the GPIO as being open source and defer driving it to when the restart is
      initiated.  If this optional property is not specified, the GPIO is initialized as an output
      in its inactive state.

  priority:
    default: 129

  active-delay:
    $ref: /schemas/types.yaml#/definitions/uint32
    description: Delay (default 100) to wait after driving gpio active [ms]
    default: 100

  inactive-delay:
    $ref: /schemas/types.yaml#/definitions/uint32
    description: Delay (default 100) to wait after driving gpio inactive [ms]
    default: 100

  wait-delay:
    $ref: /schemas/types.yaml#/definitions/uint32
    description: Delay (default 3000) to wait after completing restart sequence [ms]
    default: 100

additionalProperties: false

required:
  - compatible
  - gpios

examples:
  - |
    gpio-restart {
      compatible = "gpio-restart";
      gpios = <&gpio 4 0>;
      priority = <128>;
      active-delay = <100>;
      inactive-delay = <100>;
      wait-delay = <3000>;
    };
```

## Documentation/devicetree/bindings/power/reset/imx-snvs-poweroff.txt
```
i.mx6 Poweroff Driver

SNVS_LPCR in SNVS module can power off the whole system by pull
PMIC_ON_REQ low if PMIC_ON_REQ is connected with external PMIC.
If you don't want to use PMIC_ON_REQ as power on/off control,
please set status='disabled' to disable this driver.

Required Properties:
-compatible: "fsl,sec-v4.0-poweroff"
-reg: Specifies the physical address of the SNVS_LPCR register

Example:
	snvs@20cc000 {
		compatible = "fsl,sec-v4.0-mon", "simple-bus";
		#address-cells = <1>;
		#size-cells = <1>;
		ranges = <0 0x020cc000 0x4000>;
		.....
		snvs_poweroff: snvs-poweroff@38 {
			compatible = "fsl,sec-v4.0-poweroff";
			reg = <0x38 0x4>;
		};
	}
```

## Documentation/devicetree/bindings/power/reset/keystone-reset.txt
```
* Device tree bindings for Texas Instruments keystone reset

This node is intended to allow SoC reset in case of software reset
of selected watchdogs.

The Keystone SoCs can contain up to 4 watchdog timers to reset
SoC. Each watchdog timer event input is connected to the Reset Mux
block. The Reset Mux block can be configured to cause reset or not.

Additionally soft or hard reset can be configured.

Required properties:

- compatible:		ti,keystone-reset

- ti,syscon-pll:	phandle/offset pair. The phandle to syscon used to
			access pll controller registers and the offset to use
			reset control registers.

- ti,syscon-dev:	phandle/offset pair. The phandle to syscon used to
			access device state control registers and the offset
			in order to use mux block registers for all watchdogs.

Optional properties:

- ti,soft-reset:	Boolean option indicating soft reset.
			By default hard reset is used.

- ti,wdt-list:		WDT list that can cause SoC reset. It's not related
			to WDT driver, it's just needed to enable a SoC related
			reset that's triggered by one of WDTs. The list is
			in format: <0>, <2>; It can be in random order and
			begins from 0 to 3, as keystone can contain up to 4 SoC
			reset watchdogs and can be in random order.

Example 1:
Setup keystone reset so that in case software reset or
WDT0 is triggered it issues hard reset for SoC.

pllctrl: pll-controller@2310000 {
	compatible = "ti,keystone-pllctrl", "syscon";
	reg = <0x02310000 0x200>;
};

devctrl: device-state-control@2620000 {
	compatible = "ti,keystone-devctrl", "syscon";
	reg = <0x02620000 0x1000>;
};

rstctrl: reset-controller {
	compatible = "ti,keystone-reset";
	ti,syscon-pll = <&pllctrl 0xe4>;
	ti,syscon-dev = <&devctrl 0x328>;
	ti,wdt-list = <0>;
};

Example 2:
Setup keystone reset so that in case of software reset or
WDT0 or WDT2 is triggered it issues soft reset for SoC.

rstctrl: reset-controller {
	compatible = "ti,keystone-reset";
	ti,syscon-pll = <&pllctrl 0xe4>;
	ti,syscon-dev = <&devctrl 0x328>;
	ti,wdt-list = <0>, <2>;
	ti,soft-reset;
};
```

## Documentation/devicetree/bindings/power/reset/ltc2952-poweroff.txt
```
Binding for the LTC2952 PowerPath controller

This chip is used to externally trigger a system shut down. Once the trigger has
been sent, the chip's watchdog has to be reset to gracefully shut down.
A full powerdown can be triggered via the kill signal.

Required properties:

- compatible:		Must contain: "lltc,ltc2952"
- watchdog-gpios:	phandle + gpio-specifier for the GPIO connected to the
			chip's watchdog line
- kill-gpios:		phandle + gpio-specifier for the GPIO connected to the
			chip's kill line

Optional properties:
- trigger-gpios:	phandle + gpio-specifier for the GPIO connected to the
			chip's trigger line. If this property is not set, the
			trigger function is ignored and the chip is kept alive
			until an explicit kill signal is received

Example:

ltc2952 {
	compatible = "lltc,ltc2952";

	trigger-gpios = <&gpio0 1 GPIO_ACTIVE_LOW>;
	watchdog-gpios = <&gpio1 2 GPIO_ACTIVE_HIGH>;
	kill-gpios = <&gpio0 2 GPIO_ACTIVE_LOW>;
};
```

## Documentation/devicetree/bindings/power/reset/mt6323-poweroff.txt
```
Device Tree Bindings for Power Controller on MediaTek PMIC

The power controller which could be found on PMIC is responsible for externally
powering off or on the remote MediaTek SoC through the circuit BBPU.

Required properties:
- compatible: Should be one of follows
       "mediatek,mt6323-pwrc": for MT6323 PMIC

Example:

       pmic {
               compatible = "mediatek,mt6323";

               ...

               power-controller {
                       compatible = "mediatek,mt6323-pwrc";
               };
       }
```

## Documentation/devicetree/bindings/power/reset/mt6397-rtc-poweroff.txt
```
Device-Tree bindings for Power Device on MediaTek PMIC RTC

The power device is responsible for externally power off or on the remote
MediaTek SoC through the a tiny circuit block BBPU inside PMIC RTC.

Required parent node:
- rtc
	For MediaTek PMIC RTC bindings, see:
	Documentation/devicetree/bindings/mfd/mt6397.txt

Required properties:
- compatible: Should be one of follows
	"mediatek,mt6323-rtc-poweroff": for MT6323 PMIC
	"mediatek,mt6397-rtc-poweroff": for MT6397 PMIC

Example:

	rtc {
		compatible = "mediatek,mt6323-rtc";

		power-off {
			compatible = "mediatek,mt6323-rtc-poweroff";
		};
	};
```

## Documentation/devicetree/bindings/power/reset/nvmem-reboot-mode.txt
```
NVMEM reboot mode driver

This driver gets reboot mode magic value from reboot-mode driver
and stores it in a NVMEM cell named "reboot-mode". Then the bootloader
can read it and take different action according to the magic
value stored.

Required properties:
- compatible: should be "nvmem-reboot-mode".
- nvmem-cells: A phandle to the reboot mode provided by a nvmem device.
- nvmem-cell-names: Should be "reboot-mode".

The rest of the properties should follow the generic reboot-mode description
found in reboot-mode.txt

Example:
	reboot-mode {
		compatible = "nvmem-reboot-mode";
		nvmem-cells = <&reboot_mode>;
		nvmem-cell-names = "reboot-mode";

		mode-normal     = <0xAAAA5501>;
		mode-bootloader = <0xBBBB5500>;
		mode-recovery   = <0xCCCC5502>;
		mode-test       = <0xDDDD5503>;
	};
```

## Documentation/devicetree/bindings/power/reset/nvmem-reboot-mode.yaml
```yaml
# SPDX-License-Identifier: (GPL-2.0-only OR BSD-2-Clause)
%YAML 1.2
---
$id: http://devicetree.org/schemas/power/reset/nvmem-reboot-mode.yaml#
$schema: http://devicetree.org/meta-schemas/core.yaml#

title: Generic NVMEM reboot mode

maintainers:
  - Bartosz Golaszewski <bartosz.golaszewski@linaro.org>

description:
  This driver gets the reboot mode magic value from the reboot-mode driver
  and stores it in the NVMEM cell named "reboot-mode". The bootloader can
  then read it and take different action according to the value.

properties:
  compatible:
    const: nvmem-reboot-mode

  nvmem-cells:
    description:
      A phandle pointing to the nvmem-cells node where the vendor-specific
      magic value representing the reboot mode is stored.
    maxItems: 1

  nvmem-cell-names:
    items:
      - const: reboot-mode

allOf:
  - $ref: reboot-mode.yaml#

required:
  - compatible
  - nvmem-cells
  - nvmem-cell-names

unevaluatedProperties: false

examples:
  - |
    reboot-mode {
        compatible = "nvmem-reboot-mode";
        nvmem-cells = <&reboot_reason>;
        nvmem-cell-names = "reboot-mode";
        mode-recovery = <0x01>;
        mode-bootloader = <0x02>;
    };
...
```

## Documentation/devicetree/bindings/power/reset/ocelot-reset.txt
```
Microsemi Ocelot reset controller

The DEVCPU_GCB:CHIP_REGS have a SOFT_RST register that can be used to reset the
SoC core.

The reset registers are both present in the MSCC vcoreiii MIPS and
microchip Sparx5 armv8 SoC's.

Required Properties:

 - compatible: "mscc,ocelot-chip-reset", "mscc,luton-chip-reset",
   "mscc,jaguar2-chip-reset" or "microchip,sparx5-chip-reset"

Example:
	reset@1070008 {
		compatible = "mscc,ocelot-chip-reset";
		reg = <0x1070008 0x4>;
	};
```

## Documentation/devicetree/bindings/power/reset/qcom,pon.txt
```
Qualcomm PON Device

The Power On device for Qualcomm PM8xxx is MFD supporting pwrkey
and resin along with the Android reboot-mode.

This DT node has pwrkey and resin as sub nodes.

Required Properties:
-compatible: Must be one of:
	"qcom,pm8916-pon"
	"qcom,pms405-pon"
	"qcom,pm8998-pon"

-reg: Specifies the physical address of the pon register

Optional subnode:
-pwrkey: Specifies the subnode pwrkey and should follow the
 qcom,pm8941-pwrkey.txt description.
-resin: Specifies the subnode resin and should follow the
 qcom,pm8xxx-pwrkey.txt description.

The rest of the properties should follow the generic reboot-mode description
found in reboot-mode.txt

Example:

	pon@800 {
		compatible = "qcom,pm8916-pon";

		reg = <0x800>;
		mode-bootloader = <0x2>;
		mode-recovery = <0x1>;

		pwrkey {
			compatible = "qcom,pm8941-pwrkey";
			interrupts = <0x0 0x8 0 IRQ_TYPE_EDGE_BOTH>;
			debounce = <15625>;
			bias-pull-up;
			linux,code = <KEY_POWER>;
		};

		resin {
			compatible = "qcom,pm8941-resin";
			interrupts = <0x0 0x8 1 IRQ_TYPE_EDGE_BOTH>;
			debounce = <15625>;
			bias-pull-up;
			linux,code = <KEY_VOLUMEDOWN>;
		};
	};
```
