## Documentation/devicetree/bindings/power/rt9455_charger.txt
```
Binding for Richtek rt9455 battery charger

Required properties:
- compatible:				it should contain one of the following:
					"richtek,rt9455".
- reg:					integer, i2c address of the device.
- interrupt-parent:			the phandle for the interrupt controller that
					services interrupts for this device.
- interrupts:				interrupt mapping for GPIO IRQ, it should be
					configured with IRQ_TYPE_LEVEL_LOW flag.
- richtek,output-charge-current:	integer, output current from the charger to the
					battery, in uA.
- richtek,end-of-charge-percentage:	integer, percent of the output charge current.
					When the current in constant-voltage phase drops
					below output_charge_current x end-of-charge-percentage,
					charge is terminated.
- richtek,battery-regulation-voltage:	integer, maximum battery voltage in uV.
- richtek,boost-output-voltage:		integer, maximum voltage provided to consumer
					devices, when the charger is in boost mode, in uV.

Optional properties:
- richtek,min-input-voltage-regulation: integer, input voltage level in uV, used to
					decrease voltage level when the over current
					of the input power source occurs.
					This prevents input voltage drop due to insufficient
					current provided by the power source.
					Default: 4500000 uV (4.5V)
- richtek,avg-input-current-regulation: integer, input current value in uA drained by the
					charger from the power source.
					Default: 500000 uA (500mA)

Example:

rt9455@22 {
	compatible = "richtek,rt9455";
	reg = <0x22>;

	interrupt-parent = <&gpio1>;
	interrupts = <0 IRQ_TYPE_LEVEL_LOW>;

	richtek,output-charge-current	    = <500000>;
	richtek,end-of-charge-percentage    = <10>;
	richtek,battery-regulation-voltage  = <4200000>;
	richtek,boost-output-voltage	    = <5050000>;

	richtek,min-input-voltage-regulation = <4500000>;
	richtek,avg-input-current-regulation = <500000>;
};
```

## Documentation/devicetree/bindings/power/starfive,jh7110-pmu.yaml
```yaml
# SPDX-License-Identifier: (GPL-2.0-only OR BSD-2-Clause)
%YAML 1.2
---
$id: http://devicetree.org/schemas/power/starfive,jh7110-pmu.yaml#
$schema: http://devicetree.org/meta-schemas/core.yaml#

title: StarFive JH7110 Power Management Unit

maintainers:
  - Walker Chen <walker.chen@starfivetech.com>

description: |
  StarFive JH7110 SoC includes support for multiple power domains which can be
  powered on/off by software based on different application scenes to save power.

properties:
  compatible:
    enum:
      - starfive,jh7110-pmu

  reg:
    maxItems: 1

  interrupts:
    maxItems: 1

  "#power-domain-cells":
    const: 1

required:
  - compatible
  - reg
  - interrupts
  - "#power-domain-cells"

additionalProperties: false

examples:
  - |
    pwrc: power-controller@17030000 {
        compatible = "starfive,jh7110-pmu";
        reg = <0x17030000 0x10000>;
        interrupts = <111>;
        #power-domain-cells = <1>;
    };
```

## Documentation/devicetree/bindings/power/supply/ab8500/btemp.txt
```
=== AB8500 Battery Temperature Monitor Driver ===

The properties below describes the yesde for btemp driver.

Required Properties:
- compatible = Shall be: "stericsson,ab8500-btemp"
- battery = Shall be battery specific information

	Example:
	ab8500_btemp {
		compatible = "stericsson,ab8500-btemp";
		battery	   = <&ab8500_battery>;
	};

For information on battery specific yesde, Ref:
Documentation/devicetree/bindings/power/supply/ab8500/fg.txt
```

## Documentation/devicetree/bindings/power/supply/ab8500/chargalg.txt
```
=== AB8500 Charging Algorithm Driver ===

The properties below describes the node for chargalg driver.

Required Properties:
- compatible = Shall be: "stericsson,ab8500-chargalg"
- battery = Shall be battery specific information

Example:
ab8500_chargalg {
	compatible = "stericsson,ab8500-chargalg";
	battery	   = <&ab8500_battery>;
};

For information on battery specific node, Ref:
Documentation/devicetree/bindings/power/supply/ab8500/fg.txt
```

## Documentation/devicetree/bindings/power/supply/ab8500/charger.txt
```
=== AB8500 Charger Driver ===

Required Properties:
- compatible = Shall be "stericsson,ab8500-charger"
- battery = Shall be battery specific information
	Example:
	ab8500_charger {
		compatible = "stericsson,ab8500-charger";
		battery	   = <&ab8500_battery>;
	};

- vddadc-supply: Supply for USB and Main charger
	Example:
	ab8500-charger {
		vddadc-supply	= <&ab8500_ldo_tvout_reg>;
	}
- autopower_cfg:
	Boolean value depicting the presence of 'automatic poweron after powerloss'
	Example:
	ab8500-charger {
		autopower_cfg;
	};

For information on battery specific node, Ref:
Documentation/devicetree/bindings/power/supply/ab8500/fg.txt
```

## Documentation/devicetree/bindings/power/supply/act8945a-charger.txt
```
Device-Tree bindings for charger of Active-semi ACT8945A Multi-Function Device

Required properties:
 - compatible: "active-semi,act8945a-charger".
 - active-semi,chglev-gpios: charge current level phandle with args
   as described in ../gpio/gpio.txt.
 - active-semi,lbo-gpios: specify the low battery voltage detect phandle
   with args as as described in ../gpio/gpio.txt.
 - interrupts: <a b> where a is the interrupt number and b is a
   field that represents an encoding of the sense and level
   information for the interrupt.

Optional properties:
 - active-semi,input-voltage-threshold-microvolt: unit: mV;
   Specifies the charger's input over-voltage threshold value;
   The value can be: 6600, 7000, 7500, 8000; default: 6600
 - active-semi,precondition-timeout: unit: minutes;
   Specifies the charger's PRECONDITION safety timer setting value;
   The value can be: 40, 60, 80, 0; If 0, it means to disable this timer;
   default: 40.
 - active-semi,total-timeout: unit: hours;
   Specifies the charger's total safety timer setting value;
   The value can be: 3, 4, 5, 0; If 0, it means to disable this timer;
   default: 3.

Example:
	pmic@5b {
		compatible = "active-semi,act8945a";
		reg = <0x5b>;

		charger {
			compatible = "active-semi,act8945a-charger";
			pinctrl-names = "default";
			pinctrl-0 = <&pinctrl_charger_chglev &pinctrl_charger_lbo &pinctrl_charger_irq>;
			interrupt-parent = <&pioA>;
			interrupts = <45 GPIO_ACTIVE_LOW>;

			active-semi,chglev-gpios = <&pioA 12 GPIO_ACTIVE_HIGH>;
			active-semi,lbo-gpios = <&pioA 72 GPIO_ACTIVE_LOW>;
			active-semi,input-voltage-threshold-microvolt = <6600>;
			active-semi,precondition-timeout = <40>;
			active-semi,total-timeout = <3>;
		};
	};
```

## Documentation/devicetree/bindings/power/supply/active-semi,act8945a-charger.yaml
```yaml
# SPDX-License-Identifier: GPL-2.0
%YAML 1.2
---
$id: "http://devicetree.org/schemas/power/supply/active-semi,act8945a-charger.yaml#"
$schema: "http://devicetree.org/meta-schemas/core.yaml#"

title: Active-semi ACT8945A Charger Function

maintainers:
  - Sebastian Reichel <sre@kernel.org>

allOf:
  - $ref: power-supply.yaml#

properties:
  compatible:
    const: active-semi,act8945a-charger

  interrupts:
    maxItems: 1

  active-semi,chglev-gpios:
    maxItems: 1
    description: charge current level GPIO

  active-semi,lbo-gpios:
    maxItems: 1
    description: low battery voltage detect GPIO

  active-semi,input-voltage-threshold-microvolt:
    description: |
      Specifies the charger's input over-voltage threshold value.
      Despite the name, specified values are in millivolt (mV).
      Defaults to 6.6 V
    enum: [ 6600, 7000, 7500, 8000 ]

  active-semi,precondition-timeout:
    $ref: /schemas/types.yaml#/definitions/uint32
    description: |
      Specifies the charger's PRECONDITION safety timer setting value in minutes.
      If 0, it means to disable this timer.
      Defaults to 40 minutes.
    enum: [ 0, 40, 60, 80 ]

  active-semi,total-timeout:
    $ref: /schemas/types.yaml#/definitions/uint32
    description: |
      Specifies the charger's total safety timer setting value in hours;
      If 0, it means to disable this timer;
      Defaults to 3 hours.
    enum: [ 0, 3, 4, 5 ]

required:
  - compatible
  - interrupts
  - active-semi,chglev-gpios
  - active-semi,lbo-gpios

additionalProperties: false

examples:
  - |
    #include <dt-bindings/gpio/gpio.h>
    #include <dt-bindings/interrupt-controller/irq.h>
    pmic {
      charger {
        compatible = "active-semi,act8945a-charger";
        interrupt-parent = <&pioA>;
        interrupts = <45 IRQ_TYPE_LEVEL_LOW>;
        active-semi,chglev-gpios = <&pioA 12 GPIO_ACTIVE_HIGH>;
        active-semi,lbo-gpios = <&pioA 72 GPIO_ACTIVE_LOW>;
        active-semi,input-voltage-threshold-microvolt = <6600>;
        active-semi,precondition-timeout = <40>;
        active-semi,total-timeout = <3>;
      };
    };
```

## Documentation/devicetree/bindings/power/supply/adc-battery.yaml
```yaml
# SPDX-License-Identifier: (GPL-2.0-only OR BSD-2-Clause)
%YAML 1.2
---
$id: http://devicetree.org/schemas/power/supply/adc-battery.yaml#
$schema: http://devicetree.org/meta-schemas/core.yaml#

title: ADC battery

maintainers:
  - Sebastian Reichel <sre@kernel.org>

description:
  Basic battery capacity meter, which only reports basic battery data
  via ADC channels and optionally indicate that the battery is full by
  polling a GPIO line.

  The voltage is expected to be measured between the battery terminals
  and mandatory. The optional current/power channel is expected to
  monitor the current/power flowing out of the battery. Last but not
  least the temperature channel is supposed to measure the battery
  temperature.

allOf:
  - $ref: power-supply.yaml#

properties:
  compatible:
    const: adc-battery

  charged-gpios:
    description:
      GPIO which signals that the battery is fully charged. The GPIO is
      often provided by charger ICs, that are not software controllable.
    maxItems: 1

  io-channels:
    minItems: 1
    maxItems: 4

  io-channel-names:
    minItems: 1
    items:
      - const: voltage
      - enum: [ current, power, temperature ]
      - enum: [ power, temperature ]
      - const: temperature

  monitored-battery: true

required:
  - compatible
  - io-channels
  - io-channel-names
  - monitored-battery

unevaluatedProperties: false

examples:
  - |
    #include <dt-bindings/gpio/gpio.h>

    fuel-gauge {
        compatible = "adc-battery";
        charged-gpios = <&gpio 42 GPIO_ACTIVE_HIGH>;
        io-channels = <&adc 13>, <&adc 37>;
        io-channel-names = "voltage", "current";

        power-supplies = <&charger>;
        monitored-battery = <&battery>;
    };
```

## Documentation/devicetree/bindings/power/supply/axp20x_ac_power.txt
```
AXP20X and AXP22X PMICs' AC power supply

Required Properties:
 - compatible: One of:
			"x-powers,axp202-ac-power-supply"
			"x-powers,axp221-ac-power-supply"
			"x-powers,axp813-ac-power-supply"

This node is a subnode of the axp20x PMIC.

The AXP20X can read the current current and voltage supplied by AC by
reading ADC channels from the AXP20X ADC.

The AXP22X is only able to tell if an AC power supply is present and
usable.

AXP813/AXP803 are able to limit current and supply voltage

Example:

&axp209 {
	ac_power_supply: ac-power-supply {
		compatible = "x-powers,axp202-ac-power-supply";
	};
};
```

## Documentation/devicetree/bindings/power/supply/axp20x_battery.txt
```
AXP20x and AXP22x battery power supply

Required Properties:
 - compatible, one of:
			"x-powers,axp209-battery-power-supply"
			"x-powers,axp221-battery-power-supply"
			"x-powers,axp813-battery-power-supply"

This yesde is a subyesde of its respective PMIC DT yesde.

The supported devices can read the battery voltage, charge and discharge
currents of the battery by reading ADC channels from the ADC.

Example:

&axp209 {
	battery_power_supply: battery-power-supply {
		compatible = "x-powers,axp209-battery-power-supply";
	}
};
```

## Documentation/devicetree/bindings/power/supply/axp20x_usb_power.txt
```
AXP20x USB power supply

Required Properties:
-compatible: One of: "x-powers,axp202-usb-power-supply"
                     "x-powers,axp221-usb-power-supply"

This node is a subnode of the axp20x PMIC.

Example:

axp209: pmic@34 {
	compatible = "x-powers,axp209";
	reg = <0x34>;
	interrupt-parent = <&nmi_intc>;
	interrupts = <0 IRQ_TYPE_LEVEL_LOW>;
	interrupt-controller;
	#interrupt-cells = <1>;

	regulators {
		x-powers,dcdc-freq = <1500>;

		vdd_cpu: dcdc2 {
			regulator-always-on;
			regulator-min-microvolt = <1000000>;
			regulator-max-microvolt = <1450000>;
			regulator-name = "vdd-cpu";
		};

		...
	};

	usb-power-supply: usb-power-supply {
		compatible = "x-powers,axp202-usb-power-supply";
	};
};
```

## Documentation/devicetree/bindings/power/supply/battery.txt
```
The contents of this file has been moved to battery.yaml

Please note that not all charger drivers respect all of the properties.
```
