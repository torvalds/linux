## Documentation/devicetree/bindings/power/reset/syscon-reboot.txt
```
Generic SYSCON mapped register reset driver

This is a generic reset driver using syscon to map the reset register.
The reset is generally performed with a write to the reset register
defined by the register map pointed by syscon reference plus the offset
with the value and mask defined in the reboot node.

Required properties:
- compatible: should contain "syscon-reboot"
- regmap: this is phandle to the register map node
- offset: offset in the register map for the reboot register (in bytes)
- value: the reset value written to the reboot register (32 bit access)

Optional properties:
- mask: update only the register bits defined by the mask (32 bit)

Legacy usage:
If a node doesn't contain a value property but contains a mask property, the
mask property is used as the value.

Default will be little endian mode, 32 bit access only.

Examples:

	reboot {
	   compatible = "syscon-reboot";
	   regmap = <&regmapnode>;
	   offset = <0x0>;
	   mask = <0x1>;
	};
```

## Documentation/devicetree/bindings/power/reset/syscon-reboot.yaml
```yaml
# SPDX-License-Identifier: GPL-2.0
%YAML 1.2
---
$id: http://devicetree.org/schemas/power/reset/syscon-reboot.yaml#
$schema: http://devicetree.org/meta-schemas/core.yaml#

title: Generic SYSCON mapped register reset driver

maintainers:
  - Sebastian Reichel <sre@kernel.org>

description: |+
  This is a generic reset driver using syscon to map the reset register.
  The reset is generally performed with a write to the reset register
  defined by the SYSCON register map base plus the offset with the value and
  mask defined in the reboot node. Default will be little endian mode, 32 bit
  access only. The SYSCON registers map is normally retrieved from the
  parental dt-node. So the SYSCON reboot node should be represented as a
  sub-node of a "syscon", "simple-mfd" node. Though the regmap property
  pointing to the system controller node is also supported.

properties:
  compatible:
    enum:
      - syscon-reboot
      - google,gs101-reboot

  mask:
    $ref: /schemas/types.yaml#/definitions/uint32
    description: Update only the register bits defined by the mask (32 bit).

  offset:
    $ref: /schemas/types.yaml#/definitions/uint32
    description: Offset in the register map for the reboot register (in bytes).

  reg:
    maxItems: 1
    description: Base address and size for the reboot register.

  regmap:
    $ref: /schemas/types.yaml#/definitions/phandle
    deprecated: true
    description: |
      Phandle to the register map node. This property is deprecated in favor of
      the syscon-reboot node been a child of a system controller node.

  value:
    $ref: /schemas/types.yaml#/definitions/uint32
    description: The reset value written to the reboot register (32 bit access).

  priority:
    default: 192

required:
  - compatible

additionalProperties: false

allOf:
  - $ref: restart-handler.yaml#
  - if:
      properties:
        compatible:
          contains:
            const: google,gs101-reboot
    then:
      properties:
        mask: false
        offset: false
        reg: false
        value: false

    else:
      if:
        not:
          required:
            - mask
      then:
        required:
          - value

      oneOf:
        - required: [offset]
        - required: [reg]

examples:
  - |
    reboot {
        compatible = "syscon-reboot";
        regmap = <&regmapnode>;
        offset = <0x0>;
        mask = <0x1>;
    };

  - |
    reboot {
        compatible = "google,gs101-reboot";
    };
```

## Documentation/devicetree/bindings/power/reset/toradex,smarc-ec.yaml
```yaml
# SPDX-License-Identifier: (GPL-2.0 OR BSD-2-Clause)
%YAML 1.2
---
$id: http://devicetree.org/schemas/power/reset/toradex,smarc-ec.yaml#
$schema: http://devicetree.org/meta-schemas/core.yaml#

title: Toradex Embedded Controller

maintainers:
  - Emanuele Ghidoli <emanuele.ghidoli@toradex.com>
  - Francesco Dolcini <francesco.dolcini@toradex.com>

description: |
  The Toradex Embedded Controller (EC) is used on Toradex SMARC modules,
  primarily to manage power and reset functionalities.

  The EC provides the following functions:
    - Reads the SMARC POWER_BTN# and RESET_IN# signals and controls the PMIC accordingly.
    - Controls the SoC boot mode signals based on the SMARC BOOT_SEL# and FORCE_RECOV# inputs.
    - Manages the CARRIER_STDBY# signal in response to relevant SoC signals.

  The EC runs a small firmware, factory programmed into its internal flash, and communicates over I2C.
  It allows software to control power-off and reset functionalities of the module.

properties:
  compatible:
    items:
      - enum:
          - toradex,smarc-imx95-ec
          - toradex,smarc-imx8mp-ec
      - const: toradex,smarc-ec

  reg:
    maxItems: 1

required:
  - compatible
  - reg

additionalProperties: false

examples:
  - |
    i2c {
        #address-cells = <1>;
        #size-cells = <0>;

        reset-controller@28 {
            compatible = "toradex,smarc-imx95-ec", "toradex,smarc-ec";
            reg = <0x28>;
        };
    };
```

## Documentation/devicetree/bindings/power/reset/xlnx,zynqmp-power.txt
```
--------------------------------------------------------------------
Device Tree Bindings for the Xilinx Zynq MPSoC Power Management
--------------------------------------------------------------------
The zynqmp-power node describes the power management configurations.
It will control remote suspend/shutdown interfaces.

Required properties:
 - compatible:		Must contain:	"xlnx,zynqmp-power"
 - interrupts:		Interrupt specifier

Optional properties:
 - mbox-names	: Name given to channels seen in the 'mboxes' property.
		  "tx" - Mailbox corresponding to transmit path
		  "rx" - Mailbox corresponding to receive path
 - mboxes	: Standard property to specify a Mailbox. Each value of
		  the mboxes property should contain a phandle to the
		  mailbox controller device node and an args specifier
		  that will be the phandle to the intended sub-mailbox
		  child node to be used for communication. See
		  Documentation/devicetree/bindings/mailbox/mailbox.txt
		  for more details about the generic mailbox controller
		  and client driver bindings. Also see
		  Documentation/devicetree/bindings/mailbox/ \
		  xlnx,zynqmp-ipi-mailbox.txt for typical controller that
		  is used to communicate with this System controllers.

--------
Examples
--------

Example with interrupt method:

firmware {
	zynqmp_firmware: zynqmp-firmware {
		compatible = "xlnx,zynqmp-firmware";
		method = "smc";

		zynqmp_power: zynqmp-power {
			compatible = "xlnx,zynqmp-power";
			interrupts = <0 35 4>;
		};
	};
};

Example with IPI mailbox method:

firmware {
	zynqmp_firmware: zynqmp-firmware {
		compatible = "xlnx,zynqmp-firmware";
		method = "smc";

		zynqmp_power: zynqmp-power {
			compatible = "xlnx,zynqmp-power";
			interrupt-parent = <&gic>;
			interrupts = <0 35 4>;
			mboxes = <&ipi_mailbox_pmu0 0>,
				 <&ipi_mailbox_pmu0 1>;
			mbox-names = "tx", "rx";
		};
	};
};
```

## Documentation/devicetree/bindings/power/reset/xlnx,zynqmp-power.yaml
```yaml
# SPDX-License-Identifier: (GPL-2.0-only OR BSD-2-Clause)
%YAML 1.2
---
$id: http://devicetree.org/schemas/power/reset/xlnx,zynqmp-power.yaml#
$schema: http://devicetree.org/meta-schemas/core.yaml#

title: Xilinx Zynq MPSoC Power Management

maintainers:
  - Michal Simek <michal.simek@xilinx.com>

description: |
  The zynqmp-power node describes the power management configurations.
  It will control remote suspend/shutdown interfaces.

properties:
  compatible:
    const: xlnx,zynqmp-power

  interrupts:
    maxItems: 1

  mboxes:
    description: |
      Standard property to specify a Mailbox. Each value of
      the mboxes property should contain a phandle to the
      mailbox controller device node and an args specifier
      that will be the phandle to the intended sub-mailbox
      child node to be used for communication. See
      Documentation/devicetree/bindings/mailbox/mailbox.txt
      for more details about the generic mailbox controller
      and client driver bindings. Also see
      Documentation/devicetree/bindings/mailbox/ \
      xlnx,zynqmp-ipi-mailbox.txt for typical controller that
      is used to communicate with this System controllers.
    items:
      - description: tx channel
      - description: rx channel

  mbox-names:
    description:
      Name given to channels seen in the 'mboxes' property.
    items:
      - const: tx
      - const: rx

required:
  - compatible
  - interrupts

additionalProperties: false

examples:
  - |+

    // Example with interrupt method:

    firmware {
      zynqmp-firmware {
        zynqmp-power {
          compatible = "xlnx,zynqmp-power";
          interrupts = <0 35 4>;
        };
      };
    };

  - |+

    // Example with IPI mailbox method:

    firmware {
      zynqmp-firmware {
        zynqmp-power {
          compatible = "xlnx,zynqmp-power";
          interrupt-parent = <&gic>;
          interrupts = <0 35 4>;
          mboxes = <&ipi_mailbox_pmu1 0>,
                   <&ipi_mailbox_pmu1 1>;
          mbox-names = "tx", "rx";
        };
      };
    };
...
```

## Documentation/devicetree/bindings/power/rk817-charger.txt
```
rk817-charger
~~~~~~~~~~

Required properties :
 - compatible: "rk817,charger"
 - min_input_voltage: minimum voltage from adapter
 - max_input_current: maximum current from adapter
 - max_chrg_current: maximum current for battery charge
 - max_chrg_voltage: maximum charge voltage for battery
 - chrg_finish_cur: charging termination current

Optional properties :
 - virtual_power: test mode for none battery
 - power_dc2otg: dc can provide supply for otg 5v
 - dc_det_adc: dc detect by saradc

Example:

rk817: pmic@20 {
	compatible = "rockchip,rk817";
	reg = <0x20>;

	......

	charger {
		compatible = "rk817,charger";
		min_input_voltage = <4500>;
		max_input_current = <1500>;
		max_chrg_current = <1300>;
		max_chrg_voltage = <4200>;
		chrg_finish_cur = <300>;
		virtual_power = <0>;
		dc_det_adc = <0>;
	};

	......
};
```
