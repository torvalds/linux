## Documentation/devicetree/bindings/power/renesas,rcar-sysc.yaml
```yaml
# SPDX-License-Identifier: (GPL-2.0-only OR BSD-2-Clause)
%YAML 1.2
---
$id: http://devicetree.org/schemas/power/renesas,rcar-sysc.yaml#
$schema: http://devicetree.org/meta-schemas/core.yaml#

title: Renesas R-Car and RZ/G System Controller

maintainers:
  - Geert Uytterhoeven <geert+renesas@glider.be>
  - Magnus Damm <magnus.damm@gmail.com>

description: |
  The R-Car (RZ/G) System Controller provides power management for the CPU
  cores and various coprocessors.
  The power domain IDs for consumers are defined in header files::
  include/dt-bindings/power/r8*-sysc.h

properties:
  compatible:
    enum:
      - renesas,r8a7742-sysc  # RZ/G1H
      - renesas,r8a7743-sysc  # RZ/G1M
      - renesas,r8a7744-sysc  # RZ/G1N
      - renesas,r8a7745-sysc  # RZ/G1E
      - renesas,r8a77470-sysc # RZ/G1C
      - renesas,r8a774a1-sysc # RZ/G2M
      - renesas,r8a774b1-sysc # RZ/G2N
      - renesas,r8a774c0-sysc # RZ/G2E
      - renesas,r8a774e1-sysc # RZ/G2H
      - renesas,r8a7779-sysc  # R-Car H1
      - renesas,r8a7790-sysc  # R-Car H2
      - renesas,r8a7791-sysc  # R-Car M2-W
      - renesas,r8a7792-sysc  # R-Car V2H
      - renesas,r8a7793-sysc  # R-Car M2-N
      - renesas,r8a7794-sysc  # R-Car E2
      - renesas,r8a7795-sysc  # R-Car H3
      - renesas,r8a77961-sysc # R-Car M3-W+
      - renesas,r8a77965-sysc # R-Car M3-N
      - renesas,r8a7796-sysc  # R-Car M3-W
      - renesas,r8a77970-sysc # R-Car V3M
      - renesas,r8a77980-sysc # R-Car V3H
      - renesas,r8a77990-sysc # R-Car E3
      - renesas,r8a77995-sysc # R-Car D3
      - renesas,r8a779a0-sysc # R-Car V3U
      - renesas,r8a779f0-sysc # R-Car S4-8
      - renesas,r8a779g0-sysc # R-Car V4H
      - renesas,r8a779h0-sysc # R-Car V4M

  reg:
    maxItems: 1

  '#power-domain-cells':
    const: 1

required:
  - compatible
  - reg
  - '#power-domain-cells'

additionalProperties: false

examples:
  - |
    // System Controller node
    sysc: system-controller@e6180000 {
            compatible = "renesas,r8a7791-sysc";
            reg = <0xe6180000 0x0200>;
            #power-domain-cells = <1>;
    };
```

## Documentation/devicetree/bindings/power/renesas,sysc-rmobile.txt
```
DT bindings for the Renesas R-Mobile System Controller

== System Controller Node ==

The R-Mobile System Controller provides the following functions:
  - Boot mode management,
  - Reset generation,
  - Power management.

Required properties:
- compatible: Should be "renesas,sysc-<soctype>", "renesas,sysc-rmobile" as
	      fallback.
	      Examples with soctypes are:
		- "renesas,sysc-r8a73a4" (R-Mobile APE6)
		- "renesas,sysc-r8a7740" (R-Mobile A1)
		- "renesas,sysc-sh73a0" (SH-Mobile AG5)
- reg: Two address start and address range blocks for the device:
         - The first block refers to the normally accessible registers,
         - the second block refers to the registers protected by the HPB
	   semaphore.

Optional nodes:
- pm-domains: This node contains a hierarchy of PM domain nodes, which should
  match the Power Area Hierarchy in the Power Domain Specifications section of
  the device's datasheet.


== PM Domain Nodes ==

Each of the PM domain nodes represents a PM domain, as documented by the
generic PM domain bindings in
Documentation/devicetree/bindings/power/power_domain.txt.

The nodes should be named by the real power area names, and thus their names
should be unique.

Required properties:
  - #power-domain-cells: Must be 0.

Optional properties:
- reg: If the PM domain is not always-on, this property must contain the bit
       index number for the corresponding power area in the various Power
       Control and Status Registers. The parent's node must contain the
       following two properties:
	 - #address-cells: Must be 1,
	 - #size-cells: Must be 0.
       If the PM domain is always-on, this property must be omitted.


Example:

This shows a subset of the r8a7740 PM domain hierarchy, containing the
C5 "always-on" domain, 2 of its subdomains (A4S and A4SU), and the A3SP domain,
which is a subdomain of A4S.

	sysc: system-controller@e6180000 {
		compatible = "renesas,sysc-r8a7740", "renesas,sysc-rmobile";
		reg = <0xe6180000 0x8000>, <0xe6188000 0x8000>;

		pm-domains {
			pd_c5: c5 {
				#address-cells = <1>;
				#size-cells = <0>;
				#power-domain-cells = <0>;

				pd_a4s: a4s@10 {
					reg = <10>;
					#address-cells = <1>;
					#size-cells = <0>;
					#power-domain-cells = <0>;

					pd_a3sp: a3sp@11 {
						reg = <11>;
						#power-domain-cells = <0>;
					};
				};

				pd_a4su: a4su@20 {
					reg = <20>;
					#power-domain-cells = <0>;
				};
			};
		};
	};


== PM Domain Consumers ==

Hardware blocks belonging to a PM domain should contain a "power-domains"
property that is a phandle pointing to the corresponding PM domain node.

Example:

	tpu: pwm@e6600000 {
		compatible = "renesas,tpu-r8a7740", "renesas,tpu";
		reg = <0xe6600000 0x100>;
		clocks = <&mstp3_clks R8A7740_CLK_TPU0>;
		power-domains = <&pd_a3sp>;
		#pwm-cells = <3>;
	};
```

## Documentation/devicetree/bindings/power/renesas,sysc-rmobile.yaml
```yaml
# SPDX-License-Identifier: (GPL-2.0-only OR BSD-2-Clause)
%YAML 1.2
---
$id: http://devicetree.org/schemas/power/renesas,sysc-rmobile.yaml#
$schema: http://devicetree.org/meta-schemas/core.yaml#

title: Renesas R-Mobile System Controller

maintainers:
  - Geert Uytterhoeven <geert+renesas@glider.be>
  - Magnus Damm <magnus.damm@gmail.com>

description: |
  The R-Mobile System Controller provides the following functions:
    - Boot mode management,
    - Reset generation,
    - Power management.

properties:
  compatible:
    items:
      - enum:
          - renesas,sysc-r8a73a4    # R-Mobile APE6
          - renesas,sysc-r8a7740    # R-Mobile A1
          - renesas,sysc-sh73a0     # SH-Mobile AG5
      - const: renesas,sysc-rmobile # Generic SH/R-Mobile

  reg:
    items:
      - description: Normally accessible register block
      - description: Register block protected by the HPB semaphore

  pm-domains:
    type: object
    description: |
      This node contains a hierarchy of PM domain nodes, which should match the
      Power Area Hierarchy in the Power Domain Specifications section of the
      device's datasheet.

    properties:
      '#address-cells':
        const: 1

      '#size-cells':
        const: 0

    additionalProperties:
      $ref: "#/$defs/pd-node"

required:
  - compatible
  - reg
  - pm-domains

additionalProperties: false

$defs:
  pd-node:
    type: object
    description:
      PM domain node representing a PM domain.  This node hould be named by
      the real power area name, and thus its name should be unique.

    properties:
      reg:
        maxItems: 1
        description:
          If the PM domain is not always-on, this property must contain the
          bit index number for the corresponding power area in the various
          Power Control and Status Registers.
          If the PM domain is always-on, this property must be omitted.

      '#address-cells':
        const: 1

      '#size-cells':
        const: 0

      '#power-domain-cells':
        const: 0

    required:
      - '#power-domain-cells'

    additionalProperties:
      $ref: "#/$defs/pd-node"

examples:
  - |
    // This shows a subset of the r8a7740 PM domain hierarchy, containing the
    // C5 "always-on" domain, 2 of its subdomains (A4S and A4SU), and the A3SP
    // domain, which is a subdomain of A4S.
    sysc: system-controller@e6180000 {
            compatible = "renesas,sysc-r8a7740", "renesas,sysc-rmobile";
            reg = <0xe6180000 0x8000>, <0xe6188000 0x8000>;

            pm-domains {
                    pd_c5: c5 {
                            #address-cells = <1>;
                            #size-cells = <0>;
                            #power-domain-cells = <0>;

                            pd_a4s: a4s@10 {
                                    reg = <10>;
                                    #address-cells = <1>;
                                    #size-cells = <0>;
                                    #power-domain-cells = <0>;

                                    pd_a3sp: a3sp@11 {
                                            reg = <11>;
                                            #power-domain-cells = <0>;
                                    };
                            };

                            pd_a4su: a4su@20 {
                                    reg = <20>;
                                    #power-domain-cells = <0>;
                            };
                    };
            };
    };
```

## Documentation/devicetree/bindings/power/reset/apple,smc-reboot.yaml
```yaml
# SPDX-License-Identifier: (GPL-2.0-only OR BSD-2-Clause)
%YAML 1.2
---
$id: http://devicetree.org/schemas/power/reset/apple,smc-reboot.yaml#
$schema: http://devicetree.org/meta-schemas/core.yaml#

title: Apple SMC Reboot Controller

description:
  The Apple System Management Controller (SMC) provides reboot functionality
  on Apple Silicon SoCs. It uses NVMEM cells to store and track various
  system state information related to boot, shutdown, and panic events.

maintainers:
  - Sven Peter <sven@kernel.org>

properties:
  compatible:
    const: apple,smc-reboot

  nvmem-cells:
    items:
      - description: Flag indicating shutdown (as opposed to reboot)
      - description: Stage at which the boot process stopped (0x30 for normal boot)
      - description: Counter for boot errors
      - description: Counter for system panics

  nvmem-cell-names:
    items:
      - const: shutdown_flag
      - const: boot_stage
      - const: boot_error_count
      - const: panic_count

required:
  - compatible
  - nvmem-cells
  - nvmem-cell-names

additionalProperties: false
```

## Documentation/devicetree/bindings/power/reset/atmel,at91sam9260-shdwc.yaml
```yaml
# SPDX-License-Identifier: (GPL-2.0-only OR BSD-2-Clause)
%YAML 1.2
---
$id: http://devicetree.org/schemas/power/reset/atmel,at91sam9260-shdwc.yaml#
$schema: http://devicetree.org/meta-schemas/core.yaml#

title: Microchip AT91 SHDWC Shutdown Controller

maintainers:
  - Claudiu Beznea <claudiu.beznea@microchip.com>

description: |
  Microchip AT91 SHDWC shutdown controller controls the power supplies VDDIO
  and VDDCORE and the wake-up detection on debounced input lines.

properties:
  compatible:
    enum:
      - atmel,at91sam9260-shdwc
      - atmel,at91sam9rl-shdwc
      - atmel,at91sam9x5-shdwc

  reg:
    maxItems: 1

  clocks:
    maxItems: 1

  atmel,wakeup-mode:
    description: operation mode of the wakeup mode
    $ref: /schemas/types.yaml#/definitions/string
    enum: [ none, high, low, any ]

  atmel,wakeup-counter:
    description: counter on wake-up 0
    $ref: /schemas/types.yaml#/definitions/uint32
    minimum: 0
    maximum: 15

  atmel,wakeup-rtt-timer:
    description: enable real-time timer wake-up
    type: boolean

  atmel,wakeup-rtc-timer:
    description: enable real-time clock wake-up
    type: boolean

required:
  - compatible
  - reg
  - clocks

allOf:
  - if:
      properties:
        compatible:
          contains:
            const: atmel,at91sam9x5-shdwc
    then:
      properties:
        atmel,wakeup-rtt-timer: false

  - if:
      properties:
        compatible:
          contains:
            const: atmel,at91sam9260-shdwc
    then:
      properties:
        atmel,wakeup-rtc-timer: false

additionalProperties: false

examples:
  - |
    shdwc: poweroff@fffffd10 {
        compatible = "atmel,at91sam9260-shdwc";
        reg = <0xfffffd10 0x10>;
        clocks = <&clk32k>;
    };

...
```

## Documentation/devicetree/bindings/power/reset/atmel,sama5d2-shdwc.yaml
```yaml
# SPDX-License-Identifier: (GPL-2.0-only OR BSD-2-Clause)
%YAML 1.2
---
$id: http://devicetree.org/schemas/power/reset/atmel,sama5d2-shdwc.yaml#
$schema: http://devicetree.org/meta-schemas/core.yaml#

title: Microchip AT91 SAMA5D2 SHDWC Shutdown Controller

maintainers:
  - Claudiu Beznea <claudiu.beznea@microchip.com>

description: |
  Microchip AT91 SHDWC shutdown controller controls the power supplies VDDIO
  and VDDCORE and the wake-up detection on debounced input lines.

properties:
  compatible:
    oneOf:
      - items:
          - const: microchip,sama7g5-shdwc
          - const: syscon
      - enum:
          - atmel,sama5d2-shdwc
          - microchip,sam9x60-shdwc

  reg:
    maxItems: 1

  clocks:
    maxItems: 1

  "#address-cells":
    const: 1

  "#size-cells":
    const: 0

  debounce-delay-us:
    description:
      Minimum wake-up inputs debouncer period in microseconds. It is usually a
      board-related property.

  atmel,wakeup-rtc-timer:
    description: enable real-time clock wake-up
    type: boolean

  atmel,wakeup-rtt-timer:
    description: enable real-time timer wake-up
    type: boolean

patternProperties:
  "^input@[0-15]$":
    description:
      Wake-up input nodes. These are usually described in the "board" part of
      the Device Tree. Note also that input 0 is linked to the wake-up pin and
      is frequently used.
    type: object
    properties:
      reg:
        description: contains the wake-up input index
        minimum: 0
        maximum: 15

      atmel,wakeup-active-high:
        description:
          The corresponding wake-up input described by the child forces the
          wake-up of the core power supply on a high level. The default is to
          be active low.
        type: boolean

    required:
      - reg

    additionalProperties: false

required:
  - compatible
  - reg
  - clocks

allOf:
  - if:
      properties:
        compatible:
          contains:
            const: atmel,sama5d2-shdwc
    then:
      properties:
        atmel,wakeup-rtt-timer: false

additionalProperties: false

examples:
  - |
    shdwc: poweroff@f8048010 {
        compatible = "atmel,sama5d2-shdwc";
        reg = <0xf8048010 0x10>;
        clocks = <&clk32k>;
        #address-cells = <1>;
        #size-cells = <0>;
        atmel,wakeup-rtc-timer;
        debounce-delay-us = <976>;

        input@0 {
            reg = <0>;
        };

        input@1 {
            reg = <1>;
            atmel,wakeup-active-high;
        };
    };

...
```

## Documentation/devicetree/bindings/power/reset/brcm,bcm21664-resetmgr.yaml
```yaml
# SPDX-License-Identifier: GPL-2.0-only OR BSD-2-Clause
%YAML 1.2
---
$id: http://devicetree.org/schemas/power/reset/brcm,bcm21664-resetmgr.yaml#
$schema: http://devicetree.org/meta-schemas/core.yaml#

title: Broadcom Kona family reset manager

maintainers:
  - Florian Fainelli <f.fainelli@gmail.com>

properties:
  compatible:
    const: brcm,bcm21664-resetmgr

  reg:
    maxItems: 1

required:
  - compatible
  - reg

additionalProperties: false

examples:
  - |
    reset-controller@35001f00 {
        compatible = "brcm,bcm21664-resetmgr";
        reg = <0x35001f00 0x24>;
    };
...
```

## Documentation/devicetree/bindings/power/reset/cortina,gemini-power-controller.yaml
```yaml
# SPDX-License-Identifier: (GPL-2.0-only OR BSD-2-Clause)
%YAML 1.2
---
$id: http://devicetree.org/schemas/power/reset/cortina,gemini-power-controller.yaml#
$schema: http://devicetree.org/meta-schemas/core.yaml#

title: Cortina Systems Gemini Poweroff Controller

maintainers:
  - Linus Walleij <linusw@kernel.org>

description: |
  The Gemini power controller is a dedicated IP block in the Cortina Gemini SoC that
  controls system power-down operations.

properties:
  compatible:
    const: cortina,gemini-power-controller

  reg:
    maxItems: 1

  interrupts:
    maxItems: 1

required:
  - compatible
  - reg
  - interrupts

additionalProperties: false

examples:
  - |
    #include <dt-bindings/interrupt-controller/irq.h>

    poweroff@4b000000 {
      compatible = "cortina,gemini-power-controller";
      reg = <0x4b000000 0x100>;
      interrupts = <26 IRQ_TYPE_EDGE_FALLING>;
    };
...
```
