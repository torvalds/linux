## Documentation/devicetree/bindings/power/qcom,coincell-charger.txt
```
Qualcomm Coincell Charger:

The hardware block controls charging for a coincell or capacitor that is
used to provide power backup for certain features of the power management
IC (PMIC)

- compatible:
	Usage: required
	Value type: <string>
	Definition: must be: "qcom,pm8941-coincell"

- reg:
	Usage: required
	Value type: <u32>
	Definition: base address of the coincell charger registers

- qcom,rset-ohms:
	Usage: required
	Value type: <u32>
	Definition: resistance (in ohms) for current-limiting resistor
		must be one of: 800, 1200, 1700, 2100

- qcom,vset-millivolts:
	Usage: required
	Value type: <u32>
	Definition: voltage (in millivolts) to apply for charging
		must be one of: 2500, 3000, 3100, 3200

- qcom,charger-disable:
	Usage: optional
	Value type: <boolean>
	Definition: defining this property disables charging

This charger is a sub-node of one of the 8941 PMIC blocks, and is specified
as a child node in DTS of that node.  See ../mfd/qcom,spmi-pmic.txt and
../mfd/qcom-pm8xxx.txt

Example:

	pm8941@0 {
		coincell@2800 {
			compatible = "qcom,pm8941-coincell";
			reg = <0x2800>;

			qcom,rset-ohms = <2100>;
			qcom,vset-millivolts = <3000>;
		};
	};
```

## Documentation/devicetree/bindings/power/qcom,kpss-acc-v2.yaml
```yaml
# SPDX-License-Identifier: GPL-2.0-only OR BSD-2-Clause
%YAML 1.2
---
$id: http://devicetree.org/schemas/power/qcom,kpss-acc-v2.yaml#
$schema: http://devicetree.org/meta-schemas/core.yaml#

title: Krait Processor Sub-system (KPSS) Application Clock Controller (ACC) v2

maintainers:
  - Christian Marangi <ansuelsmth@gmail.com>

description:
  The KPSS ACC provides clock, power manager, and reset control to a Krait CPU.
  There is one ACC register region per CPU within the KPSS remapped region as
  well as an alias register region that remaps accesses to the ACC associated
  with the CPU accessing the region. ACC v2 is currently used as a
  power-manager for enabling the cpu.

properties:
  compatible:
    const: qcom,kpss-acc-v2

  reg:
    items:
      - description: Base address and size of the register region
      - description: Optional base address and size of the alias register region
    minItems: 1

required:
  - compatible
  - reg

additionalProperties: false

examples:
  - |
    power-manager@f9088000 {
      compatible = "qcom,kpss-acc-v2";
      reg = <0xf9088000 0x1000>,
            <0xf9008000 0x1000>;
    };
...
```

## Documentation/devicetree/bindings/power/qcom,rpmpd.txt
```
Qualcomm RPM/RPMh Power domains

For RPM/RPMh Power domains, we communicate a performance state to RPM/RPMh
which then translates it into a corresponding voltage on a rail

Required Properties:
 - compatible: Should be one of the following
	* qcom,msm8996-rpmpd: RPM Power domain for the msm8996 family of SoC
	* qcom,sdm845-rpmhpd: RPMh Power domain for the sdm845 family of SoC
 - #power-domain-cells: number of cells in Power domain specifier
	must be 1.
 - operating-points-v2: Phandle to the OPP table for the Power domain.
	Refer to Documentation/devicetree/bindings/power/power_domain.txt
	and Documentation/devicetree/bindings/opp/opp.txt for more details

Refer to <dt-bindings/power/qcom-rpmpd.h> for the level values for
various OPPs for different platforms as well as Power domain indexes

Example: rpmh power domain controller and OPP table

#include <dt-bindings/power/qcom-rpmhpd.h>

opp-level values specified in the OPP tables for RPMh power domains
should use the RPMH_REGULATOR_LEVEL_* constants from
<dt-bindings/power/qcom-rpmhpd.h>

	rpmhpd: power-controller {
		compatible = "qcom,sdm845-rpmhpd";
		#power-domain-cells = <1>;
		operating-points-v2 = <&rpmhpd_opp_table>;

		rpmhpd_opp_table: opp-table {
			compatible = "operating-points-v2";

			rpmhpd_opp_ret: opp1 {
				opp-level = <RPMH_REGULATOR_LEVEL_RETENTION>;
			};

			rpmhpd_opp_min_svs: opp2 {
				opp-level = <RPMH_REGULATOR_LEVEL_MIN_SVS>;
			};

			rpmhpd_opp_low_svs: opp3 {
				opp-level = <RPMH_REGULATOR_LEVEL_LOW_SVS>;
			};

			rpmhpd_opp_svs: opp4 {
				opp-level = <RPMH_REGULATOR_LEVEL_SVS>;
			};

			rpmhpd_opp_svs_l1: opp5 {
				opp-level = <RPMH_REGULATOR_LEVEL_SVS_L1>;
			};

			rpmhpd_opp_nom: opp6 {
				opp-level = <RPMH_REGULATOR_LEVEL_NOM>;
			};

			rpmhpd_opp_nom_l1: opp7 {
				opp-level = <RPMH_REGULATOR_LEVEL_NOM_L1>;
			};

			rpmhpd_opp_nom_l2: opp8 {
				opp-level = <RPMH_REGULATOR_LEVEL_NOM_L2>;
			};

			rpmhpd_opp_turbo: opp9 {
				opp-level = <RPMH_REGULATOR_LEVEL_TURBO>;
			};

			rpmhpd_opp_turbo_l1: opp10 {
				opp-level = <RPMH_REGULATOR_LEVEL_TURBO_L1>;
			};
		};
	};

Example: rpm power domain controller and OPP table

	rpmpd: power-controller {
		compatible = "qcom,msm8996-rpmpd";
		#power-domain-cells = <1>;
		operating-points-v2 = <&rpmpd_opp_table>;

		rpmpd_opp_table: opp-table {
			compatible = "operating-points-v2";

			rpmpd_opp_low: opp1 {
				opp-level = <1>;
			};

			rpmpd_opp_ret: opp2 {
				opp-level = <2>;
			};

			rpmpd_opp_svs: opp3 {
				opp-level = <3>;
			};

			rpmpd_opp_normal: opp4 {
				opp-level = <4>;
			};

			rpmpd_opp_high: opp5 {
				opp-level = <5>;
			};

			rpmpd_opp_turbo: opp6 {
				opp-level = <6>;
			};
		};
	};

Example: Client/Consumer device using OPP table

	leaky-device0@12350000 {
		compatible = "foo,i-leak-current";
		reg = <0x12350000 0x1000>;
		power-domains = <&rpmhpd SDM845_MX>;
		operating-points-v2 = <&leaky_opp_table>;
	};


	leaky_opp_table: opp-table {
		compatible = "operating-points-v2";

		opp1 {
			opp-hz = /bits/ 64 <144000>;
			required-opps = <&rpmhpd_opp_low>;
		};

		opp2 {
			opp-hz = /bits/ 64 <400000>;
			required-opps = <&rpmhpd_opp_ret>;
		};

		opp3 {
			opp-hz = /bits/ 64 <20000000>;
			required-opps = <&rpmpd_opp_svs>;
		};

		opp4 {
			opp-hz = /bits/ 64 <25000000>;
			required-opps = <&rpmpd_opp_normal>;
		};
	};
```

## Documentation/devicetree/bindings/power/qcom,rpmpd.yaml
```yaml
# SPDX-License-Identifier: (GPL-2.0-only OR BSD-2-Clause)
%YAML 1.2
---
$id: http://devicetree.org/schemas/power/qcom,rpmpd.yaml#
$schema: http://devicetree.org/meta-schemas/core.yaml#

title: Qualcomm RPM/RPMh Power domains

maintainers:
  - Rajendra Nayak <rnayak@codeaurora.org>

description:
  For RPM/RPMh Power domains, we communicate a performance state to RPM/RPMh
  which then translates it into a corresponding voltage on a rail.

properties:
  compatible:
    enum:
      - qcom,mdm9607-rpmpd
      - qcom,msm8226-rpmpd
      - qcom,msm8916-rpmpd
      - qcom,msm8939-rpmpd
      - qcom,msm8953-rpmpd
      - qcom,msm8976-rpmpd
      - qcom,msm8994-rpmpd
      - qcom,msm8996-rpmpd
      - qcom,msm8998-rpmpd
      - qcom,qcm2290-rpmpd
      - qcom,qcs404-rpmpd
      - qcom,sa8540p-rpmhpd
      - qcom,sdm660-rpmpd
      - qcom,sc7180-rpmhpd
      - qcom,sc7280-rpmhpd
      - qcom,sc8180x-rpmhpd
      - qcom,sc8280xp-rpmhpd
      - qcom,sdm845-rpmhpd
      - qcom,sdx55-rpmhpd
      - qcom,sdx65-rpmhpd
      - qcom,sm6115-rpmpd
      - qcom,sm6125-rpmpd
      - qcom,sm6350-rpmhpd
      - qcom,sm8150-rpmhpd
      - qcom,sm8250-rpmhpd
      - qcom,sm8350-rpmhpd
      - qcom,sm8450-rpmhpd

  '#power-domain-cells':
    const: 1

  operating-points-v2: true

  opp-table:
    type: object

required:
  - compatible
  - '#power-domain-cells'
  - operating-points-v2

additionalProperties: false

examples:
  - |

    // Example 1 (rpmh power domain controller and OPP table):

    #include <dt-bindings/power/qcom-rpmpd.h>

    rpmhpd: power-controller {
      compatible = "qcom,sdm845-rpmhpd";
      #power-domain-cells = <1>;
      operating-points-v2 = <&rpmhpd_opp_table>;

      rpmhpd_opp_table: opp-table {
        compatible = "operating-points-v2";

        rpmhpd_opp_ret: opp1 {
          opp-level = <RPMH_REGULATOR_LEVEL_RETENTION>;
        };

        rpmhpd_opp_min_svs: opp2 {
          opp-level = <RPMH_REGULATOR_LEVEL_MIN_SVS>;
        };

        rpmhpd_opp_low_svs: opp3 {
          opp-level = <RPMH_REGULATOR_LEVEL_LOW_SVS>;
        };

        rpmhpd_opp_svs: opp4 {
          opp-level = <RPMH_REGULATOR_LEVEL_SVS>;
        };

        rpmhpd_opp_svs_l1: opp5 {
          opp-level = <RPMH_REGULATOR_LEVEL_SVS_L1>;
        };

        rpmhpd_opp_nom: opp6 {
          opp-level = <RPMH_REGULATOR_LEVEL_NOM>;
        };

        rpmhpd_opp_nom_l1: opp7 {
          opp-level = <RPMH_REGULATOR_LEVEL_NOM_L1>;
        };

        rpmhpd_opp_nom_l2: opp8 {
          opp-level = <RPMH_REGULATOR_LEVEL_NOM_L2>;
        };

        rpmhpd_opp_turbo: opp9 {
          opp-level = <RPMH_REGULATOR_LEVEL_TURBO>;
        };

        rpmhpd_opp_turbo_l1: opp10 {
          opp-level = <RPMH_REGULATOR_LEVEL_TURBO_L1>;
        };
      };
    };

  - |

    // Example 2 (rpm power domain controller and OPP table):

    rpmpd: power-controller {
      compatible = "qcom,msm8996-rpmpd";
      #power-domain-cells = <1>;
      operating-points-v2 = <&rpmpd_opp_table>;

      rpmpd_opp_table: opp-table {
        compatible = "operating-points-v2";

        rpmpd_opp_low: opp1 {
          opp-level = <1>;
        };

        rpmpd_opp_ret: opp2 {
          opp-level = <2>;
        };

        rpmpd_opp_svs: opp3 {
          opp-level = <3>;
        };

        rpmpd_opp_normal: opp4 {
          opp-level = <4>;
        };

        rpmpd_opp_high: opp5 {
          opp-level = <5>;
        };

        rpmpd_opp_turbo: opp6 {
          opp-level = <6>;
        };
      };
    };

  - |

    // Example 3 (Client/Consumer device using OPP table):

    leaky-device0@12350000 {
      compatible = "foo,i-leak-current";
      reg = <0x12350000 0x1000>;
      power-domains = <&rpmhpd 0>;
      operating-points-v2 = <&leaky_opp_table>;
    };

    leaky_opp_table: opp-table {
      compatible = "operating-points-v2";
      opp1 {
        opp-hz = /bits/ 64 <144000>;
        required-opps = <&rpmhpd_opp_low>;
      };

      opp2 {
        opp-hz = /bits/ 64 <400000>;
        required-opps = <&rpmhpd_opp_ret>;
      };

      opp3 {
        opp-hz = /bits/ 64 <20000000>;
        required-opps = <&rpmpd_opp_svs>;
      };

      opp4 {
        opp-hz = /bits/ 64 <25000000>;
        required-opps = <&rpmpd_opp_normal>;
      };
    };
...
```

## Documentation/devicetree/bindings/power/raspberrypi,bcm2835-power.yaml
```yaml
# SPDX-License-Identifier: (GPL-2.0-only OR BSD-2-Clause)
%YAML 1.2
---
$id: http://devicetree.org/schemas/power/raspberrypi,bcm2835-power.yaml#
$schema: http://devicetree.org/meta-schemas/core.yaml#

title: Broadcom BCM2835 power domain

maintainers:
  - Alexander Aring <alex.aring@gmail.com>
  - Florian Fainelli <florian.fainelli@broadcom.com>

description:
  The Raspberry Pi power domain manages power for various subsystems
  in the Raspberry Pi BCM2835 SoC.

properties:
  compatible:
    enum:
      - raspberrypi,bcm2835-power

  firmware:
    $ref: /schemas/types.yaml#/definitions/phandle
    description: Reference to the RPi firmware device node

  "#power-domain-cells":
    const: 1

required:
  - compatible
  - firmware
  - "#power-domain-cells"

unevaluatedProperties: false

examples:
  - |
    power-controller {
      compatible = "raspberrypi,bcm2835-power";
      firmware = <&firmware>;
      #power-domain-cells = <1>;
    };
```

## Documentation/devicetree/bindings/power/renesas,apmu.txt
```
DT bindings for the Renesas Advanced Power Management Unit

Renesas R-Car line of SoCs utilize one or more APMU hardware units
for CPU core power domain control including SMP boot and CPU Hotplug.

Required properties:

- compatible: Should be "renesas,<soctype>-apmu", "renesas,apmu" as fallback.
	      Examples with soctypes are:
		- "renesas,r8a7790-apmu" (R-Car H2)
		- "renesas,r8a7791-apmu" (R-Car M2-W)
		- "renesas,r8a7792-apmu" (R-Car V2H)
		- "renesas,r8a7793-apmu" (R-Car M2-N)
		- "renesas,r8a7794-apmu" (R-Car E2)

- reg: Base address and length of the I/O registers used by the APMU.

- cpus: This node contains a list of CPU cores, which should match the order
  of CPU cores used by the WUPCR and PSTR registers in the Advanced Power
  Management Unit section of the device's datasheet.


Example:

This shows the r8a7791 APMU that can control CPU0 and CPU1.

	apmu@e6152000 {
		compatible = "renesas,r8a7791-apmu", "renesas,apmu";
		reg = <0 0xe6152000 0 0x188>;
		cpus = <&cpu0 &cpu1>;
	};
```

## Documentation/devicetree/bindings/power/renesas,apmu.yaml
```yaml
# SPDX-License-Identifier: (GPL-2.0-only OR BSD-2-Clause)
%YAML 1.2
---
$id: http://devicetree.org/schemas/power/renesas,apmu.yaml#
$schema: http://devicetree.org/meta-schemas/core.yaml#

title: Renesas Advanced Power Management Unit

maintainers:
  - Geert Uytterhoeven <geert+renesas@glider.be>
  - Magnus Damm <magnus.damm@gmail.com>

description:
  Renesas R-Car Gen2 and RZ/G1 SoCs utilize one or more APMU hardware units for
  CPU core power domain control including SMP boot and CPU Hotplug.

properties:
  compatible:
    items:
      - enum:
          - renesas,r8a7742-apmu  # RZ/G1H
          - renesas,r8a7743-apmu  # RZ/G1M
          - renesas,r8a7744-apmu  # RZ/G1N
          - renesas,r8a7745-apmu  # RZ/G1E
          - renesas,r8a77470-apmu # RZ/G1C
          - renesas,r8a7790-apmu  # R-Car H2
          - renesas,r8a7791-apmu  # R-Car M2-W
          - renesas,r8a7792-apmu  # R-Car V2H
          - renesas,r8a7793-apmu  # R-Car M2-N
          - renesas,r8a7794-apmu  # R-Car E2
      - const: renesas,apmu

  reg:
    maxItems: 1

  cpus:
    minItems: 1
    maxItems: 4
    description: |
      Array of phandles pointing to CPU cores, which should match the order of
      CPU cores used by the WUPCR and PSTR registers in the Advanced Power
      Management Unit section of the device's datasheet.

required:
  - compatible
  - reg
  - cpus

additionalProperties: false

examples:
  - |
    apmu@e6152000 {
            compatible = "renesas,r8a7791-apmu", "renesas,apmu";
            reg = <0xe6152000 0x188>;
            cpus = <&cpu0>, <&cpu1>;
    };
```

## Documentation/devicetree/bindings/power/renesas,rcar-sysc.txt
```
DT bindings for the Renesas R-Car (RZ/G) System Controller

== System Controller Node ==

The R-Car (RZ/G) System Controller provides power management for the CPU cores
and various coprocessors.

Required properties:
  - compatible: Must contain exactly one of the following:
      - "renesas,r8a7743-sysc" (RZ/G1M)
      - "renesas,r8a7745-sysc" (RZ/G1E)
      - "renesas,r8a7779-sysc" (R-Car H1)
      - "renesas,r8a7790-sysc" (R-Car H2)
      - "renesas,r8a7791-sysc" (R-Car M2-W)
      - "renesas,r8a7792-sysc" (R-Car V2H)
      - "renesas,r8a7793-sysc" (R-Car M2-N)
      - "renesas,r8a7794-sysc" (R-Car E2)
      - "renesas,r8a7795-sysc" (R-Car H3)
      - "renesas,r8a7796-sysc" (R-Car M3-W)
      - "renesas,r8a77995-sysc" (R-Car D3)
  - reg: Address start and address range for the device.
  - #power-domain-cells: Must be 1.


Example:

	sysc: system-controller@e6180000 {
		compatible = "renesas,r8a7791-sysc";
		reg = <0 0xe6180000 0 0x0200>;
		#power-domain-cells = <1>;
	};


== PM Domain Consumers ==

Devices residing in a power area must refer to that power area, as documented
by the generic PM domain bindings in
Documentation/devicetree/bindings/power/power_domain.txt.

Required properties:
  - power-domains: A phandle and symbolic PM domain specifier, as defined in
		   <dt-bindings/power/r8a77*-sysc.h>.


Example:

	L2_CA15: cache-controller@0 {
		compatible = "cache";
		power-domains = <&sysc R8A7791_PD_CA15_SCU>;
		cache-unified;
		cache-level = <2>;
	};
```
