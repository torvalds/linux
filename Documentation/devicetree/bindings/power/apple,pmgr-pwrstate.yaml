## Documentation/devicetree/bindings/power/brcm,bcm-pmb.yaml
```yaml
# SPDX-License-Identifier: GPL-2.0-only OR BSD-2-Clause
%YAML 1.2
---
$id: http://devicetree.org/schemas/power/brcm,bcm-pmb.yaml#
$schema: http://devicetree.org/meta-schemas/core.yaml#

title: Broadcom PMB (Power Management Bus) controller

description: This document describes Broadcom's PMB controller. It supports
  powering various types of connected devices (e.g. PCIe, USB, SATA).

maintainers:
  - Rafał Miłecki <rafal@milecki.pl>

properties:
  compatible:
    enum:
      - brcm,bcm4908-pmb

  reg:
    description: register space of one or more buses
    maxItems: 1

  big-endian:
    $ref: /schemas/types.yaml#/definitions/flag
    description: Flag to use for block working in big endian mode.

  "#power-domain-cells":
    description: cell specifies device ID (see bcm-pmb.h)
    const: 1

required:
  - reg
  - "#power-domain-cells"

additionalProperties: false

examples:
  - |
    #include <dt-bindings/soc/bcm-pmb.h>

    pmb: power-controller@802800e0 {
        compatible = "brcm,bcm4908-pmb";
        reg = <0x802800e0 0x40>;
        #power-domain-cells = <1>;
    };

    foo {
        power-domains = <&pmb BCM_PMB_PCIE0>;
    };
```

## Documentation/devicetree/bindings/power/brcm,bcm63xx-power.yaml
```yaml
# SPDX-License-Identifier: (GPL-2.0-only OR BSD-2-Clause)
%YAML 1.2
---
$id: "http://devicetree.org/schemas/power/brcm,bcm63xx-power.yaml#"
$schema: "http://devicetree.org/meta-schemas/core.yaml#"

title: BCM63xx power domain driver

maintainers:
  - Álvaro Fernández Rojas <noltari@gmail.com>

description: |
  BCM6318, BCM6328, BCM6362 and BCM63268 SoCs have a power domain controller
  to enable/disable certain components in order to save power.

properties:
  compatible:
    items:
      - enum:
          - brcm,bcm6318-power-controller
          - brcm,bcm6328-power-controller
          - brcm,bcm6362-power-controller
          - brcm,bcm63268-power-controller

  reg:
    maxItems: 1

  "#power-domain-cells":
    const: 1

required:
  - compatible
  - reg
  - "#power-domain-cells"

additionalProperties: false

examples:
  - |
    periph_pwr: power-controller@10001848 {
        compatible = "brcm,bcm6328-power-controller";
        reg = <0x10001848 0x4>;
        #power-domain-cells = <1>;
    };
```

## Documentation/devicetree/bindings/power/cw2015_battery.txt
```
Binding for CW201X Battery

Required properties:
- compatible: Should contain one of the following:
    * "cw201x"
- reg: integer, smbus address of the device.
- tvirtual_power: integer, test power, if battery is not exist;
- monitor_sec: integer, delay time of queue_delayed_work (s);
- bat_config_info: battery curve information;
- divider_res1: divider resistor of dual battery;
- divider_res2: divider resistor of dual battery;


Optional properties:

Example:
	cw2015@62 {
		status = "disabled";
		compatible = "cw201x";
		reg = <0x62>;
		bat_config_info = <0x15 0x42 0x60 0x59 0x52 0x58 0x4D 0x48
				   0x48 0x44 0x44 0x46 0x49 0x48 0x32 0x24
				   0x20 0x17 0x13 0x0F 0x19 0x3E 0x51 0x45
				   0x08 0x76 0x0B 0x85 0x0E 0x1C 0x2E 0x3E
				   0x4D 0x52 0x52 0x57 0x3D 0x1B 0x6A 0x2D
				   0x25 0x43 0x52 0x87 0x8F 0x91 0x94 0x52
				   0x82 0x8C 0x92 0x96 0xFF 0x7B 0xBB 0xCB
				   0x2F 0x7D 0x72 0xA5 0xB5 0xC1 0x46 0xAE>;
		monitor_sec = <5>;
		virtual_power = <0>;
		divider_res1 = <200>;
		divider_res2 = <200>;
	};
```

## Documentation/devicetree/bindings/power/cw2017_battery.txt
```
Binding for CW201X Battery

Required properties:
- compatible: Should contain one of the following:
    * "cw2017"
- reg: integer, smbus address of the device.

- cellwise,monitor-interval-ms: integer, delay time of queue_delayed_work (ms);
- cellwise,battery-profile: battery curve information;
- cellwise,dual-cell:  dual battery;
- cellwise,design-capacity-amh: the battery design capacity;
- cellwise,alert-level: the specified soc alert threshold;


Optional properties:

Example:
	cw2017@63 {
		status = "okay";
		compatible = "cellwise,cw2017";
		reg = <0x63>;
		cellwise,battery-profile = /bits/ 8
			<0x15 0xA8 0x5D 0x5D 0x59 0x55 0x57 0x50
			 0x4B 0x4F 0x55 0x53 0x43 0x37 0x2F 0x28
			 0x21 0x18 0x15 0x17 0x27 0x43 0x57 0x4F
			 0x13 0x5E 0x0A 0xE1 0x19 0x31 0x3C 0x46
			 0x4C 0x52 0x50 0x54 0x44 0x1E 0x7E 0x4C
			 0x1C 0x4A 0x52 0x87 0x8F 0x91 0x94 0x52
			 0x82 0x8C 0x92 0x96 0x00 0xAD 0xFB 0xCB
			 0x2F 0x7D 0x72 0xA5 0xB5 0xC1 0x1C 0x09>;
		cellwise,dual-cell;
		cellwise,monitor-interval-ms = <5000>;
		cellwise,dual-cell;
		cellwise,alert-level = <10>;
		cellwise,design-capacity-amh = <4500>;
	};
```

## Documentation/devicetree/bindings/power/da9150-charger.txt
```
Dialog Semiconductor DA9150 Charger Power Supply bindings

Required properties:
- compatible: "dlg,da9150-charger" for DA9150 Charger Power Supply

Optional properties:
- io-channels: List of phandle and IIO specifier pairs
- io-channel-names: List of channel names used by charger
      ["CHAN_IBUS", "CHAN_VBUS", "CHAN_TJUNC", "CHAN_VBAT"]
  (See Documentation/devicetree/bindings/iio/iio-bindings.txt for further info)


Example:

	da9150-charger {
		compatible = "dlg,da9150-charger";

		io-channels = <&gpadc 0>,
			      <&gpadc 2>,
			      <&gpadc 8>,
			      <&gpadc 5>;
		io-channel-names = "CHAN_IBUS",
				   "CHAN_VBUS",
				   "CHAN_TJUNC",
				   "CHAN_VBAT";
	};
```

## Documentation/devicetree/bindings/power/domain-idle-state.txt
```
PM Domain Idle State Node:

A domain idle state yesde represents the state parameters that will be used to
select the state when there are yes active components in the domain.

The state yesde has the following parameters -

- compatible:
	Usage: Required
	Value type: <string>
	Definition: Must be "domain-idle-state".

- entry-latency-us
	Usage: Required
	Value type: <prop-encoded-array>
	Definition: u32 value representing worst case latency in
		    microseconds required to enter the idle state.
		    The exit-latency-us duration may be guaranteed
		    only after entry-latency-us has passed.

- exit-latency-us
	Usage: Required
	Value type: <prop-encoded-array>
	Definition: u32 value representing worst case latency
		    in microseconds required to exit the idle state.

- min-residency-us
	Usage: Required
	Value type: <prop-encoded-array>
	Definition: u32 value representing minimum residency duration
		    in microseconds after which the idle state will yield
		    power benefits after overcoming the overhead in entering
i		    the idle state.
```

## Documentation/devicetree/bindings/power/domain-idle-state.yaml
```yaml
# SPDX-License-Identifier: GPL-2.0
%YAML 1.2
---
$id: http://devicetree.org/schemas/power/domain-idle-state.yaml#
$schema: http://devicetree.org/meta-schemas/core.yaml#

title: PM Domain Idle States

maintainers:
  - Ulf Hansson <ulf.hansson@linaro.org>

description:
  A domain idle state node represents the state parameters that will be used to
  select the state when there are no active components in the PM domain.

properties:
  $nodename:
    const: domain-idle-states

patternProperties:
  "^(cpu|cluster|domain)-":
    type: object
    additionalProperties: false
    description:
      Each state node represents a domain idle state description.

    properties:
      compatible:
        const: domain-idle-state

      entry-latency-us:
        description:
          The worst case latency in microseconds required to enter the idle
          state. Note that, the exit-latency-us duration may be guaranteed only
          after the entry-latency-us has passed.

      exit-latency-us:
        description:
          The worst case latency in microseconds required to exit the idle
          state.

      min-residency-us:
        description:
          The minimum residency duration in microseconds after which the idle
          state will yield power benefits, after overcoming the overhead while
          entering the idle state.

      arm,psci-suspend-param:
        $ref: /schemas/types.yaml#/definitions/uint32
        description: |
          power_state parameter to pass to the ARM PSCI suspend call.

          Device tree nodes that require usage of PSCI CPU_SUSPEND function
          (i.e. idle states node with entry-method property is set to "psci")
          must specify this property.

    required:
      - compatible
      - entry-latency-us
      - exit-latency-us
      - min-residency-us

additionalProperties: false

examples:
  - |

    domain-idle-states {
      domain_retention: domain-retention {
        compatible = "domain-idle-state";
        entry-latency-us = <20>;
        exit-latency-us = <40>;
        min-residency-us = <80>;
      };
    };
...
```

## Documentation/devicetree/bindings/power/ec_battery.txt
```
Binding for EC Battery

Required properties:
- compatible: Should contain one of the following:
    * "rockchip,ec-battery"
- reg: integer, smbus address of the device.
- tvirtual_power: integer, test power, if battery is not exist;
- monitor_sec: integer, delay time of queue_delayed_work (s);


Optional properties:

Example:

ec_battery: ec_battery09 {
	compatible = "rockchip,ec-battery";
	reg = <0x76>;
	virtual_power = <0>;
	monitor_sec = <5>;
};
```

## Documentation/devicetree/bindings/power/fsl,imx-gpc.txt
```
Freescale i.MX General Power Controller
=======================================

The i.MX6 General Power Control (GPC) block contains DVFS load tracking
counters and Power Gating Control (PGC).

Required properties:
- compatible: Should be one of the following:
  - fsl,imx6q-gpc
  - fsl,imx6qp-gpc
  - fsl,imx6sl-gpc
  - fsl,imx6sx-gpc
- reg: should be register base and length as documented in the
  datasheet
- interrupts: Should contain one interrupt specifier for the GPC interrupt
- clocks: Must contain an entry for each entry in clock-names.
  See Documentation/devicetree/bindings/clock/clock-bindings.txt for details.
- clock-names: Must include the following entries:
  - ipg

The power domains are generic power domain providers as documented in
Documentation/devicetree/bindings/power/power_domain.txt. They are described as
subnodes of the power gating controller 'pgc' node of the GPC and should
contain the following:

Required properties:
- reg: Must contain the DOMAIN_INDEX of this power domain
  The following DOMAIN_INDEX values are valid for i.MX6Q:
  ARM_DOMAIN     0
  PU_DOMAIN      1
  The following additional DOMAIN_INDEX value is valid for i.MX6SL:
  DISPLAY_DOMAIN 2
  The following additional DOMAIN_INDEX value is valid for i.MX6SX:
  PCI_DOMAIN     3

- #power-domain-cells: Should be 0

Optional properties:
- clocks: a number of phandles to clocks that need to be enabled during domain
  power-up sequencing to ensure reset propagation into devices located inside
  this power domain
- power-supply: a phandle to the regulator powering this domain

Example:

	gpc: gpc@20dc000 {
		compatible = "fsl,imx6q-gpc";
		reg = <0x020dc000 0x4000>;
		interrupts = <0 89 IRQ_TYPE_LEVEL_HIGH>,
			     <0 90 IRQ_TYPE_LEVEL_HIGH>;
		clocks = <&clks IMX6QDL_CLK_IPG>;
		clock-names = "ipg";

		pgc {
			#address-cells = <1>;
			#size-cells = <0>;

			power-domain@0 {
				reg = <0>;
				#power-domain-cells = <0>;
			};

			pd_pu: power-domain@1 {
				reg = <1>;
				#power-domain-cells = <0>;
				power-supply = <&reg_pu>;
				clocks = <&clks IMX6QDL_CLK_GPU3D_CORE>,
				         <&clks IMX6QDL_CLK_GPU3D_SHADER>,
				         <&clks IMX6QDL_CLK_GPU2D_CORE>,
				         <&clks IMX6QDL_CLK_GPU2D_AXI>,
				         <&clks IMX6QDL_CLK_OPENVG_AXI>,
				         <&clks IMX6QDL_CLK_VPU_AXI>;
			};
		};
	};


Specifying power domain for IP modules
======================================

IP cores belonging to a power domain should contain a 'power-domains' property
that is a phandle pointing to the power domain the device belongs to.

Example of a device that is part of the PU power domain:

	vpu: vpu@2040000 {
		reg = <0x02040000 0x3c000>;
		/* ... */
		power-domains = <&pd_pu>;
		/* ... */
	};
```

## Documentation/devicetree/bindings/power/fsl,imx-gpc.yaml
```yaml
# SPDX-License-Identifier: (GPL-2.0-only OR BSD-2-Clause)
%YAML 1.2
---
$id: http://devicetree.org/schemas/power/fsl,imx-gpc.yaml#
$schema: http://devicetree.org/meta-schemas/core.yaml#

title: Freescale i.MX General Power Controller

maintainers:
  - Philipp Zabel <p.zabel@pengutronix.de>

description: |
  The i.MX6 General Power Control (GPC) block contains DVFS load tracking
  counters and Power Gating Control (PGC).

  The power domains are generic power domain providers as documented in
  Documentation/devicetree/bindings/power/power-domain.yaml. They are
  described as subnodes of the power gating controller 'pgc' node of the GPC.

  IP cores belonging to a power domain should contain a 'power-domains'
  property that is a phandle pointing to the power domain the device belongs
  to.

properties:
  compatible:
    oneOf:
      - enum:
          - fsl,imx6q-gpc
      - items:
          - enum:
              - fsl,imx6qp-gpc
              - fsl,imx6sl-gpc
              - fsl,imx6sll-gpc
              - fsl,imx6sx-gpc
              - fsl,imx6ul-gpc
          - const: fsl,imx6q-gpc

  reg:
    maxItems: 1

  interrupts:
    maxItems: 1

  interrupt-controller: true
  '#interrupt-cells':
    const: 3

  clocks:
    maxItems: 1

  clock-names:
    const: ipg

  pgc:
    type: object
    additionalProperties: false
    description: list of power domains provided by this controller.

    properties:
      '#address-cells':
        const: 1

      '#size-cells':
        const: 0

    patternProperties:
      "power-domain@[0-9]$":
        type: object
        additionalProperties: false

        properties:

          '#power-domain-cells':
            const: 0

          reg:
            description: |
              The following DOMAIN_INDEX values are valid for i.MX6Q:
                ARM_DOMAIN     0
                PU_DOMAIN      1
              The following additional DOMAIN_INDEX value is valid for i.MX6SL:
                DISPLAY_DOMAIN 2
              The following additional DOMAIN_INDEX value is valid for i.MX6SX:
                PCI_DOMAIN     3
            maxItems: 1

          clocks:
            description: |
              A number of phandles to clocks that need to be enabled during domain
              power-up sequencing to ensure reset propagation into devices located
              inside this power domain.
            minItems: 1
            maxItems: 7

          power-supply: true

        required:
          - '#power-domain-cells'
          - reg

    required:
      - '#address-cells'
      - '#size-cells'

required:
  - compatible
  - reg
  - interrupts
  - clocks
  - clock-names
  - pgc

additionalProperties: false

examples:
  - |
    #include <dt-bindings/clock/imx6qdl-clock.h>
    #include <dt-bindings/interrupt-controller/arm-gic.h>

    gpc@20dc000 {
        compatible = "fsl,imx6q-gpc";
        reg = <0x020dc000 0x4000>;
        interrupts = <0 89 IRQ_TYPE_LEVEL_HIGH>;
        clocks = <&clks IMX6QDL_CLK_IPG>;
        clock-names = "ipg";

        pgc {
            #address-cells = <1>;
            #size-cells = <0>;

            power-domain@0 {
                reg = <0>;
                #power-domain-cells = <0>;
            };

            pd_pu: power-domain@1 {
                reg = <1>;
                #power-domain-cells = <0>;
                power-supply = <&reg_pu>;
                clocks = <&clks IMX6QDL_CLK_GPU3D_CORE>,
                         <&clks IMX6QDL_CLK_GPU3D_SHADER>,
                         <&clks IMX6QDL_CLK_GPU2D_CORE>,
                         <&clks IMX6QDL_CLK_GPU2D_AXI>,
                         <&clks IMX6QDL_CLK_OPENVG_AXI>,
                         <&clks IMX6QDL_CLK_VPU_AXI>;
            };
        };
    };
```
