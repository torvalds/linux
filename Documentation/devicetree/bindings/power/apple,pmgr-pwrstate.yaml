## Documentation/devicetree/bindings/power/apple,pmgr-pwrstate.yaml
```yaml
# SPDX-License-Identifier: (GPL-2.0-only OR BSD-2-Clause)
%YAML 1.2
---
$id: http://devicetree.org/schemas/power/apple,pmgr-pwrstate.yaml#
$schema: http://devicetree.org/meta-schemas/core.yaml#

title: Apple SoC PMGR Power States

maintainers:
  - Hector Martin <marcan@marcan.st>

allOf:
  - $ref: power-domain.yaml#

description: |
  Apple SoCs include PMGR blocks responsible for power management,
  which can control various clocks, resets, power states, and
  performance features. This binding describes the device power
  state registers, which control power states and resets.

  Each instance of a power controller within the PMGR syscon node
  represents a generic power domain provider, as documented in
  Documentation/devicetree/bindings/power/power-domain.yaml.
  The provider controls a single SoC block. The power hierarchy is
  represented via power-domains relationships between these nodes.

  See Documentation/devicetree/bindings/arm/apple/apple,pmgr.yaml
  for the top-level PMGR node documentation.

properties:
  compatible:
    items:
      - enum:
          - apple,t8103-pmgr-pwrstate
          - apple,t8112-pmgr-pwrstate
          - apple,t6000-pmgr-pwrstate
      - const: apple,pmgr-pwrstate

  reg:
    maxItems: 1

  "#power-domain-cells":
    const: 0

  "#reset-cells":
    const: 0

  power-domains:
    description:
      Reference to parent power domains. A domain may have multiple parents,
      and all will be powered up when it is powered.
    minItems: 1
    maxItems: 8 # Arbitrary, should be enough

  label:
    description:
      Specifies the name of the SoC domain being controlled. This is used to
      name the power/reset domains.

  apple,always-on:
    description:
      Forces this power domain to always be powered up.
    type: boolean

  apple,min-state:
    description:
      Specifies the minimum power state for auto-PM.
      0 = power gated, 4 = clock gated, 15 = on.
    $ref: /schemas/types.yaml#/definitions/uint32
    minimum: 0
    maximum: 15

required:
  - compatible
  - reg
  - "#power-domain-cells"
  - "#reset-cells"
  - label

additionalProperties: false
```

## Documentation/devicetree/bindings/power/avs/qcom,cpr.txt
```
QCOM CPR (Core Power Reduction)

CPR (Core Power Reduction) is a technology to reduce core power on a CPU
or other device. Each OPP of a device corresponds to a "corner" that has
a range of valid voltages for a particular frequency. While the device is
running at a particular frequency, CPR monitors dynamic factors such as
temperature, etc. and suggests adjustments to the voltage to save power
and meet silicon characteristic requirements.

- compatible:
	Usage: required
	Value type: <string>
	Definition: should be "qcom,qcs404-cpr", "qcom,cpr" for qcs404

- reg:
	Usage: required
	Value type: <prop-encoded-array>
	Definition: base address and size of the rbcpr register region

- interrupts:
	Usage: required
	Value type: <prop-encoded-array>
	Definition: should specify the CPR interrupt

- clocks:
	Usage: required
	Value type: <prop-encoded-array>
	Definition: phandle to the reference clock

- clock-names:
	Usage: required
	Value type: <stringlist>
	Definition: must be "ref"

- vdd-apc-supply:
	Usage: required
	Value type: <phandle>
	Definition: phandle to the vdd-apc-supply regulator

- #power-domain-cells:
	Usage: required
	Value type: <u32>
	Definition: should be 0

- operating-points-v2:
	Usage: required
	Value type: <phandle>
	Definition: A phandle to the OPP table containing the
		    performance states supported by the CPR
		    power domain

- acc-syscon:
	Usage: optional
	Value type: <phandle>
	Definition: phandle to syscon for writing ACC settings

- nvmem-cells:
	Usage: required
	Value type: <phandle>
	Definition: phandle to nvmem cells containing the data
		    that makes up a fuse corner, for each fuse corner.
		    As well as the CPR fuse revision.

- nvmem-cell-names:
	Usage: required
	Value type: <stringlist>
	Definition: should be "cpr_quotient_offset1", "cpr_quotient_offset2",
		    "cpr_quotient_offset3", "cpr_init_voltage1",
		    "cpr_init_voltage2", "cpr_init_voltage3", "cpr_quotient1",
		    "cpr_quotient2", "cpr_quotient3", "cpr_ring_osc1",
		    "cpr_ring_osc2", "cpr_ring_osc3", "cpr_fuse_revision"
		    for qcs404.

Example:

	cpr_opp_table: cpr-opp-table {
		compatible = "operating-points-v2-qcom-level";

		cpr_opp1: opp1 {
			opp-level = <1>;
			qcom,opp-fuse-level = <1>;
		};
		cpr_opp2: opp2 {
			opp-level = <2>;
			qcom,opp-fuse-level = <2>;
		};
		cpr_opp3: opp3 {
			opp-level = <3>;
			qcom,opp-fuse-level = <3>;
		};
	};

	power-controller@b018000 {
		compatible = "qcom,qcs404-cpr", "qcom,cpr";
		reg = <0x0b018000 0x1000>;
		interrupts = <0 15 IRQ_TYPE_EDGE_RISING>;
		clocks = <&xo_board>;
		clock-names = "ref";
		vdd-apc-supply = <&pms405_s3>;
		#power-domain-cells = <0>;
		operating-points-v2 = <&cpr_opp_table>;
		acc-syscon = <&tcsr>;

		nvmem-cells = <&cpr_efuse_quot_offset1>,
			<&cpr_efuse_quot_offset2>,
			<&cpr_efuse_quot_offset3>,
			<&cpr_efuse_init_voltage1>,
			<&cpr_efuse_init_voltage2>,
			<&cpr_efuse_init_voltage3>,
			<&cpr_efuse_quot1>,
			<&cpr_efuse_quot2>,
			<&cpr_efuse_quot3>,
			<&cpr_efuse_ring1>,
			<&cpr_efuse_ring2>,
			<&cpr_efuse_ring3>,
			<&cpr_efuse_revision>;
		nvmem-cell-names = "cpr_quotient_offset1",
			"cpr_quotient_offset2",
			"cpr_quotient_offset3",
			"cpr_init_voltage1",
			"cpr_init_voltage2",
			"cpr_init_voltage3",
			"cpr_quotient1",
			"cpr_quotient2",
			"cpr_quotient3",
			"cpr_ring_osc1",
			"cpr_ring_osc2",
			"cpr_ring_osc3",
			"cpr_fuse_revision";
	};
```

## Documentation/devicetree/bindings/power/avs/qcom,cpr.yaml
```yaml
# SPDX-License-Identifier: (GPL-2.0-only OR BSD-2-Clause)
%YAML 1.2
---
$id: http://devicetree.org/schemas/power/avs/qcom,cpr.yaml#
$schema: http://devicetree.org/meta-schemas/core.yaml#

title: Qualcomm Core Power Reduction (CPR) bindings

maintainers:
  - Niklas Cassel <nks@flawful.org>

description: |
  CPR (Core Power Reduction) is a technology to reduce core power on a CPU
  or other device. Each OPP of a device corresponds to a "corner" that has
  a range of valid voltages for a particular frequency. While the device is
  running at a particular frequency, CPR monitors dynamic factors such as
  temperature, etc. and suggests adjustments to the voltage to save power
  and meet silicon characteristic requirements.

properties:
  compatible:
    items:
      - enum:
          - qcom,qcs404-cpr
      - const: qcom,cpr

  reg:
    description: Base address and size of the RBCPR register region.
    maxItems: 1

  interrupts:
    maxItems: 1

  clocks:
    items:
      - description: Reference clock.

  clock-names:
    items:
      - const: ref

  vdd-apc-supply:
    description: APC regulator supply.

  '#power-domain-cells':
    const: 0

  operating-points-v2:
    description: |
      A phandle to the OPP table containing the performance states
      supported by the CPR power domain.

  acc-syscon:
    description: A phandle to the syscon used for writing ACC settings.

  nvmem-cells:
    items:
      - description: Corner 1 quotient offset
      - description: Corner 2 quotient offset
      - description: Corner 3 quotient offset
      - description: Corner 1 initial voltage
      - description: Corner 2 initial voltage
      - description: Corner 3 initial voltage
      - description: Corner 1 quotient
      - description: Corner 2 quotient
      - description: Corner 3 quotient
      - description: Corner 1 ring oscillator
      - description: Corner 2 ring oscillator
      - description: Corner 3 ring oscillator
      - description: Fuse revision

  nvmem-cell-names:
    items:
      - const: cpr_quotient_offset1
      - const: cpr_quotient_offset2
      - const: cpr_quotient_offset3
      - const: cpr_init_voltage1
      - const: cpr_init_voltage2
      - const: cpr_init_voltage3
      - const: cpr_quotient1
      - const: cpr_quotient2
      - const: cpr_quotient3
      - const: cpr_ring_osc1
      - const: cpr_ring_osc2
      - const: cpr_ring_osc3
      - const: cpr_fuse_revision

required:
  - compatible
  - reg
  - interrupts
  - clocks
  - clock-names
  - vdd-apc-supply
  - '#power-domain-cells'
  - operating-points-v2
  - nvmem-cells
  - nvmem-cell-names

additionalProperties: false

examples:
  - |
    #include <dt-bindings/interrupt-controller/arm-gic.h>

    cpr_opp_table: opp-table-cpr {
        compatible = "operating-points-v2-qcom-level";

        cpr_opp1: opp1 {
            opp-level = <1>;
            qcom,opp-fuse-level = <1>;
        };
        cpr_opp2: opp2 {
            opp-level = <2>;
            qcom,opp-fuse-level = <2>;
        };
        cpr_opp3: opp3 {
            opp-level = <3>;
            qcom,opp-fuse-level = <3>;
        };
    };

    power-controller@b018000 {
        compatible = "qcom,qcs404-cpr", "qcom,cpr";
        reg = <0x0b018000 0x1000>;
        interrupts = <0 15 IRQ_TYPE_EDGE_RISING>;
        clocks = <&xo_board>;
        clock-names = "ref";
        vdd-apc-supply = <&pms405_s3>;
        #power-domain-cells = <0>;
        operating-points-v2 = <&cpr_opp_table>;
        acc-syscon = <&tcsr>;

        nvmem-cells = <&cpr_efuse_quot_offset1>,
            <&cpr_efuse_quot_offset2>,
            <&cpr_efuse_quot_offset3>,
            <&cpr_efuse_init_voltage1>,
            <&cpr_efuse_init_voltage2>,
            <&cpr_efuse_init_voltage3>,
            <&cpr_efuse_quot1>,
            <&cpr_efuse_quot2>,
            <&cpr_efuse_quot3>,
            <&cpr_efuse_ring1>,
            <&cpr_efuse_ring2>,
            <&cpr_efuse_ring3>,
            <&cpr_efuse_revision>;
        nvmem-cell-names = "cpr_quotient_offset1",
            "cpr_quotient_offset2",
            "cpr_quotient_offset3",
            "cpr_init_voltage1",
            "cpr_init_voltage2",
            "cpr_init_voltage3",
            "cpr_quotient1",
            "cpr_quotient2",
            "cpr_quotient3",
            "cpr_ring_osc1",
            "cpr_ring_osc2",
            "cpr_ring_osc3",
            "cpr_fuse_revision";
    };
```

## Documentation/devicetree/bindings/power/bq2415x.txt
```
Binding for TI bq2415x Li-Ion Charger

Required properties:
- compatible: Should contain one of the following:
 * "ti,bq24150"
 * "ti,bq24150"
 * "ti,bq24150a"
 * "ti,bq24151"
 * "ti,bq24151a"
 * "ti,bq24152"
 * "ti,bq24153"
 * "ti,bq24153a"
 * "ti,bq24155"
 * "ti,bq24156"
 * "ti,bq24156a"
 * "ti,bq24158"
- reg:			   integer, i2c address of the device.
- ti,current-limit:	   integer, initial maximum current charger can pull
			   from power supply in mA.
- ti,weak-battery-voltage: integer, weak battery voltage threshold in mV.
			   The chip will use slow precharge if battery voltage
			   is below this value.
- ti,battery-regulation-voltage: integer, maximum charging voltage in mV.
- ti,charge-current:	   integer, maximum charging current in mA.
- ti,termination-current:  integer, charge will be terminated when current in
			   constant-voltage phase drops below this value (in mA).
- ti,resistor-sense:	   integer, value of sensing resistor in milliohm.

Optional properties:
- ti,usb-charger-detection: phandle to usb charger detection device.
			    (required for auto mode)

Example from Nokia N900:

bq24150a {
	compatible = "ti,bq24150a";
	reg = <0x6b>;

	ti,current-limit = <100>;
	ti,weak-battery-voltage = <3400>;
	ti,battery-regulation-voltage = <4200>;
	ti,charge-current = <650>;
	ti,termination-current = <100>;
	ti,resistor-sense = <68>;

	ti,usb-charger-detection = <&isp1704>;
};
```

## Documentation/devicetree/bindings/power/bq24257.txt
```
Binding for TI bq24250/bq24251/bq24257 Li-Ion Charger

Required properties:
- compatible: Should contain one of the following:
 * "ti,bq24250"
 * "ti,bq24251"
 * "ti,bq24257"
- reg: integer, i2c address of the device.
- interrupt-parent: Should be the phandle for the interrupt controller. Use in
    conjunction with "interrupts".
- interrupts: Interrupt mapping for GPIO IRQ (configure for both edges). Use in
    conjunction with "interrupt-parent".
- ti,battery-regulation-voltage: integer, maximum charging voltage in uV.
- ti,charge-current: integer, maximum charging current in uA.
- ti,termination-current: integer, charge will be terminated when current in
    constant-voltage phase drops below this value (in uA).

Optional properties:
- pg-gpios: GPIO used for connecting the bq2425x device PG (Power Good) pin.
    This pin is not available on all devices however it should be used if
    possible as this is the recommended way to obtain the charger's input PG
    state. If this pin is not specified a software-based approach for PG
    detection is used.
- ti,current-limit: The maximum current to be drawn from the charger's input
    (in uA). If this property is not specified, the input limit current is
    set automatically using USB D+/D- signal based charger type detection.
    If the hardware does not support the D+/D- based detection, a default
    of 500,000 is used (=500mA) instead.
- ti,ovp-voltage: Configures the over voltage protection voltage (in uV). If
    not specified a default of 6,5000,000 (=6.5V) is used.
- ti,in-dpm-voltage: Configures the threshold input voltage for the dynamic
    power path management (in uV). If not specified a default of 4,360,000
    (=4.36V) is used.

Example:

bq24257 {
	compatible = "ti,bq24257";
	reg = <0x6a>;
	interrupt-parent = <&gpio1>;
	interrupts = <16 IRQ_TYPE_EDGE_BOTH>;

	pg-gpios = <&gpio1 28 GPIO_ACTIVE_HIGH>;

	ti,battery-regulation-voltage = <4200000>;
	ti,charge-current = <1000000>;
	ti,termination-current = <50000>;
};

Example:

bq24250 {
	compatible = "ti,bq24250";
	reg = <0x6a>;
	interrupt-parent = <&gpio1>;
	interrupts = <16 IRQ_TYPE_EDGE_BOTH>;

	ti,battery-regulation-voltage = <4200000>;
	ti,charge-current = <500000>;
	ti,termination-current = <50000>;
	ti,current-limit = <900000>;
	ti,ovp-voltage = <9500000>;
	ti,in-dpm-voltage = <4440000>;
};
```

## Documentation/devicetree/bindings/power/bq25700.txt
```
Binding for TI bq25700 Li-Ion Charger

Required properties:
- compatible: Should contain one of the following:
    * "ti,bq25700"
- reg: integer, smbus address of the device.
- ti,battery-regulation-voltage: integer, maximum charging voltage (in uV);
- ti,charge-current: integer, maximum charging current (in uA);
- ti,minimum-sys-voltage: integer, when battery is charging and it is below
    minimum system voltage, the system will be regulated above
    minimum-sys-voltage setting (in uV);

Optional properties:

Example:

bq25700 {
        compatible = "ti,bq25700";
        reg = <0x09>;

        ti,charge-current = <1000000>;
        ti,termination-current = <50000>;
        ti,minimum-sys-voltage = <3600000>;
};
```

## Documentation/devicetree/bindings/power/bq25703.txt
```
Binding for TI bq25703 Li-Ion Charger

Required properties:
- compatible: Should contain one of the following:
    * "ti,bq25703"
- reg: integer, i2c address of the device.
- ti,max-charge-voltage: integer, maximum charging voltage (in uV);
- ti,charge-current: integer, maximum charging current (in uA);
- ti,minimum-sys-voltage: integer, when battery is charging and it is below
    minimum system voltage, the system will be regulated above
    minimum-sys-voltage setting (in uV);

Optional properties:

Example:

	bq25703@6b {
		compatible = "ti,bq25703";
		reg = <0x6b>;

		ti,max-charge-voltage = <4200000>;
		ti,charge-current = <1000000>;
		ti,minimum-sys-voltage = <3600000>;
	};
```
