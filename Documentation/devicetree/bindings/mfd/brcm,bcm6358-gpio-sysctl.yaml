## Documentation/devicetree/bindings/mfd/fsl,imx8qxp-csr.yaml
```yaml
# SPDX-License-Identifier: (GPL-2.0-only OR BSD-2-Clause)
%YAML 1.2
---
$id: http://devicetree.org/schemas/mfd/fsl,imx8qxp-csr.yaml#
$schema: http://devicetree.org/meta-schemas/core.yaml#

title: Freescale i.MX8qm/qxp Control and Status Registers Module

maintainers:
  - Liu Ying <victor.liu@nxp.com>

description: |
  As a system controller, the Freescale i.MX8qm/qxp Control and Status
  Registers(CSR) module represents a set of miscellaneous registers of a
  specific subsystem.  It may provide control and/or status report interfaces
  to a mix of standalone hardware devices within that subsystem.  One typical
  use-case is for some other nodes to acquire a reference to the syscon node
  by phandle, and the other typical use-case is that the operating system
  should consider all subnodes of the CSR module as separate child devices.

properties:
  $nodename:
    pattern: "^syscon@[0-9a-f]+$"

  compatible:
    items:
      - enum:
          - fsl,imx8qxp-mipi-lvds-csr
          - fsl,imx8qm-lvds-csr
      - const: syscon
      - const: simple-mfd

  reg:
    maxItems: 1

  clocks:
    maxItems: 1

  clock-names:
    const: ipg

patternProperties:
  "^(ldb|phy|pxl2dpi)$":
    type: object
    description: The possible child devices of the CSR module.

required:
  - compatible
  - reg
  - clocks
  - clock-names

allOf:
  - if:
      properties:
        compatible:
          contains:
            const: fsl,imx8qxp-mipi-lvds-csr
    then:
      required:
        - pxl2dpi
        - ldb

  - if:
      properties:
        compatible:
          contains:
            const: fsl,imx8qm-lvds-csr
    then:
      required:
        - phy
        - ldb

additionalProperties: false

examples:
  - |
    #include <dt-bindings/clock/imx8-lpcg.h>
    #include <dt-bindings/firmware/imx/rsrc.h>
    mipi_lvds_0_csr: syscon@56221000 {
        compatible = "fsl,imx8qxp-mipi-lvds-csr", "syscon", "simple-mfd";
        reg = <0x56221000 0x1000>;
        clocks = <&mipi_lvds_0_di_mipi_lvds_regs_lpcg IMX_LPCG_CLK_4>;
        clock-names = "ipg";

        mipi_lvds_0_pxl2dpi: pxl2dpi {
            compatible = "fsl,imx8qxp-pxl2dpi";
            fsl,sc-resource = <IMX_SC_R_MIPI_0>;
            power-domains = <&pd IMX_SC_R_MIPI_0>;

            ports {
                #address-cells = <1>;
                #size-cells = <0>;

                port@0 {
                    #address-cells = <1>;
                    #size-cells = <0>;
                    reg = <0>;

                    mipi_lvds_0_pxl2dpi_dc0_pixel_link0: endpoint@0 {
                        reg = <0>;
                        remote-endpoint = <&dc0_pixel_link0_mipi_lvds_0_pxl2dpi>;
                    };

                    mipi_lvds_0_pxl2dpi_dc0_pixel_link1: endpoint@1 {
                        reg = <1>;
                        remote-endpoint = <&dc0_pixel_link1_mipi_lvds_0_pxl2dpi>;
                    };
                };

                port@1 {
                    #address-cells = <1>;
                    #size-cells = <0>;
                    reg = <1>;

                    mipi_lvds_0_pxl2dpi_mipi_lvds_0_ldb_ch0: endpoint@0 {
                        reg = <0>;
                        remote-endpoint = <&mipi_lvds_0_ldb_ch0_mipi_lvds_0_pxl2dpi>;
                    };

                    mipi_lvds_0_pxl2dpi_mipi_lvds_0_ldb_ch1: endpoint@1 {
                        reg = <1>;
                        remote-endpoint = <&mipi_lvds_0_ldb_ch1_mipi_lvds_0_pxl2dpi>;
                    };
                };
            };
        };

        mipi_lvds_0_ldb: ldb {
            #address-cells = <1>;
            #size-cells = <0>;
            compatible = "fsl,imx8qxp-ldb";
            clocks = <&clk IMX_SC_R_LVDS_0 IMX_SC_PM_CLK_MISC2>,
                     <&clk IMX_SC_R_LVDS_0 IMX_SC_PM_CLK_BYPASS>;
            clock-names = "pixel", "bypass";
            power-domains = <&pd IMX_SC_R_LVDS_0>;

            channel@0 {
                #address-cells = <1>;
                #size-cells = <0>;
                reg = <0>;
                phys = <&mipi_lvds_0_phy>;
                phy-names = "lvds_phy";

                port@0 {
                    reg = <0>;

                    mipi_lvds_0_ldb_ch0_mipi_lvds_0_pxl2dpi: endpoint {
                        remote-endpoint = <&mipi_lvds_0_pxl2dpi_mipi_lvds_0_ldb_ch0>;
                    };
                };

                port@1 {
                    reg = <1>;

                    /* ... */
                };
            };

            channel@1 {
                #address-cells = <1>;
                #size-cells = <0>;
                reg = <1>;
                phys = <&mipi_lvds_0_phy>;
                phy-names = "lvds_phy";

                port@0 {
                    reg = <0>;

                    mipi_lvds_0_ldb_ch1_mipi_lvds_0_pxl2dpi: endpoint {
                        remote-endpoint = <&mipi_lvds_0_pxl2dpi_mipi_lvds_0_ldb_ch1>;
                    };
                };

                port@1 {
                    reg = <1>;

                    /* ... */
                };
            };
        };
    };

    mipi_lvds_0_phy: phy@56228300 {
        compatible = "fsl,imx8qxp-mipi-dphy";
        reg = <0x56228300 0x100>;
        clocks = <&clk IMX_SC_R_LVDS_0 IMX_SC_PM_CLK_PHY>;
        clock-names = "phy_ref";
        #phy-cells = <0>;
        fsl,syscon = <&mipi_lvds_0_csr>;
        power-domains = <&pd IMX_SC_R_MIPI_0>;
    };
```

## Documentation/devicetree/bindings/mfd/fsl,mc13xxx.yaml
```yaml
# SPDX-License-Identifier: (GPL-2.0-only OR BSD-2-Clause)
%YAML 1.2
---
$id: http://devicetree.org/schemas/mfd/fsl,mc13xxx.yaml#
$schema: http://devicetree.org/meta-schemas/core.yaml#

title: Freescale MC13xxx Power Management Integrated Circuits (PMIC)

maintainers:
  - Alexander Kurz <akurz@blala.de>

description: >
  The MC13xxx PMIC series consists of the three models MC13783, MC13892
  and MC34708 and provide regulators and other features like RTC, ADC,
  LED, touchscreen, codec and input buttons.

  Link to datasheets
    https://www.nxp.com/docs/en/data-sheet/MC13783.pdf
    https://www.nxp.com/docs/en/data-sheet/MC13892.pdf
    https://www.nxp.com/docs/en/data-sheet/MC34708.pdf

properties:
  compatible:
    enum:
      - fsl,mc13783
      - fsl,mc13892
      - fsl,mc34708

  reg:
    description: I2C slave address or SPI chip select number.
    maxItems: 1

  spi-max-frequency: true

  spi-cs-high: true

  system-power-controller: true

  interrupts:
    maxItems: 1

  buttons:
    type: object
    properties:
      "#address-cells":
        const: 1

      "#size-cells":
        const: 0

    patternProperties:
      "^onkey@[0-2]$":
        $ref: /schemas/input/input.yaml#
        unevaluatedProperties: false
        type: object

        properties:
          reg:
            description: |
              One of
              MC13783 BUTTON IDs:
                0: ONOFD1
                1: ONOFD2
                2: ONOFD3

              MC13892 BUTTON IDs:
                0: PWRON1
                1: PWRON2
                2: PWRON3

              MC34708 BUTTON IDs:
                0: PWRON1
                1: PWRON2
            maximum: 2

          debounce-delay-ms:
            enum: [0, 30, 150, 750]
            default: 30
            description:
              Sets the debouncing delay in milliseconds.

          active-low:
            description: Set active when pin is pulled low.

          linux,code: true

          fsl,enable-reset:
            description:
              Setting of the global reset option.
            type: boolean

    unevaluatedProperties: false

  leds:
    type: object
    $ref: /schemas/leds/common.yaml#

    properties:
      reg:
        description: |
          One of
          MC13783 LED IDs
            0: Main display
            1: AUX display
            2: Keypad
            3: Red 1
            4: Green 1
            5: Blue 1
            6: Red 2
            7: Green 2
            8: Blue 2
            9: Red 3
            10: Green 3
            11: Blue 3

          MC13892 LED IDs
            0: Main display
            1: AUX display
            2: Keypad
            3: Red
            4: Green
            5: Blue

          MC34708 LED IDs
            0: Charger Red
            1: Charger Green
        maxItems: 1

      led-control:
        $ref: /schemas/types.yaml#/definitions/uint32-array
        description: |
          Setting for LED-Control register array length depends on model,
          mc13783: 6, mc13892: 4, mc34708: 1

  regulators:
    type: object

    additionalProperties:
      type: object

    description: |
      List of child nodes specifying the regulators, depending on chip variant.
      Each child node is defined using the standard binding for regulators and
      the optional regulator properties defined below.

  fsl,mc13xxx-uses-adc:
    type: boolean
    description: Indicate the ADC is being used

  fsl,mc13xxx-uses-codec:
    type: boolean
    description: Indicate the Audio Codec is being used

  fsl,mc13xxx-uses-rtc:
    type: boolean
    description: Indicate the RTC is being used

  fsl,mc13xxx-uses-touch:
    type: boolean
    description: Indicate the touchscreen controller is being used

required:
  - compatible
  - reg

allOf:
  - if:
      properties:
        compatible:
          contains:
            const: fsl,mc13783
    then:
      properties:
        leds:
          properties:
            led-control:
              minItems: 6
              maxItems: 6
        regulators:
          patternProperties:
            "^gpo[1-4]|pwgt[12]spi|sw[12][ab]|sw3|vaudio|vcam|vdig|vesim|vgen|viohi|violo|vmmc[12]|vrf[12]|vrfbg|vrfcp|vrfdig|vrfref|vsim|vvib$":
              type: object
              $ref: /schemas/regulator/regulator.yaml#

              unevaluatedProperties: false

  - if:
      properties:
        compatible:
          contains:
            const: fsl,mc13892
    then:
      properties:
        leds:
          properties:
            led-control:
              minItems: 4
              maxItems: 4
        regulators:
          patternProperties:
            "^gpo[1-4]|pwgt[12]spi|sw[1-4]|swbst|vaudio|vcam|vcoincell|vdig|vgen[1-3]|viohi|vpll|vsd|vusb|vusb2|vvideo$":
              type: object
              $ref: /schemas/regulator/regulator.yaml#

              unevaluatedProperties: false

  - if:
      properties:
        compatible:
          contains:
            const: fsl,mc34708
    then:
      properties:
        buttons:
          patternProperties:
            "^onkey@[0-2]$":
              properties:
                reg:
                  maximum: 1
        leds:
          properties:
            led-control:
              minItems: 1
              maxItems: 1

additionalProperties: false

examples:
  - |
    #include <dt-bindings/gpio/gpio.h>
    #include <dt-bindings/interrupt-controller/irq.h>
    #include <dt-bindings/leds/common.h>

    spi {
        #address-cells = <1>;
        #size-cells = <0>;

        pmic: mc13892@0 {
            compatible = "fsl,mc13892";
            reg = <0>;
            spi-max-frequency = <1000000>;
            spi-cs-high;
            interrupt-parent = <&gpio0>;
            interrupts = <8 IRQ_TYPE_LEVEL_HIGH>;
            fsl,mc13xxx-uses-rtc;
            fsl,mc13xxx-uses-adc;

            buttons {
                #address-cells = <1>;
                #size-cells = <0>;

                onkey@0 {
                    reg = <0>;
                    debounce-delay-ms = <30>;
                    active-low;
                    fsl,enable-reset;
                };
            };

            leds {
                #address-cells = <1>;
                #size-cells = <0>;
                led-control = <0x000 0x000 0x0e0 0x000>;

                sysled@3 {
                    reg = <3>;
                    label = "system:red:live";
                    linux,default-trigger = "heartbeat";
                };
            };

            regulators {
                sw1_reg: sw1 {
                    regulator-min-microvolt = <600000>;
                    regulator-max-microvolt = <1375000>;
                    regulator-boot-on;
                    regulator-always-on;
                };

                sw2_reg: sw2 {
                    regulator-min-microvolt = <900000>;
                    regulator-max-microvolt = <1850000>;
                    regulator-boot-on;
                    regulator-always-on;
                };
            };
        };
    };
```
