## Documentation/devicetree/bindings/mfd/brcm,cru.yaml
```yaml
# SPDX-License-Identifier: GPL-2.0-only OR BSD-2-Clause
%YAML 1.2
---
$id: http://devicetree.org/schemas/mfd/brcm,cru.yaml#
$schema: http://devicetree.org/meta-schemas/core.yaml#

title: Broadcom CRU

maintainers:
  - Rafał Miłecki <rafal@milecki.pl>

description: |
  Broadcom CRU ("Clock and Reset Unit" or "Central Resource Unit") is a hardware
  block grouping smaller blocks. On Broadcom Northstar platform it contains e.g.
  clocks, pinctrl, USB PHY and thermal.

properties:
  compatible:
    items:
      - enum:
          - brcm,ns-cru
      - const: simple-mfd

  reg:
    description: CRU registers

  ranges: true

  "#address-cells":
    const: 1

  "#size-cells":
    const: 1

patternProperties:
  '^clock-controller@[a-f0-9]+$':
    $ref: ../clock/brcm,iproc-clocks.yaml

  '^pin-controller@[a-f0-9]+$':
    $ref: ../pinctrl/brcm,ns-pinmux.yaml

  '^thermal@[a-f0-9]+$':
    $ref: ../thermal/brcm,ns-thermal.yaml

additionalProperties: false

required:
  - reg

examples:
  - |
    cru-bus@1800c100 {
        compatible = "brcm,ns-cru", "simple-mfd";
        reg = <0x1800c100 0x1d0>;
        ranges;
        #address-cells = <1>;
        #size-cells = <1>;

        clock-controller@100 {
            #clock-cells = <1>;
            compatible = "brcm,nsp-lcpll0";
            reg = <0x100 0x14>;
            clocks = <&osc>;
            clock-output-names = "lcpll0", "pcie_phy", "sdio", "ddr_phy";
        };

        clock-controller@140 {
            #clock-cells = <1>;
            compatible = "brcm,nsp-genpll";
            reg = <0x140 0x24>;
            clocks = <&osc>;
            clock-output-names = "genpll", "phy", "ethernetclk", "usbclk",
                                 "iprocfast", "sata1", "sata2";
        };

        pin-controller@1c0 {
            compatible = "brcm,bcm4708-pinmux";
            reg = <0x1c0 0x24>;
            reg-names = "cru_gpio_control";
        };

        thermal@2c0 {
            compatible = "brcm,ns-thermal";
            reg = <0x2c0 0x10>;
            #thermal-sensor-cells = <0>;
        };
    };
```

## Documentation/devicetree/bindings/mfd/brcm,iproc-cdru.txt
```
Broadcom iProc Chip Device Resource Unit (CDRU)

Various Broadcom iProc SoCs have a set of registers that provide various
chip specific device and resource configurations. This node allows access to
these CDRU registers via syscon.

Required properties:
- compatible: should contain:
		"brcm,sr-cdru", "syscon" for Stingray
- reg: base address and range of the CDRU registers

Example:
	cdru: syscon@6641d000 {
		compatible = "brcm,sr-cdru", "syscon";
		reg = <0 0x6641d000 0 0x400>;
	};
```

## Documentation/devicetree/bindings/mfd/brcm,iproc-mhb.txt
```
Broadcom iProc Multi Host Bridge (MHB)

Certain Broadcom iProc SoCs have a multi host bridge (MHB) block that controls
the connection and configuration of 1) internal PCIe serdes; 2) PCIe endpoint
interface; 3) access to the Nitro (network processing) engine

This node allows access to these MHB registers via syscon.

Required properties:
- compatible: should contain:
		"brcm,sr-mhb", "syscon" for Stingray
- reg: base address and range of the MHB registers

Example:
	mhb: syscon@60401000 {
		compatible = "brcm,sr-mhb", "syscon";
		reg = <0 0x60401000 0 0x38c>;
	};
```

## Documentation/devicetree/bindings/mfd/brcm,misc.yaml
```yaml
# SPDX-License-Identifier: GPL-2.0-only OR BSD-2-Clause
%YAML 1.2
---
$id: http://devicetree.org/schemas/mfd/brcm,misc.yaml#
$schema: http://devicetree.org/meta-schemas/core.yaml#

title: Broadcom's MISC block

maintainers:
  - Rafał Miłecki <rafal@milecki.pl>

description: |
  Broadcom's MISC is a hardware block used on some SoCs (e.g. bcm63xx and
  bcm4908). It's used to implement some simple functions like a watchdog, PCIe
  reset, UniMAC control and more.

properties:
  compatible:
    items:
      - const: brcm,misc
      - const: simple-mfd

  reg:
    description: MISC block registers

  ranges: true

  "#address-cells":
    const: 1

  "#size-cells":
    const: 1

patternProperties:
  '^reset-controller@[a-f0-9]+$':
    $ref: /schemas/reset/brcm,bcm4908-misc-pcie-reset.yaml

additionalProperties: false

required:
  - reg
  - '#address-cells'
  - '#size-cells'

examples:
  - |
    misc@ff802600 {
        compatible = "brcm,misc", "simple-mfd";
        reg = <0xff802600 0xe4>;

        #address-cells = <1>;
        #size-cells = <1>;
        ranges = <0x0 0x0 0xe4>;

        reset-controller@44 {
            compatible = "brcm,bcm4908-misc-pcie-reset";
            reg = <0x44 0x4>;
            #reset-cells = <1>;
        };
    };
```

## Documentation/devicetree/bindings/mfd/brcm,twd.yaml
```yaml
# SPDX-License-Identifier: GPL-2.0-only OR BSD-2-Clause
%YAML 1.2
---
$id: http://devicetree.org/schemas/mfd/brcm,twd.yaml#
$schema: http://devicetree.org/meta-schemas/core.yaml#

title: Broadcom's Timer-Watchdog (aka TWD)

maintainers:
  - Rafał Miłecki <rafal@milecki.pl>

description: |
  Broadcom has a Timer-Watchdog block used in multiple SoCs (e.g., BCM4908,
  BCM63xx, BCM7038). There are few variants available (they differ slightly in
  registers layout). This block consists of: timers, watchdog and optionally a
  software reset handler.

properties:
  compatible:
    items:
      - enum:
          - brcm,bcm4908-twd
          - brcm,bcm7038-twd
      - const: simple-mfd
      - const: syscon

  reg:
    maxItems: 1

  ranges: true

  "#address-cells":
    const: 1

  "#size-cells":
    const: 1

patternProperties:
  '^timer@[a-f0-9]+$':
    $ref: /schemas/timer/brcm,bcmbca-timer.yaml

  '^watchdog@[a-f0-9]+$':
    $ref: /schemas/watchdog/brcm,bcm7038-wdt.yaml

additionalProperties: false

required:
  - reg

examples:
  - |
    timer-mfd@ff800400 {
        compatible = "brcm,bcm4908-twd", "simple-mfd", "syscon";
        reg = <0xff800400 0x4c>;
        ranges = <0x00000000 0xff800400 0x4c>;

        #address-cells = <1>;
        #size-cells = <1>;

        timer@0 {
            compatible = "brcm,bcm63138-timer";
            reg = <0x0 0x28>;
        };

        watchdog@28 {
            compatible = "brcm,bcm7038-wdt";
            reg = <0x28 0x8>;
        };
    };
```

## Documentation/devicetree/bindings/mfd/canaan,k210-sysctl.yaml
```yaml
# SPDX-License-Identifier: (GPL-2.0-only OR BSD-2-Clause)
%YAML 1.2
---
$id: http://devicetree.org/schemas/mfd/canaan,k210-sysctl.yaml#
$schema: http://devicetree.org/meta-schemas/core.yaml#

title: Canaan Kendryte K210 System Controller

maintainers:
  - Damien Le Moal <dlemoal@kernel.org>

description:
  Canaan Inc. Kendryte K210 SoC system controller which provides a
  register map for controlling the clocks, reset signals and pin power
  domains of the SoC.

properties:
  compatible:
    items:
      - const: canaan,k210-sysctl
      - const: syscon
      - const: simple-mfd

  clocks:
    maxItems: 1
    description:
      System controller Advanced Power Bus (APB) interface clock source.

  clock-names:
    items:
      - const: pclk

  reg:
    maxItems: 1

  clock-controller:
    # Child node
    type: object
    $ref: ../clock/canaan,k210-clk.yaml
    description:
      Clock controller for the SoC clocks. This child node definition
      should follow the bindings specified in
      Documentation/devicetree/bindings/clock/canaan,k210-clk.yaml.

  reset-controller:
    # Child node
    type: object
    $ref: ../reset/canaan,k210-rst.yaml
    description:
      Reset controller for the SoC. This child node definition
      should follow the bindings specified in
      Documentation/devicetree/bindings/reset/canaan,k210-rst.yaml.

  syscon-reboot:
    # Child node
    type: object
    $ref: ../power/reset/syscon-reboot.yaml
    description:
      Reboot method for the SoC. This child node definition
      should follow the bindings specified in
      Documentation/devicetree/bindings/power/reset/syscon-reboot.yaml.

required:
  - compatible
  - clocks
  - reg
  - clock-controller

additionalProperties: false

examples:
  - |
    #include <dt-bindings/clock/k210-clk.h>
    #include <dt-bindings/reset/k210-rst.h>

    clocks {
      in0: oscllator {
        compatible = "fixed-clock";
        #clock-cells = <0>;
        clock-frequency = <26000000>;
      };
    };

    sysctl: syscon@50440000 {
      compatible = "canaan,k210-sysctl",
                   "syscon", "simple-mfd";
      reg = <0x50440000 0x100>;
      clocks = <&sysclk K210_CLK_APB1>;
      clock-names = "pclk";

      sysclk: clock-controller {
        #clock-cells = <1>;
        compatible = "canaan,k210-clk";
        clocks = <&in0>;
      };

      sysrst: reset-controller {
        compatible = "canaan,k210-rst";
        #reset-cells = <1>;
      };

      reboot: syscon-reboot {
        compatible = "syscon-reboot";
        regmap = <&sysctl>;
        offset = <48>;
        mask = <1>;
        value = <1>;
      };
    };
```

## Documentation/devicetree/bindings/mfd/cirrus,lochnagar.txt
```
Cirrus Logic Lochnagar Audio Development Board

Lochnagar is an evaluation and development board for Cirrus Logic
Smart CODEC and Amp devices. It allows the connection of most Cirrus
Logic devices on mini-cards, as well as allowing connection of
various application processor systems to provide a full evaluation
platform.  Audio system topology, clocking and power can all be
controlled through the Lochnagar, allowing the device under test
to be used in a variety of possible use cases.

Also see these documents for generic binding information:
  [1] GPIO : ../gpio/gpio.txt

And these for relevant defines:
  [2] include/dt-bindings/pinctrl/lochnagar.h
  [3] include/dt-bindings/clock/lochnagar.h

And these documents for the required sub-node binding details:
  [4] Clock: ../clock/cirrus,lochnagar.txt
  [5] Pinctrl: ../pinctrl/cirrus,lochnagar.txt
  [6] Regulator: ../regulator/cirrus,lochnagar.txt
  [7] Sound: ../sound/cirrus,lochnagar.txt
  [8] Hardware Monitor: ../hwmon/cirrus,lochnagar.txt

Required properties:

  - compatible : One of the following strings:
                 "cirrus,lochnagar1"
                 "cirrus,lochnagar2"

  - reg : I2C slave address

  - reset-gpios : Reset line to the Lochnagar, see [1].

Required sub-nodes:

  - lochnagar-clk : Binding for the clocking components, see [4].

  - lochnagar-pinctrl : Binding for the pin control components, see [5].

Optional sub-nodes:

  - Bindings for the regulator components, see [6]. Only available on
    Lochnagar 2.

  - lochnagar-sc : Binding for the sound card components, see [7].
                   Only available on Lochnagar 2.
  - lochnagar-hwmon : Binding for the hardware monitor components, see [8].
                      Only available on Lochnagar 2.

Optional properties:

  - present-gpios : Host present line, indicating the presence of a
    host system, see [1]. This can be omitted if the present line is
    tied in hardware.

Example:

lochnagar: lochnagar@22 {
	compatible = "cirrus,lochnagar2";
	reg = <0x22>;

	reset-gpios = <&gpio0 55 0>;
	present-gpios = <&gpio0 60 0>;

	lochnagar-clk {
		compatible = "cirrus,lochnagar2-clk";
		...
	};

	lochnagar-pinctrl {
		compatible = "cirrus,lochnagar-pinctrl";
		...
	};

	lochnagar-sc {
		compatible = "cirrus,lochnagar2-soundcard";
		...
	};

	lochnagar-hwmon {
		compatible = "cirrus,lochnagar2-hwmon";
		...
	};
};
```
