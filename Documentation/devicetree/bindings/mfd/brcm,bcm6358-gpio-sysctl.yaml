## Documentation/devicetree/bindings/mfd/da9062.txt
```
* Dialog DA9062 Power Management Integrated Circuit (PMIC)

Product information for the DA9062 and DA9061 devices can be found here:
- https://www.dialog-semiconductor.com/products/da9062
- https://www.dialog-semiconductor.com/products/da9061

The DA9062 PMIC consists of:

Device                   Supply Names    Description
------                   ------------    -----------
da9062-regulator        :               : LDOs & BUCKs
da9062-rtc              :               : Real-Time Clock
da9062-onkey            :               : On Key
da9062-watchdog         :               : Watchdog Timer
da9062-thermal          :               : Thermal
da9062-gpio             :               : GPIOs

The DA9061 PMIC consists of:

Device                   Supply Names    Description
------                   ------------    -----------
da9062-regulator        :               : LDOs & BUCKs
da9062-onkey            :               : On Key
da9062-watchdog         :               : Watchdog Timer
da9062-thermal          :               : Thermal

======

Required properties:

- compatible : Should be
    "dlg,da9062" for DA9062
    "dlg,da9061" for DA9061
- reg : Specifies the I2C slave address (this defaults to 0x58 but it can be
  modified to match the chip's OTP settings).
- interrupts : IRQ line information.
- interrupt-controller

See Documentation/devicetree/bindings/interrupt-controller/interrupts.txt for
further information on IRQ bindings.

Optional properties:

- gpio-controller : Marks the device as a gpio controller.
- #gpio-cells     : Should be two. The first cell is the pin number and the
                    second cell is used to specify the gpio polarity.

See Documentation/devicetree/bindings/gpio/gpio.txt for further information on
GPIO bindings.

Sub-nodes:

- regulators : This node defines the settings for the LDOs and BUCKs.
  The DA9062 regulators are bound using their names listed below:

    buck1    : BUCK_1
    buck2    : BUCK_2
    buck3    : BUCK_3
    buck4    : BUCK_4
    ldo1     : LDO_1
    ldo2     : LDO_2
    ldo3     : LDO_3
    ldo4     : LDO_4

  The DA9061 regulators are bound using their names listed below:

    buck1    : BUCK_1
    buck2    : BUCK_2
    buck3    : BUCK_3
    ldo1     : LDO_1
    ldo2     : LDO_2
    ldo3     : LDO_3
    ldo4     : LDO_4

  The component follows the standard regulator framework and the bindings
  details of individual regulator device can be found in:
  Documentation/devicetree/bindings/regulator/regulator.txt

  regulator-initial-mode may be specified for buck regulators using mode values
  from include/dt-bindings/regulator/dlg,da9063-regulator.h.

- rtc : This node defines settings required for the Real-Time Clock associated
  with the DA9062. There are currently no entries in this binding, however
  compatible = "dlg,da9062-rtc" should be added if a node is created.

- onkey : See ../input/da9062-onkey.txt

- watchdog: See ../watchdog/da9062-watchdog.txt

- thermal : See ../thermal/da9062-thermal.txt

Example:

	pmic0: da9062@58 {
		compatible = "dlg,da9062";
		reg = <0x58>;
		interrupt-parent = <&gpio6>;
		interrupts = <11 IRQ_TYPE_LEVEL_LOW>;
		interrupt-controller;

		rtc {
			compatible = "dlg,da9062-rtc";
		};

		regulators {
			DA9062_BUCK1: buck1 {
				regulator-name = "BUCK1";
				regulator-min-microvolt = <300000>;
				regulator-max-microvolt = <1570000>;
				regulator-min-microamp = <500000>;
				regulator-max-microamp = <2000000>;
				regulator-initial-mode = <DA9063_BUCK_MODE_SYNC>;
				regulator-boot-on;
			};
			DA9062_LDO1: ldo1 {
				regulator-name = "LDO_1";
				regulator-min-microvolt = <900000>;
				regulator-max-microvolt = <3600000>;
				regulator-boot-on;
			};
		};
	};
```

## Documentation/devicetree/bindings/mfd/da9063.txt
```
* Dialog DA9063/DA9063L Power Management Integrated Circuit (PMIC)

DA9063 consists of a large and varied group of sub-devices (I2C Only):

Device                   Supply Names    Description
------                   ------------    -----------
da9063-regulator        :               : LDOs & BUCKs
da9063-onkey            :               : On Key
da9063-rtc              :               : Real-Time Clock (DA9063 only)
da9063-watchdog         :               : Watchdog

======

Required properties:

- compatible : Should be "dlg,da9063" or "dlg,da9063l"
- reg : Specifies the I2C slave address (this defaults to 0x58 but it can be
  modified to match the chip's OTP settings).
- interrupts : IRQ line information.
- interrupt-controller

Sub-nodes:

- regulators : This node defines the settings for the LDOs and BUCKs.
  The DA9063(L) regulators are bound using their names listed below:

    bcore1    : BUCK CORE1
    bcore2    : BUCK CORE2
    bpro      : BUCK PRO
    bmem      : BUCK MEM
    bio       : BUCK IO
    bperi     : BUCK PERI
    ldo1      : LDO_1	(DA9063 only)
    ldo2      : LDO_2	(DA9063 only)
    ldo3      : LDO_3
    ldo4      : LDO_4	(DA9063 only)
    ldo5      : LDO_5	(DA9063 only)
    ldo6      : LDO_6	(DA9063 only)
    ldo7      : LDO_7
    ldo8      : LDO_8
    ldo9      : LDO_9
    ldo10     : LDO_10	(DA9063 only)
    ldo11     : LDO_11

  The component follows the standard regulator framework and the bindings
  details of individual regulator device can be found in:
  Documentation/devicetree/bindings/regulator/regulator.txt

- rtc : This node defines settings for the Real-Time Clock associated with
  the DA9063 only. The RTC is not present in DA9063L. There are currently
  no entries in this binding, however compatible = "dlg,da9063-rtc" should
  be added if a node is created.

- onkey : This node defines the OnKey settings for controlling the key
  functionality of the device. The node should contain the compatible property
  with the value "dlg,da9063-onkey".

  Optional onkey properties:

  - dlg,disable-key-power : Disable power-down using a long key-press. If this
    entry exists the OnKey driver will remove support for the KEY_POWER key
    press. If this entry does not exist then by default the key-press
    triggered power down is enabled and the OnKey will support both KEY_POWER
    and KEY_SLEEP.

- watchdog : This node defines settings for the Watchdog timer associated
  with the DA9063 and DA9063L. The node should contain the compatible property
  with the value "dlg,da9063-watchdog".

  Optional watchdog properties:
  - dlg,use-sw-pm: Add this property to disable the watchdog during suspend.
  Only use this option if you can't use the watchdog automatic suspend
  function during a suspend (see register CONTROL_B).

Example:

	pmic0: da9063@58 {
		compatible = "dlg,da9063"
		reg = <0x58>;
		interrupt-parent = <&gpio6>;
		interrupts = <11 IRQ_TYPE_LEVEL_LOW>;
		interrupt-controller;

		rtc {
			compatible = "dlg,da9063-rtc";
		};

		wdt {
			compatible = "dlg,da9063-watchdog";
		};

		onkey {
			compatible = "dlg,da9063-onkey";
			dlg,disable-key-power;
		};

		regulators {
			DA9063_BCORE1: bcore1 {
				regulator-name = "BCORE1";
				regulator-min-microvolt = <300000>;
				regulator-max-microvolt = <1570000>;
				regulator-min-microamp = <500000>;
				regulator-max-microamp = <2000000>;
				regulator-boot-on;
			};
			DA9063_LDO11: ldo11 {
				regulator-name = "LDO_11";
				regulator-min-microvolt = <900000>;
				regulator-max-microvolt = <3600000>;
				regulator-boot-on;
			};
		};
	};
```

## Documentation/devicetree/bindings/mfd/da9150.txt
```
Dialog Semiconductor DA9150 Combined Charger/Fuel-Gauge MFD bindings

DA9150 consists of a group of sub-devices:

Device			 Description
------			 -----------
da9150-gpadc		: General Purpose ADC
da9150-charger		: Battery Charger
da9150-fg		: Battery Fuel-Gauge

======

Required properties:
- compatible : Should be "dlg,da9150"
- reg: Specifies the I2C slave address
- interrupt-parent: Specifies the phandle of the interrupt controller to which
  the IRQs from da9150 are delivered to.
- interrupts: IRQ line info for da9150 chip.
- interrupt-controller: da9150 has internal IRQs (own IRQ domain).
  (See ../interrupt-controller/interrupts.txt for
   further information relating to interrupt properties)

Sub-devices:
- da9150-gpadc: See ../iio/adc/da9150-gpadc.txt
- da9150-charger: See ../power/da9150-charger.txt
- da9150-fg: See ../power/da9150-fg.txt

Example:

	charger_fg: da9150@58 {
		compatible = "dlg,da9150";
		reg = <0x58>;
		interrupt-parent = <&gpio6>;
		interrupts = <11 IRQ_TYPE_LEVEL_LOW>;
		interrupt-controller;

		gpadc: da9150-gpadc {
			compatible = "dlg,da9150-gpadc";
			#io-channel-cells = <1>;
		};

		charger {
			compatible = "dlg,da9150-charger";

			io-channels = <&gpadc 0>,
				      <&gpadc 2>,
				      <&gpadc 8>,
				      <&gpadc 5>;
			io-channel-names = "CHAN_IBUS",
					   "CHAN_VBUS",
					   "CHAN_TJUNC",
					   "CHAN_VBAT";
		};

		fuel-gauge {
			compatible = "dlg,da9150-fuel-gauge";

			dlg,update-interval = <10000>;
			dlg,warn-soc-level = /bits/ 8 <15>;
			dlg,crit-soc-level = /bits/ 8 <5>
		};
	};
```

## Documentation/devicetree/bindings/mfd/delta,tn48m-cpld.yaml
```yaml
# SPDX-License-Identifier: (GPL-2.0-only OR BSD-2-Clause)
%YAML 1.2
---
$id: http://devicetree.org/schemas/mfd/delta,tn48m-cpld.yaml#
$schema: http://devicetree.org/meta-schemas/core.yaml#

title: Delta Networks TN48M CPLD controller

maintainers:
  - Robert Marko <robert.marko@sartura.hr>

description: |
  Lattice CPLD onboard the TN48M switches is used for system
  management.

  It provides information about the hardware model, revision,
  PSU status etc.

  It is also being used as a GPIO expander and reset controller
  for the switch MAC-s and other peripherals.

properties:
  compatible:
    const: delta,tn48m-cpld

  reg:
    description:
      I2C device address.
    maxItems: 1

  "#address-cells":
    const: 1

  "#size-cells":
    const: 0

required:
  - compatible
  - reg
  - "#address-cells"
  - "#size-cells"

patternProperties:
  "^gpio(@[0-9a-f]+)?$":
    $ref: ../gpio/delta,tn48m-gpio.yaml

  "^reset-controller?$":
    $ref: ../reset/delta,tn48m-reset.yaml

additionalProperties: false

examples:
  - |
    i2c {
        #address-cells = <1>;
        #size-cells = <0>;

        cpld@41 {
            compatible = "delta,tn48m-cpld";
            reg = <0x41>;
            #address-cells = <1>;
            #size-cells = <0>;

            gpio@31 {
                compatible = "delta,tn48m-gpo";
                reg = <0x31>;
                gpio-controller;
                #gpio-cells = <2>;
            };

            gpio@3a {
                compatible = "delta,tn48m-gpi";
                reg = <0x3a>;
                gpio-controller;
                #gpio-cells = <2>;
            };

            gpio@40 {
                compatible = "delta,tn48m-gpi";
                reg = <0x40>;
                gpio-controller;
                #gpio-cells = <2>;
            };

            reset-controller {
              compatible = "delta,tn48m-reset";
              #reset-cells = <1>;
            };
        };
    };
```

## Documentation/devicetree/bindings/mfd/dlg,da9052.yaml
```yaml
# SPDX-License-Identifier: (GPL-2.0-only OR BSD-2-Clause)
%YAML 1.2
---
$id: http://devicetree.org/schemas/mfd/dlg,da9052.yaml#
$schema: http://devicetree.org/meta-schemas/core.yaml#

title: Dialog DA9052/53 Power Management Integrated Circuit (PMIC)

maintainers:
  - Frank Li <Frank.Li@nxp.com>

properties:
  compatible:
    oneOf:
      - enum:
          - dlg,da9053-aa
          - dlg,da9053-ab
          - dlg,da9053-bb
          - dlg,da9053-bc
          - dlg,da9052

  reg:
    maxItems: 1

  interrupts:
    maxItems: 1

  dlg,tsi-as-adc:
    type: boolean
    description:
      if set the X+, X-, Y+, Y- touchscreen input lines are used as general
      purpose analogue input.

  tsiref-supply:
    description: The reference voltage for the TSIREF pin.

  regulators:
    type: object
    additionalProperties: false

    patternProperties:
      "^(ldo([1-9]|10)|buck[1-4])$":
        type: object
        $ref: /schemas/regulator/regulator.yaml#
        unevaluatedProperties: false

required:
  - compatible
  - reg
  - regulators

allOf:
  - $ref: /schemas/spi/spi-peripheral-props.yaml#

unevaluatedProperties: false

examples:
  - |
    i2c {
        #address-cells = <1>;
        #size-cells = <0>;

        pmic@48 {
            compatible = "dlg,da9053-aa";
            reg = <0x48>;

            regulators {
                buck1 {
                    regulator-min-microvolt = <500000>;
                    regulator-max-microvolt = <2075000>;
                };

                buck2 {
                    regulator-min-microvolt = <500000>;
                    regulator-max-microvolt = <2075000>;
                };

                buck3 {
                    regulator-min-microvolt = <925000>;
                    regulator-max-microvolt = <2500000>;
                };

                buck4 {
                    regulator-min-microvolt = <925000>;
                    regulator-max-microvolt = <2500000>;
                };
            };
        };
    };
```
