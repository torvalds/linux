## Documentation/devicetree/bindings/mfd/hisilicon,hi655x.txt
```
Hisilicon Hi655x Power Management Integrated Circuit (PMIC)

The hardware layout for access PMIC Hi655x from AP SoC Hi6220.
Between PMIC Hi655x and Hi6220, the physical signal channel is SSI.
We can use memory-mapped I/O to communicate.

+----------------+             +-------------+
|                |             |             |
|    Hi6220      |   SSI bus   |   Hi655x    |
|                |-------------|             |
|                |(REGMAP_MMIO)|             |
+----------------+             +-------------+

Required properties:
- compatible:           Should be "hisilicon,hi655x-pmic".
- reg:                  Base address of PMIC on Hi6220 SoC.
- interrupt-controller: Hi655x has internal IRQs (has own IRQ domain).
- pmic-gpios:           The GPIO used by PMIC IRQ.

Example:
	pmic: pmic@f8000000 {
		compatible = "hisilicon,hi655x-pmic";
		reg = <0x0 0xf8000000 0x0 0x1000>;
		interrupt-controller;
		#interrupt-cells = <2>;
		pmic-gpios = <&gpio1 2 GPIO_ACTIVE_HIGH>;
	}
```

## Documentation/devicetree/bindings/mfd/iei,wt61p803-puzzle.yaml
```yaml
# SPDX-License-Identifier: GPL-2.0-only OR BSD-2-Clause
%YAML 1.2
---
$id: http://devicetree.org/schemas/mfd/iei,wt61p803-puzzle.yaml#
$schema: http://devicetree.org/meta-schemas/core.yaml#

title: IEI WT61P803 PUZZLE MCU from IEI Integration Corp.

maintainers:
  - Luka Kovacic <luka.kovacic@sartura.hr>

description: |
  IEI WT61P803 PUZZLE MCU is embedded in some IEI Puzzle series boards.
  It's used for controlling system power states, fans, LEDs and temperature
  sensors.

  For Device Tree bindings of other sub-modules (HWMON, LEDs) refer to the
  binding documents under the respective subsystem directories.

properties:
  compatible:
    const: iei,wt61p803-puzzle

  current-speed: true

  enable-beep:
    type: boolean

  hwmon:
    $ref: /schemas/hwmon/iei,wt61p803-puzzle-hwmon.yaml

  leds:
    $ref: /schemas/leds/iei,wt61p803-puzzle-leds.yaml

required:
  - compatible
  - current-speed

additionalProperties: false

examples:
  - |
    #include <dt-bindings/leds/common.h>
    serial {
        mcu {
            compatible = "iei,wt61p803-puzzle";
            current-speed = <115200>;
            enable-beep;

            leds {
                compatible = "iei,wt61p803-puzzle-leds";
                #address-cells = <1>;
                #size-cells = <0>;

                led@0 {
                    reg = <0>;
                    function = LED_FUNCTION_POWER;
                    color = <LED_COLOR_ID_BLUE>;
                };
            };

            hwmon {
                compatible = "iei,wt61p803-puzzle-hwmon";
                #address-cells = <1>;
                #size-cells = <0>;

                fan-group@0 {
                    #cooling-cells = <2>;
                    reg = <0x00>;
                    cooling-levels = <64 102 170 230 250>;
                };

                fan-group@1 {
                    #cooling-cells = <2>;
                    reg = <0x01>;
                    cooling-levels = <64 102 170 230 250>;
                };
            };
        };
    };
```

## Documentation/devicetree/bindings/mfd/iqs62x.yaml
```yaml
# SPDX-License-Identifier: (GPL-2.0 OR BSD-2-Clause)
%YAML 1.2
---
$id: http://devicetree.org/schemas/mfd/iqs62x.yaml#
$schema: http://devicetree.org/meta-schemas/core.yaml#

title: Azoteq IQS620A/621/622/624/625 Multi-Function Sensors

maintainers:
  - Jeff LaBundy <jeff@labundy.com>

description: |
  The Azoteq IQS620A, IQS621, IQS622, IQS624 and IQS625 multi-function sensors
  integrate multiple sensing technologies in a single package.

  Link to datasheets: https://www.azoteq.com/

properties:
  compatible:
    enum:
      - azoteq,iqs620a
      - azoteq,iqs621
      - azoteq,iqs622
      - azoteq,iqs624
      - azoteq,iqs625

  reg:
    maxItems: 1

  interrupts:
    maxItems: 1

  firmware-name:
    $ref: /schemas/types.yaml#/definitions/string
    description:
      Specifies the name of the calibration and configuration file selected by
      the driver. If this property is omitted, the name is chosen based on the
      device name with ".bin" as the extension (e.g. iqs620a.bin for IQS620A).

  keys:
    $ref: ../input/iqs62x-keys.yaml

  pwm:
    $ref: ../pwm/iqs620a-pwm.yaml

required:
  - compatible
  - reg
  - interrupts

additionalProperties: false

examples:
  - |
    /*
     * Dual capacitive buttons with proximity-activated function, unipolar lid
     * switch and panel-mounted LED.
     */
    #include <dt-bindings/input/input.h>
    #include <dt-bindings/interrupt-controller/irq.h>

    i2c {
            #address-cells = <1>;
            #size-cells = <0>;

            iqs620a@44 {
                    compatible = "azoteq,iqs620a";
                    reg = <0x44>;
                    interrupt-parent = <&gpio>;
                    interrupts = <17 IRQ_TYPE_LEVEL_LOW>;

                    keys {
                            compatible = "azoteq,iqs620a-keys";

                            linux,keycodes = <KEY_SELECT>,
                                             <KEY_MENU>,
                                             <KEY_OK>,
                                             <KEY_MENU>;

                            hall-switch-south {
                                    linux,code = <SW_LID>;
                                    azoteq,use-prox;
                            };
                    };

                    iqs620a_pwm: pwm {
                            compatible = "azoteq,iqs620a-pwm";
                            #pwm-cells = <2>;
                    };
            };
    };

    pwmleds {
            compatible = "pwm-leds";

            led-1 {
                    pwms = <&iqs620a_pwm 0 1000000>;
                    max-brightness = <255>;
            };
    };

  - |
    /* Single inductive button with bipolar dock/tablet-mode switch. */
    #include <dt-bindings/input/input.h>
    #include <dt-bindings/interrupt-controller/irq.h>

    i2c {
            #address-cells = <1>;
            #size-cells = <0>;

            iqs620a@44 {
                    compatible = "azoteq,iqs620a";
                    reg = <0x44>;
                    interrupt-parent = <&gpio>;
                    interrupts = <17 IRQ_TYPE_LEVEL_LOW>;

                    firmware-name = "iqs620a_coil.bin";

                    keys {
                            compatible = "azoteq,iqs620a-keys";

                            linux,keycodes = <0>,
                                             <0>,
                                             <0>,
                                             <0>,
                                             <0>,
                                             <0>,
                                             <KEY_MUTE>;

                            hall-switch-north {
                                    linux,code = <SW_DOCK>;
                            };

                            hall-switch-south {
                                    linux,code = <SW_TABLET_MODE>;
                            };
                    };
            };
    };

  - |
    /* Dual capacitive buttons with volume knob. */
    #include <dt-bindings/input/input.h>
    #include <dt-bindings/interrupt-controller/irq.h>

    i2c {
            #address-cells = <1>;
            #size-cells = <0>;

            iqs624@44 {
                    compatible = "azoteq,iqs624";
                    reg = <0x44>;
                    interrupt-parent = <&gpio>;
                    interrupts = <17 IRQ_TYPE_LEVEL_LOW>;

                    keys {
                            compatible = "azoteq,iqs624-keys";

                            linux,keycodes = <BTN_0>,
                                             <0>,
                                             <BTN_1>,
                                             <0>,
                                             <0>,
                                             <0>,
                                             <0>,
                                             <0>,
                                             <0>,
                                             <0>,
                                             <0>,
                                             <0>,
                                             <0>,
                                             <0>,
                                             <KEY_VOLUMEUP>,
                                             <KEY_VOLUMEDOWN>;
                    };
            };
    };

...
```

## Documentation/devicetree/bindings/mfd/khadas,mcu.yaml
```yaml
# SPDX-License-Identifier: (GPL-2.0-only OR BSD-2-Clause)
%YAML 1.2
---
$id: http://devicetree.org/schemas/mfd/khadas,mcu.yaml#
$schema: http://devicetree.org/meta-schemas/core.yaml#

title: Khadas on-board Microcontroller

maintainers:
  - Neil Armstrong <neil.armstrong@linaro.org>

description: |
  Khadas embeds a microcontroller on their VIM and Edge boards adding some
  system feature as PWM Fan control (for VIM2 rev14 or VIM3), User memory
  storage, IR/Key resume control, system power LED control and more.

properties:
  compatible:
    enum:
      - khadas,mcu # MCU revision is discoverable
      - khadas,vim4-mcu # Different MCU variant, not discoverable

  "#cooling-cells": # Only needed for boards having FAN control feature
    const: 2

  reg:
    maxItems: 1

  fan-supply:
    description: Phandle to the regulator that powers the fan.

required:
  - compatible
  - reg

allOf:
  - if:
      properties:
        compatible:
          contains:
            const: khadas,vim4-mcu
    then:
      required:
        - fan-supply
    else:
      properties:
        fan-supply: false

additionalProperties: false

examples:
  - |
    i2c {
      #address-cells = <1>;
      #size-cells = <0>;
      khadas_mcu: system-controller@18 {
        compatible = "khadas,mcu";
        reg = <0x18>;
        #cooling-cells = <2>;
      };
    };
```

## Documentation/devicetree/bindings/mfd/kontron,sl28cpld.yaml
```yaml
# SPDX-License-Identifier: (GPL-2.0-only OR BSD-2-Clause)
%YAML 1.2
---
$id: http://devicetree.org/schemas/mfd/kontron,sl28cpld.yaml#
$schema: http://devicetree.org/meta-schemas/core.yaml#

title: Kontron's sl28cpld board management controller

maintainers:
  - Michael Walle <michael@walle.cc>

description: |
  The board management controller may contain different IP blocks like
  watchdog, fan monitoring, PWM controller, interrupt controller and a
  GPIO controller.

properties:
  compatible:
    const: kontron,sl28cpld

  reg:
    description:
      I2C device address.
    maxItems: 1

  "#address-cells":
    const: 1

  "#size-cells":
    const: 0

  "#interrupt-cells":
    const: 2

  interrupts:
    maxItems: 1

  interrupt-controller: true

patternProperties:
  "^gpio(@[0-9a-f]+)?$":
    $ref: ../gpio/kontron,sl28cpld-gpio.yaml

  "^hwmon(@[0-9a-f]+)?$":
    $ref: ../hwmon/kontron,sl28cpld-hwmon.yaml

  "^interrupt-controller(@[0-9a-f]+)?$":
    $ref: ../interrupt-controller/kontron,sl28cpld-intc.yaml

  "^pwm(@[0-9a-f]+)?$":
    $ref: ../pwm/kontron,sl28cpld-pwm.yaml

  "^watchdog(@[0-9a-f]+)?$":
    $ref: ../watchdog/kontron,sl28cpld-wdt.yaml

required:
  - "#address-cells"
  - "#size-cells"
  - compatible
  - reg

additionalProperties: false

examples:
  - |
    #include <dt-bindings/interrupt-controller/irq.h>
    i2c {
        #address-cells = <1>;
        #size-cells = <0>;

        sl28cpld@4a {
            compatible = "kontron,sl28cpld";
            reg = <0x4a>;
            #address-cells = <1>;
            #size-cells = <0>;

            watchdog@4 {
                compatible = "kontron,sl28cpld-wdt";
                reg = <0x4>;
                kontron,assert-wdt-timeout-pin;
            };

            hwmon@b {
                compatible = "kontron,sl28cpld-fan";
                reg = <0xb>;
            };

            pwm@c {
                compatible = "kontron,sl28cpld-pwm";
                reg = <0xc>;
                #pwm-cells = <2>;
            };

            pwm@e {
                compatible = "kontron,sl28cpld-pwm";
                reg = <0xe>;
                #pwm-cells = <2>;
            };

            gpio@10 {
                compatible = "kontron,sl28cpld-gpio";
                reg = <0x10>;
                interrupts-extended = <&gpio2 6
                               IRQ_TYPE_EDGE_FALLING>;

                gpio-controller;
                #gpio-cells = <2>;
                gpio-line-names = "a", "b", "c";

                interrupt-controller;
                #interrupt-cells = <2>;
            };

            gpio@15 {
                compatible = "kontron,sl28cpld-gpio";
                reg = <0x15>;
                interrupts-extended = <&gpio2 6
                               IRQ_TYPE_EDGE_FALLING>;

                gpio-controller;
                #gpio-cells = <2>;

                interrupt-controller;
                #interrupt-cells = <2>;
            };

            gpio@1a {
                compatible = "kontron,sl28cpld-gpo";
                reg = <0x1a>;

                gpio-controller;
                #gpio-cells = <2>;
            };

            gpio@1b {
                compatible = "kontron,sl28cpld-gpi";
                reg = <0x1b>;

                gpio-controller;
                #gpio-cells = <2>;
            };

            interrupt-controller@1c {
                compatible = "kontron,sl28cpld-intc";
                reg = <0x1c>;
                interrupts-extended = <&gpio2 6
                               IRQ_TYPE_EDGE_FALLING>;

                interrupt-controller;
                #interrupt-cells = <2>;
            };
        };
    };
```

## Documentation/devicetree/bindings/mfd/lp3943.txt
```
TI/National Semiconductor LP3943 MFD driver

Required properties:
  - compatible: "ti,lp3943"
  - reg: I2C slave address. From 0x60 to 0x67.

LP3943 consists of two sub-devices, lp3943-gpio and lp3943-pwm.

For the LP3943 GPIO properties please refer to:
Documentation/devicetree/bindings/gpio/gpio-lp3943.txt

For the LP3943 PWM properties please refer to:
Documentation/devicetree/bindings/pwm/pwm-lp3943.txt

Example:

lp3943@60 {
	compatible = "ti,lp3943";
	reg = <0x60>;

	gpioex: gpio {
		compatible = "ti,lp3943-gpio";
		gpio-controller;
		#gpio-cells = <2>;
	};

	pwm3943: pwm {
		compatible = "ti,lp3943-pwm";
		#pwm-cells = <2>;
		ti,pwm0 = <8 9 10>;
		ti,pwm1 = <15>;
	};
};
```
