## Documentation/devicetree/bindings/mfd/fsl,mcu-mpc8349emitx.yaml
```yaml
# SPDX-License-Identifier: (GPL-2.0-only OR BSD-2-Clause)
%YAML 1.2
---
$id: http://devicetree.org/schemas/mfd/fsl,mcu-mpc8349emitx.yaml#
$schema: http://devicetree.org/meta-schemas/core.yaml#

title: Freescale MPC8349E-mITX-compatible Power Management Micro Controller Unit (MCU)

maintainers:
  - J. Neuschäfer <j.ne@posteo.net>

properties:
  compatible:
    oneOf:
      - items:
          - enum:
              - fsl,mc9s08qg8-mpc8315erdb
              - fsl,mc9s08qg8-mpc8349emitx
              - fsl,mc9s08qg8-mpc8377erdb
              - fsl,mc9s08qg8-mpc8378erdb
              - fsl,mc9s08qg8-mpc8379erdb
          - const: fsl,mcu-mpc8349emitx

  reg:
    maxItems: 1

  "#gpio-cells":
    const: 2

  gpio-controller: true

required:
  - compatible
  - reg
  - "#gpio-cells"
  - gpio-controller

additionalProperties: false

examples:
  - |
    i2c {
        #address-cells = <1>;
        #size-cells = <0>;

        mcu@a {
            #gpio-cells = <2>;
            compatible = "fsl,mc9s08qg8-mpc8349emitx",
                         "fsl,mcu-mpc8349emitx";
            reg = <0x0a>;
            gpio-controller;
        };
    };
```

## Documentation/devicetree/bindings/mfd/fsl-imx25-tsadc.txt
```
Freescale MX25 ADC/TSC MultiFunction Device (MFD)

This device combines two general purpose conversion queues one used for general
ADC and the other used for touchscreens.

Required properties:
 - compatible:			Should be "fsl,imx25-tsadc".
 - reg:				Start address and size of the memory area of
 					the device
 - interrupts:			Interrupt for this device
					(See: ../interrupt-controller/interrupts.txt)
 - clocks:			An 'ipg' clock (See: ../clock/clock-bindings.txt)
 - interrupt-controller:	This device is an interrupt controller. It
   					controls the interrupts of both
					conversion queues.
 - #interrupt-cells:		Should be '<1>'.
 - #address-cells:		Should be '<1>'.
 - #size-cells:			Should be '<1>'.

This device includes two conversion queues which can be added as subnodes.
The first queue is for the touchscreen, the second for general purpose ADC.

Example:
	tscadc: tscadc@50030000 {
		compatible = "fsl,imx25-tsadc";
		reg = <0x50030000 0xc>;
		interrupts = <46>;
		clocks = <&clks 119>;
		clock-names = "ipg";
		interrupt-controller;
		#interrupt-cells = <1>;
		#address-cells = <1>;
		#size-cells = <1>;
		ranges;

		tsc: tcq@50030400 {
			compatible = "fsl,imx25-tcq";
			reg = <0x50030400 0x60>;
			...
		};

		adc: gcq@50030800 {
			compatible = "fsl,imx25-gcq";
			reg = <0x50030800 0x60>;
			...
		};
	};
```

## Documentation/devicetree/bindings/mfd/fusb302.txt
```
Fairchild FUSB301 Driver

Required properties:
- compatible: "fairchild,fusb302"
- reg: I2C slave address
- pinctrl-names: Musb be "default"
- pinctrl-0: fusb1_int musb be set to pull up.
- vbus-5v-gpios: enable/disable 5v vbus output
- vbus-other-gpios: enable/disable other high-voltage vbus output
- int-n-gpios: I2C int pin
- fusb302,role: typec port power role
		(ROLE_MODE_DRP/ROLE_MODE_DFP/ROLE_MODE_UFP)
- fusb302,try_role: enable try.role function, it would try your wanted
		    role when detect.
		    Valid when fusb302,role == ROLE_MODE_DRP.
		    (ROLE_MODE_DFP/ROLE_MODE_UFP)

example:
	fusb1: fusb30x@22 {
		compatible = "fairchild,fusb302";
		reg = <0x22>;
		pinctrl-names = "default";
		pinctrl-0 = <&fusb1_int>;
		vbus-5v-gpios = <&gpio1 4 GPIO_ACTIVE_LOW>;
		vbus-other-gpios = <&gpio1 5 GPIO_ACTIVE_LOW>;
		int-n-gpios = <&gpio1 24 GPIO_ACTIVE_HIGH>;
		fusb302,role = "ROLE_MODE_DRP";
		fusb302,try_role = "ROLE_MODE_DFP";
		status = "okay";
	};
```

## Documentation/devicetree/bindings/mfd/google,cros-ec.yaml
```yaml
# SPDX-License-Identifier: (GPL-2.0-only OR BSD-2-Clause)
%YAML 1.2
---
$id: http://devicetree.org/schemas/mfd/google,cros-ec.yaml#
$schema: http://devicetree.org/meta-schemas/core.yaml#

title: ChromeOS Embedded Controller

maintainers:
  - Benson Leung <bleung@chromium.org>
  - Guenter Roeck <groeck@chromium.org>

description:
  Google's ChromeOS EC is a microcontroller which talks to the AP and
  implements various functions such as keyboard and battery charging.
  The EC can be connected through various interfaces (I2C, SPI, and others)
  and the compatible string specifies which interface is being used.

properties:
  compatible:
    oneOf:
      - description:
          For implementations of the EC is connected through I2C.
        const: google,cros-ec-i2c
      - description:
          For implementations of the EC is connected through SPI.
        const: google,cros-ec-spi
      - description:
          For implementations of the EC is connected through RPMSG.
        const: google,cros-ec-rpmsg

  controller-data:
    description:
      SPI controller data, see bindings/spi/samsung,spi-peripheral-props.yaml
    type: object

  google,cros-ec-spi-pre-delay:
    description:
      This property specifies the delay in usecs between the
      assertion of the CS and the first clock pulse.
    $ref: /schemas/types.yaml#/definitions/uint32
    default: 0

  google,cros-ec-spi-msg-delay:
    description:
      This property specifies the delay in usecs between messages.
    $ref: /schemas/types.yaml#/definitions/uint32
    default: 0

  google,has-vbc-nvram:
    description:
      Some implementations of the EC include a small nvram space used to
      store verified boot context data. This boolean flag is used to specify
      whether this nvram is present or not.
    type: boolean

  mediatek,rpmsg-name:
    description:
      Must be defined if the cros-ec is a rpmsg device for a Mediatek
      ARM Cortex M4 Co-processor. Contains the name of the rpmsg
      device. Used to match the subnode to the rpmsg device announced by
      the SCP.
    $ref: "/schemas/types.yaml#/definitions/string"

  spi-max-frequency:
    description: Maximum SPI frequency of the device in Hz.

  reg:
    maxItems: 1

  interrupts:
    maxItems: 1

  wakeup-source:
    description: Button can wake-up the system.

  '#address-cells':
    const: 1

  '#size-cells':
    const: 0

  typec:
    $ref: "/schemas/chrome/google,cros-ec-typec.yaml#"

  ec-pwm:
    $ref: "/schemas/pwm/google,cros-ec-pwm.yaml#"
    deprecated: true

  pwm:
    $ref: "/schemas/pwm/google,cros-ec-pwm.yaml#"

  kbd-led-backlight:
    $ref: "/schemas/chrome/google,cros-kbd-led-backlight.yaml#"

  keyboard-controller:
    $ref: "/schemas/input/google,cros-ec-keyb.yaml#"

  proximity:
    $ref: "/schemas/iio/proximity/google,cros-ec-mkbp-proximity.yaml#"

  codecs:
    type: object
    additionalProperties: false

    properties:
      '#address-cells':
        const: 2

      '#size-cells':
        const: 1

    patternProperties:
      "^ec-codec@[a-f0-9]+$":
        type: object
        $ref: "/schemas/sound/google,cros-ec-codec.yaml#"

    required:
      - "#address-cells"
      - "#size-cells"

  cbas:
    type: object

    description:
      This device is used to signal when a detachable base is attached
      to a Chrome OS tablet. This device cannot be detected at runtime.

    properties:
      compatible:
        const: google,cros-cbas

    required:
      - compatible

    additionalProperties: false

patternProperties:
  "^i2c-tunnel[0-9]*$":
    type: object
    $ref: "/schemas/i2c/google,cros-ec-i2c-tunnel.yaml#"

  "^regulator@[0-9]+$":
    type: object
    $ref: "/schemas/regulator/google,cros-ec-regulator.yaml#"

  "^extcon[0-9]*$":
    type: object
    $ref: "/schemas/extcon/extcon-usbc-cros-ec.yaml#"

required:
  - compatible

allOf:
  - if:
      properties:
        compatible:
          contains:
            enum:
              - google,cros-ec-i2c
              - google,cros-ec-rpmsg
    then:
      properties:
        google,cros-ec-spi-pre-delay: false
        google,cros-ec-spi-msg-delay: false
        spi-max-frequency: false
    else:
      $ref: /schemas/spi/spi-peripheral-props.yaml

additionalProperties: false

examples:
  # Example for I2C
  - |
    #include <dt-bindings/gpio/gpio.h>
    #include <dt-bindings/interrupt-controller/irq.h>

    i2c0 {
        #address-cells = <1>;
        #size-cells = <0>;

        cros-ec@1e {
            compatible = "google,cros-ec-i2c";
            reg = <0x1e>;
            interrupts = <6 0>;
            interrupt-parent = <&gpio0>;
        };
    };

  # Example for SPI
  - |
    #include <dt-bindings/gpio/gpio.h>
    #include <dt-bindings/interrupt-controller/irq.h>

    spi0 {
        #address-cells = <1>;
        #size-cells = <0>;

        cros-ec@0 {
            compatible = "google,cros-ec-spi";
            reg = <0x0>;
            google,cros-ec-spi-msg-delay = <30>;
            google,cros-ec-spi-pre-delay = <10>;
            interrupts = <99 0>;
            interrupt-parent = <&gpio7>;
            spi-max-frequency = <5000000>;

            proximity {
                compatible = "google,cros-ec-mkbp-proximity";
            };

            cbas {
                compatible = "google,cros-cbas";
            };
        };
    };

  # Example for RPMSG
  - |
    scp0 {
        cros-ec {
            compatible = "google,cros-ec-rpmsg";
        };
    };
...
```

## Documentation/devicetree/bindings/mfd/hi6421.txt
```
* HI6421 Multi-Functional Device (MFD), by HiSilicon Ltd.

Required parent device properties:
- compatible    : One of the following chip-specific strings:
	"hisilicon,hi6421-pmic";
	"hisilicon,hi6421v530-pmic";
- reg		: register range space of hi6421;

Supported Hi6421 sub-devices include:

Device                     IRQ Names              Supply Names   Description
------                     ---------              ------------   -----------
regulators               :  None                 : None         : Regulators

Required child device properties:
None.

Example:
	hi6421 {
		compatible = "hisilicon,hi6421-pmic";
		reg = <0xfcc00000 0x0180>; /* 0x60 << 2 */

		regulators {
			// supply for MLC NAND/ eMMC
			hi6421_vout0_reg: hi6421_vout0 {
				regulator-name = "VOUT0";
				regulator-min-microvolt = <2850000>;
				regulator-max-microvolt = <2850000>;
			};

			// supply for 26M Oscillator
			hi6421_vout1_reg: hi6421_vout1 {
				regulator-name = "VOUT1";
				regulator-min-microvolt = <1700000>;
				regulator-max-microvolt = <2000000>;
				regulator-boot-on;
				regulator-always-on;
			};
		};
	};
```

## Documentation/devicetree/bindings/mfd/hisilicon,hi6421-spmi-pmic.yaml
```yaml
# SPDX-License-Identifier: GPL-2.0
%YAML 1.2
---
$id: http://devicetree.org/schemas/mfd/hisilicon,hi6421-spmi-pmic.yaml#
$schema: http://devicetree.org/meta-schemas/core.yaml#

title: HiSilicon 6421v600 SPMI PMIC

maintainers:
  - Mauro Carvalho Chehab <mchehab+huawei@kernel.org>

description: |
  HiSilicon 6421v600 should be connected inside a MIPI System Power Management
  (SPMI) bus. It provides interrupts and power supply.

  The GPIO and interrupt settings are represented as part of the top-level PMIC
  node.

  The SPMI controller part is provided by
  Documentation/devicetree/bindings/mfd/hisilicon,hi6421-spmi-pmic.yaml

properties:
  $nodename:
    pattern: "pmic@[0-9a-f]"

  compatible:
    const: hisilicon,hi6421v600-spmi

  reg:
    maxItems: 1

  '#interrupt-cells':
    const: 2

  interrupt-controller: true

  interrupts:
    maxItems: 1

  regulators:
    type: object

    additionalProperties: false

    properties:
      '#address-cells':
        const: 1

      '#size-cells':
        const: 0

    patternProperties:
      '^ldo[0-9]+$':
        type: object

        $ref: "/schemas/regulator/regulator.yaml#"

        unevaluatedProperties: false

required:
  - compatible
  - reg
  - regulators

additionalProperties: false

examples:
  - |

    pmic: pmic@0 {
      compatible = "hisilicon,hi6421v600-spmi";
      reg = <0 0>;

      #interrupt-cells = <2>;
      interrupt-controller;
      interrupt-parent = <&gpio28>;
      interrupts = <0 0>;

      regulators {
        #address-cells = <1>;
        #size-cells = <0>;

        ldo3: ldo3 {
          regulator-name = "ldo3";
          regulator-min-microvolt = <1500000>;
          regulator-max-microvolt = <2000000>;
          regulator-boot-on;
        };

        ldo4: ldo4 {
          regulator-name = "ldo4";
          regulator-min-microvolt = <1725000>;
          regulator-max-microvolt = <1900000>;
          regulator-boot-on;
        };

        ldo9: ldo9 {
          regulator-name = "ldo9";
          regulator-min-microvolt = <1750000>;
          regulator-max-microvolt = <3300000>;
          regulator-boot-on;
        };

        ldo15: ldo15 {
          regulator-name = "ldo15";
          regulator-min-microvolt = <1800000>;
          regulator-max-microvolt = <3000000>;
          regulator-always-on;
        };

        ldo16: ldo16 {
          regulator-name = "ldo16";
          regulator-min-microvolt = <1800000>;
          regulator-max-microvolt = <3000000>;
          regulator-boot-on;
        };

        ldo17: ldo17 {
          regulator-name = "ldo17";
          regulator-min-microvolt = <2500000>;
          regulator-max-microvolt = <3300000>;
        };

        ldo33: ldo33 {
          regulator-name = "ldo33";
          regulator-min-microvolt = <2500000>;
          regulator-max-microvolt = <3300000>;
          regulator-boot-on;
        };

        ldo34: ldo34 {
          regulator-name = "ldo34";
          regulator-min-microvolt = <2600000>;
          regulator-max-microvolt = <3300000>;
        };
      };
    };
```

## Documentation/devicetree/bindings/mfd/hisilicon,hi655x-pmic.yaml
```yaml
# SPDX-License-Identifier: (GPL-2.0-only OR BSD-2-Clause)
%YAML 1.2
---
$id: http://devicetree.org/schemas/mfd/hisilicon,hi655x-pmic.yaml#
$schema: http://devicetree.org/meta-schemas/core.yaml#

title: Hisilicon Hi655x Power Management Integrated Circuit

maintainers:
  - Chen Feng <puck.chen@hisilicon.com>
  - Daniel Lezcano <daniel.lezcano@kernel.org>

description:
  The hardware layout for access PMIC Hi655x from AP SoC Hi6220.
  Between PMIC Hi655x and Hi6220, the physical signal channel is SSI.
  We can use memory-mapped I/O to communicate.

properties:
  compatible:
    const: hisilicon,hi655x-pmic

  reg:
    maxItems: 1

  interrupt-controller: true

  '#interrupt-cells':
    const: 2

  pmic-gpios:
    maxItems: 1
    description: The GPIO used by PMIC IRQ

  '#clock-cells':
    const: 0

  clock-output-names:
    maxItems: 1

  regulators:
    type: object
    additionalProperties: false

    patternProperties:
      '^LDO(2|7|10|13|14|15|17|19|21|22)$':
        type: object
        $ref: /schemas/regulator/regulator.yaml#
        unevaluatedProperties: false

required:
  - compatible
  - reg
  - interrupt-controller
  - '#interrupt-cells'
  - pmic-gpios
  - '#clock-cells'

additionalProperties: false

examples:
  - |
    #include <dt-bindings/gpio/gpio.h>

    pmic: pmic@f8000000 {
        compatible = "hisilicon,hi655x-pmic";
        reg = <0xf8000000 0x1000>;
        #clock-cells = <0>;
        interrupt-controller;
        #interrupt-cells = <2>;
        pmic-gpios = <&gpio1 2 GPIO_ACTIVE_HIGH>;

        regulators {
            ldo2: LDO2 {
                regulator-name = "LDO2_2V8";
                regulator-min-microvolt = <2500000>;
                regulator-max-microvolt = <3200000>;
                regulator-enable-ramp-delay = <120>;
            };
        };
    };
```
