## Documentation/devicetree/bindings/mfd/lp873x.txt
```
TI LP873X PMIC MFD driver

Required properties:
  - compatible:	"ti,lp8732", "ti,lp8733"
  - reg:		I2C slave address.
  - gpio-controller:	Marks the device node as a GPIO Controller.
  - #gpio-cells:	Should be two.  The first cell is the pin number and
			the second cell is used to specify flags.
			See ../gpio/gpio.txt for more information.
  - xxx-in-supply:	Phandle to parent supply node of each regulator
			populated under regulators node. xxx can be
			buck0, buck1, ldo0 or ldo1.
  - regulators:	List of child nodes that specify the regulator
			initialization data.
Example:

pmic: lp8733@60 {
	compatible = "ti,lp8733";
	reg = <0x60>;
	gpio-controller;
	#gpio-cells = <2>;

	buck0-in-supply = <&vsys_3v3>;
	buck1-in-supply = <&vsys_3v3>;
	ldo0-in-supply = <&vsys_3v3>;
	ldo1-in-supply = <&vsys_3v3>;

	regulators {
		lp8733_buck0: buck0 {
			regulator-name = "lp8733-buck0";
			regulator-min-microvolt = <800000>;
			regulator-max-microvolt = <1400000>;
			regulator-min-microamp = <1500000>;
			regulator-max-microamp = <4000000>;
			regulator-ramp-delay = <10000>;
			regulator-always-on;
			regulator-boot-on;
		};

		lp8733_buck1: buck1 {
			regulator-name = "lp8733-buck1";
			regulator-min-microvolt = <800000>;
			regulator-max-microvolt = <1400000>;
			regulator-min-microamp = <1500000>;
			regulator-max-microamp = <4000000>;
			regulator-ramp-delay = <10000>;
			regulator-boot-on;
			regulator-always-on;
		};

		lp8733_ldo0: ldo0 {
			regulator-name = "lp8733-ldo0";
			regulator-min-microvolt = <800000>;
			regulator-max-microvolt = <3000000>;
			regulator-boot-on;
			regulator-always-on;
		};

		lp8733_ldo1: ldo1 {
			regulator-name = "lp8733-ldo1";
			regulator-min-microvolt = <800000>;
			regulator-max-microvolt = <3000000>;
			regulator-always-on;
			regulator-boot-on;
		};
	};
};
```

## Documentation/devicetree/bindings/mfd/lp87565.txt
```
TI LP87565 PMIC MFD driver

Required properties:
  - compatible:	"ti,lp87565", "ti,lp87565-q1"
  - reg:		I2C slave address.
  - gpio-controller:	Marks the device node as a GPIO Controller.
  - #gpio-cells:	Should be two.  The first cell is the pin number and
			the second cell is used to specify flags.
			See ../gpio/gpio.txt for more information.
  - xxx-in-supply:	Phandle to parent supply node of each regulator
			populated under regulators node. xxx should match
			the supply_name populated in driver.
Example:

lp87565_pmic: pmic@60 {
	compatible = "ti,lp87565-q1";
	reg = <0x60>;
	gpio-controller;
	#gpio-cells = <2>;

	buck10-in-supply = <&vsys_3v3>;
	buck23-in-supply = <&vsys_3v3>;

	regulators: regulators {
		buck10_reg: buck10 {
			/* VDD_MPU */
			regulator-name = "buck10";
			regulator-min-microvolt = <850000>;
			regulator-max-microvolt = <1250000>;
			regulator-always-on;
			regulator-boot-on;
		};

		buck23_reg: buck23 {
			/* VDD_GPU */
			regulator-name = "buck23";
			regulator-min-microvolt = <850000>;
			regulator-max-microvolt = <1250000>;
			regulator-boot-on;
			regulator-always-on;
		};
	};
};

TI LP87561 PMIC:

This is a single output 4-phase regulator configuration

Required properties:
  - compatible:	"ti,lp87561-q1"
  - reg:		I2C slave address.
  - gpio-controller:	Marks the device node as a GPIO Controller.
  - #gpio-cells:	Should be two.  The first cell is the pin number and
			the second cell is used to specify flags.
			See ../gpio/gpio.txt for more information.
  - xxx-in-supply:	Phandle to parent supply node of each regulator
			populated under regulators node. xxx should match
			the supply_name populated in driver.
Example:

lp87561_pmic: pmic@62 {
	compatible = "ti,lp87561-q1";
	reg = <0x62>;
	gpio-controller;
	#gpio-cells = <2>;

	buck3210-in-supply = <&vsys_3v3>;

	regulators: regulators {
		buck3210_reg: buck3210 {
			/* VDD_CORE */
			regulator-name = "buck3210";
			regulator-min-microvolt = <800000>;
			regulator-max-microvolt = <800000>;
			regulator-always-on;
			regulator-boot-on;
		};
	};
};
```

## Documentation/devicetree/bindings/mfd/madera.txt
```
Cirrus Logic Madera class audio codecs Multi-Functional Device

These devices are audio SoCs with extensive digital capabilities and a range
of analogue I/O.

See also the child driver bindings in:
bindings/pinctrl/cirrus,madera-pinctrl.txt
bindings/regulator/arizona-regulator.txt
bindings/sound/madera.txt

Required properties:

  - compatible : One of the following chip-specific strings:
        "cirrus,cs47l35"
        "cirrus,cs47l85"
        "cirrus,cs47l90"
        "cirrus,cs47l91"
        "cirrus,wm1840"

  - reg : I2C slave address when connected using I2C, chip select number when
    using SPI.

  - DCVDD-supply : Power supply for the device as defined in
    bindings/regulator/regulator.txt
    Mandatory on CS47L35, CS47L90, CS47L91
    Optional on CS47L85, WM1840

  - AVDD-supply, DBVDD1-supply, DBVDD2-supply, CPVDD1-supply, CPVDD2-supply :
    Power supplies for the device

  - DBVDD3-supply, DBVDD4-supply : Power supplies for the device
    (CS47L85, CS47L90, CS47L91, WM1840)

  - SPKVDDL-supply, SPKVDDR-supply : Power supplies for the device
    (CS47L85, WM1840)

  - SPKVDD-supply : Power supply for the device
    (CS47L35)

  - interrupt-controller : Indicates that this device is an interrupt controller

  - #interrupt-cells: the number of cells to describe an IRQ, must be 2.
    The first cell is the IRQ number.
    The second cell is the flags, encoded as the trigger masks from
    bindings/interrupt-controller/interrupts.txt

  - gpio-controller : Indicates this device is a GPIO controller.

  - #gpio-cells : Must be 2. The first cell is the pin number. The second cell
    is reserved for future use and must be zero

  - interrupt-parent : The parent interrupt controller.

  - interrupts : The interrupt line the /IRQ signal for the device is
    connected to.

Optional properties:

  - MICVDD-supply : Power supply, only need to be specified if
    powered externally

  - reset-gpios : One entry specifying the GPIO controlling /RESET.
    As defined in bindings/gpio.txt.
    Although optional, it is strongly recommended to use a hardware reset

  - MICBIASx : Initial data for the MICBIAS regulators, as covered in
    Documentation/devicetree/bindings/regulator/regulator.txt.
    One for each MICBIAS generator (MICBIAS1, MICBIAS2, ...)
    (all codecs)

    One for each output pin (MICBIAS1A, MIBCIAS1B, MICBIAS2A, ...)
    (all except CS47L85, WM1840)

    The following following additional property is supported for the generator
    nodes:
      - cirrus,ext-cap : Set to 1 if the MICBIAS has external decoupling
        capacitors attached.

Optional child nodes:
    micvdd : Node containing initialization data for the micvdd regulator
    See bindings/regulator/arizona-regulator.txt

    ldo1 : Node containing initialization data for the LDO1 regulator
    See bindings/regulator/arizona-regulator.txt
    (cs47l85, wm1840)

Example:

cs47l85@0 {
	compatible = "cirrus,cs47l85";
	reg = <0>;

	reset-gpios = <&gpio 0>;

	interrupt-controller;
	#interrupt-cells = <2>;
	interrupts = <&host_irq1>;
	interrupt-parent = <&gic>;

	gpio-controller;
	#gpio-cells = <2>;
};
```

## Documentation/devicetree/bindings/mfd/marvell,88pm886-a1.yaml
```yaml
# SPDX-License-Identifier: (GPL-2.0-only OR BSD-2-Clause)
%YAML 1.2
---
$id: http://devicetree.org/schemas/mfd/marvell,88pm886-a1.yaml#
$schema: http://devicetree.org/meta-schemas/core.yaml#

title: Marvell 88PM886 PMIC core

maintainers:
  - Karel Balej <balejk@matfyz.cz>

description:
  Marvell 88PM886 is a PMIC providing several functions such as onkey,
  regulators or battery and charger.

properties:
  compatible:
    const: marvell,88pm886-a1

  reg:
    maxItems: 1

  interrupts:
    maxItems: 1

  wakeup-source: true

  regulators:
    type: object
    additionalProperties: false
    patternProperties:
      "^(ldo(1[0-6]|[1-9])|buck[1-5])$":
        type: object
        $ref: /schemas/regulator/regulator.yaml#
        description: LDO or buck regulator.
        unevaluatedProperties: false

required:
  - compatible
  - reg
  - interrupts

additionalProperties: false

examples:
  - |
    #include <dt-bindings/interrupt-controller/irq.h>
    i2c {
      #address-cells = <1>;
      #size-cells = <0>;
      pmic@30 {
        compatible = "marvell,88pm886-a1";
        reg = <0x30>;
        interrupts = <0 4 IRQ_TYPE_LEVEL_HIGH>;
        interrupt-parent = <&gic>;
        wakeup-source;

        regulators {
          ldo2: ldo2 {
            regulator-min-microvolt = <3100000>;
            regulator-max-microvolt = <3300000>;
          };

          ldo15: ldo15 {
            regulator-min-microvolt = <3300000>;
            regulator-max-microvolt = <3300000>;
          };

          buck2: buck2 {
            regulator-min-microvolt = <1800000>;
            regulator-max-microvolt = <1800000>;
          };
        };
      };
    };
...
```

## Documentation/devicetree/bindings/mfd/max14577.txt
```
Maxim MAX14577/77836 Multi-Function Device

MAX14577 is a Multi-Function Device with Micro-USB Interface Circuit, Li+
Battery Charger and SFOUT LDO output for powering USB devices. It is
interfaced to host controller using I2C.

MAX77836 additionally contains PMIC (with two LDO regulators) and Fuel Gauge.


Required properties:
- compatible : Must be "maxim,max14577" or "maxim,max77836".
- reg : I2C slave address for the max14577 chip (0x25 for max14577/max77836)
- interrupts : IRQ line for the chip.


Required nodes:
 - charger :
	Node for configuring the charger driver.
	Required properties:
		- compatible : "maxim,max14577-charger"
			or "maxim,max77836-charger"
		- maxim,fast-charge-uamp : Current in uA for Fast Charge;
			Valid values:
			- for max14577: 90000 - 950000;
			- for max77836: 45000 - 475000;
		- maxim,eoc-uamp : Current in uA for End-Of-Charge mode;
			Valid values:
			- for max14577: 50000 - 200000;
			- for max77836: 5000 - 100000;
		- maxim,ovp-uvolt : OverVoltage Protection Threshold in uV;
			In an overvoltage condition, INT asserts and charging
			stops. Valid values:
			- 6000000, 6500000, 7000000, 7500000;
		- maxim,constant-uvolt : Battery Constant Voltage in uV;
			Valid values:
			- 4000000 - 4280000 (step by 20000);
			- 4350000;


Optional nodes:
- max14577-muic/max77836-muic :
	Node used only by extcon consumers.
	Required properties:
		- compatible : "maxim,max14577-muic" or "maxim,max77836-muic"

- regulators :
	Required properties:
		- compatible : "maxim,max14577-regulator"
			or "maxim,max77836-regulator"

	May contain a sub-node per regulator from the list below. Each
	sub-node should contain the constraints and initialization information
	for that regulator. See regulator.txt for a description of standard
	properties for these sub-nodes.

	List of valid regulator names:
	- for max14577: CHARGER, SAFEOUT.
	- for max77836: CHARGER, SAFEOUT, LDO1, LDO2.

	The SAFEOUT is a fixed voltage regulator so there is no need to specify
	voltages for it.


Example:

#include <dt-bindings/interrupt-controller/irq.h>

max14577@25 {
	compatible = "maxim,max14577";
	reg = <0x25>;
	interrupt-parent = <&gpx1>;
	interrupts = <5 IRQ_TYPE_NONE>;

	muic: max14577-muic {
		compatible = "maxim,max14577-muic";
	};

	regulators {
		compatible = "maxim,max14577-regulator";

		SAFEOUT {
			regulator-name = "SAFEOUT";
		};
		CHARGER {
			regulator-name = "CHARGER";
			regulator-min-microamp = <90000>;
			regulator-max-microamp = <950000>;
			regulator-boot-on;
		};
	};

	charger {
		compatible = "maxim,max14577-charger";

		maxim,constant-uvolt = <4350000>;
		maxim,fast-charge-uamp = <450000>;
		maxim,eoc-uamp = <50000>;
		maxim,ovp-uvolt = <6500000>;
	};
};


max77836@25 {
	compatible = "maxim,max77836";
	reg = <0x25>;
	interrupt-parent = <&gpx1>;
	interrupts = <5 IRQ_TYPE_NONE>;

	muic: max77836-muic {
		compatible = "maxim,max77836-muic";
	};

	regulators {
		compatible = "maxim,max77836-regulator";

		SAFEOUT {
			regulator-name = "SAFEOUT";
		};
		CHARGER {
			regulator-name = "CHARGER";
			regulator-min-microamp = <90000>;
			regulator-max-microamp = <950000>;
			regulator-boot-on;
		};
		LDO1 {
			regulator-name = "LDO1";
			regulator-min-microvolt = <2700000>;
			regulator-max-microvolt = <2700000>;
		};
		LDO2 {
			regulator-name = "LDO2";
			regulator-min-microvolt = <800000>;
			regulator-max-microvolt = <3950000>;
		};
	};

	charger {
		compatible = "maxim,max77836-charger";

		maxim,constant-uvolt = <4350000>;
		maxim,fast-charge-uamp = <225000>;
		maxim,eoc-uamp = <7500>;
		maxim,ovp-uvolt = <6500000>;
	};
};
```
