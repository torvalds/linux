## Documentation/devicetree/bindings/mfd/max77693.txt
```
Maxim MAX77693 multi-function device

MAX77693 is a Multifunction device with the following submodules:
- PMIC,
- CHARGER,
- LED,
- MUIC,
- HAPTIC

It is interfaced to host controller using i2c.
This document describes the bindings for the mfd device.

Required properties:
- compatible : Must be "maxim,max77693".
- reg : Specifies the i2c slave address of PMIC block.
- interrupts : This i2c device has an IRQ line connected to the main SoC.
- interrupt-parent :  The parent interrupt controller.

Optional properties:
- regulators : The regulators of max77693 have to be instantiated under subnod
  named "regulators" using the following format.

	regulators {
		regualtor-compatible = ESAFEOUT1/ESAFEOUT2/CHARGER
		standard regulator constratints[*].
	};

	[*] refer Documentation/devicetree/bindings/regulator/regulator.txt

- haptic : The MAX77693 haptic device utilises a PWM controlled motor to provide
  users with tactile feedback. PWM period and duty-cycle are varied in
  order to provide the approprite level of feedback.

 Required properties:
	- compatible : Must be "maxim,max77693-hpatic"
	- haptic-supply : power supply for the haptic motor
	[*] refer Documentation/devicetree/bindings/regulator/regulator.txt
	- pwms : phandle to the physical PWM(Pulse Width Modulation) device.
	 PWM properties should be named "pwms". And number of cell is different
	 for each pwm device.
	 To get more informations, please refer to documentaion.
	[*] refer Documentation/devicetree/bindings/pwm/pwm.txt

- charger : Node configuring the charger driver.
  If present, required properties:
  - compatible : Must be "maxim,max77693-charger".

  Optional properties (if not set, defaults will be used):
  - maxim,constant-microvolt : Battery constant voltage in uV. The charger
    will operate in fast charge constant current mode till battery voltage
    reaches this level. Then the charger will switch to fast charge constant
    voltage mode. Also vsys (system voltage) will be set to this value when
    DC power is supplied but charger is not enabled.
    Valid values: 3650000 - 4400000, step by 25000 (rounded down)
    Default: 4200000

  - maxim,min-system-microvolt : Minimal system voltage in uV.
    Valid values: 3000000 - 3700000, step by 100000 (rounded down)
    Default: 3600000

  - maxim,thermal-regulation-celsius : Temperature in Celsius for entering
    high temperature charging mode. If die temperature exceeds this value
    the charging current will be reduced by 105 mA/Celsius.
    Valid values: 70, 85, 100, 115
    Default: 100

  - maxim,battery-overcurrent-microamp : Overcurrent protection threshold
    in uA (current from battery to system).
    Valid values: 2000000 - 3500000, step by 250000 (rounded down)
    Default: 3500000

  - maxim,charge-input-threshold-microvolt : Threshold voltage in uV for
    triggering input voltage regulation loop. If input voltage decreases
    below this value, the input current will be reduced to reach the
    threshold voltage.
    Valid values: 4300000, 4700000, 4800000, 4900000
    Default: 4300000

- led : the LED submodule device node

There are two LED outputs available - FLED1 and FLED2. Each of them can
control a separate LED or they can be connected together to double
the maximum current for a single connected LED. One LED is represented
by one child node.

Required properties:
- compatible : Must be "maxim,max77693-led".

Optional properties:
- maxim,boost-mode :
	In boost mode the device can produce up to 1.2A of total current
	on both outputs. The maximum current on each output is reduced
	to 625mA then. If not enabled explicitly, boost setting defaults to
	LEDS_BOOST_FIXED in case both current sources are used.
	Possible values:
		LEDS_BOOST_OFF (0) - no boost,
		LEDS_BOOST_ADAPTIVE (1) - adaptive mode,
		LEDS_BOOST_FIXED (2) - fixed mode.
- maxim,boost-mvout : Output voltage of the boost module in millivolts.
	Valid values: 3300 - 5500, step by 25 (rounded down)
	Default: 3300
- maxim,mvsys-min : Low input voltage level in millivolts. Flash is not fired
	if chip estimates that system voltage could drop below this level due
	to flash power consumption.
	Valid values: 2400 - 3400, step by 33 (rounded down)
	Default: 2400

Required properties for the LED child node:
- led-sources : see Documentation/devicetree/bindings/leds/common.txt;
		device current output identifiers: 0 - FLED1, 1 - FLED2
- led-max-microamp : see Documentation/devicetree/bindings/leds/common.txt
	Valid values for a LED connected to one FLED output:
		15625 - 250000, step by 15625 (rounded down)
	Valid values for a LED connected to both FLED outputs:
		15625 - 500000, step by 15625 (rounded down)
- flash-max-microamp : see Documentation/devicetree/bindings/leds/common.txt
	Valid values for a single LED connected to one FLED output
	(boost mode must be turned off):
		15625 - 1000000, step by 15625 (rounded down)
	Valid values for a single LED connected to both FLED outputs:
		15625 - 1250000, step by 15625 (rounded down)
	Valid values for two LEDs case:
		15625 - 625000, step by 15625 (rounded down)
- flash-max-timeout-us : see Documentation/devicetree/bindings/leds/common.txt
	Valid values: 62500 - 1000000, step by 62500 (rounded down)

Optional properties for the LED child node:
- label : see Documentation/devicetree/bindings/leds/common.txt

Example:
#include <dt-bindings/leds/common.h>

	max77693@66 {
		compatible = "maxim,max77693";
		reg = <0x66>;
		interrupt-parent = <&gpx1>;
		interrupts = <5 2>;

		regulators {
			esafeout@1 {
				regulator-compatible = "ESAFEOUT1";
				regulator-name = "ESAFEOUT1";
				regulator-boot-on;
			};
			esafeout@2 {
				regulator-compatible = "ESAFEOUT2";
				regulator-name = "ESAFEOUT2";
				};
			charger@0 {
				regulator-compatible = "CHARGER";
				regulator-name = "CHARGER";
				regulator-min-microamp = <60000>;
				regulator-max-microamp = <2580000>;
					regulator-boot-on;
			};
		};

		haptic {
			compatible = "maxim,max77693-haptic";
			haptic-supply = <&haptic_supply>;
			pwms = <&pwm 0 40000 0>;
			pwm-names = "haptic";
		};

		charger {
			compatible = "maxim,max77693-charger";

			maxim,constant-microvolt = <4200000>;
			maxim,min-system-microvolt = <3600000>;
			maxim,thermal-regulation-celsius = <75>;
			maxim,battery-overcurrent-microamp = <3000000>;
			maxim,charge-input-threshold-microvolt = <4300000>;

		led {
			compatible = "maxim,max77693-led";
			maxim,boost-mode = <LEDS_BOOST_FIXED>;
			maxim,boost-mvout = <5000>;
			maxim,mvsys-min = <2400>;

			camera_flash: flash-led {
				label = "max77693-flash";
				led-sources = <0>, <1>;
				led-max-microamp = <500000>;
				flash-max-microamp = <1250000>;
				flash-max-timeout-us = <1000000>;
			};
		};
	};
```

## Documentation/devicetree/bindings/mfd/max77802.txt
```
Maxim MAX77802 multi-function device

The Maxim MAX77802 is a Power Management IC (PMIC) that contains 10 high
efficiency Buck regulators, 32 Low-DropOut (LDO) regulators used to power
up application processors and peripherals, a 2-channel 32kHz clock outputs,
a Real-Time-Clock (RTC) and a I2C interface to program the individual
regulators, clocks outputs and the RTC.

Bindings for the built-in 32k clock generator block and
regulators are defined in ../clk/maxim,max77802.txt and
../regulator/max77802.txt respectively.

Required properties:
- compatible		: Must be "maxim,max77802"
- reg			: Specifies the I2C slave address of PMIC block.
- interrupts		: I2C device IRQ line connected to the main SoC.
- interrupt-parent	: The parent interrupt controller.

Example:

	max77802: pmic@09 {
		compatible = "maxim,max77802";
		interrupt-parent = <&intc>;
		interrupts = <26 IRQ_TYPE_NONE>;
		reg = <0x09>;
	};
```

## Documentation/devicetree/bindings/mfd/max77xxx.txt
```
Maxim MAX77XXX multi-function device

MAX77XXX is a Mulitifunction device with PMIC, RTC and Charger on chip. It is
interfaced to host controller using i2c interface. PMIC and Charger submodules
are addressed using same i2c slave address whereas the RTC submodule can use
a different i2c slave address (this feature is used for MAX77686).

This document describes the binding for mfd device and PMIC submodule.

Required properties:
- compatible : Must be "maxim,max77686" or "maxim,max77802"
- reg : Specifies the i2c slave address of PMIC block.
- interrupts : This i2c device has an IRQ line connected to the main SoC.
- interrupt-parent : The parent interrupt controller.

Optional properties:
- max77xxx,pmic-buck-default-dvs-idx: We'll always write this DVS index in the
  PMIC for BUCKs with DVS (on 77686 this is bucks 2-4; on 77802 it is 1-4, 6).
  NOTE: at the moment these bindings don't include enough details for actual
  GPIO-DVS--this just lets you choose which single slot to use.

- max77xxx,pmic-buck-dvs-gpios: The DVS GPIOs.  We'll try to set these GPIOs
  to match pmic-buck-default-dvs-idx at probe time if they are defined.  If
  some or all of these GPIOs are not defined it's assumed that the board has
  any missing GPIOs hardwired to match pmic-buck-default-dvs-idx.

- max77xxx,pmic-buck-selb-gpios: GPIOs to enable DVS-GPIO for BUCKs.
  On 77686 should be three values: 2, 3, and 4.  On 77802 should be five
  values: 1, 2, 3, 4, 6.  It is strongly suggested to include these GPIOs
  if there's any chance that changing DVS GPIOs one line at a time might
  glitch your DVS values.


Optional node:
- voltage-regulators : The regulators of max77686 have to be instantiated
  under subnode named "voltage-regulators" using the following format.

	regulator_name {
		standard regulator constraints....
	};
	refer Documentation/devicetree/bindings/regulator/regulator.txt

Required properties for each regulator:
- regulator-op-mode : Regulator operating mode, the meaning is regulator-
     dependent. Valid values are 0-3.

  The regulator_name should be initialized with a string which matches
  the hardware counterparts as follow:

	-LDOn	:	for LDOs, where n can lie in range 1 to 26 (1 to 35
			for MAX77802).
			example: LDO1, LDO2, LDO26.
	-BUCKn	:	for BUCKs, where n can lie in range 1 to 9 (1 TO 10
			FOR max77802)
			example: BUCK1, BUCK5, BUCK9.
	EN32KHZ_AP, EN32KHZ_CP	: fake regulators which actually produce
			32KHx clocks
	P32KHZ	:	MAX77686 only: another 32KHz clock

Optional subnode (to enable the RTC):
 - rtc : Indicates that the PMIC includes a real-time-clock. For MAX77686
	the reg property indicates the i2c slave address to use for talking
	to this. For MAX77802 the reg property is not needed and should not
	be specified.


Example:

	max77686@9 {
		compatible = "maxim,max77686";
		interrupt-parent = <&wakeup_eint>;
		interrupts = <26 0>;
		reg = <0x09>;
		#address-cells = <1>;
		#size-cells = <0>;

		max77xxx,pmic-buck-default-dvs-idx = <1>;
		max77xxx,pmic-buck-dvs-gpios = <&gpy7 6 0>,
					       <&gpj4 2 0>,
					       <&gpj4 3 0>;
		max77xxx,pmic-buck-selb-gpios = <&gph0 2 0>,
						<&gph0 3 0>,
						<&gph0 4 0>,
						<&gph0 5 0>,
						<&gph0 6 0>;

		voltage-regulators {
			LDO11 {
				regulator-name = "vdd_ldo11";
				regulator-min-microvolt = <1900000>;
				regulator-max-microvolt = <1900000>;
				regulator-always-on;
				regulator-op-mode = <3>;
			};

			BUCK1 {
				regulator-name = "vdd_mif";
				regulator-min-microvolt = <950000>;
				regulator-max-microvolt = <1300000>;
				regulator-always-on;
				regulator-boot-on;
				regulator-op-mode = <3>;
			};

			EN32KHZ_CP {
				regulator-name = "en32khz_cp";
				regulator-always-on;
				regulator-op-mode = <1>;
			};

		rtc@c {
			reg = <0xc>;
		};
	}
```
