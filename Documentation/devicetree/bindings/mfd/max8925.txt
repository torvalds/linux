## Documentation/devicetree/bindings/mfd/max8925.txt
```
* Maxim max8925 Power Management IC

Required parent device properties:
- compatible : "maxim,max8925"
- reg : the I2C slave address for the max8925 chip
- interrupts : IRQ line for the max8925 chip
- interrupt-controller: describes the max8925 as an interrupt
  controller (has its own domain)
- #interrupt-cells : should be 1.
	- The cell is the max8925 local IRQ number

Optional parent device properties:
- maxim,tsc-irq: there are 2 IRQ lines for max8925, one is indicated in
  interrupts property, the other is indicated here.

max8925 consists of a large and varied group of sub-devices:

Device			 Supply Names	 Description
------			 ------------	 -----------
max8925-onkey		:		: On key
max8925-rtc		:		: RTC
max8925-regulator	:		: Regulators
max8925-backlight	:		: Backlight
max8925-touch		:		: Touchscreen
max8925-power		:		: Charger

Example:

	pmic: max8925@3c {
		compatible = "maxim,max8925";
		reg = <0x3c>;
		interrupts = <1>;
		interrupt-parent = <&intcmux4>;
		interrupt-controller;
		#interrupt-cells = <1>;
		maxim,tsc-irq = <0>;

		regulators {
			SDV1 {
				regulator-min-microvolt = <637500>;
				regulator-max-microvolt = <1425000>;
				regulator-boot-on;
				regulator-always-on;
			};

			LDO1 {
				regulator-min-microvolt = <750000>;
				regulator-max-microvolt = <3900000>;
				regulator-boot-on;
				regulator-always-on;
			};

		};
		backlight {
			maxim,max8925-dual-string = <0>;
		};
		charger {
			batt-detect = <0>;
			topoff-threshold = <1>;
			fast-charge = <7>;
			no-temp-support = <0>;
			no-insert-detect = <0>;
		};
	};
```

## Documentation/devicetree/bindings/mfd/max8998.txt
```
* Maxim MAX8998, National/TI LP3974 multi-function device

The Maxim MAX8998 is a multi-function device which includes voltage/current
regulators, real time clock, battery charging controller and several
other sub-blocks. It is interfaced using an I2C interface. Each sub-block
is addressed by the host system using different i2c slave address.

PMIC sub-block
--------------

The PMIC sub-block contains a number of voltage and current regulators,
with controllable parameters and dynamic voltage scaling capability.
In addition, it includes a real time clock and battery charging controller
as well. It is accessible at I2C address 0x66.

Required properties:
- compatible: Should be one of the following:
    - "maxim,max8998" for Maxim MAX8998
    - "national,lp3974" or "ti,lp3974" for National/TI LP3974.
- reg: Specifies the i2c slave address of the pmic block. It should be 0x66.

Optional properties:
- interrupt-parent: Specifies the phandle of the interrupt controller to which
  the interrupts from MAX8998 are routed to.
- interrupts: Interrupt specifiers for two interrupt sources.
  - First interrupt specifier is for main interrupt.
  - Second interrupt specifier is for power-on/-off interrupt.
- max8998,pmic-buck1-dvs-gpios: GPIO specifiers for two host gpios used
  for buck 1 dvs. The format of the gpio specifier depends on the gpio
  controller.
- max8998,pmic-buck2-dvs-gpio: GPIO specifier for host gpio used
  for buck 2 dvs. The format of the gpio specifier depends on the gpio
  controller.
- max8998,pmic-buck1-default-dvs-idx: Default voltage setting selected from
  the possible 4 options selectable by the dvs gpios. The value of this
  property should be 0, 1, 2 or 3. If not specified or out of range,
  a default value of 0 is taken.
- max8998,pmic-buck2-default-dvs-idx: Default voltage setting selected from
  the possible 2 options selectable by the dvs gpios. The value of this
  property should be 0 or 1. If not specified or out of range, a default
  value of 0 is taken.
- max8998,pmic-buck-voltage-lock: If present, disallows changing of
  preprogrammed buck dvfs voltages.

Additional properties required if max8998,pmic-buck1-dvs-gpios is defined:
- max8998,pmic-buck1-dvs-voltage: An array of 4 voltage values in microvolts
  for buck1 regulator that can be selected using dvs gpio.

Additional properties required if max8998,pmic-buck2-dvs-gpio is defined:
- max8998,pmic-buck2-dvs-voltage: An array of 2 voltage values in microvolts
  for buck2 regulator that can be selected using dvs gpio.

Regulators: All the regulators of MAX8998 to be instantiated shall be
listed in a child node named 'regulators'. Each regulator is represented
by a child node of the 'regulators' node.

	regulator-name {
		/* standard regulator bindings here */
	};

Following regulators of the MAX8998 PMIC block are supported. Note that
the 'n' in regulator name, as in LDOn or BUCKn, represents the LDO or BUCK
number as described in MAX8998 datasheet.

	- LDOn
		  - valid values for n are 2 to 17
		  - Example: LDO2, LDO10, LDO17
	- BUCKn
		  - valid values for n are 1 to 4.
		  - Example: BUCK1, BUCK2, BUCK3, BUCK4

	- ENVICHG: Battery Charging Current Monitor Output. This is a fixed
		   voltage type regulator

	- ESAFEOUT1: (ldo19)
	- ESAFEOUT2: (ld020)

Standard regulator bindings are used inside regulator subnodes. Check
  Documentation/devicetree/bindings/regulator/regulator.txt
for more details.

Example:

	pmic@66 {
		compatible = "maxim,max8998-pmic";
		reg = <0x66>;
		interrupt-parent = <&wakeup_eint>;
		interrupts = <4 0>, <3 0>;

		/* Buck 1 DVS settings */
		max8998,pmic-buck1-default-dvs-idx = <0>;
		max8998,pmic-buck1-dvs-gpios = <&gpx0 0 1 0 0>, /* SET1 */
					       <&gpx0 1 1 0 0>; /* SET2 */
		max8998,pmic-buck1-dvs-voltage = <1350000>, <1300000>,
						 <1000000>, <950000>;

		/* Buck 2 DVS settings */
		max8998,pmic-buck2-default-dvs-idx = <0>;
		max8998,pmic-buck2-dvs-gpio = <&gpx0 0 3 0 0>; /* SET3 */
		max8998,pmic-buck2-dvs-voltage = <1350000>, <1300000>;

		/* Regulators to instantiate */
		regulators {
			ldo2_reg: LDO2 {
				regulator-name = "VDD_ALIVE_1.1V";
				regulator-min-microvolt = <1100000>;
				regulator-max-microvolt = <1100000>;
				regulator-always-on;
			};

			buck1_reg: BUCK1 {
				regulator-name = "VDD_ARM_1.2V";
				regulator-min-microvolt = <950000>;
				regulator-max-microvolt = <1350000>;
				regulator-always-on;
				regulator-boot-on;
			};
		};
	};
```

## Documentation/devicetree/bindings/mfd/maxim,max14577.yaml
```yaml
# SPDX-License-Identifier: GPL-2.0-only
%YAML 1.2
---
$id: http://devicetree.org/schemas/mfd/maxim,max14577.yaml#
$schema: http://devicetree.org/meta-schemas/core.yaml#

title: Maxim MAX14577/MAX77836 MicroUSB and Companion Power Management IC

maintainers:
  - Krzysztof Kozlowski <krzysztof.kozlowski@canonical.com>

description: |
  This is a part of device tree bindings for Maxim MAX14577/MAX77836 MicroUSB
  Integrated Circuit (MUIC).

  The Maxim MAX14577 is a MicroUSB and Companion Power Management IC which
  includes voltage safeout regulators, charger and MicroUSB management IC.

  The Maxim MAX77836 is a MicroUSB and Companion Power Management IC which
  includes voltage safeout and LDO regulators, charger, fuel-gauge and MicroUSB
  management IC.

properties:
  compatible:
    enum:
      - maxim,max14577
      - maxim,max77836

  interrupts:
    maxItems: 1

  reg:
    maxItems: 1

  wakeup-source: true

  charger:
    $ref: /schemas/power/supply/maxim,max14577.yaml

  extcon:
    type: object
    properties:
      compatible:
        enum:
          - maxim,max14577-muic
          - maxim,max77836-muic

    required:
      - compatible

  regulators:
    $ref: /schemas/regulator/maxim,max14577.yaml

required:
  - compatible
  - interrupts
  - reg
  - charger

allOf:
  - if:
      properties:
        compatible:
          contains:
            const: maxim,max14577
    then:
      properties:
        charger:
          properties:
            compatible:
              const: maxim,max14577-charger
        extcon:
          properties:
            compatible:
              const: maxim,max14577-muic
        regulator:
          properties:
            compatible:
              const: maxim,max14577-regulator
    else:
      properties:
        charger:
          properties:
            compatible:
              const: maxim,max77836-charger
        extcon:
          properties:
            compatible:
              const: maxim,max77836-muic
        regulator:
          properties:
            compatible:
              const: maxim,max77836-regulator

additionalProperties: false

examples:
  - |
    #include <dt-bindings/interrupt-controller/irq.h>

    i2c {
        #address-cells = <1>;
        #size-cells = <0>;

        pmic@25 {
            compatible = "maxim,max14577";
            reg = <0x25>;
            interrupt-parent = <&gpx1>;
            interrupts = <5 IRQ_TYPE_LEVEL_LOW>;

            extcon {
                compatible = "maxim,max14577-muic";
            };

            regulators {
                compatible = "maxim,max14577-regulator";

                SAFEOUT {
                    regulator-name = "SAFEOUT";
                };

                CHARGER {
                    regulator-name = "CHARGER";
                    regulator-min-microamp = <90000>;
                    regulator-max-microamp = <950000>;
                    regulator-boot-on;
                };
            };

            charger {
                compatible = "maxim,max14577-charger";

                maxim,constant-uvolt = <4350000>;
                maxim,fast-charge-uamp = <450000>;
                maxim,eoc-uamp = <50000>;
                maxim,ovp-uvolt = <6500000>;
            };
        };
    };

  - |
    #include <dt-bindings/interrupt-controller/irq.h>

    i2c {
        #address-cells = <1>;
        #size-cells = <0>;

        pmic@25 {
            compatible = "maxim,max77836";
            interrupt-parent = <&gpx1>;
            interrupts = <5 IRQ_TYPE_NONE>;
            reg = <0x25>;
            wakeup-source;

            extcon {
                compatible = "maxim,max77836-muic";
            };

            regulators {
                compatible = "maxim,max77836-regulator";

                SAFEOUT {
                    regulator-name = "SAFEOUT";
                };

                CHARGER {
                    regulator-name = "CHARGER";
                    regulator-min-microamp = <45000>;
                    regulator-max-microamp = <475000>;
                    regulator-boot-on;
                };

                LDO1 {
                    regulator-name = "MOT_2.7V";
                    regulator-min-microvolt = <1100000>;
                    regulator-max-microvolt = <2700000>;
                };

                LDO2 {
                    regulator-name = "UNUSED_LDO2";
                    regulator-min-microvolt = <800000>;
                    regulator-max-microvolt = <3950000>;
                };
            };

            charger {
                compatible = "maxim,max77836-charger";

                maxim,constant-uvolt = <4350000>;
                maxim,fast-charge-uamp = <225000>;
                maxim,eoc-uamp = <7500>;
                maxim,ovp-uvolt = <6500000>;
            };
        };
    };
```

## Documentation/devicetree/bindings/mfd/maxim,max5970.yaml
```yaml
# SPDX-License-Identifier: (GPL-2.0 OR BSD-2-Clause)
%YAML 1.2
---
$id: http://devicetree.org/schemas/mfd/maxim,max5970.yaml#
$schema: http://devicetree.org/meta-schemas/core.yaml#

title: Regulator for MAX5970 Smart Switch from Maxim Integrated

maintainers:
  - Patrick Rudolph <patrick.rudolph@9elements.com>

description: |
  The smart switch provides no output regulation, but independent fault protection
  and voltage and current sensing.
  Programming is done through I2C bus.

  Datasheets:
    https://datasheets.maximintegrated.com/en/ds/MAX5970.pdf
    https://datasheets.maximintegrated.com/en/ds/MAX5978.pdf

properties:
  compatible:
    enum:
      - maxim,max5970
      - maxim,max5978

  reg:
    maxItems: 1

  interrupts:
    maxItems: 1

  leds:
    type: object
    description:
      Properties for four LEDS.

    properties:
      "#address-cells":
        const: 1

      "#size-cells":
        const: 0

    patternProperties:
      "^led@[0-3]$":
        $ref: /schemas/leds/common.yaml#
        unevaluatedProperties: false
        type: object

        properties:
          reg:
            maximum: 3

    additionalProperties: false

  vss1-supply:
    description: Supply of the first channel.

  vss2-supply:
    description: Supply of the second channel.

  regulators:
    type: object
    description:
      Properties for both hot swap control/switch.

    patternProperties:
      "^sw[0-1]$":
        $ref: /schemas/regulator/regulator.yaml#
        type: object
        properties:
          shunt-resistor-micro-ohms:
            description: |
              The value of current sense resistor in microohms.

        required:
          - shunt-resistor-micro-ohms

        unevaluatedProperties: false

    additionalProperties: false

required:
  - compatible
  - reg
  - regulators
  - vss1-supply

allOf:
  - if:
      properties:
        compatible:
          enum:
            - maxim,max5970
    then:
      required:
        - vss2-supply

additionalProperties: false

examples:
  - |
    i2c {
        #address-cells = <1>;
        #size-cells = <0>;
        regulator@3a {
            compatible = "maxim,max5978";
            reg = <0x3a>;
            vss1-supply = <&p3v3>;

            regulators {
                sw0_ref_0: sw0 {
                    shunt-resistor-micro-ohms = <12000>;
                };
            };

            leds {
                #address-cells = <1>;
                #size-cells = <0>;
                led@0 {
                    reg = <0>;
                    label = "led0";
                    default-state = "on";
                };
                led@1 {
                    reg = <1>;
                    label = "led1";
                    default-state = "on";
                };
            };
        };
    };

  - |
    i2c {
        #address-cells = <1>;
        #size-cells = <0>;

        regulator@3a {
            compatible = "maxim,max5970";
            reg = <0x3a>;
            vss1-supply = <&p3v3>;
            vss2-supply = <&p5v>;

            regulators {
                sw0_ref_1: sw0 {
                    shunt-resistor-micro-ohms = <12000>;
                };
                sw1_ref_1: sw1 {
                    shunt-resistor-micro-ohms = <10000>;
                };
            };
        };
    };
...
```
