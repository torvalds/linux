## Documentation/devicetree/bindings/mfd/mediatek,mt6357.yaml
```yaml
# SPDX-License-Identifier: GPL-2.0-only OR BSD-2-Clause
%YAML 1.2
---
$id: http://devicetree.org/schemas/mfd/mediatek,mt6357.yaml#
$schema: http://devicetree.org/meta-schemas/core.yaml#

title: MediaTek MT6357 PMIC

maintainers:
  - Flora Fu <flora.fu@mediatek.com>
  - Alexandre Mergnat <amergnat@baylibre.com>

description: |
  MT6357 is a power management system chip containing 5 buck
  converters and 29 LDOs. Supported features are audio codec,
  USB battery charging, fuel gauge, RTC

  This is a multifunction device with the following sub modules:
  - Regulator
  - RTC
  - Keys

  It is interfaced to host controller using SPI interface by a proprietary hardware
  called PMIC wrapper or pwrap. This MFD is a child device of pwrap.
  See the following for pwrap node definitions:
  Documentation/devicetree/bindings/soc/mediatek/mediatek,pwrap.yaml

properties:
  compatible:
    const: mediatek,mt6357

  interrupts:
    maxItems: 1

  interrupt-controller: true

  "#interrupt-cells":
    const: 2

  regulators:
    type: object
    $ref: /schemas/regulator/mediatek,mt6357-regulator.yaml
    description:
      List of MT6357 BUCKs and LDOs regulators.

  rtc:
    type: object
    $ref: /schemas/rtc/rtc.yaml#
    description:
      MT6357 Real Time Clock.
    properties:
      compatible:
        const: mediatek,mt6357-rtc
      start-year: true
    required:
      - compatible

  keys:
    type: object
    $ref: /schemas/input/mediatek,pmic-keys.yaml
    description:
      MT6357 power and home keys.

required:
  - compatible
  - regulators

additionalProperties: false

examples:
  - |
    #include <dt-bindings/interrupt-controller/arm-gic.h>

    pwrap {
        pmic {
            compatible = "mediatek,mt6357";

            interrupt-parent = <&pio>;
            interrupts = <145 IRQ_TYPE_LEVEL_HIGH>;
            interrupt-controller;
            #interrupt-cells = <2>;

            regulators {
                mt6357_vproc_reg: buck-vproc {
                    regulator-name = "vproc";
                    regulator-min-microvolt = <518750>;
                    regulator-max-microvolt = <1312500>;
                    regulator-ramp-delay = <6250>;
                    regulator-enable-ramp-delay = <220>;
                    regulator-always-on;
                };

                // ...

                mt6357_vusb33_reg: ldo-vusb33 {
                    regulator-name = "vusb33";
                    regulator-min-microvolt = <3000000>;
                    regulator-max-microvolt = <3100000>;
                    regulator-enable-ramp-delay = <264>;
                };
            };

            rtc {
                compatible = "mediatek,mt6357-rtc";
            };

            keys {
                compatible = "mediatek,mt6357-keys";
            };
        };
    };
```

## Documentation/devicetree/bindings/mfd/mediatek,mt6360.yaml
```yaml
# SPDX-License-Identifier: (GPL-2.0 OR BSD-2-Clause)
%YAML 1.2
---
$id: http://devicetree.org/schemas/mfd/mediatek,mt6360.yaml#
$schema: http://devicetree.org/meta-schemas/core.yaml#

title: MT6360 PMIC from MediaTek Integrated

maintainers:
  - Gene Chen <gene_chen@richtek.com>

description: |
  MT6360 is a PMIC device with the following sub modules.
  It is interfaced to host controller using I2C interface.

  This document describes the binding for PMIC device and its sub module.

properties:
  compatible:
    const: mediatek,mt6360

  reg:
    maxItems: 1

  wakeup-source: true

  interrupts:
    maxItems: 1

  interrupt-names:
    const: IRQB

  interrupt-controller: true

  "#interrupt-cells":
    const: 1
    description:
      The first cell is the IRQ number.

  regulators:
    $ref: /schemas/regulator/mt6360-regulator.yaml#

  charger:
    $ref: /schemas/power/supply/mt6360_charger.yaml#

  tcpc:
    $ref: /schemas/usb/mediatek,mt6360-tcpc.yaml#

  led-controller:
    $ref: /schemas/leds/leds-mt6360.yaml#

required:
  - compatible
  - reg
  - interrupts
  - interrupt-controller
  - "#interrupt-cells"

additionalProperties:
  type: object

examples:
  - |
    #include <dt-bindings/interrupt-controller/irq.h>
    #include <dt-bindings/regulator/mediatek,mt6360-regulator.h>
    #include <dt-bindings/leds/common.h>
    #include <dt-bindings/usb/pd.h>
    i2c {
        #address-cells = <1>;
        #size-cells = <0>;

        pmic@34 {
            compatible = "mediatek,mt6360";
            reg = <0x34>;
            wakeup-source;
            interrupts-extended = <&gpio26 0 IRQ_TYPE_LEVEL_LOW>;
            interrupt-names = "IRQB";
            interrupt-controller;
            #interrupt-cells = <1>;

            mt6360_charger: charger {
                compatible = "mediatek,mt6360-chg";
                richtek,vinovp-microvolt = <14500000>;

                otg_vbus_regulator: usb-otg-vbus-regulator {
                    regulator-name = "usb-otg-vbus";
                    regulator-min-microvolt = <4425000>;
                    regulator-max-microvolt = <5825000>;
                };
            };

            led-controller {
                compatible = "mediatek,mt6360-led";
                #address-cells = <1>;
                #size-cells = <0>;

                multi-led@0 {
                    reg = <0>;
                    function = LED_FUNCTION_INDICATOR;
                    color = <LED_COLOR_ID_RGB>;
                    led-max-microamp = <24000>;
                    #address-cells = <1>;
                    #size-cells = <0>;
                    led@0 {
                        reg = <0>;
                        color = <LED_COLOR_ID_RED>;
                    };
                    led@1 {
                        reg = <1>;
                        color = <LED_COLOR_ID_GREEN>;
                    };
                    led@2 {
                        reg = <2>;
                        color = <LED_COLOR_ID_BLUE>;
                    };
                };
                led@3 {
                    reg = <3>;
                    function = LED_FUNCTION_INDICATOR;
                    color = <LED_COLOR_ID_WHITE>;
                    led-max-microamp = <150000>;
                };
                led@4 {
                    reg = <4>;
                    function = LED_FUNCTION_FLASH;
                    color = <LED_COLOR_ID_WHITE>;
                    function-enumerator = <1>;
                    led-max-microamp = <200000>;
                    flash-max-microamp = <500000>;
                    flash-max-timeout-us = <1024000>;
                };
                led@5 {
                    reg = <5>;
                    function = LED_FUNCTION_FLASH;
                    color = <LED_COLOR_ID_WHITE>;
                    function-enumerator = <2>;
                    led-max-microamp = <200000>;
                    flash-max-microamp = <500000>;
                    flash-max-timeout-us = <1024000>;
                };
            };

            regulators {
                compatible = "mediatek,mt6360-regulator";
                LDO_VIN3-supply = <&BUCK2>;
                buck1 {
                    regulator-name = "mt6360,buck1";
                    regulator-min-microvolt = <300000>;
                    regulator-max-microvolt = <1300000>;
                    regulator-allowed-modes = <MT6360_OPMODE_NORMAL
                         MT6360_OPMODE_LP
                         MT6360_OPMODE_ULP>;
                };
                BUCK2: buck2 {
                    regulator-name = "mt6360,buck2";
                    regulator-min-microvolt = <300000>;
                    regulator-max-microvolt = <1300000>;
                    regulator-allowed-modes = <MT6360_OPMODE_NORMAL
                         MT6360_OPMODE_LP
                         MT6360_OPMODE_ULP>;
                };
                ldo6 {
                    regulator-name = "mt6360,ldo6";
                    regulator-min-microvolt = <500000>;
                    regulator-max-microvolt = <2100000>;
                    regulator-allowed-modes = <MT6360_OPMODE_NORMAL
                         MT6360_OPMODE_LP>;
                };
                ldo7 {
                    regulator-name = "mt6360,ldo7";
                    regulator-min-microvolt = <500000>;
                    regulator-max-microvolt = <2100000>;
                    regulator-allowed-modes = <MT6360_OPMODE_NORMAL
                         MT6360_OPMODE_LP>;
                };
                ldo1 {
                    regulator-name = "mt6360,ldo1";
                    regulator-min-microvolt = <1200000>;
                    regulator-max-microvolt = <3600000>;
                    regulator-allowed-modes = <MT6360_OPMODE_NORMAL
                         MT6360_OPMODE_LP>;
                };
                ldo2 {
                    regulator-name = "mt6360,ldo2";
                    regulator-min-microvolt = <1200000>;
                    regulator-max-microvolt = <3600000>;
                    regulator-allowed-modes = <MT6360_OPMODE_NORMAL
                         MT6360_OPMODE_LP>;
                };
                ldo3 {
                    regulator-name = "mt6360,ldo3";
                    regulator-min-microvolt = <1200000>;
                    regulator-max-microvolt = <3600000>;
                    regulator-allowed-modes = <MT6360_OPMODE_NORMAL
                         MT6360_OPMODE_LP>;
                };
                ldo5 {
                    regulator-name = "mt6360,ldo5";
                    regulator-min-microvolt = <2700000>;
                    regulator-max-microvolt = <3600000>;
                    regulator-allowed-modes = <MT6360_OPMODE_NORMAL
                         MT6360_OPMODE_LP>;
                };
            };

            tcpc {
                compatible = "mediatek,mt6360-tcpc";
                interrupts-extended = <&gpio26 3 IRQ_TYPE_LEVEL_LOW>;
                interrupt-names = "PD_IRQB";

                connector {
                    compatible = "usb-c-connector";
                    label = "USB-C";
                    data-role = "dual";
                    power-role = "dual";
                    try-power-role = "sink";
                    source-pdos = <PDO_FIXED(5000, 1000, PDO_FIXED_DUAL_ROLE | PDO_FIXED_DATA_SWAP)>;
                    sink-pdos = <PDO_FIXED(5000, 2000, PDO_FIXED_DUAL_ROLE | PDO_FIXED_DATA_SWAP)>;
                    op-sink-microwatt = <10000000>;

                    ports {
                        #address-cells = <1>;
                        #size-cells = <0>;

                        port@0 {
                            reg = <0>;
                            endpoint {
                                remote-endpoint = <&usb_hs>;
                            };
                        };
                        port@1 {
                            reg = <1>;
                            endpoint {
                                remote-endpoint = <&usb_ss>;
                          };
                        };
                        port@2 {
                            reg = <2>;
                            endpoint {
                                remote-endpoint = <&dp_aux>;
                            };
                        };
                    };
                };
            };
        };
    };
```
