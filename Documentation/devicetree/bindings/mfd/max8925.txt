## Documentation/devicetree/bindings/mfd/maxim,max7360.yaml
```yaml
# SPDX-License-Identifier: (GPL-2.0-only OR BSD-2-Clause)
%YAML 1.2
---
$id: http://devicetree.org/schemas/mfd/maxim,max7360.yaml#
$schema: http://devicetree.org/meta-schemas/core.yaml#

title: Maxim MAX7360 Keypad, Rotary encoder, PWM and GPIO controller

maintainers:
  - Kamel Bouhara <kamel.bouhara@bootlin.com>
  - Mathieu Dubois-Briand <mathieu.dubois-briand@bootlin.com>

description: |
  Maxim MAX7360 device, with following functions:
    - keypad controller
    - rotary controller
    - GPIO and GPO controller
    - PWM controller

  https://www.analog.com/en/products/max7360.html

allOf:
  - $ref: /schemas/input/matrix-keymap.yaml#
  - $ref: /schemas/input/input.yaml#

properties:
  compatible:
    enum:
      - maxim,max7360

  reg:
    maxItems: 1

  interrupts:
    maxItems: 2

  interrupt-names:
    items:
      - const: inti
      - const: intk

  keypad-debounce-delay-ms:
    description: Keypad debounce delay in ms
    minimum: 9
    maximum: 40
    default: 9

  rotary-debounce-delay-ms:
    description: Rotary encoder debounce delay in ms
    minimum: 0
    maximum: 15
    default: 0

  linux,axis:
    $ref: /schemas/input/rotary-encoder.yaml#/properties/linux,axis

  rotary-encoder,relative-axis:
    $ref: /schemas/types.yaml#/definitions/flag
    description:
      Register a relative axis rather than an absolute one.

  rotary-encoder,steps:
    $ref: /schemas/types.yaml#/definitions/uint32
    default: 24
    description:
      Number of steps in a full turnaround of the
      encoder. Only relevant for absolute axis. Defaults to 24 which is a
      typical value for such devices.

  rotary-encoder,rollover:
    $ref: /schemas/types.yaml#/definitions/flag
    description:
      Automatic rollover when the rotary value becomes
      greater than the specified steps or smaller than 0. For absolute axis only.

  "#pwm-cells":
    const: 3

  gpio:
    $ref: /schemas/gpio/maxim,max7360-gpio.yaml#
    description:
      PORT0 to PORT7 general purpose input/output pins configuration.

  gpo:
    $ref: /schemas/gpio/maxim,max7360-gpio.yaml#
    description: >
      COL2 to COL7 general purpose output pins configuration. Allows to use
      unused keypad columns as outputs.

      The MAX7360 has 8 column lines and 6 of them can be used as GPOs. GPIOs
      numbers used for this gpio-controller node do correspond to the column
      numbers: values 0 and 1 are never valid, values from 2 to 7 might be valid
      depending on the value of the keypad,num-column property.

patternProperties:
  '-pins$':
    type: object
    description:
      Pinctrl node's client devices use subnodes for desired pin configuration.
      Client device subnodes use below standard properties.
    $ref: /schemas/pinctrl/pincfg-node.yaml

    properties:
      pins:
        description:
          List of gpio pins affected by the properties specified in this
          subnode.
        items:
          pattern: '^(PORT[0-7]|ROTARY)$'
        minItems: 1
        maxItems: 8

      function:
        description:
          Specify the alternative function to be configured for the specified
          pins.
        enum: [gpio, pwm, rotary]

    additionalProperties: false

required:
  - compatible
  - reg
  - interrupts
  - interrupt-names
  - linux,keymap
  - linux,axis
  - "#pwm-cells"
  - gpio
  - gpo

unevaluatedProperties: false

examples:
  - |
    #include <dt-bindings/input/input.h>
    #include <dt-bindings/interrupt-controller/arm-gic.h>

    i2c {
      #address-cells = <1>;
      #size-cells = <0>;

      io-expander@38 {
        compatible = "maxim,max7360";
        reg = <0x38>;

        interrupt-parent = <&gpio1>;
        interrupts = <23 IRQ_TYPE_LEVEL_LOW>,
                     <24 IRQ_TYPE_LEVEL_LOW>;
        interrupt-names = "inti", "intk";

        keypad,num-rows = <8>;
        keypad,num-columns = <4>;
        linux,keymap = <
          MATRIX_KEY(0x00, 0x00, KEY_F5)
          MATRIX_KEY(0x01, 0x00, KEY_F4)
          MATRIX_KEY(0x02, 0x01, KEY_F6)
          >;
        keypad-debounce-delay-ms = <10>;
        autorepeat;

        rotary-debounce-delay-ms = <2>;
        linux,axis = <0>; /* REL_X */
        rotary-encoder,relative-axis;

        #pwm-cells = <3>;

        max7360_gpio: gpio {
          compatible = "maxim,max7360-gpio";

          gpio-controller;
          #gpio-cells = <2>;
          maxim,constant-current-disable = <0x06>;

          interrupt-controller;
          #interrupt-cells = <0x2>;
        };

        max7360_gpo: gpo {
          compatible = "maxim,max7360-gpo";

          gpio-controller;
          #gpio-cells = <2>;
        };

        backlight_pins: backlight-pins {
          pins = "PORT2";
          function = "pwm";
        };
      };
    };
```

## Documentation/devicetree/bindings/mfd/maxim,max77686.yaml
```yaml
# SPDX-License-Identifier: GPL-2.0-only OR BSD-2-Clause
%YAML 1.2
---
$id: http://devicetree.org/schemas/mfd/maxim,max77686.yaml#
$schema: http://devicetree.org/meta-schemas/core.yaml#

title: Maxim MAX77686 Power Management IC

maintainers:
  - Chanwoo Choi <cw00.choi@samsung.com>
  - Krzysztof Kozlowski <krzysztof.kozlowski@canonical.com>

description: |
  This is a part of device tree bindings for Maxim MAX77686 Power Management
  Integrated Circuit (PMIC).

  The Maxim MAX77686 is a Power Management IC which includes voltage and
  current regulators, RTC and clock outputs.

  The MAX77686 provides three 32.768khz clock outputs that can be controlled
  (gated/ungated) over I2C.  The clock IDs are defined as preprocessor macros
  in dt-bindings/clock/maxim,max77686.h.

properties:
  compatible:
    const: maxim,max77686

  '#clock-cells':
    const: 1

  interrupts:
    maxItems: 1

  reg:
    maxItems: 1

  voltage-regulators:
    $ref: ../regulator/maxim,max77686.yaml
    description:
      List of child nodes that specify the regulators.

  wakeup-source: true

required:
  - compatible
  - '#clock-cells'
  - reg

additionalProperties: false

examples:
  - |
    #include <dt-bindings/gpio/gpio.h>
    #include <dt-bindings/interrupt-controller/irq.h>

    i2c {
        #address-cells = <1>;
        #size-cells = <0>;

        max77686: pmic@9 {
            compatible = "maxim,max77686";
            reg = <0x09>;

            interrupt-parent = <&gpx0>;
            interrupts = <7 IRQ_TYPE_LEVEL_LOW>;
            pinctrl-0 = <&max77686_irq>;
            pinctrl-names = "default";
            wakeup-source;
            #clock-cells = <1>;

            voltage-regulators {
                LDO1 {
                    regulator-name = "VALIVE_1.0V_AP";
                    regulator-min-microvolt = <1000000>;
                    regulator-max-microvolt = <1000000>;
                    regulator-always-on;
                };

                LDO2 {
                    regulator-name = "VM1M2_1.2V_AP";
                    regulator-min-microvolt = <1200000>;
                    regulator-max-microvolt = <1200000>;
                    regulator-always-on;
                    regulator-state-mem {
                        regulator-on-in-suspend;
                    };
                };

                // ...

                LDO22 {
                    regulator-name = "VMEM_VDD_2.8V";
                    regulator-min-microvolt = <2800000>;
                    regulator-max-microvolt = <2800000>;
                    maxim,ena-gpios = <&gpk0 2 GPIO_ACTIVE_HIGH>;
                };

                // ...

                BUCK1 {
                    regulator-name = "VDD_MIF";
                    regulator-min-microvolt = <850000>;
                    regulator-max-microvolt = <1100000>;
                    regulator-always-on;
                    regulator-boot-on;
                    regulator-state-mem {
                        regulator-off-in-suspend;
                    };
                };

                BUCK2 {
                    regulator-name = "VDD_ARM";
                    regulator-min-microvolt = <850000>;
                    regulator-max-microvolt = <1500000>;
                    regulator-always-on;
                    regulator-boot-on;
                    regulator-state-mem {
                        regulator-on-in-suspend;
                    };
                };

                // ...

                BUCK9 {
                    regulator-name = "CAM_ISP_CORE_1.2V";
                    regulator-min-microvolt = <1000000>;
                    regulator-max-microvolt = <1200000>;
                    maxim,ena-gpios = <&gpm0 3 GPIO_ACTIVE_HIGH>;
                };
            };
        };
    };
```

## Documentation/devicetree/bindings/mfd/maxim,max77693.yaml
```yaml
# SPDX-License-Identifier: GPL-2.0-only
%YAML 1.2
---
$id: http://devicetree.org/schemas/mfd/maxim,max77693.yaml#
$schema: http://devicetree.org/meta-schemas/core.yaml#

title: Maxim MAX77693 MicroUSB and Companion Power Management IC

maintainers:
  - Chanwoo Choi <cw00.choi@samsung.com>
  - Krzysztof Kozlowski <krzk@kernel.org>

description: |
  This is a part of device tree bindings for Maxim MAX77693 MicroUSB
  Integrated Circuit (MUIC).

  The Maxim MAX77693 is a MicroUSB and Companion Power Management IC which
  includes voltage current regulators, charger, LED/flash, haptic motor driver
  and MicroUSB management IC.

properties:
  compatible:
    const: maxim,max77693

  interrupts:
    maxItems: 1

  reg:
    maxItems: 1

  charger:
    $ref: /schemas/power/supply/maxim,max77693.yaml

  led:
    $ref: /schemas/leds/maxim,max77693.yaml

  max77693-muic:
    type: object
    additionalProperties: false
    deprecated: true

    properties:
      compatible:
        const: maxim,max77693-muic

    required:
      - compatible

  muic:
    type: object
    additionalProperties: false

    properties:
      compatible:
        const: maxim,max77693-muic

      connector:
        $ref: /schemas/connector/usb-connector.yaml#
        unevaluatedProperties: false

    required:
      - compatible

  motor-driver:
    type: object
    additionalProperties: false

    properties:
      compatible:
        const: maxim,max77693-haptic

      haptic-supply:
        description: Power supply to the haptic motor

      pwms:
        maxItems: 1

    required:
      - compatible
      - haptic-supply
      - pwms

  regulators:
    $ref: /schemas/regulator/maxim,max77693.yaml
    description:
      List of child nodes that specify the regulators.

required:
  - compatible
  - interrupts
  - reg

additionalProperties: false

examples:
  - |
    #include <dt-bindings/interrupt-controller/irq.h>
    #include <dt-bindings/leds/common.h>

    i2c {
        #address-cells = <1>;
        #size-cells = <0>;

        pmic@66 {
            compatible = "maxim,max77693";
            reg = <0x66>;
            interrupt-parent = <&gpx1>;
            interrupts = <5 IRQ_TYPE_LEVEL_LOW>;

            regulators {
                ESAFEOUT1 {
                    regulator-name = "ESAFEOUT1";
                };

                ESAFEOUT2 {
                    regulator-name = "ESAFEOUT2";
                };

                CHARGER {
                    regulator-name = "CHARGER";
                    regulator-min-microamp = <60000>;
                    regulator-max-microamp = <2580000>;
                };
            };

            muic {
                compatible = "maxim,max77693-muic";

                connector {
                    compatible = "samsung,usb-connector-11pin",
                                 "usb-b-connector";
                    label = "micro-USB";
                    type = "micro";

                    ports {
                        #address-cells = <1>;
                        #size-cells = <0>;

                        port@0 {
                            reg = <0>;

                            muic_to_usb: endpoint {
                                remote-endpoint = <&usb_to_muic>;
                            };
                        };

                        port@3 {
                            reg = <3>;

                            muic_to_mhl: endpoint {
                                remote-endpoint = <&mhl_to_muic>;
                            };
                        };
                    };
                };
            };

            motor-driver {
                compatible = "maxim,max77693-haptic";
                haptic-supply = <&ldo26_reg>;
                pwms = <&pwm 0 38022 0>;
            };

            charger {
                compatible = "maxim,max77693-charger";

                maxim,constant-microvolt = <4350000>;
                maxim,min-system-microvolt = <3600000>;
                maxim,thermal-regulation-celsius = <100>;
                maxim,battery-overcurrent-microamp = <3500000>;
                maxim,charge-input-threshold-microvolt = <4300000>;
            };

            led {
                compatible = "maxim,max77693-led";
                maxim,boost-mode = <LEDS_BOOST_FIXED>;
                maxim,boost-mvout = <5000>;
                maxim,mvsys-min = <2400>;

                flash-led {
                    label = "max77693-flash";
                    function = LED_FUNCTION_FLASH;
                    color = <LED_COLOR_ID_WHITE>;
                    led-sources = <0>, <1>;
                    led-max-microamp = <500000>;
                    flash-max-microamp = <1250000>;
                    flash-max-timeout-us = <1000000>;
                };
            };
        };
    };
```
