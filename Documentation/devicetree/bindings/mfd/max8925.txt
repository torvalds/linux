## Documentation/devicetree/bindings/mfd/mediatek,mt8195-scpsys.yaml
```yaml
# SPDX-License-Identifier: GPL-2.0-only OR BSD-2-Clause
%YAML 1.2
---
$id: http://devicetree.org/schemas/mfd/mediatek,mt8195-scpsys.yaml#
$schema: http://devicetree.org/meta-schemas/core.yaml#

title: MediaTek System Control Processor System

maintainers:
  - MandyJH Liu <mandyjh.liu@mediatek.com>

description:
  MediaTek System Control Processor System (SCPSYS) has several
  power management tasks. The tasks include MTCMOS power
  domain control, thermal measurement, DVFS, etc.

properties:
  compatible:
    items:
      - enum:
          - mediatek,mt8167-scpsys
          - mediatek,mt8173-scpsys
          - mediatek,mt8183-scpsys
          - mediatek,mt8186-scpsys
          - mediatek,mt8188-scpsys
          - mediatek,mt8192-scpsys
          - mediatek,mt8195-scpsys
          - mediatek,mt8365-scpsys
      - const: syscon
      - const: simple-mfd

  reg:
    maxItems: 1

  power-controller:
    $ref: /schemas/power/mediatek,power-controller.yaml#

required:
  - compatible
  - reg

additionalProperties: false

examples:
  - |
    #include <dt-bindings/clock/mt8195-clk.h>
    #include <dt-bindings/power/mt8195-power.h>

    syscon@10006000 {
      compatible = "mediatek,mt8195-scpsys", "syscon", "simple-mfd";
      reg = <0x10006000 0x100>;

      spm: power-controller {
        compatible = "mediatek,mt8195-power-controller";
        #address-cells = <1>;
        #size-cells = <0>;
        #power-domain-cells = <1>;

        /* sample of power domain nodes */
        power-domain@MT8195_POWER_DOMAIN_PCIE_PHY {
          reg = <MT8195_POWER_DOMAIN_PCIE_PHY>;
          #power-domain-cells = <0>;
        };

        power-domain@MT8195_POWER_DOMAIN_SSUSB_PCIE_PHY {
          reg = <MT8195_POWER_DOMAIN_SSUSB_PCIE_PHY>;
          #power-domain-cells = <0>;
        };
      };
    };
```

## Documentation/devicetree/bindings/mfd/mfd.txt
```
Multi-Function Devices (MFD)

These devices comprise a nexus for heterogeneous hardware blocks containing
more than one non-unique yet varying hardware functionality.

A typical MFD can be:

- A mixed signal ASIC on an external bus, sometimes a PMIC (Power Management
  Integrated Circuit) that is manufactured in a lower technology node (rough
  silicon) that handles analog drivers for things like audio amplifiers, LED
  drivers, level shifters, PHY (physical interfaces to things like USB or
  ethernet), regulators etc.

- A range of memory registers containing "miscellaneous system registers" also
  known as a system controller "syscon" or any other memory range containing a
  mix of unrelated hardware devices.

Optional properties:

- compatible : "simple-mfd" - this signifies that the operating system should
  consider all subnodes of the MFD device as separate devices akin to how
  "simple-bus" indicates when to see subnodes as children for a simple
  memory-mapped bus. For more complex devices, when the nexus driver has to
  probe registers to figure out what child devices exist etc, this should not
  be used. In the latter case the child devices will be determined by the
  operating system.

- ranges: Describes the address mapping relationship to the parent. Should set
  the child's base address to 0, the physical address within parent's address
  space, and the length of the address map.

- #address-cells: Specifies the number of cells used to represent physical base
  addresses. Must be present if ranges is used.

- #size-cells: Specifies the number of cells used to represent the size of an
  address. Must be present if ranges is used.

Example:

foo@1000 {
	compatible = "syscon", "simple-mfd";
	reg = <0x01000 0x1000>;

	led@8.0 {
		compatible = "register-bit-led";
		offset = <0x08>;
		mask = <0x01>;
		label = "myled";
		default-state = "on";
	};
};
```

## Documentation/devicetree/bindings/mfd/motorola-cpcap.txt
```
Motorola CPCAP PMIC device tree binding

Required properties:
- compatible		: One or both of "motorola,cpcap" or "ste,6556002"
- reg			: SPI chip select
- interrupt-parent	: The parent interrupt controller
- interrupts		: The interrupt line the device is connected to
- interrupt-controller	: Marks the device node as an interrupt controller
- #interrupt-cells	: The number of cells to describe an IRQ, should be 2
- #address-cells	: Child device offset number of cells, should be 1
- #size-cells		: Child device size number of cells, should be 0
- spi-max-frequency	: Typically set to 3000000
- spi-cs-high		: SPI chip select direction

Optional subnodes:

The sub-functions of CPCAP get their own node with their own compatible values,
which are described in the following files:

- ../power/supply/cpcap-battery.txt
- ../power/supply/cpcap-charger.txt
- ../regulator/cpcap-regulator.txt
- ../phy/phy-cpcap-usb.txt
- ../input/cpcap-pwrbutton.txt
- ../rtc/cpcap-rtc.txt
- ../leds/leds-cpcap.txt
- ../iio/adc/cpcap-adc.txt

The only exception is the audio codec. Instead of a compatible value its
node must be named "audio-codec".

Required properties for the audio-codec subnode:

- #sound-dai-cells = <1>;

The audio-codec provides two DAIs. The first one is connected to the
Stereo HiFi DAC and the second one is connected to the Voice DAC.

Example:

&mcspi1 {
	cpcap: pmic@0 {
		compatible = "motorola,cpcap", "ste,6556002";
		reg = <0>;	/* cs0 */
		interrupt-parent = <&gpio1>;
		interrupts = <7 IRQ_TYPE_EDGE_RISING>;
		interrupt-controller;
		#interrupt-cells = <2>;
		#address-cells = <1>;
		#size-cells = <0>;
		spi-max-frequency = <3000000>;
		spi-cs-high;

		audio-codec {
			#sound-dai-cells = <1>;

			/* HiFi */
			port@0 {
				endpoint {
					remote-endpoint = <&cpu_dai1>;
				};
			};

			/* Voice */
			port@1 {
				endpoint {
					remote-endpoint = <&cpu_dai2>;
				};
			};
		};
	};
};
```

## Documentation/devicetree/bindings/mfd/mps,mp2629.yaml
```yaml
# SPDX-License-Identifier: GPL-2.0-only OR BSD-2-Clause
%YAML 1.2
---
$id: http://devicetree.org/schemas/mfd/mps,mp2629.yaml#
$schema: http://devicetree.org/meta-schemas/core.yaml#

title: MP2629 Battery Charger PMIC from Monolithic Power System.

maintainers:
  - Saravanan Sekar <sravanhome@gmail.com>

description: |
  MP2629 is a PMIC providing battery charging and power supply for smartphones,
  wireless camera and portable devices. Chip is controlled over I2C.

  The battery charge management device handles battery charger controller and
  ADC IIO device for battery, system voltage

properties:
  compatible:
    enum:
      - mps,mp2629
      - mps,mp2733

  reg:
    maxItems: 1

  interrupts:
    maxItems: 1

  interrupt-controller: true

  "#interrupt-cells":
    const: 2
    description:
      The first cell is the IRQ number, the second cell is the trigger type.

required:
  - compatible
  - reg
  - interrupts
  - interrupt-controller
  - "#interrupt-cells"

additionalProperties: false

examples:
  - |
    #include <dt-bindings/interrupt-controller/irq.h>
    #include <dt-bindings/input/linux-event-codes.h>
    i2c {
        #address-cells = <1>;
        #size-cells = <0>;

        pmic@4b {
            compatible = "mps,mp2629";
            reg = <0x4b>;

            interrupt-controller;
            interrupt-parent = <&gpio2>;
            #interrupt-cells = <2>;
            interrupts = <3 IRQ_TYPE_LEVEL_HIGH>;
        };
    };
```

## Documentation/devicetree/bindings/mfd/mscc,ocelot.yaml
```yaml
# SPDX-License-Identifier: GPL-2.0 OR BSD-2-Clause */
%YAML 1.2
---
$id: http://devicetree.org/schemas/mfd/mscc,ocelot.yaml#
$schema: http://devicetree.org/meta-schemas/core.yaml#

title: Ocelot Externally-Controlled Ethernet Switch

maintainers:
  - Colin Foster <colin.foster@in-advantage.com>

description: |
  The Ocelot ethernet switch family contains chips that have an internal CPU
  (VSC7513, VSC7514) and chips that don't (VSC7511, VSC7512). All switches have
  the option to be controlled externally via external interfaces like SPI or
  PCIe.

  The switch family is a multi-port networking switch that supports many
  interfaces. Additionally, the device can perform pin control, MDIO buses, and
  external GPIO expanders.

properties:
  compatible:
    enum:
      - mscc,vsc7512

  reg:
    maxItems: 1

  "#address-cells":
    const: 1

  "#size-cells":
    const: 1

  spi-max-frequency:
    maxItems: 1

patternProperties:
  "^pinctrl@[0-9a-f]+$":
    type: object
    $ref: /schemas/pinctrl/mscc,ocelot-pinctrl.yaml

  "^gpio@[0-9a-f]+$":
    type: object
    $ref: /schemas/pinctrl/microchip,sparx5-sgpio.yaml
    properties:
      compatible:
        enum:
          - mscc,ocelot-sgpio

  "^mdio@[0-9a-f]+$":
    type: object
    $ref: /schemas/net/mscc,miim.yaml
    properties:
      compatible:
        enum:
          - mscc,ocelot-miim

required:
  - compatible
  - reg
  - '#address-cells'
  - '#size-cells'

additionalProperties: false

examples:
  - |
    ocelot_clock: ocelot-clock {
          compatible = "fixed-clock";
          #clock-cells = <0>;
          clock-frequency = <125000000>;
      };

    spi {
        #address-cells = <1>;
        #size-cells = <0>;

        soc@0 {
            compatible = "mscc,vsc7512";
            spi-max-frequency = <2500000>;
            reg = <0>;
            #address-cells = <1>;
            #size-cells = <1>;

            mdio@7107009c {
                compatible = "mscc,ocelot-miim";
                #address-cells = <1>;
                #size-cells = <0>;
                reg = <0x7107009c 0x24>;

                sw_phy0: ethernet-phy@0 {
                    reg = <0x0>;
                };
            };

            mdio@710700c0 {
                compatible = "mscc,ocelot-miim";
                pinctrl-names = "default";
                pinctrl-0 = <&miim1_pins>;
                #address-cells = <1>;
                #size-cells = <0>;
                reg = <0x710700c0 0x24>;

                sw_phy4: ethernet-phy@4 {
                    reg = <0x4>;
                };
            };

            gpio: pinctrl@71070034 {
                compatible = "mscc,ocelot-pinctrl";
                gpio-controller;
                #gpio-cells = <2>;
                gpio-ranges = <&gpio 0 0 22>;
                reg = <0x71070034 0x6c>;

                sgpio_pins: sgpio-pins {
                    pins = "GPIO_0", "GPIO_1", "GPIO_2", "GPIO_3";
                    function = "sg0";
                };

                miim1_pins: miim1-pins {
                    pins = "GPIO_14", "GPIO_15";
                    function = "miim";
                };
            };

            gpio@710700f8 {
                compatible = "mscc,ocelot-sgpio";
                #address-cells = <1>;
                #size-cells = <0>;
                bus-frequency = <12500000>;
                clocks = <&ocelot_clock>;
                microchip,sgpio-port-ranges = <0 15>;
                pinctrl-names = "default";
                pinctrl-0 = <&sgpio_pins>;
                reg = <0x710700f8 0x100>;

                sgpio_in0: gpio@0 {
                    compatible = "microchip,sparx5-sgpio-bank";
                    reg = <0>;
                    gpio-controller;
                    #gpio-cells = <3>;
                    ngpios = <64>;
                };

                sgpio_out1: gpio@1 {
                    compatible = "microchip,sparx5-sgpio-bank";
                    reg = <1>;
                    gpio-controller;
                    #gpio-cells = <3>;
                    ngpios = <64>;
                };
            };
        };
    };

...
```

## Documentation/devicetree/bindings/mfd/mt6397.txt
```
MediaTek MT6397/MT6323 Multifunction Device Driver

MT6397/MT6323 is a multifunction device with the following sub modules:
- Regulator
- RTC
- Audio codec
- GPIO
- Clock
- LED
- Keys
- Power controller

It is interfaced to host controller using SPI interface by a proprietary hardware
called PMIC wrapper or pwrap. MT6397/MT6323 MFD is a child device of pwrap.
See the following for pwarp node definitions:
../soc/mediatek/pwrap.txt

This document describes the binding for MFD device and its sub module.

Required properties:
compatible:
	"mediatek,mt6323" for PMIC MT6323
	"mediatek,mt6331" for PMIC MT6331 and MT6332
	"mediatek,mt6357" for PMIC MT6357
	"mediatek,mt6358" for PMIC MT6358
	"mediatek,mt6359" for PMIC MT6359
	"mediatek,mt6366", "mediatek,mt6358" for PMIC MT6366
	"mediatek,mt6397" for PMIC MT6397

Optional subnodes:

- rtc
	Required properties: Should be one of follows
		- compatible: "mediatek,mt6323-rtc"
		- compatible: "mediatek,mt6331-rtc"
		- compatible: "mediatek,mt6358-rtc"
		- compatible: "mediatek,mt6397-rtc"
	For details, see ../rtc/rtc-mt6397.txt
- regulators
	Required properties:
		- compatible: "mediatek,mt6323-regulator"
	see ../regulator/mt6323-regulator.txt
		- compatible: "mediatek,mt6358-regulator"
		- compatible: "mediatek,mt6366-regulator", "mediatek-mt6358-regulator"
	see ../regulator/mt6358-regulator.txt
		- compatible: "mediatek,mt6397-regulator"
	see ../regulator/mt6397-regulator.txt
- codec
	Required properties:
		- compatible: "mediatek,mt6397-codec" or "mediatek,mt6358-sound"
- clk
	Required properties:
		- compatible: "mediatek,mt6397-clk"
- led
	Required properties:
		- compatible: "mediatek,mt6323-led"
	see ../leds/leds-mt6323.txt

- keys
	Required properties: Should be one of the following
		- compatible: "mediatek,mt6323-keys"
		- compatible: "mediatek,mt6331-keys"
		- compatible: "mediatek,mt6397-keys"
	see ../input/mtk-pmic-keys.txt

- power-controller
	Required properties:
		- compatible: "mediatek,mt6323-pwrc"
	For details, see ../power/reset/mt6323-poweroff.txt

- pin-controller
	Required properties:
		- compatible: "mediatek,mt6397-pinctrl"
	For details, see ../pinctrl/pinctrl-mt65xx.txt

Example:
	pwrap: pwrap@1000f000 {
		compatible = "mediatek,mt8135-pwrap";

		...

		pmic {
			compatible = "mediatek,mt6397";

			codec: mt6397codec {
				compatible = "mediatek,mt6397-codec";
			};

			regulators {
				compatible = "mediatek,mt6397-regulator";

				mt6397_vpca15_reg: buck_vpca15 {
					regulator-compatible = "buck_vpca15";
					regulator-name = "vpca15";
					regulator-min-microvolt = <850000>;
					regulator-max-microvolt = <1400000>;
					regulator-ramp-delay = <12500>;
					regulator-always-on;
				};

				mt6397_vgp4_reg: ldo_vgp4 {
					regulator-compatible = "ldo_vgp4";
					regulator-name = "vgp4";
					regulator-min-microvolt = <1200000>;
					regulator-max-microvolt = <3300000>;
					regulator-enable-ramp-delay = <218>;
				};
			};
		};
	};
```
