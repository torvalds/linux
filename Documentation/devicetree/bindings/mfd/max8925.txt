## Documentation/devicetree/bindings/mfd/maxim,max8998.yaml
```yaml
# SPDX-License-Identifier: GPL-2.0-only OR BSD-2-Clause
%YAML 1.2
---
$id: http://devicetree.org/schemas/mfd/maxim,max8998.yaml#
$schema: http://devicetree.org/meta-schemas/core.yaml#

title: Maxim MAX8998, National/TI LP3974 Power Management IC

maintainers:
  - Krzysztof Kozlowski <krzk@kernel.org>

description:
  The Maxim MAX8998 is a Power Management IC which includes voltage/current
  regulators, real time clock, battery charging controller and several other
  sub-blocks. It is interfaced using an I2C interface. Each sub-block is
  addressed by the host system using different i2c slave address.

properties:
  compatible:
    enum:
      - maxim,max8998
      - national,lp3974
      - ti,lp3974

  reg:
    maxItems: 1

  interrupts:
    minItems: 1
    items:
      - description: Main interrupt
      - description: Power-on/-off interrupt

  max8998,pmic-buck1-dvs-gpios:
    maxItems: 2
    description:
      Two host gpios used for buck1 DVS.

  max8998,pmic-buck2-dvs-gpio:
    maxItems: 1
    description:
      Host gpio used for buck2 DVS.

  max8998,pmic-buck1-default-dvs-idx:
    $ref: /schemas/types.yaml#/definitions/uint32
    enum: [0, 1, 2, 3]
    default: 0
    description:
      Default voltage setting selected from the possible 4 options selectable
      by the DVS gpios.

  max8998,pmic-buck2-default-dvs-idx:
    $ref: /schemas/types.yaml#/definitions/uint32
    enum: [0, 1]
    default: 0
    description:
      Default voltage setting selected from the possible 2 options selectable
      by the DVS GPIOs.

  max8998,pmic-buck-voltage-lock:
    type: boolean
    description:
      If present, disallows changing of preprogrammed buck DVS voltages.

  max8998,pmic-buck1-dvs-voltage:
    $ref: /schemas/types.yaml#/definitions/uint32-array
    maxItems: 4
    description:
      Four voltage values in microvolts for buck1 regulator that can be
      selected using DVS GPIO.

  max8998,pmic-buck2-dvs-voltage:
    $ref: /schemas/types.yaml#/definitions/uint32-array
    maxItems: 2
    description:
      Two voltage values in microvolts for buck2 regulator that can be
      selected using DVS GPIO.

  regulators:
    type: object
    additionalProperties: false

    properties:
      CHARGER:
        type: object
        $ref: /schemas/regulator/regulator.yaml#
        unevaluatedProperties: false
        description:
          CHARGER is main battery charger current control, wrongly represented
          as regulator.

        properties:
          regulator-min-microamp:
            minimum: 90000
            maximum: 800000

          regulator-max-microamp:
            minimum: 90000
            maximum: 800000

          regulator-min-microvolt: false
          regulator-max-microvolt: false

        required:
          - regulator-name

    patternProperties:
      "^(LDO([2-9]|1[0-7])|BUCK[1-4])$":
        type: object
        $ref: /schemas/regulator/regulator.yaml#
        unevaluatedProperties: false

        required:
          - regulator-name

      "^(EN32KHz-AP|EN32KHz-CP|ENVICHG|ESAFEOUT[12])$":
        type: object
        $ref: /schemas/regulator/regulator.yaml#
        unevaluatedProperties: false
        description: |
          EN32KHz-AP and EN32KHz-CP are 32768 Hz clocks, wrongly represented as
          regulators.
          ENVICHG is a Battery Charging Current Monitor Output.

        properties:
          regulator-min-microvolt: false
          regulator-max-microvolt: false

        required:
          - regulator-name

dependencies:
  max8998,pmic-buck1-dvs-gpios: [ "max8998,pmic-buck1-dvs-voltage" ]
  max8998,pmic-buck2-dvs-gpio: [ "max8998,pmic-buck2-dvs-voltage" ]

required:
  - compatible
  - reg
  - regulators

additionalProperties: false

examples:
  - |
    #include <dt-bindings/gpio/gpio.h>
    #include <dt-bindings/interrupt-controller/irq.h>

    i2c {
        #address-cells = <1>;
        #size-cells = <0>;

        pmic@66 {
            compatible = "national,lp3974";
            reg = <0x66>;
            interrupts-extended = <&gpx0 7 IRQ_TYPE_LEVEL_LOW>,
                                  <&gpx2 7 IRQ_TYPE_LEVEL_LOW>;
            pinctrl-names = "default";
            pinctrl-0 = <&lp3974_irq>;

            max8998,pmic-buck1-default-dvs-idx = <0>;
            max8998,pmic-buck1-dvs-gpios = <&gpx0 5 GPIO_ACTIVE_HIGH>,
                                           <&gpx0 6 GPIO_ACTIVE_HIGH>;
            max8998,pmic-buck1-dvs-voltage = <1100000>, <1000000>,
                                             <1100000>, <1000000>;
            max8998,pmic-buck2-default-dvs-idx = <0>;
            max8998,pmic-buck2-dvs-gpio = <&gpe2 0 GPIO_ACTIVE_HIGH>;
            max8998,pmic-buck2-dvs-voltage = <1200000>, <1100000>;

            regulators {
                LDO2 {
                    regulator-name = "VALIVE_1.2V";
                    regulator-min-microvolt = <1200000>;
                    regulator-max-microvolt = <1200000>;
                    regulator-always-on;
                };

                LDO3 {
                    regulator-name = "VUSB+MIPI_1.1V";
                    regulator-min-microvolt = <1100000>;
                    regulator-max-microvolt = <1100000>;
                    regulator-always-on;
                };

                LDO4 {
                    regulator-name = "VADC_3.3V";
                    regulator-min-microvolt = <3300000>;
                    regulator-max-microvolt = <3300000>;
                };

                LDO5 {
                    regulator-name = "VTF_2.8V";
                    regulator-min-microvolt = <2800000>;
                    regulator-max-microvolt = <2800000>;
                };

                LDO6 {
                    regulator-name = "LDO6";
                    regulator-min-microvolt = <2000000>;
                    regulator-max-microvolt = <2000000>;
                };

                LDO7 {
                    regulator-name = "VLCD+VMIPI_1.8V";
                    regulator-min-microvolt = <1800000>;
                    regulator-max-microvolt = <1800000>;
                };

                LDO8 {
                    regulator-name = "VUSB+VDAC_3.3V";
                    regulator-min-microvolt = <3300000>;
                    regulator-max-microvolt = <3300000>;
                    regulator-always-on;
                };

                LDO9 {
                    regulator-name = "VCC_2.8V";
                    regulator-min-microvolt = <2800000>;
                    regulator-max-microvolt = <2800000>;
                    regulator-always-on;
                };

                LDO10 {
                    regulator-name = "VPLL_1.1V";
                    regulator-min-microvolt = <1100000>;
                    regulator-max-microvolt = <1100000>;
                    regulator-boot-on;
                    regulator-always-on;
                };

                LDO11 {
                    regulator-name = "CAM_AF_3.3V";
                    regulator-min-microvolt = <3300000>;
                    regulator-max-microvolt = <3300000>;
                };

                LDO12 {
                    regulator-name = "PS_2.8V";
                    regulator-min-microvolt = <2800000>;
                    regulator-max-microvolt = <2800000>;
                };

                LDO13 {
                    regulator-name = "VHIC_1.2V";
                    regulator-min-microvolt = <1200000>;
                    regulator-max-microvolt = <1200000>;
                };

                LDO14 {
                    regulator-name = "CAM_I_HOST_1.8V";
                    regulator-min-microvolt = <1800000>;
                    regulator-max-microvolt = <1800000>;
                };

                LDO15 {
                    regulator-name = "CAM_S_DIG+FM33_CORE_1.2V";
                    regulator-min-microvolt = <1200000>;
                    regulator-max-microvolt = <1200000>;
                };

                LDO16 {
                    regulator-name = "CAM_S_ANA_2.8V";
                    regulator-min-microvolt = <2800000>;
                    regulator-max-microvolt = <2800000>;
                };

                LDO17 {
                    regulator-name = "VCC_3.0V_LCD";
                    regulator-min-microvolt = <3000000>;
                    regulator-max-microvolt = <3000000>;
                };

                BUCK1 {
                    regulator-name = "VINT_1.1V";
                    regulator-min-microvolt = <750000>;
                    regulator-max-microvolt = <1500000>;
                    regulator-boot-on;
                    regulator-always-on;
                };

                BUCK2 {
                    regulator-name = "VG3D_1.1V";
                    regulator-min-microvolt = <750000>;
                    regulator-max-microvolt = <1500000>;
                    regulator-boot-on;
                };

                BUCK3 {
                    regulator-name = "VCC_1.8V";
                    regulator-min-microvolt = <1800000>;
                    regulator-max-microvolt = <1800000>;
                    regulator-always-on;
                };

                BUCK4 {
                    regulator-name = "VMEM_1.2V";
                    regulator-min-microvolt = <1200000>;
                    regulator-max-microvolt = <1200000>;
                    regulator-always-on;
                };

                EN32KHz-AP {
                    regulator-name = "32KHz AP";
                    regulator-always-on;
                };

                EN32KHz-CP {
                    regulator-name = "32KHz CP";
                };

                ENVICHG {
                    regulator-name = "VICHG";
                };

                ESAFEOUT1 {
                    regulator-name = "SAFEOUT1";
                };

                ESAFEOUT2 {
                    regulator-name = "SAFEOUT2";
                    regulator-boot-on;
                };
            };
        };
    };
```

## Documentation/devicetree/bindings/mfd/mc13xxx.txt
```
* Freescale MC13783/MC13892 Power Management Integrated Circuit (PMIC)

Required properties:
- compatible : Should be "fsl,mc13783" or "fsl,mc13892"

Optional properties:
- fsl,mc13xxx-uses-adc : Indicate the ADC is being used
- fsl,mc13xxx-uses-codec : Indicate the Audio Codec is being used
- fsl,mc13xxx-uses-rtc : Indicate the RTC is being used
- fsl,mc13xxx-uses-touch : Indicate the touchscreen controller is being used

Sub-nodes:
- codec: Contain the Audio Codec node.
  - adc-port: Contain PMIC SSI port number used for ADC.
  - dac-port: Contain PMIC SSI port number used for DAC.
- leds : Contain the led nodes and initial register values in property
  "led-control". Number of register depends of used IC, for MC13783 is 6,
  for MC13892 is 4, for MC34708 is 1. See datasheet for bits definitions of
  these registers.
  - #address-cells: Must be 1.
  - #size-cells: Must be 0.
  Each led node should contain "reg", which used as LED ID (described below).
  Optional properties "label" and "linux,default-trigger" is described in
  Documentation/devicetree/bindings/leds/common.txt.
- regulators : Contain the regulator nodes. The regulators are bound using
  their names as listed below with their registers and bits for enabling.

MC13783 LED IDs:
    0  : Main display
    1  : AUX display
    2  : Keypad
    3  : Red 1
    4  : Green 1
    5  : Blue 1
    6  : Red 2
    7  : Green 2
    8  : Blue 2
    9  : Red 3
    10 : Green 3
    11 : Blue 3

MC13892 LED IDs:
    0  : Main display
    1  : AUX display
    2  : Keypad
    3  : Red
    4  : Green
    5  : Blue

MC34708 LED IDs:
    0  : Charger Red
    1  : Charger Green

MC13783 regulators:
    sw1a      : regulator SW1A      (register 24, bit 0)
    sw1b      : regulator SW1B      (register 25, bit 0)
    sw2a      : regulator SW2A      (register 26, bit 0)
    sw2b      : regulator SW2B      (register 27, bit 0)
    sw3       : regulator SW3       (register 29, bit 20)
    vaudio    : regulator VAUDIO    (register 32, bit 0)
    viohi     : regulator VIOHI     (register 32, bit 3)
    violo     : regulator VIOLO     (register 32, bit 6)
    vdig      : regulator VDIG      (register 32, bit 9)
    vgen      : regulator VGEN      (register 32, bit 12)
    vrfdig    : regulator VRFDIG    (register 32, bit 15)
    vrfref    : regulator VRFREF    (register 32, bit 18)
    vrfcp     : regulator VRFCP     (register 32, bit 21)
    vsim      : regulator VSIM      (register 33, bit 0)
    vesim     : regulator VESIM     (register 33, bit 3)
    vcam      : regulator VCAM      (register 33, bit 6)
    vrfbg     : regulator VRFBG     (register 33, bit 9)
    vvib      : regulator VVIB      (register 33, bit 11)
    vrf1      : regulator VRF1      (register 33, bit 12)
    vrf2      : regulator VRF2      (register 33, bit 15)
    vmmc1     : regulator VMMC1     (register 33, bit 18)
    vmmc2     : regulator VMMC2     (register 33, bit 21)
    gpo1      : regulator GPO1      (register 34, bit 6)
    gpo2      : regulator GPO2      (register 34, bit 8)
    gpo3      : regulator GPO3      (register 34, bit 10)
    gpo4      : regulator GPO4      (register 34, bit 12)
    pwgt1spi  : regulator PWGT1SPI  (register 34, bit 15)
    pwgt2spi  : regulator PWGT2SPI  (register 34, bit 16)

MC13892 regulators:
    vcoincell : regulator VCOINCELL (register 13, bit 23)
    sw1       : regulator SW1	    (register 24, bit 0)
    sw2       : regulator SW2	    (register 25, bit 0)
    sw3       : regulator SW3	    (register 26, bit 0)
    sw4       : regulator SW4	    (register 27, bit 0)
    swbst     : regulator SWBST	    (register 29, bit 20)
    vgen1     : regulator VGEN1	    (register 32, bit 0)
    viohi     : regulator VIOHI	    (register 32, bit 3)
    vdig      : regulator VDIG	    (register 32, bit 9)
    vgen2     : regulator VGEN2	    (register 32, bit 12)
    vpll      : regulator VPLL	    (register 32, bit 15)
    vusb2     : regulator VUSB2	    (register 32, bit 18)
    vgen3     : regulator VGEN3	    (register 33, bit 0)
    vcam      : regulator VCAM	    (register 33, bit 6)
    vvideo    : regulator VVIDEO    (register 33, bit 12)
    vaudio    : regulator VAUDIO    (register 33, bit 15)
    vsd       : regulator VSD	    (register 33, bit 18)
    gpo1      : regulator GPO1	    (register 34, bit 6)
    gpo2      : regulator GPO2	    (register 34, bit 8)
    gpo3      : regulator GPO3	    (register 34, bit 10)
    gpo4      : regulator GPO4	    (register 34, bit 12)
    pwgt1spi  : regulator PWGT1SPI  (register 34, bit 15)
    pwgt2spi  : regulator PWGT2SPI  (register 34, bit 16)
    vusb      : regulator VUSB	    (register 50, bit 3)

  The bindings details of individual regulator device can be found in:
  Documentation/devicetree/bindings/regulator/regulator.txt

Examples:

ecspi@70010000 { /* ECSPI1 */
	cs-gpios = <&gpio4 24 0>, /* GPIO4_24 */
		   <&gpio4 25 0>; /* GPIO4_25 */

	pmic: mc13892@0 {
		#address-cells = <1>;
		#size-cells = <0>;
		compatible = "fsl,mc13892";
		spi-max-frequency = <6000000>;
		reg = <0>;
		interrupt-parent = <&gpio0>;
		interrupts = <8>;

		leds {
			#address-cells = <1>;
			#size-cells = <0>;
			led-control = <0x000 0x000 0x0e0 0x000>;

			sysled@3 {
				reg = <3>;
				label = "system:red:live";
				linux,default-trigger = "heartbeat";
			};
		};

		regulators {
			sw1_reg: mc13892__sw1 {
				regulator-min-microvolt = <600000>;
				regulator-max-microvolt = <1375000>;
				regulator-boot-on;
				regulator-always-on;
			};

			sw2_reg: mc13892__sw2 {
				regulator-min-microvolt = <900000>;
				regulator-max-microvolt = <1850000>;
				regulator-boot-on;
				regulator-always-on;
			};
		};
	};
};
```
