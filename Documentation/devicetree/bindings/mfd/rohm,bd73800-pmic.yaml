## Documentation/devicetree/bindings/net/pse-pd/realtek,pse-mcu-gen1.yaml
```yaml
# SPDX-License-Identifier: (GPL-2.0-only OR BSD-2-Clause)
%YAML 1.2
---
$id: http://devicetree.org/schemas/net/pse-pd/realtek,pse-mcu-gen1.yaml#
$schema: http://devicetree.org/meta-schemas/core.yaml#

title: Realtek PSE MCU

maintainers:
  - Jonas Jelonek <jelonek.jonas@gmail.com>

description: |
  A microcontroller (MCU) that manages the PSE (Power Sourcing Equipment)
  hardware on a range of managed PoE switches. The host CPU talks only to
  this MCU - over I2C/SMBus or UART - using a small message-based protocol;
  the PSE silicon it drives sits behind the MCU and is never accessed
  directly. For example, on the Zyxel GS1900-10HP the SoC reaches the MCU
  over UART, and the MCU manages the on-board PSE chip.

  This binding describes the MCU together with its Realtek firmware: the
  firmware and its host protocol, which are stable across boards. The
  microcontroller silicon is a general-purpose part that varies, and the
  PSE silicon behind the MCU (Realtek RTL823x/RTL8239* or Broadcom
  BCM59xxx) is reported by the MCU and detected at runtime - neither is
  named here.

  Two protocol generations exist, both Realtek's:
    gen1  older boards, where the MCU fronts Broadcom PSE silicon
    gen2  the altered protocol used with Realtek's own PSE silicon

  On an I2C attachment the framing the MCU firmware expects is part of the
  compatible: '-smbus' (reads carry a leading command byte and a repeated
  start) or '-i2c' (bare block writes and reads). A UART attachment carries
  no framing suffix; the transport is given by the parent 'serial' node.

  Each board additionally carries a device-specific compatible that falls
  back to one of the protocol compatibles above. Drivers bind on the
  protocol compatible; the device-specific string identifies the board and
  reserves a place for a future per-board quirk without having to retrofit
  device trees already in the field.

properties:
  compatible:
    oneOf:
      # UART
      - items:
          - enum:
              - zyxel,gs1900-10hp-a1-pse
          - const: realtek,pse-mcu-gen1

      # I2C, SMBus framing
      - items:
          - enum:
              - zyxel,gs1920-24hp-v2-pse
          - const: realtek,pse-mcu-gen1-smbus

      # UART
      - items:
          - enum:
              - zyxel,gs1900-10hp-b1-pse
              - zyxel,xmg1915-10ep-pse
          - const: realtek,pse-mcu-gen2

      # I2C, SMBus framing
      - items:
          - enum:
              - zyxel,xs1930-12hp-pse
          - const: realtek,pse-mcu-gen2-smbus

      # I2C, raw framing
      - items:
          - enum:
              - linksys,lgs328mpc-v2-pse
          - const: realtek,pse-mcu-gen2-i2c

  reg:
    maxItems: 1

  reset-gpios:
    description: Reset line of the MCU.
    maxItems: 1

  disable-ports-gpios:
    description:
      Hardware gate that forces all ports into admin-disabled state while
      asserted.
    maxItems: 1

required:
  - compatible

allOf:
  - $ref: pse-controller.yaml#
  # A '-smbus'/'-i2c' compatible is an I2C attachment: it has 'reg' and
  # cannot carry serial bus properties. A bare gen compatible is a UART
  # attachment: no 'reg', the transport comes from the parent serial node.
  - if:
      properties:
        compatible:
          contains:
            enum:
              - realtek,pse-mcu-gen1-smbus
              - realtek,pse-mcu-gen2-smbus
              - realtek,pse-mcu-gen2-i2c
    then:
      required:
        - reg
      properties:
        current-speed: false
        max-speed: false
    else:
      allOf:
        - $ref: /schemas/serial/serial-peripheral-props.yaml#

      properties:
        reg: false

unevaluatedProperties: false

examples:
  # SMBus-framed I2C attachment
  - |
    i2c {
        #address-cells = <1>;
        #size-cells = <0>;

        ethernet-pse@20 {
            compatible = "zyxel,xs1930-12hp-pse", "realtek,pse-mcu-gen2-smbus";
            reg = <0x20>;

            pse-pis {
                #address-cells = <1>;
                #size-cells = <0>;

                pse-pi@0 {
                    reg = <0>;
                    #pse-cells = <0>;
                };
            };
        };
    };

  # Raw-I2C-framed attachment
  - |
    i2c {
        #address-cells = <1>;
        #size-cells = <0>;

        ethernet-pse@20 {
            compatible = "linksys,lgs328mpc-v2-pse", "realtek,pse-mcu-gen2-i2c";
            reg = <0x20>;

            pse-pis {
                #address-cells = <1>;
                #size-cells = <0>;

                pse-pi@0 {
                    reg = <0>;
                    #pse-cells = <0>;
                };
            };
        };
    };

  # UART attachment
  - |
    serial {
        ethernet-pse {
            compatible = "zyxel,gs1900-10hp-a1-pse", "realtek,pse-mcu-gen1";
            current-speed = <19200>;

            pse-pis {
                #address-cells = <1>;
                #size-cells = <0>;

                pse-pi@0 {
                    reg = <0>;
                    #pse-cells = <0>;
                };
            };
        };
    };
```

## Documentation/devicetree/bindings/net/qcom,sa8255p-ethqos.yaml
```yaml
# SPDX-License-Identifier: GPL-2.0 OR BSD-2-Clause
%YAML 1.2
---
$id: http://devicetree.org/schemas/net/qcom,sa8255p-ethqos.yaml#
$schema: http://devicetree.org/meta-schemas/core.yaml#

title: Qualcomm Ethernet ETHQOS device (firmware managed)

maintainers:
  - Bjorn Andersson <andersson@kernel.org>
  - Konrad Dybcio <konradybcio@kernel.org>
  - Bartosz Golaszewski <bartosz.golaszewski@linaro.org>

description:
  dwmac based Qualcomm ethernet devices which support Gigabit
  ethernet (version v2.3.0 and onwards) with clocks, interconnects, etc.
  managed by firmware

allOf:
  - $ref: snps,dwmac.yaml#

properties:
  compatible:
    const: qcom,sa8255p-ethqos

  reg:
    maxItems: 2

  reg-names:
    items:
      - const: stmmaceth
      - const: rgmii

  interrupts:
    items:
      - description: Combined signal for various interrupt events
      - description: The interrupt that occurs when HW safety error triggered

  interrupt-names:
    items:
      - const: macirq
      - const: sfty

  power-domains:
    minItems: 2
    maxItems: 2

  power-domain-names:
    items:
      - const: core
      - const: mdio

  phys:
    maxItems: 1

  phy-names:
    items:
      - const: serdes

  iommus:
    maxItems: 1

  dma-coherent: true

required:
  - compatible
  - reg-names
  - power-domains
  - power-domain-names

unevaluatedProperties: false

examples:
  - |
    #include <dt-bindings/interrupt-controller/arm-gic.h>

    ethernet: ethernet@23040000 {
        compatible = "qcom,sa8255p-ethqos";
        reg = <0x23040000 0x10000>,
              <0x23056000 0x100>;
        reg-names = "stmmaceth", "rgmii";

        iommus = <&apps_smmu 0x120 0x7>;

        interrupts = <GIC_SPI 946 IRQ_TYPE_LEVEL_HIGH>,
                     <GIC_SPI 782 IRQ_TYPE_LEVEL_HIGH>;
        interrupt-names = "macirq", "sfty";

        dma-coherent;

        snps,tso;
        snps,pbl = <32>;
        rx-fifo-depth = <16384>;
        tx-fifo-depth = <16384>;

        phy-handle = <&ethernet_phy>;
        phy-mode = "2500base-x";

        snps,mtl-rx-config = <&mtl_rx_setup1>;
        snps,mtl-tx-config = <&mtl_tx_setup1>;

        power-domains = <&scmi8_pd 0>, <&scmi8_pd 1>;
        power-domain-names = "core", "mdio";

        phys = <&serdes1>;
        phy-names = "serdes";
    };
```

## Documentation/devicetree/bindings/net/realtek,rtl8224-package.yaml
```yaml
# SPDX-License-Identifier: (GPL-2.0-only OR BSD-2-Clause)
%YAML 1.2
---
$id: http://devicetree.org/schemas/net/realtek,rtl8224-package.yaml#
$schema: http://devicetree.org/meta-schemas/core.yaml#

title: Realtek RTL8224 Ethernet PHY package

maintainers:
  - Andrew Lunn <andrew@lunn.ch>
  - Florian Fainelli <f.fainelli@gmail.com>
  - Heiner Kallweit <hkallweit1@gmail.com>

description:
  The RTL8224 is a four-port 2.5Gbps Ethernet PHY. Its PHYs occupy four
  consecutive MDIO addresses and share package-wide configuration registers.

  A package node is required when the first PHY's MDIO address is not a
  multiple of four. Existing aligned layouts without a package node remain
  supported.

  The package reg must identify the first physical PHY's MDIO address,
  even if that PHY has no child node. Each child PHY reg is its absolute
  MDIO address, not an offset from the package base. Unused PHY ports may
  be omitted. The base address must not exceed 28, so that all four PHY
  addresses fit within the MDIO address space.

  The enet-phy-pair-order and enet-phy-pair-polarity properties belong
  to the individual PHY nodes and describe each port's MDI wiring.

$ref: ethernet-phy-package.yaml#

properties:
  compatible:
    const: realtek,rtl8224-package

  reg:
    maximum: 28

patternProperties:
  "^ethernet-phy@[a-f0-9]+$":
    $ref: ethernet-phy.yaml#

    properties:
      compatible:
        const: ethernet-phy-ieee802.3-c45

      leds: false

    required:
      - compatible

    unevaluatedProperties: false

required:
  - compatible

# Enumerate the ranges because child addresses depend on the package base.
allOf:
  - if:
      properties:
        reg: { const: 0 }
    then:
      patternProperties:
        "^ethernet-phy@[a-f0-9]+$":
          properties:
            reg: { minimum: 0, maximum: 3 }
  - if:
      properties:
        reg: { const: 1 }
    then:
      patternProperties:
        "^ethernet-phy@[a-f0-9]+$":
          properties:
            reg: { minimum: 1, maximum: 4 }
  - if:
      properties:
        reg: { const: 2 }
    then:
      patternProperties:
        "^ethernet-phy@[a-f0-9]+$":
          properties:
            reg: { minimum: 2, maximum: 5 }
  - if:
      properties:
        reg: { const: 3 }
    then:
      patternProperties:
        "^ethernet-phy@[a-f0-9]+$":
          properties:
            reg: { minimum: 3, maximum: 6 }
  - if:
      properties:
        reg: { const: 4 }
    then:
      patternProperties:
        "^ethernet-phy@[a-f0-9]+$":
          properties:
            reg: { minimum: 4, maximum: 7 }
  - if:
      properties:
        reg: { const: 5 }
    then:
      patternProperties:
        "^ethernet-phy@[a-f0-9]+$":
          properties:
            reg: { minimum: 5, maximum: 8 }
  - if:
      properties:
        reg: { const: 6 }
    then:
      patternProperties:
        "^ethernet-phy@[a-f0-9]+$":
          properties:
            reg: { minimum: 6, maximum: 9 }
  - if:
      properties:
        reg: { const: 7 }
    then:
      patternProperties:
        "^ethernet-phy@[a-f0-9]+$":
          properties:
            reg: { minimum: 7, maximum: 10 }
  - if:
      properties:
        reg: { const: 8 }
    then:
      patternProperties:
        "^ethernet-phy@[a-f0-9]+$":
          properties:
            reg: { minimum: 8, maximum: 11 }
  - if:
      properties:
        reg: { const: 9 }
    then:
      patternProperties:
        "^ethernet-phy@[a-f0-9]+$":
          properties:
            reg: { minimum: 9, maximum: 12 }
  - if:
      properties:
        reg: { const: 10 }
    then:
      patternProperties:
        "^ethernet-phy@[a-f0-9]+$":
          properties:
            reg: { minimum: 10, maximum: 13 }
  - if:
      properties:
        reg: { const: 11 }
    then:
      patternProperties:
        "^ethernet-phy@[a-f0-9]+$":
          properties:
            reg: { minimum: 11, maximum: 14 }
  - if:
      properties:
        reg: { const: 12 }
    then:
      patternProperties:
        "^ethernet-phy@[a-f0-9]+$":
          properties:
            reg: { minimum: 12, maximum: 15 }
  - if:
      properties:
        reg: { const: 13 }
    then:
      patternProperties:
        "^ethernet-phy@[a-f0-9]+$":
          properties:
            reg: { minimum: 13, maximum: 16 }
  - if:
      properties:
        reg: { const: 14 }
    then:
      patternProperties:
        "^ethernet-phy@[a-f0-9]+$":
          properties:
            reg: { minimum: 14, maximum: 17 }
  - if:
      properties:
        reg: { const: 15 }
    then:
      patternProperties:
        "^ethernet-phy@[a-f0-9]+$":
          properties:
            reg: { minimum: 15, maximum: 18 }
  - if:
      properties:
        reg: { const: 16 }
    then:
      patternProperties:
        "^ethernet-phy@[a-f0-9]+$":
          properties:
            reg: { minimum: 16, maximum: 19 }
  - if:
      properties:
        reg: { const: 17 }
    then:
      patternProperties:
        "^ethernet-phy@[a-f0-9]+$":
          properties:
            reg: { minimum: 17, maximum: 20 }
  - if:
      properties:
        reg: { const: 18 }
    then:
      patternProperties:
        "^ethernet-phy@[a-f0-9]+$":
          properties:
            reg: { minimum: 18, maximum: 21 }
  - if:
      properties:
        reg: { const: 19 }
    then:
      patternProperties:
        "^ethernet-phy@[a-f0-9]+$":
          properties:
            reg: { minimum: 19, maximum: 22 }
  - if:
      properties:
        reg: { const: 20 }
    then:
      patternProperties:
        "^ethernet-phy@[a-f0-9]+$":
          properties:
            reg: { minimum: 20, maximum: 23 }
  - if:
      properties:
        reg: { const: 21 }
    then:
      patternProperties:
        "^ethernet-phy@[a-f0-9]+$":
          properties:
            reg: { minimum: 21, maximum: 24 }
  - if:
      properties:
        reg: { const: 22 }
    then:
      patternProperties:
        "^ethernet-phy@[a-f0-9]+$":
          properties:
            reg: { minimum: 22, maximum: 25 }
  - if:
      properties:
        reg: { const: 23 }
    then:
      patternProperties:
        "^ethernet-phy@[a-f0-9]+$":
          properties:
            reg: { minimum: 23, maximum: 26 }
  - if:
      properties:
        reg: { const: 24 }
    then:
      patternProperties:
        "^ethernet-phy@[a-f0-9]+$":
          properties:
            reg: { minimum: 24, maximum: 27 }
  - if:
      properties:
        reg: { const: 25 }
    then:
      patternProperties:
        "^ethernet-phy@[a-f0-9]+$":
          properties:
            reg: { minimum: 25, maximum: 28 }
  - if:
      properties:
        reg: { const: 26 }
    then:
      patternProperties:
        "^ethernet-phy@[a-f0-9]+$":
          properties:
            reg: { minimum: 26, maximum: 29 }
  - if:
      properties:
        reg: { const: 27 }
    then:
      patternProperties:
        "^ethernet-phy@[a-f0-9]+$":
          properties:
            reg: { minimum: 27, maximum: 30 }
  - if:
      properties:
        reg: { const: 28 }
    then:
      patternProperties:
        "^ethernet-phy@[a-f0-9]+$":
          properties:
            reg: { minimum: 28, maximum: 31 }

unevaluatedProperties: false

examples:
  - |
    mdio {
        #address-cells = <1>;
        #size-cells = <0>;

        ethernet-phy-package@1 {
            compatible = "realtek,rtl8224-package";
            reg = <1>;
            #address-cells = <1>;
            #size-cells = <0>;

            ethernet-phy@1 {
                compatible = "ethernet-phy-ieee802.3-c45";
                reg = <1>;
                enet-phy-pair-order = <0>;
            };

            ethernet-phy@2 {
                compatible = "ethernet-phy-ieee802.3-c45";
                reg = <2>;
                enet-phy-pair-order = <0>;
            };

            ethernet-phy@3 {
                compatible = "ethernet-phy-ieee802.3-c45";
                reg = <3>;
                enet-phy-pair-order = <1>;
            };

            ethernet-phy@4 {
                compatible = "ethernet-phy-ieee802.3-c45";
                reg = <4>;
                enet-phy-pair-order = <1>;
                enet-phy-pair-polarity = <0x1>;
            };
        };
    };
```
