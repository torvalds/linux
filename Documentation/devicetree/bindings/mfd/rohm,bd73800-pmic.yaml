## Documentation/devicetree/bindings/mmc/amlogic,meson-gx-mmc.yaml
```yaml
# SPDX-License-Identifier: (GPL-2.0-only OR BSD-2-Clause)
%YAML 1.2
---
$id: http://devicetree.org/schemas/mmc/amlogic,meson-gx-mmc.yaml#
$schema: http://devicetree.org/meta-schemas/core.yaml#

title: Amlogic SD / eMMC controller for S905/GXBB family SoCs

description:
  The MMC 5.1 compliant host controller on Amlogic provides the
  interface for SD, eMMC and SDIO devices

maintainers:
  - Neil Armstrong <neil.armstrong@linaro.org>

allOf:
  - $ref: mmc-controller.yaml#
  - if:
      properties:
        compatible:
          contains:
            const: amlogic,t7-mmc
    then:
      properties:
        clocks:
          minItems: 4
        clock-names:
          minItems: 4
    else:
      properties:
        clocks:
          maxItems: 3
        clock-names:
          maxItems: 3

properties:
  compatible:
    oneOf:
      - items:
          - enum:
              - amlogic,t7-mmc
          - const: amlogic,meson-axg-mmc
      - const: amlogic,meson-axg-mmc
      - items:
          - const: amlogic,meson-gx-mmc
          - const: amlogic,meson-gxbb-mmc

  reg:
    maxItems: 1

  interrupts:
    minItems: 1
    items:
      - description: mmc controller instance
      - description: card detect

  clocks:
    minItems: 3
    items:
      - description: core clock
      - description: clock input 0 of the internal mux
      - description: clock input 1 of the internal mux
      - description:
          clock of the pipeline stage inserted in the bus path between
          the controller and the DRAM. Without it, the controller cannot
          complete DMA transfers.

  clock-names:
    minItems: 3
    items:
      - const: core
      - const: clkin0
      - const: clkin1
      - const: pipeline

  resets:
    maxItems: 1

  amlogic,dram-access-quirk:
    type: boolean
    description:
      set when controller's internal DMA engine cannot access the DRAM memory,
      like on the G12A dedicated SDIO controller.

  power-domains:
    maxItems: 1

required:
  - compatible
  - reg
  - interrupts
  - clocks
  - clock-names
  - resets

unevaluatedProperties: false

examples:
  - |
    #include <dt-bindings/interrupt-controller/irq.h>
    #include <dt-bindings/interrupt-controller/arm-gic.h>
    mmc@70000 {
        compatible = "amlogic,meson-gx-mmc", "amlogic,meson-gxbb-mmc";
        reg = <0x70000 0x2000>;
        interrupts = <GIC_SPI 216 IRQ_TYPE_EDGE_RISING>;
        clocks = <&clk_mmc>, <&xtal>, <&clk_div>;
        clock-names = "core", "clkin0", "clkin1";
        pinctrl-0 = <&emm_pins>;
        resets = <&reset_mmc>;
    };
```

## Documentation/devicetree/bindings/mmc/cdns,sd6hc.yaml
```yaml
# SPDX-License-Identifier: GPL-2.0-only OR BSD-2-Clause
%YAML 1.2
---
$id: http://devicetree.org/schemas/mmc/cdns,sd6hc.yaml#
$schema: http://devicetree.org/meta-schemas/core.yaml#

title: Cadence SD6HC SD/SDIO/eMMC Host Controller

maintainers:
  - Tanmay Kathpalia <tanmay.kathpalia@altera.com>

description:
  Cadence SD6HC is a sixth-generation SD/SDIO/eMMC host controller with an
  interface to a Cadence Combo PHY. The controller has separate card interface
  and bus interface clock domains.

properties:
  compatible:
    items:
      - const: altr,agilex5-sd6hc
      - const: cdns,sd6hc

  reg:
    maxItems: 1

  interrupts:
    maxItems: 1

  clocks:
    items:
      - description: card interface unit (CIU / SDMCLK) clock
      - description: bus interface unit (BIU) clock

  clock-names:
    items:
      - const: ciu
      - const: biu

  resets:
    items:
      - description: SDHC controller reset
      - description: Combo PHY reset
      - description: SDMMC OCP/AXI reset

  reset-names:
    items:
      - const: sdhc-reset
      - const: combophy
      - const: sdmmc-ocp

  iommus:
    maxItems: 1

  dma-coherent: true

  cdns,iocell-input-delay-ps:
    description:
      Input delay across the IO cells, used for SD6HC PHY timing calculations.
    minimum: 0
    maximum: 20000
    default: 2500

  cdns,iocell-output-delay-ps:
    description:
      Output delay across the IO cells, used for SD6HC PHY timing calculations.
    minimum: 0
    maximum: 20000
    default: 2500

  cdns,delay-element-ps:
    description:
      DLL delay element size, used for SD6HC PHY timing calculations.
    minimum: 1
    maximum: 1000
    default: 24

required:
  - compatible
  - reg
  - interrupts
  - clocks
  - clock-names
  - resets
  - reset-names

allOf:
  - $ref: sdhci-common.yaml#

unevaluatedProperties: false

examples:
  - |
    #include <dt-bindings/interrupt-controller/arm-gic.h>

    mmc@10808000 {
        compatible = "altr,agilex5-sd6hc", "cdns,sd6hc";
        reg = <0x10808000 0x1000>;
        interrupts = <GIC_SPI 96 IRQ_TYPE_LEVEL_HIGH>;
        clocks = <&clkmgr 0>, <&clkmgr 1>;
        clock-names = "ciu", "biu";
        resets = <&rst 0>, <&rst 1>, <&rst 2>;
        reset-names = "sdhc-reset", "combophy", "sdmmc-ocp";
        iommus = <&smmu 5>;
        dma-coherent;
    };
```

## Documentation/devicetree/bindings/mtd/ibm,ndfc.yaml
```yaml
# SPDX-License-Identifier: (GPL-2.0-only OR BSD-2-Clause)
%YAML 1.2
---
$id: http://devicetree.org/schemas/mtd/ibm,ndfc.yaml#
$schema: http://devicetree.org/meta-schemas/core.yaml#

title: IBM/AMCC NDFC (NAND Flash Controller)

maintainers:
  - Miquel Raynal <miquel.raynal@bootlin.com>
  - Richard Weinberger <richard@nod.at>

description: |
  The NDFC is the NAND flash controller integrated into the IBM/AMCC
  PowerPC 44x SoCs.

allOf:
  - $ref: nand-controller-legacy.yaml#

properties:
  compatible:
    const: ibm,ndfc

  reg:
    description: Chip select and size used for the chip.
    maxItems: 1

  ccr:
    description: NDFC config and control register value.
    $ref: /schemas/types.yaml#/definitions/uint32

  bank-settings:
    description: NDFC bank configuration register value.
    $ref: /schemas/types.yaml#/definitions/uint32

  nand:
    type: object
    description: |
      NAND chip attached to the controller. The driver picks the first
      child of the controller node, so this node is not required to be
      named "nand@<cs>".

    allOf:
      - $ref: mtd.yaml#
      - $ref: nand-property.yaml#
      - $ref: raw-nand-property.yaml#

    properties:
      "#address-cells":
        const: 1
      "#size-cells":
        const: 1

    patternProperties:
      "^partition@[0-9a-f]+$":
        $ref: /schemas/mtd/partitions/partition.yaml#/$defs/partition-node
        deprecated: true

    unevaluatedProperties: false

required:
  - compatible
  - reg

unevaluatedProperties: false

examples:
  - |
    ebc {
        #address-cells = <2>;
        #size-cells = <1>;

        ndfc@1,0 {
            compatible = "ibm,ndfc";
            reg = <0x00000001 0x00000000 0x00002000>;
            ccr = <0x00001000>;
            bank-settings = <0x80002222>;
            #address-cells = <1>;
            #size-cells = <1>;

            nand {
                #address-cells = <1>;
                #size-cells = <1>;

                partition@0 {
                    label = "kernel";
                    reg = <0x00000000 0x00200000>;
                };
                partition@200000 {
                    label = "root";
                    reg = <0x00200000 0x03e00000>;
                };
            };
        };
    };
  - |
    ebc {
        #address-cells = <2>;
        #size-cells = <1>;

        ndfc@1,0 {
            compatible = "ibm,ndfc";
            reg = <0x00000001 0x00000000 0x00002000>;
            #address-cells = <1>;
            #size-cells = <1>;

            nand {
                #address-cells = <1>;
                #size-cells = <1>;

                partitions {
                    compatible = "fixed-partitions";
                    #address-cells = <1>;
                    #size-cells = <1>;

                    partition@0 {
                        label = "kernel";
                        reg = <0x00000000 0x00200000>;
                    };
                    partition@200000 {
                        label = "root";
                        reg = <0x00200000 0x03e00000>;
                    };
                };
            };
        };
    };
...
```

## Documentation/devicetree/bindings/net/can/ti,am3517-hecc.yaml
```yaml
# SPDX-License-Identifier: (GPL-2.0-only OR BSD-2-Clause)
%YAML 1.2
---
$id: http://devicetree.org/schemas/net/can/ti,am3517-hecc.yaml#
$schema: http://devicetree.org/meta-schemas/core.yaml#

title: Texas Instruments High End CAN Controller (HECC)

maintainers:
  - Eduard Bostina <egbostina@gmail.com>

allOf:
  - $ref: can-controller.yaml#

properties:
  compatible:
    const: ti,am3517-hecc

  reg:
    maxItems: 3

  reg-names:
    items:
      - const: hecc
      - const: hecc-ram
      - const: mbx

  interrupts:
    maxItems: 1

  clocks:
    maxItems: 1

  ti,use-hecc1int:
    type: boolean
    description:
      If provided, configures HECC to produce all interrupts on the
      HECC1INT interrupt line. By default, the HECC0INT interrupt line
      will be used.
    default: false

  xceiver-supply:
    description: Regulator that powers the CAN transceiver.

required:
  - compatible
  - reg
  - reg-names
  - interrupts
  - clocks

unevaluatedProperties: false

examples:
  - |
    can@5c050000 {
        compatible = "ti,am3517-hecc";
        reg = <0x5c050000 0x80>,
              <0x5c053000 0x180>,
              <0x5c052000 0x200>;
        reg-names = "hecc", "hecc-ram", "mbx";
        interrupts = <24>;
        clocks = <&hecc_ck>;
    };
```

## Documentation/devicetree/bindings/net/dptel,dap8211r.yaml
```yaml
# SPDX-License-Identifier: (GPL-2.0-only OR BSD-2-Clause)
%YAML 1.2
---
$id: http://devicetree.org/schemas/net/dptel,dap8211r.yaml#
$schema: http://devicetree.org/meta-schemas/core.yaml#

title: DAPU Telecom DAP8211R(I) Gigabit Ethernet PHY

maintainers:
  - Artem Shimko <a.shimko.dev@gmail.com>

description: |
  The DAP8211R(I) is a Gigabit Ethernet PHY with RGMII interface,
  supporting IEEE 802.3az Energy Efficient Ethernet, IEEE 1588 SyncE,
  and an internal packet generator for diagnostics.

  Specifications:
    - 10BASE-Te, 100BASE-TX, 1000BASE-T
    - RGMII with configurable TX/RX clock delays (150 ps steps, 0-2250 ps)
    - IEEE 802.3az-2010 Energy Efficient Ethernet
    - IEEE 1588 SyncE support
    - Internal packet generator and checker for link diagnostics

allOf:
  - $ref: ethernet-phy.yaml#

properties:
  compatible:
    const: ethernet-phy-id0008.011b

  reg:
    maxItems: 1

  rx-internal-delay-ps:
    description:
      RGMII RX clock delay in picoseconds (0 to maximum).
    multipleOf: 150
    maximum: 2250
    default: 1950

  tx-internal-delay-ps:
    description:
      RGMII TX clock delay in picoseconds (0 to maximum).
    multipleOf: 150
    maximum: 2250
    default: 1950

unevaluatedProperties: false

examples:
  - |
    mdio {
        #address-cells = <1>;
        #size-cells = <0>;

        ethernet-phy@1 {
            compatible = "ethernet-phy-id0008.011b";
            reg = <1>;
            rx-internal-delay-ps = <1950>;
            tx-internal-delay-ps = <1950>;
        };
    };
```

## Documentation/devicetree/bindings/net/dsa/mediatek,mt7628-esw.yaml
```yaml
# SPDX-License-Identifier: (GPL-2.0-only OR BSD-2-Clause)
%YAML 1.2
---
$id: http://devicetree.org/schemas/net/dsa/mediatek,mt7628-esw.yaml#
$schema: http://devicetree.org/meta-schemas/core.yaml#

title: Mediatek MT7628 Embedded Ethernet Switch

maintainers:
  - Joris Vaisvila <joey@tinyisr.com>

description:
  The MT7628 SoC's built-in Ethernet Switch has five user ports and one
  internally connected CPU port. The user ports are all connected to the SoC's
  integrated Fast Ethernet PHYs. The switch registers are directly mapped in
  the SoC's memory.

allOf:
  - $ref: dsa.yaml#/$defs/ethernet-ports

properties:
  compatible:
    const: mediatek,mt7628-esw

  reg:
    maxItems: 1

  resets:
    items:
      - description: internal switch block reset
      - description: internal phy package reset

  reset-names:
    items:
      - const: esw
      - const: ephy

required:
  - compatible
  - reg
  - resets
  - reset-names
  - ethernet-ports

unevaluatedProperties: false

examples:
  - |
    switch@10110000 {
        compatible = "mediatek,mt7628-esw";
        reg = <0x10110000 0x8000>;

        resets = <&sysc 23>, <&sysc 24>;
        reset-names = "esw", "ephy";

        ethernet-ports {
            #address-cells = <1>;
            #size-cells = <0>;

            ethernet-port@0 {
                reg = <0>;
                phy-mode = "internal";
            };

            ethernet-port@1 {
                reg = <1>;
                phy-mode = "internal";
            };

            ethernet-port@2 {
                reg = <2>;
                phy-mode = "internal";
            };

            ethernet-port@3 {
                reg = <3>;
                phy-mode = "internal";
            };

            ethernet-port@4 {
                reg = <4>;
                phy-mode = "internal";
            };

            ethernet-port@6 {
                reg = <6>;
                phy-mode = "internal";
                ethernet = <&ethernet>;

                fixed-link {
                    speed = <1000>;
                    full-duplex;
                };
            };
        };
    };
```
