## Documentation/devicetree/bindings/net/hisilicon,hns-dsaf-v1.yaml
```yaml
# SPDX-License-Identifier: (GPL-2.0-only OR BSD-2-Clause)
# Copyright 2025 Hisilicon Ltd.
%YAML 1.2
---
$id: http://devicetree.org/schemas/net/hisilicon,hns-dsaf-v1.yaml#
$schema: http://devicetree.org/meta-schemas/core.yaml#

title: Hisilicon DSA Fabric device controller

maintainers:
  - Jian Shen <shenjian15@huawei.com>
  - Jijie Shao <shaojijie@huawei.com>

properties:
  compatible:
    items:
      - enum:
          - hisilicon,hns-dsaf-v1
          - hisilicon,hns-dsaf-v2

  reg:
    minItems: 1
    items:
      - description:
          PPE register base and size
      - description:
          DSA Fabric base register and size (not required for single-port mode)

  reg-names:
    minItems: 1
    items:
      - const: ppe-base
      - const: dsaf-base

  interrupts:
    minItems: 1
    maxItems: 409

  dma-coherent: true

  '#address-cells':
    const: 1

  '#size-cells':
    const: 0

  mode:
    description: DSA Fabric mode string
    $ref: /schemas/types.yaml#/definitions/string
    enum:
      - 2port-64vf
      - 6port-16rss
      - 6port-16vf
      - single-port

  subctrl-syscon:
    description: syscon handle for external interface control register
    $ref: /schemas/types.yaml#/definitions/phandle

  reset-field-offset:
    description: offset of reset field in the control register
    $ref: /schemas/types.yaml#/definitions/uint32

  buf-size:
    description: RX buffer size (bytes)
    $ref: /schemas/types.yaml#/definitions/uint32
    enum: [512, 1024, 2048, 4096]

  desc-num:
    description: number of descriptors in TX and RX queue
    $ref: /schemas/types.yaml#/definitions/uint32
    minimum: 16
    maximum: 1024

patternProperties:
  "^port@[0-5]$":
    description: DSA Fabric port node
    $ref: ethernet-switch-port.yaml#
    additionalProperties: false

    properties:
      reg:
        maximum: 5

      phy-handle: true

      serdes-syscon:
        description: syscon handle for SerDes register
        $ref: /schemas/types.yaml#/definitions/phandle

      cpld-syscon:
        description: syscon handle plus register offset for CPLD register
        $ref: /schemas/types.yaml#/definitions/phandle-array
        items:
          - items:
              - description: CPLD phandle
              - description: offset

      port-rst-offset:
        description: reset field offset for this port
        $ref: /schemas/types.yaml#/definitions/uint32

      port-mode-offset:
        description: port mode field offset for this port
        $ref: /schemas/types.yaml#/definitions/uint32

      mc-mac-mask:
        description: multicast MAC address mask
        $ref: /schemas/types.yaml#/definitions/uint8-array
        maxItems: 6

      media-type:
        $ref: /schemas/types.yaml#/definitions/string
        enum:
          - backplane
          - copper
          - fiber

    required:
      - reg
      - serdes-syscon

required:
  - compatible
  - reg
  - reg-names
  - interrupts
  - subctrl-syscon
  - mode
  - buf-size
  - desc-num

additionalProperties: false

examples:
  - |
    dsa@c5000000 {
        compatible = "hisilicon,hns-dsaf-v1";
        #address-cells = <1>;
        #size-cells = <0>;
        mode = "6port-16rss";
        reg = <0xc5000000 0x890000
               0xc7000000 0x60000>;
        reg-names = "ppe-base", "dsaf-base";
        subctrl-syscon = <&subctrl>;
        reset-field-offset = <0>;
        interrupts = <131 4>, <132 4>, <133 4>, <134 4>,
                     <135 4>, <136 4>, <137 4>, <138 4>,
                     <139 4>, <140 4>, <141 4>, <142 4>,
                     <143 4>, <144 4>, <145 4>, <146 4>,
                     <147 4>, <148 4>, <384 1>, <385 1>,
                     <386 1>, <387 1>, <388 1>, <389 1>,
                     <390 1>, <391 1>;
        buf-size = <4096>;
        desc-num = <1024>;
        dma-coherent;

        port@0 {
            reg = <0>;
            phy-handle = <&phy0>;
            serdes-syscon = <&serdes>;
            mc-mac-mask = [ff f0 00 00 00 00];
        };

        port@1 {
            reg = <1>;
            serdes-syscon = <&serdes>;
            mc-mac-mask = [ff f0 00 00 00 00];
        };
    };
```

## Documentation/devicetree/bindings/net/hisilicon,hns-mdio.yaml
```yaml
# SPDX-License-Identifier: (GPL-2.0-only OR BSD-2-Clause)
%YAML 1.2
---
$id: http://devicetree.org/schemas/net/hisilicon,hns-mdio.yaml#
$schema: http://devicetree.org/meta-schemas/core.yaml#

title: Hisilicon HNS MDIO bus controller

maintainers:
  - Jian Shen <shenjian15@huawei.com>
  - Jijie Shao <shaojijie@huawei.com>

allOf:
  - $ref: mdio.yaml#

properties:
  compatible:
    enum:
      - hisilicon,hns-mdio
      - hisilicon,mdio

  reg:
    maxItems: 1

  subctrl-vbase:
    $ref: /schemas/types.yaml#/definitions/phandle-array
    items:
      - items:
          - description: syscon phandle
          - description: MDIO clock enable register offset
          - description: MDIO reset request register offset
          - description: MDIO clock state register offset
          - description: MDIO reset state register offset

required:
  - compatible
  - reg
  - '#address-cells'
  - '#size-cells'
  - subctrl-vbase

unevaluatedProperties: false

examples:
  - |
    bus {
        #address-cells = <2>;
        #size-cells = <2>;

        mdio@803c0000 {
            #address-cells = <1>;
            #size-cells = <0>;
            compatible = "hisilicon,hns-mdio";
            reg = <0x0 0x803c0000 0x0 0x10000>;
            subctrl-vbase = <&peri_c_subctrl 0x338 0xa38 0x531c 0x5a1c>;

            ethernet-phy@0 {
                reg = <0>;
            };
        };
    };
```

## Documentation/devicetree/bindings/net/hisilicon,hns-nic.yaml
```yaml
# SPDX-License-Identifier: (GPL-2.0-only OR BSD-2-Clause)
%YAML 1.2
---
$id: http://devicetree.org/schemas/net/hisilicon,hns-nic.yaml#
$schema: http://devicetree.org/meta-schemas/core.yaml#

title: Hisilicon Network Subsystem NIC controller

maintainers:
  - Jian Shen <shenjian15@huawei.com>
  - Jijie Shao <shaojijie@huawei.com>

allOf:
  - $ref: ethernet-controller.yaml#

properties:
  compatible:
    enum:
      - hisilicon,hns-nic-v1
      - hisilicon,hns-nic-v2

  ae-handle:
    description:
      accelerator engine handle for hns, specifies a reference to the
      associating hardware driver node.
    $ref: /schemas/types.yaml#/definitions/phandle

  port-id:
    description: |
      is the index of port provided by DSAF (the accelerator). DSAF can connect to 8 PHYs.
      Port 0 to 1 are both used for administration purpose.
      They are called debug ports.

      The remaining 6 PHYs are taken according to the mode of DSAF.

      In NIC mode of DSAF, all 6 PHYs are taken as ethernet ports to the CPU.
      The port-id can be 2 to 7. Here is the diagram:
            +-----+---------------+
            |            CPU      |
            +-+-+-+---+-+-+-+-+-+-+
              | |     | | | | | |
             debug       service
             port         port
             (0,1)       (2-7)

      In Switch mode of DSAF, all 6 PHYs are taken as physical ports connect to a LAN Switch,
      while the CPU side assume itself have one single NIC connect to this switch.
      In this case, the port-id will be 2 only.
            +-----+---------------+
            |            CPU      |
            +-+-+-+---+-+-+-+-+-+-+
              | |   service| port(2)
             debug   +------------+
             port    |   switch   |
             (0,1)   +-+-+-+-+-+-++
                       | | | | | |
                      external port
    $ref: /schemas/types.yaml#/definitions/uint32
    maximum: 7
    deprecated: true

  port-idx-in-ae:
    description: |
      is the index of port provided by AE.
      In NIC mode of DSAF, all 6 PHYs of service DSAF are taken as ethernet ports to the CPU.
      The port-idx-in-ae can be 0 to 5. Here is the diagram:
            +-----+---------------+
            |            CPU      |
            +-+-+-+---+-+-+-+-+-+-+
              |    |   | | | | | |
           debug debug   service
           port  port     port
           (0)   (0)     (0-5)

      In Switch mode of DSAF, all 6 PHYs of service DSAF are taken as physical ports connected to
      a LAN Switch,
      while the CPU side assume itself have one single NIC connected to this switch.
      In this case, the port-idx-in-ae will be 0 only.
            +-----+-----+------+------+
            |                CPU      |
            +-+-+-+-+-+-+-+-+-+-+-+-+-+
              |    |     service| port(0)
            debug debug  +------------+
            port  port   |   switch   |
            (0)   (0)    +-+-+-+-+-+-++
                          | | | | | |
                         external port
    $ref: /schemas/types.yaml#/definitions/uint32
    maximum: 5

  dma-coherent: true

required:
  - compatible
  - ae-handle
  - port-idx-in-ae
  - local-mac-address

unevaluatedProperties: false

examples:
  - |
    ethernet {
        compatible = "hisilicon,hns-nic-v1";
        ae-handle = <&dsaf0>;
        port-idx-in-ae = <0>;
        local-mac-address = [a2 14 e4 4b 56 76];
    };
```

## Documentation/devicetree/bindings/net/pcs/rockchip,rk3568-xpcs.yaml
```yaml
# SPDX-License-Identifier: (GPL-2.0-only OR BSD-2-Clause)
%YAML 1.2
---
$id: http://devicetree.org/schemas/net/pcs/rockchip,rk3568-xpcs.yaml#
$schema: http://devicetree.org/meta-schemas/core.yaml#

title: Rockchip RK3568 Synopsys DesignWare Ethernet PCS

maintainers:
  - Coia Prant <coiaprant@gmail.com>

description: |
  Rockchip RK3568 SoC integrates a Synopsys DesignWare Ethernet Physical
  Coding Sublayer (XPCS).
  The PCS provides an interface between the Media Access Control (MAC)
  and the Physical Medium Attachment (PMA) sublayer through a Media
  Independent Interface (GMII).

  The XPCS is accessed over the APB3 bus and internally connected to a
  Naneng Combo SerDes PHY.
  It supports 1000BASE-X, SGMII and QSGMII modes.

properties:
  compatible:
    const: rockchip,rk3568-xpcs

  reg:
    maxItems: 1

  clocks:
    items:
      - description: APB3 bus interface clock (clk_csr_i), required for register access
      - description: EEE clock (clk_eee_i), required for Energy Efficient Ethernet operation

  clock-names:
    items:
      - const: csr
      - const: eee

  phys:
    maxItems: 1

  power-domains:
    maxItems: 1

required:
  - compatible
  - reg
  - clocks
  - clock-names
  - phys
  - power-domains

additionalProperties: false

examples:
  - |
    #include <dt-bindings/clock/rk3568-cru.h>
    #include <dt-bindings/power/rk3568-power.h>
    #include <dt-bindings/phy/phy.h>

    ethernet-pcs@fda00000 {
      compatible = "rockchip,rk3568-xpcs";
      reg = <0xfda00000 0x200000>;
      clocks = <&cru PCLK_XPCS>, <&cru CLK_XPCS_EEE>;
      clock-names = "csr", "eee";
      phys = <&combphy2 PHY_TYPE_SGMII>;
      power-domains = <&power RK3568_PD_PIPE>;
    };
```
