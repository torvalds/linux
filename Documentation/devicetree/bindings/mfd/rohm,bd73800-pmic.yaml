## Documentation/devicetree/bindings/mfd/rohm,bd73800-pmic.yaml
```yaml
# SPDX-License-Identifier: GPL-2.0-only OR BSD-2-Clause
%YAML 1.2
---
$id: http://devicetree.org/schemas/mfd/rohm,bd73800-pmic.yaml#
$schema: http://devicetree.org/meta-schemas/core.yaml#

title: ROHM BD73800 Power Management Integrated Circuit

maintainers:
  - Matti Vaittinen <mazziesaccount@gmail.com>

description:
  BD73800GW is a single-chip power management IC for battery-powered
  portable devices. It integrates 8 buck converters, 4 LDOs and a current
  sense amplifier with ADC. Also included is a Real Time Clock (RTC) and a
  32.768 kHz clock gate. Depending on the OTP configuration the BD73800
  may also have interrupt controller and GPIOs.

  There are also different variants called BD71851 and BD71885 which are
  almost identical from the software point of view.

allOf:
  - $ref: rohm,pmic-pins.yaml#

properties:
  compatible:
    oneOf:
      - const: rohm,bd73800

      - items:
          - enum:
              - rohm,bd71851
              - rohm,bd71885
          - const: rohm,bd73800

  reg:
    maxItems: 1

  interrupts:
    maxItems: 1

  # The GPIO1, CLKOUT (GPIO2), FAULT_B and EXTEN_OUT pins can be
  # configured to interrupt pins by OTP.
  interrupt-controller: true

  "#interrupt-cells":
    const: 1
    description:
      The IRQ number. 0 is GPIO1, 1 CLKOUT (GPIO2), 2 FAULT_B and 3 EXTEN_OUT.
      NOTE, A pin can operate as IRQ source only when the OTP
      configuration for it has been set to GPI.

  gpio-controller: true

  "#gpio-cells":
    const: 2

  rohm,pin-gpio1:
    $ref: /schemas/types.yaml#/definitions/string
    description:
      Indicate if the GPIO1 pin has been set to GPI or GPO at manufacturing.
      The GPIO1, CLKOUT, FAULT_B and EXTEN_OUT pins may be configured for a
      specific purpose (like ADC input, 32.768 clk output, fault indicator or
      delivering power sequence to a companion PMIC when multiple PMICs are
      used) - but also to be either a GPO or GPI. (When used as a GPI the pin
      can also be used as an IRQ source). The pin purpose is determined by
      OTP (One Time Programmable memory), typically during device
      manufacturing. The OTP can't be read at runtime so device-tree should
      describe the GPIO pins.
    enum: [gpi, gpo]

  rohm,pin-clkout:
    enum: [gpi, gpo]

  rohm,pin-fault_b:
    enum: [gpi, gpo]

  rohm,pin-exten:
    enum: [gpi, gpo]

  clocks:
    description:
      The CLKOUT pin may have its purpose overridden by OTP configuration. It
      is possible the BD73800 does not output a clock signal. Hence the clk
      properties are optional.
    maxItems: 1

  "#clock-cells":
    const: 0

  clock-output-names:
    maxItems: 1

  rohm,clkout-open-drain: true

  regulators:
    $ref: /schemas/regulator/rohm,bd73800-regulator.yaml
    description:
      List of child nodes that specify the regulators.

required:
  - compatible
  - reg
  - interrupts
  - regulators

additionalProperties: false

examples:
  - |
    #include <dt-bindings/interrupt-controller/irq.h>
    #include <dt-bindings/leds/common.h>
    i2c {
        #address-cells = <1>;
        #size-cells = <0>;
        pmic: pmic@4b {
            compatible = "rohm,bd73800";
            reg = <0x4b>;

            interrupt-parent = <&gpio1>;
            interrupts = <29 IRQ_TYPE_LEVEL_LOW>;

            clocks = <&osc 0>;
            #clock-cells = <0>;
            clock-output-names = "bd73800-32k-out";

            gpio-controller;
            #gpio-cells = <2>;

            rohm,pin-gpio1 = "gpo";
            rohm,pin-exten = "gpi";

            regulators {
                buck1: buck1 {
                    regulator-name = "buck1";
                    regulator-min-microvolt = <800000>;
                    regulator-max-microvolt = <2000000>;
                    regulator-always-on;
                    regulator-ramp-delay = <1250>;
                    rohm,dvs-run-voltage = <1150000>;
                    rohm,dvs-suspend-voltage = <950000>;
                };
                buck2: buck2 {
                    regulator-name = "buck2";
                    regulator-min-microvolt = <800000>;
                    regulator-max-microvolt = <2000000>;
                    regulator-always-on;
                    regulator-ramp-delay = <1250>;
                    rohm,dvs-run-voltage = <1150000>;
                    rohm,dvs-suspend-voltage = <950000>;
                };
                buck3: buck3 {
                    regulator-name = "buck3";
                    regulator-min-microvolt = <1200000>;
                    regulator-max-microvolt = <2700000>;
                    rohm,dvs-run-voltage = <1150000>;
                    rohm,dvs-idle-voltage = <1100000>;
                    rohm,dvs-suspend-voltage = <950000>;
                    regulator-always-on;
                };
                buck4: buck4 {
                    regulator-name = "buck4";
                    regulator-min-microvolt = <1100000>;
                    regulator-max-microvolt = <1850000>;
                    regulator-always-on;
                };
                buck5: buck5 {
                    regulator-name = "buck5";
                    regulator-min-microvolt = <1800000>;
                    regulator-max-microvolt = <3300000>;
                    regulator-always-on;
                };
                buck6: buck6 {
                    regulator-name = "buck6";
                    regulator-min-microvolt = <1800000>;
                    regulator-max-microvolt = <3300000>;
                    regulator-always-on;
                };
                buck7: buck7 {
                    regulator-name = "buck7";
                    regulator-min-microvolt = <1800000>;
                    regulator-max-microvolt = <3300000>;
                    regulator-always-on;
                };
                buck8: buck8 {
                    regulator-name = "buck8";
                    regulator-min-microvolt = <500000>;
                    regulator-max-microvolt = <1300000>;
                    regulator-always-on;
                };
                ldo1: ldo1 {
                    regulator-name = "ldo1";
                    rohm,ldo-range-high;
                    regulator-min-microvolt = <800000>;
                    regulator-max-microvolt = <3300000>;
                    regulator-always-on;
                };
                ldo2: ldo2 {
                    regulator-name = "ldo2";
                    regulator-min-microvolt = <800000>;
                    regulator-max-microvolt = <3300000>;
                    regulator-always-on;
                };
                ldo3: ldo3 {
                    regulator-name = "ldo3";
                    regulator-min-microvolt = <800000>;
                    regulator-max-microvolt = <3300000>;
                    regulator-always-on;
                };
                ldo4: ldo4 {
                    regulator-name = "ldo4";
                    regulator-min-microvolt = <650000>;
                    regulator-max-microvolt = <1750000>;
                    regulator-always-on;
                };
            };
        };
    };
```

## Documentation/devicetree/bindings/mfd/ti,keystone-devctrl.yaml
```yaml
# SPDX-License-Identifier: (GPL-2.0-only OR BSD-2-Clause)
%YAML 1.2
---
$id: http://devicetree.org/schemas/mfd/ti,keystone-devctrl.yaml#
$schema: http://devicetree.org/meta-schemas/core.yaml#

title: Texas Instruments Keystone Device State Control

maintainers:
  - Ivan Khoronzhuk <ivan.khoronzhuk@ti.com>

description:
  The Keystone II devices have a set of registers that are used to control the
  status of its peripherals. This node is intended to allow access to this
  functionality.

properties:
  compatible:
    items:
      - const: ti,keystone-devctrl
      - const: syscon
      - const: simple-mfd

  reg:
    maxItems: 1

  "#address-cells":
    const: 1

  "#size-cells":
    const: 1

  ranges: true

patternProperties:
  "^gpio@[0-9a-f]+$":
    type: object
    description: Keystone DSP GPIO controller
    required:
      - compatible

  "^interrupt-controller@[0-9a-f]+$":
    type: object
    description: Keystone DSP to ARM interrupt controller
    required:
      - compatible

  "^reset-controller@[0-9a-f]+$":
    type: object
    description: Keystone reset controller
    required:
      - compatible

required:
  - compatible
  - reg
  - "#address-cells"
  - "#size-cells"
  - ranges

additionalProperties: false

examples:
  - |
    #include <dt-bindings/interrupt-controller/arm-gic.h>

    device-state-control@2620000 {
        compatible = "ti,keystone-devctrl", "syscon", "simple-mfd";
        reg = <0x02620000 0x1000>;
        #address-cells = <1>;
        #size-cells = <1>;
        ranges = <0x0 0x02620000 0x1000>;

        interrupt-controller@2a0 {
            compatible = "ti,keystone-irq";
            reg = <0x2a0 0x4>;
            interrupts = <GIC_SPI 4 IRQ_TYPE_EDGE_RISING>;
            interrupt-controller;
            #interrupt-cells = <1>;
            ti,syscon-dev = <&devctrl 0x2a0>;
        };

        reset-controller@328 {
            compatible = "ti,keystone-reset";
            reg = <0x328 0x10>;
            ti,syscon-pll = <&pllctrl 0xe4>;
            ti,syscon-dev = <&devctrl 0x328>;
            ti,wdt-list = <0>;
        };
    };
```

## Documentation/devicetree/bindings/mfd/ti,lp3943.yaml
```yaml
# SPDX-License-Identifier: (GPL-2.0-only OR BSD-2-Clause)
%YAML 1.2
---
$id: http://devicetree.org/schemas/mfd/ti,lp3943.yaml#
$schema: http://devicetree.org/meta-schemas/core.yaml#

title: TI/National Semiconductor LP3943 MFD driver

maintainers:
  - Chaosheng Qu <quchaosheng000406@163.com>

description:
  LP3943 is an integrated device capable of driving LEDs. It contains two
  sub-devices, lp3943-gpio and lp3943-pwm, which are instantiated by the MFD
  core from the child nodes described below.

properties:
  compatible:
    const: ti,lp3943

  reg:
    maxItems: 1
    description: I2C slave address, from 0x60 to 0x67

patternProperties:
  "^gpio":
    type: object
    $ref: /schemas/gpio/trivial-gpio.yaml#

  "^pwm":
    type: object
    $ref: /schemas/pwm/pwm-lp3943.yaml#

required:
  - compatible
  - reg

additionalProperties: false

examples:
  - |
    i2c {
        #address-cells = <1>;
        #size-cells = <0>;

        lp3943: gpio@60 {
            compatible = "ti,lp3943";
            reg = <0x60>;

            gpio {
                compatible = "ti,lp3943-gpio";
                gpio-controller;
                #gpio-cells = <2>;
            };

            pwm {
                compatible = "ti,lp3943-pwm";
                #pwm-cells = <2>;
                ti,pwm0 = <8 9 10>;
                ti,pwm1 = <15>;
            };
        };
    };
...
```

## Documentation/devicetree/bindings/mfd/ti,tps61050.yaml
```yaml
# SPDX-License-Identifier: (GPL-2.0-only OR BSD-2-Clause)
%YAML 1.2
---
$id: http://devicetree.org/schemas/mfd/ti,tps61050.yaml#
$schema: http://devicetree.org/meta-schemas/core.yaml#

title: Texas Instruments TPS61050/TPS61052 Boost Converter

maintainers:
  - Eduard Bostina <egbostina@gmail.com>

description:
  The TP61050/TPS61052 is a high-power "white LED driver". The device
  provides LED, GPIO and regulator functionalities.

properties:
  compatible:
    enum:
      - ti,tps61050
      - ti,tps61052

  reg:
    maxItems: 1

  regulator:
    type: object
    $ref: /schemas/regulator/regulator.yaml#
    description: Puts the chip in regulator mode.
    unevaluatedProperties: false

  led:
    type: object
    $ref: /schemas/leds/common.yaml#
    description: Puts the chip in LED mode.
    unevaluatedProperties: false

required:
  - compatible
  - reg

allOf:
  - not:
      required:
        - regulator
        - led

additionalProperties: false

examples:
  - |
    i2c {
        #address-cells = <1>;
        #size-cells = <0>;

        tps61052@33 {
            compatible = "ti,tps61052";
            reg = <0x33>;
        };
    };

  - |
    i2c {
        #address-cells = <1>;
        #size-cells = <0>;

        tps61052@33 {
            compatible = "ti,tps61052";
            reg = <0x33>;

            regulator {
                regulator-min-microvolt = <5000000>;
                regulator-max-microvolt = <5000000>;
                regulator-always-on;
            };
        };
    };

  - |
    #include <dt-bindings/leds/common.h>
    i2c {
        #address-cells = <1>;
        #size-cells = <0>;

        tps61052@33 {
            compatible = "ti,tps61052";
            reg = <0x33>;

            led {
                color = <LED_COLOR_ID_WHITE>;
            };
        };
    };
```
