## Documentation/devicetree/bindings/mfd/ti,twl6040.yaml
```yaml
# SPDX-License-Identifier: (GPL-2.0-only OR BSD-2-Clause)
%YAML 1.2
---
$id: http://devicetree.org/schemas/mfd/ti,twl6040.yaml#
$schema: http://devicetree.org/meta-schemas/core.yaml#

title: Texas Instruments TWL6040 family audio codec

maintainers:
  - Eduard Bostina <egbostina@gmail.com>

description:
  The TWL6040s are 8-channel high quality low-power audio codecs providing
  audio, vibra and GPO functionality on OMAP4+ platforms. They are connected
  to the host processor via i2c for commands, McPDM for audio data and
  commands.

properties:
  compatible:
    enum:
      - ti,twl6040
      - ti,twl6041

  reg:
    const: 0x4b

  interrupts:
    maxItems: 1

  gpio-controller: true

  "#gpio-cells":
    const: 1

  "#clock-cells":
    const: 0

  ti,audpwron-gpio:
    maxItems: 1
    description: Power on GPIO line for the twl6040

  vio-supply:
    description: Regulator for the twl6040 VIO supply

  v2v1-supply:
    description: Regulator for the twl6040 V2V1 supply

  enable-active-high:
    type: boolean
    description: To power on the twl6040 during boot.

  clocks:
    minItems: 1
    maxItems: 2

  clock-names:
    minItems: 1
    maxItems: 2
    items:
      enum:
        - clk32k
        - mclk

  vddvibl-supply:
    description: Regulator for the left vibra motor

  vddvibr-supply:
    description: Regulator for the right vibra motor

  vibra:
    type: object
    additionalProperties: false
    properties:
      ti,vibldrv-res:
        $ref: /schemas/types.yaml#/definitions/uint32
        description: Resistance parameter for left driver

      ti,vibrdrv-res:
        $ref: /schemas/types.yaml#/definitions/uint32
        description: Resistance parameter for right driver

      ti,viblmotor-res:
        $ref: /schemas/types.yaml#/definitions/uint32
        description: Resistance parameter for left motor

      ti,vibrmotor-res:
        $ref: /schemas/types.yaml#/definitions/uint32
        description: Resistance parameter for right motor

      ti,vddvibl-uV:
        $ref: /schemas/types.yaml#/definitions/uint32
        description: vddvibl default voltage if it needs to be changed

      ti,vddvibr-uV:
        $ref: /schemas/types.yaml#/definitions/uint32
        description: vddvibr default voltage if it needs to be changed

    required:
      - ti,vibldrv-res
      - ti,vibrdrv-res
      - ti,viblmotor-res
      - ti,vibrmotor-res

required:
  - compatible
  - reg
  - interrupts
  - "#clock-cells"
  - vio-supply
  - v2v1-supply

allOf:
  - if:
      required:
        - vibra
    then:
      required:
        - vddvibl-supply
        - vddvibr-supply

additionalProperties: false

examples:
  - |
    #include <dt-bindings/interrupt-controller/irq.h>

    i2c {
        #address-cells = <1>;
        #size-cells = <0>;

        audio-codec@4b {
            compatible = "ti,twl6040";
            reg = <0x4b>;
            interrupts = <0 119 IRQ_TYPE_LEVEL_HIGH>;
            interrupt-parent = <&gic>;
            gpio-controller;
            #gpio-cells = <1>;
            #clock-cells = <0>;
            ti,audpwron-gpio = <&gpio4 31 0>;

            vio-supply = <&v1v8>;
            v2v1-supply = <&v2v1>;
            enable-active-high;

            /* regulators for vibra motor */
            vddvibl-supply = <&vbat>;
            vddvibr-supply = <&vbat>;

            vibra {
                ti,vibldrv-res = <8>;
                ti,vibrdrv-res = <3>;
                ti,viblmotor-res = <10>;
                ti,vibrmotor-res = <10>;
            };
        };
    };
```

## Documentation/devicetree/bindings/mfd/ti,usbhs-tll.yaml
```yaml
# SPDX-License-Identifier: (GPL-2.0-only OR BSD-2-Clause)
%YAML 1.2
---
$id: http://devicetree.org/schemas/mfd/ti,usbhs-tll.yaml#
$schema: http://devicetree.org/meta-schemas/core.yaml#

title: OMAP HS USB Host TLL (Transceiver-Less Interface)

maintainers:
  - Eduard Bostina <egbostina@gmail.com>

properties:
  compatible:
    const: ti,usbhs-tll

  reg:
    maxItems: 1

  interrupts:
    maxItems: 1

  ti,hwmods:
    description: Name of the hwmod associated with the USB TLL.
    $ref: /schemas/types.yaml#/definitions/string
    const: usb_tll_hs

  clocks:
    minItems: 1
    maxItems: 3
    description: A list of phandles and clock-specifier pairs.

  clock-names:
    minItems: 1
    items:
      - const: usb_tll_hs_usb_ch0_clk
      - const: usb_tll_hs_usb_ch1_clk
      - const: usb_tll_hs_usb_ch2_clk

required:
  - compatible
  - reg
  - interrupts

additionalProperties: false

examples:
  - |
    usb-tll@4a062000 {
        compatible = "ti,usbhs-tll";
        reg = <0x4a062000 0x1000>;
        interrupts = <78>;
        ti,hwmods = "usb_tll_hs";
    };
```

## Documentation/devicetree/bindings/mfd/x-powers,ac200.yaml
```yaml
# SPDX-License-Identifier: (GPL-2.0-only OR BSD-2-Clause)
%YAML 1.2
---
$id: http://devicetree.org/schemas/mfd/x-powers,ac200.yaml#
$schema: http://devicetree.org/meta-schemas/core.yaml#

title: X-Powers AC200 mixed-signal IC

maintainers:
  - James Hilliard <james.hilliard1@gmail.com>
  - Jernej Skrabec <jernej.skrabec@gmail.com>

description:
  The AC200 is a mixed-signal companion IC containing audio, video, RTC and
  Fast Ethernet PHY functions. Its control registers are accessed over I2C.
  The audio codec and TV encoder are described by properties of this node.
  The Ethernet PHY is described separately on its MDIO bus.

allOf:
  - $ref: /schemas/sound/dai-common.yaml#

properties:
  compatible:
    const: x-powers,ac200

  reg:
    maxItems: 1

  clocks:
    maxItems: 1
    description:
      AC200 input clock. When using the Ethernet PHY, its configured rate must
      be 24 or 27 MHz, matching the rates encoded by the documented EPHY clock
      selector.

  interrupts:
    maxItems: 1
    description:
      The shared, level-triggered, open-drain INTB output for the TV encoder,
      Ethernet PHY and RTC interrupts. Omit when INTB is not connected. TV
      encoder cable detection status can also be read over I2C without an
      interrupt.

  '#sound-dai-cells':
    const: 0

  ac-ldoin-supply:
    description:
      The 3.3 V supply connected to the AC_LDOIN pin for the audio codec LDO
      input. This may be the same regulator as tv-vcc-supply.

  tv-vcc-supply:
    description:
      The 3.3 V supply connected to the TV_VCC pin for the composite-video
      DAC. This may be the same regulator as ac-ldoin-supply.

  nvmem-cells:
    maxItems: 1
    description: TV encoder bandgap calibration.

  nvmem-cell-names:
    items:
      - const: bandgap

  ports:
    $ref: /schemas/graph.yaml#/properties/ports

    properties:
      port@0:
        $ref: /schemas/graph.yaml#/properties/port
        description: Input to the TV encoder, carrying CCIR656.

      port@1:
        $ref: /schemas/graph.yaml#/properties/port
        description: Output to the composite-video connector.

    required:
      - port@0
      - port@1

required:
  - compatible
  - reg
  - clocks

dependencies:
  '#sound-dai-cells': [ ac-ldoin-supply ]
  ports: [ tv-vcc-supply ]
  nvmem-cells: [ nvmem-cell-names ]
  nvmem-cell-names: [ nvmem-cells ]

unevaluatedProperties: false

examples:
  - |
    #include <dt-bindings/interrupt-controller/irq.h>

    i2c {
        #address-cells = <1>;
        #size-cells = <0>;

        mixed-signal@10 {
            compatible = "x-powers,ac200";
            reg = <0x10>;
            clocks = <&pwm 5>;
            interrupt-parent = <&pio>;
            interrupts = <1 20 IRQ_TYPE_LEVEL_LOW>;
            #sound-dai-cells = <0>;
            ac-ldoin-supply = <&reg_aldo2>;
            tv-vcc-supply = <&reg_aldo2>;

            ports {
                #address-cells = <1>;
                #size-cells = <0>;

                port@0 {
                    reg = <0>;

                    tve_in: endpoint {
                        remote-endpoint = <&tcon_out_tve>;
                    };
                };

                port@1 {
                    reg = <1>;

                    tve_out: endpoint {
                        remote-endpoint = <&composite_in>;
                    };
                };
            };
        };
    };
  - |
    i2c {
        #address-cells = <1>;
        #size-cells = <0>;

        mixed-signal@10 {
            compatible = "x-powers,ac200";
            reg = <0x10>;
            clocks = <&pwm 5>;
            /* INTB is not connected. */
            tv-vcc-supply = <&reg_aldo2>;

            ports {
                #address-cells = <1>;
                #size-cells = <0>;

                port@0 {
                    reg = <0>;

                    endpoint {
                        remote-endpoint = <&tcon_out_tve>;
                    };
                };

                port@1 {
                    reg = <1>;

                    endpoint {
                        remote-endpoint = <&composite_in>;
                    };
                };
            };
        };
    };
...
```

## Documentation/devicetree/bindings/misc/pci1179,0220.yaml
```yaml
# SPDX-License-Identifier: (GPL-2.0-only OR BSD-2-Clause)
%YAML 1.2
---
$id: http://devicetree.org/schemas/misc/pci1179,0220.yaml#
$schema: http://devicetree.org/meta-schemas/core.yaml#

title: Toshiba TC9564 internal PCI endpoint function

maintainers:
  - Alex Elder <elder@kernel.org>
  - Daniel Thompson <danielt@kernel.org>

description: >
  The Toshiba TC9564 is specialized SoC that implements a PCIe switch
  as well as an Ethernet AVB/TSN bridge.  In addition to these, the SoC
  implements other functions, including a reset and clock controller,
  an address translation unit, and a few other devices.

  The PCI switch has three downstream ports.  The first two are exposed
  externally, while the third is used by an internal PCIe endpoint.  The
  internal endpoint implements two PCIe functions, and attached to each
  of these is a 10 Gbps capable Synopsys Ethernet controller and an
  interrupt controller that converts internal "wired" interrupts into
  MSIs delivered to the host.

  PCIe BARs provide access to registers that manage almost all IP blocks.
  The SoC is modeled using a PCI endpoint bus.  The IP blocks are bound
  to platform drivers that access the hardware using MMIO through the
  PCI BARs.

          ------------------------------------
          |               Host               |
          -----........---------------...-----
              |        |             |   |
              |  PCIe  |             |I2C|
              |        |             |   |
    ----------+........+-------------+...+-------------------------------
    |         |upstream|          |          |       ----------------   |
    | Toshiba | Port 0 |          |          +-------+ PCIe pwrctrl |   |
    | TC9564  ----++----          |   I2C    |       ----------------   |
    |  SoC        ||              |controller|       ----------------   |
    |             ||              |          +-------+     GPIO     |   |
    |             ||              |          |       |  controller  |   |
    |       ------++------        ------------       ----------------   |
    |       |     US     |                                              |
    |       |            |    ----------------------------------------  |
    |       |         DS3+====+          downstream port 3           |  |
    |       |            |    |--------------------------------------|  |
    |       |    PCIe    |    |        embedded PCIe endpoint        |  |
    |       |   switch   |    |~~~~~~~~~~~~~~~~~~~++~~~~~~~~~~~~~~~~~|  |
    |       |            |    |  PCIe function 0  || PCIe function 1 |  |
    |       |            |    |-------------------||-----------------|  |
    |       |            |    | BAR || BAR || BAR || BAR | BAR | BAR |  |
    |       |            |    |  0  ||  2  ||  4  ||  0  |  2  |  4  |  |
    |       | DS1    DS2 |    ---.------.------.--++--------------.---  |
    |       --++------++--       :      :      :                  :     |
    |         ||      ||         :   ---.--    :.......           :     |
    |         ||      ||         :   |SRAM|    :      :           :     |
    |         ||      ||         :   ------    :   ---.---        :     |
    |         ||      ||         :         ....:   |clock|    ....:     |
    |         ||      ||         :         :   :   -------    :   :     |
    |         ||      ||   ------.----    -.-  :             -.-  :     |
    |         ||      ||   |translate|    |M|  :.......      |M|  :     |
    |         ||      ||   -----------    |S|  :      :      |S|  :     |
    |         ||      ||                  |I|  :   ---.---   |I|  :     |
    |         ||      ||                  |G|  :   |reset|   |G|  :     |
    |         ||      ||                  |E|  :   -------   |E|  :     |
    | --------++--  --++--------          |N|  :             |N|  :     |
    | |downstream|  |downstream|         ------.----        ------.---- |
    | |  port 1  |  |  port 2  |         | XGMAC 0 |        | XGMAC 1 | |
    --+..........+--+..........+----------+.......+-----------+.....+----
                                          |       |           |     |
                                          |USXGMII|           |SGMII|
                                          |       |           |     |
                                        --+.......+--      ---+.....+---
                                        | Ethernet  |      | Ethernet  |
                                        |    PHY    |      |    PHY    |
                                        -------------      -------------

allOf:
  - $ref: /schemas/pci/pci-ep-bus.yaml

properties:
  compatible:
    const: pci1179,0220         # Toshiba TC9564 (a.k.a. Qualcomm QPS615)

  reg:
    maxItems: 1
    description: PCI Bus/Device/Function config space address

unevaluatedProperties: false

required:
  - compatible
  - reg
  - '#address-cells'
  - '#size-cells'
  - ranges

examples:
  - |
    pcie@0,0 {
        reg = <0x0  0x0>;
        #address-cells = <3>;
        #size-cells = <2>;
        device_type = "pci";
        ranges = <0x83000000 0x0 0x0  0x0  0x0 0x1fd00000>;

        dev@0,0 {
            compatible = "pci1179,0220";
            reg = <0x0 0x0 0x0 0x0 0x0>;
            #address-cells = <3>;
            #size-cells = <2>;
            /* Ranges will be updated dynamically */
            ranges = <0x0 0x0 0x0  0x83000000 0x0 0x0  0x0 0x4000>,
                     <0x2 0x0 0x0  0x83000000 0x0 0x4000  0x0 0x80000>,
                     <0x4 0x0 0x0  0x83000000 0x0 0x84000  0x0 0x200000>;

            pci-ep-bus@4 {
                compatible = "simple-bus";
                #address-cells = <1>;
                #size-cells = <1>;
                /* Map 0x0-0x1fffff to BAR 4 */
                ranges = <0x0  0x4 0x0 0x0  0x200000>;
            };
        };

        dev@0,1 {
            compatible = "pci1179,0220";
            reg = <0x100 0x0 0x0 0x0 0x0>;
            #address-cells = <3>;
            #size-cells = <2>;
            /* Ranges will be updated dynamically */
            ranges = <0x0 0x0 0x0  0x83000100 0x0 0x0  0x0 0x4000>,
                     <0x2 0x0 0x0  0x83000100 0x0 0x4000  0x0 0x80000>,
                     <0x4 0x0 0x0  0x83000100 0x0 0x84000  0x0 0x200000>;

            pci-ep-bus@4 {
                compatible = "simple-bus";
                #address-cells = <1>;
                #size-cells = <1>;
                /* Map 0x0-0x1fffff to BAR 4 */
                ranges = <0x0  0x4 0x0 0x0  0x200000>;
            };
        };
    };
```
