## Documentation/devicetree/bindings/net/realtek,rtl9301-mdio.yaml
```yaml
# SPDX-License-Identifier: (GPL-2.0-only OR BSD-2-Clause)
%YAML 1.2
---
$id: http://devicetree.org/schemas/net/realtek,rtl9301-mdio.yaml#
$schema: http://devicetree.org/meta-schemas/core.yaml#

title: Realtek Otto Switches Ethernet MDIO Controller

maintainers:
  - Chris Packham <chris.packham@alliedtelesis.co.nz>

properties:
  compatible:
    oneOf:
      - items:
          - enum:
              - realtek,rtl8381-mdio
              - realtek,rtl8382-mdio
          - const: realtek,rtl8380-mdio
      - items:
          - enum:
              - realtek,rtl8392-mdio
              - realtek,rtl8393-mdio
          - const: realtek,rtl8391-mdio
      - items:
          - enum:
              - realtek,rtl9302b-mdio
              - realtek,rtl9302c-mdio
              - realtek,rtl9303-mdio
          - const: realtek,rtl9301-mdio
      - items:
          - enum:
              - realtek,rtl9312-mdio
              - realtek,rtl9313-mdio
          - const: realtek,rtl9311-mdio
      - enum:
          - realtek,rtl8380-mdio
          - realtek,rtl8391-mdio
          - realtek,rtl9301-mdio
          - realtek,rtl9311-mdio

  '#address-cells':
    const: 1

  '#size-cells':
    const: 0

  reg:
    maxItems: 1

patternProperties:
  '^mdio-bus@[0-3]$':
    $ref: mdio.yaml#

    properties:
      reg:
        maxItems: 1

    required:
      - reg

    patternProperties:
      '^ethernet-phy@[a-f0-9]+$':
        type: object
        $ref: ethernet-phy.yaml#
        unevaluatedProperties: false

    unevaluatedProperties: false

required:
  - compatible
  - reg

allOf:
  - if:
      properties:
        compatible:
          contains:
            enum:
              - realtek,rtl8380-mdio
              - realtek,rtl8381-mdio
              - realtek,rtl8382-mdio
    then:
      properties:
        mdio-bus@0:
          properties:
            clock-frequency:
              enum: [2500000, 10000000]
              default: 2500000

      patternProperties:
        '^mdio-bus@[1-3]$': false

  - if:
      properties:
        compatible:
          contains:
            enum:
              - realtek,rtl8391-mdio
              - realtek,rtl8392-mdio
              - realtek,rtl8393-mdio
    then:
      patternProperties:
        '^mdio-bus@[01]$':
          properties:
            clock-frequency:
              enum: [1250000, 2500000, 5000000]
              description: |
                RTL839x has one clock selector shared by both MDIO buses. All explicitly
                specified clock-frequency values must be identical. A bus without this
                property inherits the shared frequency selected by another available bus.
                If neither available bus specifies a frequency, 2500000 Hz is used.

        '^mdio-bus@[2-3]$': false

  - if:
      properties:
        compatible:
          contains:
            enum:
              - realtek,rtl9301-mdio
              - realtek,rtl9302b-mdio
              - realtek,rtl9302c-mdio
              - realtek,rtl9303-mdio
              - realtek,rtl9311-mdio
              - realtek,rtl9312-mdio
              - realtek,rtl9313-mdio
    then:
      patternProperties:
        '^mdio-bus@[0-3]$':
          properties:
            clock-frequency:
              enum: [1250000, 2500000, 5000000]
              default: 2500000

unevaluatedProperties: false

examples:
  - |
    mdio-controller@ca00 {
      compatible = "realtek,rtl9301-mdio";
      reg = <0xca00 0x200>;
      #address-cells = <1>;
      #size-cells = <0>;

      mdio-bus@0 {
        reg = <0>;
        #address-cells = <1>;
        #size-cells = <0>;

        ethernet-phy@0 {
          compatible = "ethernet-phy-ieee802.3-c45";
          reg = <0>;
        };
      };

      mdio-bus@1 {
        reg = <1>;
        #address-cells = <1>;
        #size-cells = <0>;

        ethernet-phy@0 {
          compatible = "ethernet-phy-ieee802.3-c45";
          reg = <0>;
        };
      };
    };
```

## Documentation/devicetree/bindings/net/snps,dwmac-common.yaml
```yaml
# SPDX-License-Identifier: GPL-2.0
%YAML 1.2
---
$id: http://devicetree.org/schemas/net/snps,dwmac-common.yaml#
$schema: http://devicetree.org/meta-schemas/core.yaml#

title: Synopsys DesignWare MAC common properties

maintainers:
  - Alexandre Torgue <alexandre.torgue@foss.st.com>
  - Giuseppe Cavallaro <peppe.cavallaro@st.com>
  - Jose Abreu <joabreu@synopsys.com>

properties:
  stmmac-axi-config:
    type: object
    unevaluatedProperties: false
    description:
      AXI BUS Mode parameters.

    properties:
      snps,lpi_en:
        $ref: /schemas/types.yaml#/definitions/flag
        description:
          enable Low Power Interface

      snps,xit_frm:
        $ref: /schemas/types.yaml#/definitions/flag
        description:
          unlock on WoL

      snps,wr_osr_lmt:
        $ref: /schemas/types.yaml#/definitions/uint32
        description:
          max write outstanding req. limit

      snps,rd_osr_lmt:
        $ref: /schemas/types.yaml#/definitions/uint32
        description:
          max read outstanding req. limit

      snps,blen:
        $ref: /schemas/types.yaml#/definitions/uint32-array
        description:
          this is a vector of supported burst length.
        minItems: 7
        maxItems: 7

      snps,fb:
        $ref: /schemas/types.yaml#/definitions/flag
        description:
          fixed-burst

  snps,axi-config:
    $ref: /schemas/types.yaml#/definitions/phandle
    description:
      AXI BUS Mode parameters. Phandle to a node that can contain the
      following properties
        * snps,lpi_en, enable Low Power Interface
        * snps,xit_frm, unlock on WoL
        * snps,wr_osr_lmt, max write outstanding req. limit
        * snps,rd_osr_lmt, max read outstanding req. limit
        * snps,blen, this is a vector of supported burst length.
        * snps,fb, fixed-burst

additionalProperties: true
```

## Documentation/devicetree/bindings/net/ultrarisc,dp1000-gmac.yaml
```yaml
# SPDX-License-Identifier: (GPL-2.0-only OR BSD-2-Clause)
%YAML 1.2
---
$id: http://devicetree.org/schemas/net/ultrarisc,dp1000-gmac.yaml#
$schema: http://devicetree.org/meta-schemas/core.yaml#

title: UltraRISC DP1000 DWMAC Ethernet controller

maintainers:
  - Jia Wang <wangjia@ultrarisc.com>

description:
  The DP1000 integrates a Synopsys DesignWare GMAC controller from the
  5.20 series. The SoC integration adds fixed RGMII TX and RX clock delays
  which cannot be disabled. Consequently, a functional RGMII link requires
  a PCB without TX or RX clock delays, represented by "rgmii-id".

select:
  properties:
    compatible:
      contains:
        const: ultrarisc,dp1000-gmac
  required:
    - compatible

properties:
  compatible:
    items:
      - const: ultrarisc,dp1000-gmac
      - const: snps,dwmac-5.20

  reg:
    maxItems: 1

  clocks:
    maxItems: 1

  clock-names:
    const: stmmaceth

  interrupts:
    maxItems: 1

  interrupt-names:
    const: macirq

  phy-mode:
    const: rgmii-id

required:
  - compatible
  - reg
  - clocks
  - clock-names
  - interrupts
  - interrupt-names
  - phy-mode

allOf:
  - $ref: snps,dwmac.yaml#

unevaluatedProperties: false

examples:
  - |
    ethernet@38000000 {
        compatible = "ultrarisc,dp1000-gmac", "snps,dwmac-5.20";
        reg = <0x38000000 0x1000000>;
        clocks = <&clk 0>;
        clock-names = "stmmaceth";
        interrupts = <84>;
        interrupt-names = "macirq";
        phy-mode = "rgmii-id";
    };
```
