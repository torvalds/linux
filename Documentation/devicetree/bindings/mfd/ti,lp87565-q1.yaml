## Documentation/devicetree/bindings/mfd/ti,lp87565-q1.yaml
```yaml
# SPDX-License-Identifier: (GPL-2.0-only OR BSD-2-Clause)
%YAML 1.2
---
$id: http://devicetree.org/schemas/mfd/ti,lp87565-q1.yaml#
$schema: http://devicetree.org/meta-schemas/core.yaml#

title: TI LP87565-Q1 / LP87565 dual 2-phase output buck converter

maintainers:
  - Keerthy <j-keerthy@ti.com>

properties:
  compatible:
    enum:
      - ti,lp87565
      - ti,lp87565-q1

  reg:
    description: I2C slave address
    const: 0x60

  reset-gpios:
    description: GPIO connected to NRST pin (active low reset, pin 20)
    maxItems: 1

  gpio-controller: true

  '#gpio-cells':
    description:
      The first cell is the pin number.
      The second cell is used to specify flags.
      See ../gpio/gpio.txt for more information.
    const: 2

  buck10-in-supply:
    description:
      Voltage regulator supply for BUCK0 and BUCK1 converters.

  buck23-in-supply:
    description:
      Voltage regulator supply for BUCK2 and BUCK3 converters.

  regulators:
    type: object

    patternProperties:
      "^buck(10|23)$":
        type: object
        $ref: /schemas/regulator/regulator.yaml#
        unevaluatedProperties: false

    required:
      - buck10
      - buck23

    additionalProperties: false

required:
  - compatible
  - reg
  - gpio-controller
  - '#gpio-cells'
  - buck10-in-supply
  - buck23-in-supply

additionalProperties: false

examples:
  - |
    i2c@0 {
        reg = <0x0 0x100>;
        #address-cells = <1>;
        #size-cells = <0>;

        pmic@60 {
            compatible = "ti,lp87565-q1";
            reg = <0x60>;
            gpio-controller;
            #gpio-cells = <2>;

            buck10-in-supply = <&vsys_3v3>;
            buck23-in-supply = <&vsys_3v3>;

            regulators {
                buck10_reg: buck10 {
                    /* VDD_MPU */
                    regulator-name = "buck10";
                    regulator-min-microvolt = <850000>;
                    regulator-max-microvolt = <1250000>;
                    regulator-always-on;
                    regulator-boot-on;
                };

                buck23_reg: buck23 {
                    /* VDD_GPU */
                    regulator-name = "buck23";
                    regulator-min-microvolt = <850000>;
                    regulator-max-microvolt = <1250000>;
                    regulator-boot-on;
                    regulator-always-on;
                };
            };
        };
    };

...
```

## Documentation/devicetree/bindings/mfd/ti,nspire-misc.yaml
```yaml
# SPDX-License-Identifier: (GPL-2.0-only OR BSD-2-Clause)
# Copyright (C) 2022-2023 Texas Instruments Incorporated - https://www.ti.com/
%YAML 1.2
---
$id: http://devicetree.org/schemas/mfd/ti,nspire-misc.yaml#
$schema: http://devicetree.org/meta-schemas/core.yaml#

title: TI Nspire MISC hardware block

maintainers:
  - Andrew Davis <afd@ti.com>

description:
  System controller node represents a register region containing a set
  of miscellaneous registers. The registers are not cohesive enough to
  represent as any specific type of device. Currently there is a reset
  controller.

properties:
  compatible:
    items:
      - enum:
          - ti,nspire-misc
      - const: syscon
      - const: simple-mfd

  reg:
    maxItems: 1

  reboot:
    $ref: /schemas/power/reset/syscon-reboot.yaml#

required:
  - compatible
  - reg
  - reboot

additionalProperties: false

examples:
  - |
    misc: misc@900a0000 {
      compatible = "ti,nspire-misc", "syscon", "simple-mfd";
      reg = <0x900a0000 0x1000>;

      reboot {
        compatible = "syscon-reboot";
        offset = <0x08>;
        value = <0x02>;
      };
    };
```

## Documentation/devicetree/bindings/mfd/ti,tps65086.yaml
```yaml
# SPDX-License-Identifier: (GPL-2.0-only OR BSD-2-Clause)
%YAML 1.2
---
$id: http://devicetree.org/schemas/mfd/ti,tps65086.yaml#
$schema: http://devicetree.org/meta-schemas/core.yaml#

title: TPS65086 Power Management Integrated Circuit (PMIC)

maintainers:
  - Emil Renner Berthing <kernel@esmil.dk>

properties:
  compatible:
    const: ti,tps65086

  reg:
    const: 0x5e
    description: I2C slave address

  interrupts:
    maxItems: 1

  interrupt-controller: true

  '#interrupt-cells':
    const: 2
    description: |
      The first cell is the IRQ number. The second cell is the flags,
      encoded as trigger masks from ../interrupt-controller/interrupts.txt.

  gpio-controller: true

  '#gpio-cells':
    const: 2
    description: |
      The first cell is the pin number and the second cell is used to specify
      flags.  See ../gpio/gpio.txt for more information.

  regulators:
    type: object
    additionalProperties: false
    description: |
      List of child nodes that specify the regulator initialization data.
      Child nodes must be named after their hardware counterparts:
      buck[1-6], ldoa[1-3], swa1, swb[1-2], and vtt.
      Each child node is defined using the standard binding for regulators and
      the optional regulator properties defined below.

    patternProperties:
      "^buck[1-6]$":
        type: object
        $ref: ../regulator/regulator.yaml

        properties:
          regulator-name: true
          regulator-boot-on: true
          regulator-always-on: true
          regulator-min-microvolt: true
          regulator-max-microvolt: true
          ti,regulator-step-size-25mv:
            type: boolean
            description: |
              Set this if the regulator is factory set with a 25mv step voltage
              mapping.
          ti,regulator-decay:
            type: boolean
            description: |
              Set this if the output needs to decay, default is for the output
              to slew down.

        additionalProperties: false

      "^(ldoa[1-3]|swa1|swb[1-2]|vtt)$":
        type: object
        $ref: ../regulator/regulator.yaml

        properties:
          regulator-name: true
          regulator-boot-on: true
          regulator-always-on: true
          regulator-min-microvolt: true
          regulator-max-microvolt: true

        additionalProperties: false

additionalProperties: false

required:
  - compatible
  - reg
  - gpio-controller
  - '#gpio-cells'
  - regulators

examples:
  - |
    #include <dt-bindings/interrupt-controller/irq.h>
    i2c0 {
        #address-cells = <1>;
        #size-cells = <0>;

        pmic: pmic@5e {
            compatible = "ti,tps65086";
            reg = <0x5e>;
            interrupt-parent = <&gpio1>;
            interrupts = <28 IRQ_TYPE_LEVEL_LOW>;
            interrupt-controller;
            #interrupt-cells = <2>;
            gpio-controller;
            #gpio-cells = <2>;

            regulators {
                buck1 {
                    regulator-name = "vcc1";
                    regulator-min-microvolt = <1600000>;
                    regulator-max-microvolt = <1600000>;
                    regulator-boot-on;
                    ti,regulator-decay;
                    ti,regulator-step-size-25mv;
                };
            };
        };
    };

...
```
