## Documentation/devicetree/bindings/mfd/ti,tps65910.yaml
```yaml
# SPDX-License-Identifier: GPL-2.0-only OR BSD-2-Clause
%YAML 1.2
---
$id: http://devicetree.org/schemas/mfd/ti,tps65910.yaml#
$schema: http://devicetree.org/meta-schemas/core.yaml#

title: TI TPS65910 Power Management Integrated Circuit

maintainers:
  - Shree Ramamoorthy <s-ramamoorthy@ti.com>

description:
  TPS65910 device is a Power Management IC that provides 3 step-down converters,
  1 stepup converter, and 8 LDOs. The device contains an embedded power controller (EPC),
  1 GPIO, and an RTC.

properties:
  compatible:
    enum:
      - ti,tps65910
      - ti,tps65911

  reg:
    description: I2C slave address
    maxItems: 1

  gpio-controller: true

  '#gpio-cells':
    const: 2
    description: |
      The first cell is the GPIO number.
      The second cell is used to specify additional options <unused>.

  interrupts:
    maxItems: 1

  interrupt-controller: true

  '#interrupt-cells':
    description: Specifies the IRQ number and flags
    const: 2

  ti,vmbch-threshold:
    description: |
      (TPS65911) Main battery charged threshold comparator.
      See VMBCH_VSEL in TPS65910 datasheet.
    $ref: /schemas/types.yaml#/definitions/uint32
    enum: [0, 1, 2, 3]

  ti,vmbch2-threshold:
    description: |
      (TPS65911) Main battery discharged threshold comparator.
      See VMBCH_VSEL in TPS65910 datasheet.
    $ref: /schemas/types.yaml#/definitions/uint32
    enum: [0, 1, 2, 3]

  ti,en-ck32k-xtal:
    type: boolean
    description: Enable external 32-kHz crystal oscillator.

  ti,en-gpio-sleep:
    description: |
      Enable sleep control for gpios.
    $ref: /schemas/types.yaml#/definitions/uint32-array
    minItems: 9
    maxItems: 9
    items:
      minimum: 0
      maximum: 1

  ti,system-power-controller:
    type: boolean
    description: Identify whether or not this pmic controls the system power

  ti,sleep-enable:
    type: boolean
    description: Enable SLEEP state.

  ti,sleep-keep-therm:
    type: boolean
    description: Keep thermal monitoring on in sleep state.

  ti,sleep-keep-ck32k:
    type: boolean
    description: Keep the 32KHz clock output on in sleep state.

  ti,sleep-keep-hsclk:
    type: boolean
    description: Keep high speed internal clock on in sleep state.

  regulators:
    type: object
    additionalProperties: false
    description: List of regulators provided by this controller.

    patternProperties:
      "^(vrtc|vio|vpll|vdac|vmmc|vbb|vddctrl)$":
        type: object
        $ref: /schemas/regulator/regulator.yaml#
        properties:
          ti,regulator-ext-sleep-control:
            description: |
              Enable external sleep control through external inputs:
              [0 (not enabled), 1 (EN1), 2 (EN2) or 4(EN3)].
              If this property is not defined, it defaults to 0 (not enabled).
            $ref: /schemas/types.yaml#/definitions/uint32
            enum: [0, 1, 2, 4, 8]
        unevaluatedProperties: false

      "^(vdd[1-3]|vaux([1-2]|33)|vdig[1-2])$":
        type: object
        $ref: /schemas/regulator/regulator.yaml#
        properties:
          ti,regulator-ext-sleep-control:
            description: |
              Enable external sleep control through external inputs:
              [0 (not enabled), 1 (EN1), 2 (EN2) or 4(EN3)].
              If this property is not defined, it defaults to 0 (not enabled).
            $ref: /schemas/types.yaml#/definitions/uint32
            enum: [0, 1, 2, 4, 8]
        unevaluatedProperties: false

      "^ldo[1-8]$":
        type: object
        $ref: /schemas/regulator/regulator.yaml#
        properties:
          ti,regulator-ext-sleep-control:
            description: |
              Enable external sleep control through external inputs:
              [0 (not enabled), 1 (EN1), 2 (EN2) or 4(EN3)].
              If this property is not defined, it defaults to 0 (not enabled).
            $ref: /schemas/types.yaml#/definitions/uint32
            enum: [0, 1, 2, 4, 8]
        unevaluatedProperties: false

patternProperties:
  "^(vcc(io|[1-7])-supply)$":
    description: |
      Input voltage supply phandle for regulators.
      These entries are required if PMIC regulators are enabled, or else it
      can cause the regulator registration to fail.

      If some input supply is powered through battery or always-on supply, then
      it is also required to have these parameters with the proper node handle for always-on
      power supply.
      tps65910:
        vcc1-supply: VDD1 input.
        vcc2-supply: VDD2 input.
        vcc3-supply: VAUX33 and VMMC input.
        vcc4-supply: VAUX1 and VAUX2 input.
        vcc5-supply: VPLL and VDAC input.
        vcc6-supply: VDIG1 and VDIG2 input.
        vcc7-supply: VRTC and VBB input.
        vccio-supply: VIO input.
      tps65911:
        vcc1-supply: VDD1 input.
        vcc2-supply: VDD2 input.
        vcc3-supply: LDO6, LDO7 and LDO8 input.
        vcc4-supply: LDO5 input.
        vcc5-supply: LDO3 and LDO4 input.
        vcc6-supply: LDO1 and LDO2 input.
        vcc7-supply: VRTC input.
        vccio-supply: VIO input.

required:
  - compatible
  - reg
  - interrupts
  - interrupt-controller
  - '#interrupt-cells'
  - gpio-controller
  - '#gpio-cells'
  - regulators

additionalProperties: false

allOf:
  - if:
      properties:
        compatible:
          contains:
            enum:
              - ti,tps65910
    then:
      properties:
        regulators:
          patternProperties:
            "^(ldo[1-8]|vddctrl)$": false
  - if:
      properties:
        compatible:
          contains:
            enum:
              - ti,tps65911
    then:
      properties:
        regulators:
          patternProperties:
            "^(vdd3|vaux([1-2]|33)|vdig[1-2])$": false
            "^(vpll|vdac|vmmc|vbb)$": false

examples:
  - |
    #include <dt-bindings/interrupt-controller/arm-gic.h>
    i2c {
        #address-cells = <1>;
        #size-cells = <0>;

        pmic: tps65910@2d {
            compatible = "ti,tps65910";
            reg = <0x2d>;
            interrupt-parent = <&intc>;
            interrupts = < 0 118 0x04 >;

            #gpio-cells = <2>;
            gpio-controller;

            #interrupt-cells = <2>;
            interrupt-controller;

            ti,system-power-controller;

            ti,vmbch-threshold = <0>;
            ti,vmbch2-threshold = <0>;
            ti,en-ck32k-xtal;
            ti,en-gpio-sleep = <0 0 1 0 0 0 0 0 0>;

            vcc1-supply = <&reg_parent>;
            vcc2-supply = <&some_reg>;
            vcc3-supply = <&vbat>;
            vcc4-supply = <&vbat>;
            vcc5-supply = <&vbat>;
            vcc6-supply = <&vbat>;
            vcc7-supply = <&vbat>;
            vccio-supply = <&vbat>;

            regulators {
                vio_reg: vio {
                    regulator-name = "vio";
                    regulator-min-microvolt = <1500000>;
                    regulator-max-microvolt = <3300000>;
                    regulator-always-on;
                    regulator-boot-on;
                };
                vdd1_reg: vdd1 {
                    regulator-name = "vdd1";
                    regulator-min-microvolt = < 600000>;
                    regulator-max-microvolt = <1500000>;
                    regulator-always-on;
                    regulator-boot-on;
                    ti,regulator-ext-sleep-control = <0>;
                };
                vdd2_reg: vdd2 {
                    regulator-name = "vdd2";
                    regulator-min-microvolt = < 600000>;
                    regulator-max-microvolt = <1500000>;
                    regulator-always-on;
                    regulator-boot-on;
                };
                vdd3_reg: vdd3 {
                    regulator-name = "vdd3";
                    regulator-min-microvolt = <5000000>;
                    regulator-max-microvolt = <5000000>;
                    regulator-always-on;
                };
                vdig1_reg: vdig1 {
                    regulator-name = "vdig1";
                    regulator-min-microvolt = <1200000>;
                    regulator-max-microvolt = <2700000>;
                    regulator-always-on;
                };
                vdig2_reg: vdig2 {
                    regulator-name = "vdig2";
                    regulator-min-microvolt = <1000000>;
                    regulator-max-microvolt = <1800000>;
                    regulator-always-on;
                };
                vpll_reg: vpll {
                    regulator-name = "vpll";
                    regulator-min-microvolt = <1000000>;
                    regulator-max-microvolt = <2500000>;
                    regulator-always-on;
                };
                vdac_reg: vdac {
                    regulator-name = "vdac";
                    regulator-min-microvolt = <1800000>;
                    regulator-max-microvolt = <2850000>;
                    regulator-always-on;
                };
                vaux1_reg: vaux1 {
                    regulator-name = "vaux1";
                    regulator-min-microvolt = <1800000>;
                    regulator-max-microvolt = <2850000>;
                    regulator-always-on;
                };
                vaux2_reg: vaux2 {
                    regulator-name = "vaux2";
                    regulator-min-microvolt = <1800000>;
                    regulator-max-microvolt = <3300000>;
                    regulator-always-on;
                };
                vaux33_reg: vaux33 {
                    regulator-name = "vaux33";
                    regulator-min-microvolt = <1800000>;
                    regulator-max-microvolt = <3300000>;
                    regulator-always-on;
                };
                vmmc_reg: vmmc {
                    regulator-name = "vmmc";
                    regulator-min-microvolt = <1800000>;
                    regulator-max-microvolt = <3300000>;
                    regulator-always-on;
                    regulator-boot-on;
                };
            };
        };
    };
```

## Documentation/devicetree/bindings/mfd/ti,tps6594.yaml
```yaml
# SPDX-License-Identifier: GPL-2.0-only OR BSD-2-Clause
%YAML 1.2
---
$id: http://devicetree.org/schemas/mfd/ti,tps6594.yaml#
$schema: http://devicetree.org/meta-schemas/core.yaml#

title: TI TPS6594 Power Management Integrated Circuit

maintainers:
  - Julien Panis <jpanis@baylibre.com>

description:
  TPS6594 is a Power Management IC which provides regulators and others
  features like GPIOs, RTC, watchdog, ESMs (Error Signal Monitor), and
  PFSM (Pre-configurable Finite State Machine) managing the state of the device.
  TPS6594 is the super-set device while TPS6593 and LP8764 are derivatives.

properties:
  compatible:
    enum:
      - ti,lp8764-q1
      - ti,tps6593-q1
      - ti,tps6594-q1
      - ti,tps65224-q1

  reg:
    description: I2C slave address or SPI chip select number.
    maxItems: 1

  ti,primary-pmic:
    type: boolean
    description: |
      Identify the primary PMIC on SPMI bus.
      A multi-PMIC synchronization scheme is implemented in the PMIC device
      to synchronize the power state changes with other PMIC devices. This is
      accomplished through a SPMI bus: the primary PMIC is the controller
      device on the SPMI bus, and the secondary PMICs are the target devices
      on the SPMI bus.

  system-power-controller: true

  gpio-controller: true

  '#gpio-cells':
    const: 2
    description: |
      The first cell is the pin number, the second cell is used to specify flags.
      See ../gpio/gpio.txt for more information.

  interrupts:
    maxItems: 1

  regulators:
    type: object
    description: List of regulators provided by this controller.

    patternProperties:
      "^buck([1-5]|12|34|123|1234)$":
        type: object
        $ref: /schemas/regulator/regulator.yaml#

        unevaluatedProperties: false

      "^ldo[1-4]$":
        type: object
        $ref: /schemas/regulator/regulator.yaml#

        unevaluatedProperties: false

    allOf:
      - if:
          required:
            - buck12
        then:
          properties:
            buck123: false
            buck1234: false
      - if:
          required:
            - buck123
        then:
          properties:
            buck34: false
      - if:
          required:
            - buck1234
        then:
          properties:
            buck34: false

    additionalProperties: false

patternProperties:
  "^buck([1-5]|12|34|123|1234)-supply$":
    description: Input supply phandle for each buck.

  "^ldo[1-4]-supply$":
    description: Input supply phandle for each ldo.

required:
  - compatible
  - reg
  - interrupts

additionalProperties: false

examples:
  - |
    #include <dt-bindings/interrupt-controller/arm-gic.h>
    i2c {
        #address-cells = <1>;
        #size-cells = <0>;

        tps6593: pmic@48 {
            compatible = "ti,tps6593-q1";
            reg = <0x48>;
            ti,primary-pmic;
            system-power-controller;

            gpio-controller;
            #gpio-cells = <2>;

            pinctrl-names = "default";
            pinctrl-0 = <&pmic_irq_pins_default>;
            interrupt-parent = <&mcu_gpio0>;
            interrupts = <0 IRQ_TYPE_EDGE_FALLING>;

            buck123-supply = <&vcc_3v3_sys>;
            buck4-supply = <&vcc_3v3_sys>;
            buck5-supply = <&vcc_3v3_sys>;
            ldo1-supply = <&vcc_3v3_sys>;
            ldo2-supply = <&vcc_3v3_sys>;
            ldo3-supply = <&buck5>;
            ldo4-supply = <&vcc_3v3_sys>;

            regulators {
                buck123: buck123 {
                    regulator-name = "vcc_core";
                    regulator-min-microvolt = <750000>;
                    regulator-max-microvolt = <850000>;
                    regulator-boot-on;
                    regulator-always-on;
                };

                buck4: buck4 {
                    regulator-name = "vcc_1v1";
                    regulator-min-microvolt = <1100000>;
                    regulator-max-microvolt = <1100000>;
                    regulator-boot-on;
                    regulator-always-on;
                };

                buck5: buck5 {
                    regulator-name = "vcc_1v8_sys";
                    regulator-min-microvolt = <1800000>;
                    regulator-max-microvolt = <1800000>;
                    regulator-boot-on;
                    regulator-always-on;
                };

                ldo1: ldo1 {
                    regulator-name = "vddshv5_sdio";
                    regulator-min-microvolt = <3300000>;
                    regulator-max-microvolt = <3300000>;
                    regulator-boot-on;
                    regulator-always-on;
                };

                ldo2: ldo2 {
                    regulator-name = "vpp_1v8";
                    regulator-min-microvolt = <1800000>;
                    regulator-max-microvolt = <1800000>;
                    regulator-boot-on;
                    regulator-always-on;
                };

                ldo3: ldo3 {
                    regulator-name = "vcc_0v85";
                    regulator-min-microvolt = <850000>;
                    regulator-max-microvolt = <850000>;
                    regulator-boot-on;
                    regulator-always-on;
                };

                ldo4: ldo4 {
                    regulator-name = "vdda_1v8";
                    regulator-min-microvolt = <1800000>;
                    regulator-max-microvolt = <1800000>;
                    regulator-boot-on;
                    regulator-always-on;
                };
            };
        };
    };
```
