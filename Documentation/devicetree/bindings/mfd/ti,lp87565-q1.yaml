## Documentation/devicetree/bindings/mfd/tps65912.txt
```
* TPS65912 Power Management Integrated Circuit bindings

Required properties:
 - compatible		: Should be "ti,tps65912".
 - reg			: Slave address or chip select number (I2C / SPI).
 - interrupt-parent	: The parent interrupt controller.
 - interrupts		: The interrupt line the device is connected to.
 - interrupt-controller	: Marks the device node as an interrupt controller.
 - #interrupt-cells	: The number of cells to describe an IRQ, should be 2.
			    The first cell is the IRQ number.
			    The second cell is the flags, encoded as trigger
			    masks from ../interrupt-controller/interrupts.txt.
 - gpio-controller	: Marks the device node as a GPIO Controller.
 - #gpio-cells		: Should be two.  The first cell is the pin number and
			    the second cell is used to specify flags.
			    See ../gpio/gpio.txt for more information.
 - regulators:		: List of child nodes that specify the regulator
			    initialization data. Child nodes must be named
			    after their hardware counterparts: dcdc[1-4] and
			    ldo[1-10]. Each child nodes is defined using the
			    standard binding for regulators.

Example:

	pmic: tps65912@2d {
		compatible = "ti,tps65912";
		reg = <0x2d>;
		interrupt-parent = <&gpio1>;
		interrupts = <28 IRQ_TYPE_LEVEL_LOW>;
		interrupt-controller;
		#interrupt-cells = <2>;
		gpio-controller;
		#gpio-cells = <2>;

		regulators {
			dcdc1 {
				regulator-name = "vdd_core";
				regulator-min-microvolt = <912000>;
				regulator-max-microvolt = <1144000>;
				regulator-boot-on;
				regulator-always-on;
			};

			ldo1 {
				regulator-name = "ldo1";
				regulator-min-microvolt = <1900000>;
				regulator-max-microvolt = <1900000>;
			};
		};
	};
```

## Documentation/devicetree/bindings/mfd/twl-family.txt
```
Texas Instruments TWL family

The TWLs are Integrated Power Management Chips.
Some version might contain much more analog function like
USB transceiver or Audio amplifier.
These chips are connected to an i2c bus.


Required properties:
- compatible : Must be "ti,twl4030";
  For Integrated power-management/audio CODEC device used in OMAP3
  based boards
- compatible : Must be "ti,twl6030";
  For Integrated power-management used in OMAP4 based boards
- interrupts : This i2c device has an IRQ line connected to the main SoC
- interrupt-controller : Since the twl support several interrupts internally,
  it is considered as an interrupt controller cascaded to the SoC one.
- #interrupt-cells = <1>;

Optional node:
- Child nodes contain in the twl. The twl family is made of several variants
  that support a different number of features.
  The children nodes will thus depend of the capability of the variant.


Example:
/*
 * Integrated Power Management Chip
 * https://www.ti.com/lit/ds/symlink/twl6030.pdf
 */
twl@48 {
    compatible = "ti,twl6030";
    reg = <0x48>;
    interrupts = <39>; /* IRQ_SYS_1N cascaded to gic */
    interrupt-controller;
    #interrupt-cells = <1>;
    interrupt-parent = <&gic>;
    #address-cells = <1>;
    #size-cells = <0>;

    twl_rtc {
        compatible = "ti,twl_rtc";
        interrupts = <11>;
        reg = <0>;
    };
};
```

## Documentation/devicetree/bindings/mfd/twl4030-audio.txt
```
Texas Instruments TWL family (twl4030) audio module

The audio module inside the TWL family consist of an audio codec and a vibra
driver.

Required properties:
- compatible : must be "ti,twl4030-audio"

Optional properties, nodes:

Audio functionality:
- codec { }: Need to be present if the audio functionality is used. Within this
	     section the following options can be used:
- ti,digimic_delay: Delay need after enabling the digimic to reduce artifacts
		    from the start of the recorded sample (in ms)
-ti,ramp_delay_value: HS ramp delay configuration to reduce pop noise
-ti,hs_extmute: Use external mute for HS pop reduction
-ti,hs_extmute_gpio: Use external GPIO to control the external mute
-ti,offset_cncl_path: Offset cancellation path selection, refer to TRM for the
		      valid values.

Vibra functionality
- ti,enable-vibra: Need to be set to <1> if the vibra functionality is used. if
		   missing or it is 0, the vibra functionality is disabled.

Example:
&i2c1 {
	clock-frequency = <2600000>;

	twl: twl@48 {
		reg = <0x48>;
		interrupts = <7>; /* SYS_NIRQ cascaded to intc */
		interrupt-parent = <&intc>;

		twl_audio: audio {
			compatible = "ti,twl4030-audio";

			ti,enable-vibra = <1>;

			codec {
				ti,ramp_delay_value = <3>;
			};

		};
	};
};
```

## Documentation/devicetree/bindings/mfd/twl4030-power.txt
```
Texas Instruments TWL family (twl4030) reset and power management module

The power management module inside the TWL family provides several facilities
to control the power resources, including power scripts. For now, the
binding only supports the complete shutdown of the system after poweroff.

Required properties:
- compatible : must be one of the following
	"ti,twl4030-power"
	"ti,twl4030-power-reset"
	"ti,twl4030-power-idle"
	"ti,twl4030-power-idle-osc-off"

The use of ti,twl4030-power-reset is recommended at least on
3530 that needs a special configuration for warm reset to work.

When using ti,twl4030-power-idle, the TI recommended configuration
for idle modes is loaded to the tlw4030 PMIC.

When using ti,twl4030-power-idle-osc-off, the TI recommended
configuration is used with the external oscillator being shut
down during off-idle. Note that this does not work on all boards
depending on how the external oscillator is wired.

Optional properties:

- ti,system-power-controller: This indicates that TWL4030 is the
  power supply master of the system. With this flag, the chip will
  initiate an ACTIVE-to-OFF or SLEEP-to-OFF transition when the
  system poweroffs.

- ti,use_poweroff: Deprecated name for ti,system-power-controller

Example:
&i2c1 {
	clock-frequency = <2600000>;

	twl: twl@48 {
		reg = <0x48>;
		interrupts = <7>; /* SYS_NIRQ cascaded to intc */
		interrupt-parent = <&intc>;

		twl_power: power {
			compatible = "ti,twl4030-power";
			ti,use_poweroff;
		};
	};
};
```

## Documentation/devicetree/bindings/mfd/twl6040.txt
```
Texas Instruments TWL6040 family

The TWL6040s are 8-channel high quality low-power audio codecs providing audio,
vibra and GPO functionality on OMAP4+ platforms.
They are connected ot the host processor via i2c for commands, McPDM for audio
data and commands.

Required properties:
- compatible : "ti,twl6040" for twl6040, "ti,twl6041" for twl6041
- reg: must be 0x4b for i2c address
- interrupts: twl6040 has one interrupt line connecteded to the main SoC
- interrupt-parent: The parent interrupt controller
- gpio-controller:
- #gpio-cells = <1>: twl6040 provides GPO lines.
- twl6040,audpwron-gpio: Power on GPIO line for the twl6040

- vio-supply: Regulator for the twl6040 VIO supply
- v2v1-supply: Regulator for the twl6040 V2V1 supply

Optional properties, nodes:
- enable-active-high: To power on the twl6040 during boot.
- clocks: phandle to the clk32k and/or to mclk clock provider
- clock-names: Must be "clk32k" for the 32K clock and "mclk" for the MCLK.

Vibra functionality
Required properties:
- vddvibl-supply: Regulator for the left vibra motor
- vddvibr-supply: Regulator for the right vibra motor
- vibra { }: Configuration section for vibra parameters containing the following
	     properties:
- ti,vibldrv-res: Resistance parameter for left driver
- ti,vibrdrv-res: Resistance parameter for right driver
- ti,viblmotor-res: Resistance parameter for left motor
- ti,viblmotor-res: Resistance parameter for right motor

Optional properties within vibra { } section:
- vddvibl_uV: If the vddvibl default voltage need to be changed
- vddvibr_uV: If the vddvibr default voltage need to be changed

Example:
&i2c1 {
	twl6040: twl@4b {
		compatible = "ti,twl6040";

		interrupts = <0 119 4>;
		interrupt-parent = <&gic>;
		twl6040,audpwron-gpio = <&gpio4 31 0>;

		vio-supply = <&v1v8>;
		v2v1-supply = <&v2v1>;
		enable-active-high;

		/* regulators for vibra motor */
		vddvibl-supply = <&vbat>;
		vddvibr-supply = <&vbat>;

		vibra {
			/* Vibra driver, motor resistance parameters */
			ti,vibldrv-res = <8>;
			ti,vibrdrv-res = <3>;
			ti,viblmotor-res = <10>;
			ti,vibrmotor-res = <10>;
		};
	};
};

/include/ "twl6040.dtsi"
```

## Documentation/devicetree/bindings/mfd/vexpress-spc.txt
```
* ARM Versatile Express Serial Power Controller device tree bindings

Latest ARM development boards implement a power management interface (serial
power controller - SPC) that is capable of managing power/voltage and
operating point transitions, through memory mapped registers interface.

On testchips like TC2 it also provides a configuration interface that can
be used to read/write values which cannot be read/written through simple
memory mapped reads/writes.

- spc node

	- compatible:
		Usage: required
		Value type: <stringlist>
		Definition: must be
			    "arm,vexpress-spc,v2p-ca15_a7","arm,vexpress-spc"
	- reg:
		Usage: required
		Value type: <prop-encode-array>
		Definition: A standard property that specifies the base address
			    and the size of the SPC address space
	- interrupts:
		Usage: required
		Value type: <prop-encoded-array>
		Definition:  SPC interrupt configuration. A standard property
			     that follows ePAPR interrupts specifications

Example:

spc: spc@7fff0000 {
	compatible = "arm,vexpress-spc,v2p-ca15_a7","arm,vexpress-spc";
	reg = <0 0x7FFF0000 0 0x1000>;
	interrupts = <0 95 4>;
};
```
