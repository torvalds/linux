## Documentation/devicetree/bindings/mfd/ti-lmu.txt
```
TI LMU (Lighting Management Unit) device tree bindings

TI LMU driver supports lighting devices below.

   Name                  Child nodes
  ------      ---------------------------------
  LM3631       Backlight and regulator
  LM3632       Backlight and regulator
  LM3633       Backlight, LED and fault monitor
  LM3695       Backlight
  LM3697       Backlight and fault monitor

Required properties:
  - compatible: Should be one of:
                "ti,lm3631"
                "ti,lm3632"
                "ti,lm3633"
                "ti,lm3695"
                "ti,lm3697"
  - reg: I2C slave address.
         0x11 for LM3632
         0x29 for LM3631
         0x36 for LM3633, LM3697
         0x63 for LM3695

Optional property:
  - enable-gpios: A GPIO specifier for hardware enable pin.

Required node:
  - backlight: All LMU devices have backlight child nodes.
               For the properties, please refer to [1].

Optional nodes:
  - fault-monitor: Hardware fault monitoring driver for LM3633 and LM3697.
    Required properties:
      - compatible: Should be one of:
                    "ti,lm3633-fault-monitor"
                    "ti,lm3697-fault-monitor"
  - leds: LED properties for LM3633. Please refer to [2].
  - regulators: Regulator properties for LM3631 and LM3632.
                Please refer to [3].

[1] ../leds/backlight/ti-lmu-backlight.txt
[2] ../leds/leds-lm3633.txt
[3] ../regulator/lm363x-regulator.txt

lm3631@29 {
	compatible = "ti,lm3631";
	reg = <0x29>;

	regulators {
		compatible = "ti,lm363x-regulator";

		vboost {
			regulator-name = "lcd_boost";
			regulator-min-microvolt = <4500000>;
			regulator-max-microvolt = <6350000>;
			regulator-always-on;
		};

		vcont {
			regulator-name = "lcd_vcont";
			regulator-min-microvolt = <1800000>;
			regulator-max-microvolt = <3300000>;
		};

		voref {
			regulator-name = "lcd_voref";
			regulator-min-microvolt = <4000000>;
			regulator-max-microvolt = <6000000>;
		};

		vpos {
			regulator-name = "lcd_vpos";
			regulator-min-microvolt = <4000000>;
			regulator-max-microvolt = <6000000>;
			regulator-boot-on;
		};

		vneg {
			regulator-name = "lcd_vneg";
			regulator-min-microvolt = <4000000>;
			regulator-max-microvolt = <6000000>;
			regulator-boot-on;
		};
	};

	backlight {
		compatible = "ti,lm3631-backlight";

		lcd_bl {
			led-sources = <0 1>;
			ramp-up-msec = <300>;
		};
	};
};

lm3632@11 {
	compatible = "ti,lm3632";
	reg = <0x11>;

	enable-gpios = <&pioC 2 GPIO_ACTIVE_HIGH>; /* PC2 */

	regulators {
		compatible = "ti,lm363x-regulator";

		enable-gpios = <&pioC 0 GPIO_ACTIVE_HIGH>,
			       <&pioC 1 GPIO_ACTIVE_HIGH>;

		vboost {
			regulator-name = "lcd_boost";
			regulator-min-microvolt = <4500000>;
			regulator-max-microvolt = <6400000>;
			regulator-always-on;
		};

		vpos {
			regulator-name = "lcd_vpos";
			regulator-min-microvolt = <4000000>;
			regulator-max-microvolt = <6000000>;
		};

		vneg {
			regulator-name = "lcd_vneg";
			regulator-min-microvolt = <4000000>;
			regulator-max-microvolt = <6000000>;
		};
	};

	backlight {
		compatible = "ti,lm3632-backlight";

		pwms = <&pwm0 0 10000 0>; /* pwm number, period, polarity */
		pwm-names = "lmu-backlight";

		lcd {
			led-sources = <0 1>;
			pwm-period = <10000>;
		};
	};
};

lm3633@36 {
	compatible = "ti,lm3633";
	reg = <0x36>;

	enable-gpios = <&pioC 2 GPIO_ACTIVE_HIGH>;

	backlight {
		compatible = "ti,lm3633-backlight";

		main {
			label = "main_lcd";
			led-sources = <1 2>;
			ramp-up-msec = <500>;
			ramp-down-msec = <500>;
		};

		front {
			label = "front_lcd";
			led-sources = <0>;
			ramp-up-msec = <1000>;
			ramp-down-msec = <0>;
		};
	};

	leds {
		compatible = "ti,lm3633-leds";

		chan1 {
			label = "status";
			led-sources = <1>;
			led-max-microamp = <6000>;
		};

		chan345 {
			label = "rgb";
			led-sources = <3 4 5>;
			led-max-microamp = <10000>;
		};
	};

	fault-monitor {
		compatible = "ti,lm3633-fault-monitor";
	};
};

lm3695@63 {
	compatible = "ti,lm3695";
	reg = <0x63>;

	enable-gpios = <&pioC 2 GPIO_ACTIVE_HIGH>;

	backlight {
		compatible = "ti,lm3695-backlight";

		lcd {
			label = "bl";
			led-sources = <0 1>;
		};
	};
};

lm3697@36 {
	compatible = "ti,lm3697";
	reg = <0x36>;

	enable-gpios = <&pioC 2 GPIO_ACTIVE_HIGH>;

	backlight {
		compatible = "ti,lm3697-backlight";

		lcd {
			led-sources = <0 1 2>;
			ramp-up-msec = <200>;
			ramp-down-msec = <200>;
		};
	};

	fault-monitor {
		compatible = "ti,lm3697-fault-monitor";
	};
};
```

## Documentation/devicetree/bindings/mfd/tps6105x.txt
```
* Device tree bindings for TI TPS61050/61052 Boost Converters

The TP61050/TPS61052 is a high-power "white LED driver". The
device provides LED, GPIO and regulator functionalities.

Required properties:
- compatible:		"ti,tps61050" or "ti,tps61052"
- reg:			Specifies the I2C slave address

Optional sub-node:

This subnode selects the chip's operational mode.
There can be at most one single available subnode.

- regulator: presence of this sub-node puts the chip in regulator mode.
	see ../regulator/regulator.yaml

- led: presence of this sub-node puts the chip in led mode.
	Optional properties:
	- function : see ../leds/common.txt
	- color    : see ../leds/common.txt
	- label    : see ../leds/common.txt
			(deprecated)

Example (GPIO operation only):

i2c0 {
	tps61052@33 {
		compatible = "ti,tps61052";
		reg = <0x33>;
	};
};

Example (GPIO + regulator operation):

i2c0 {
	tps61052@33 {
		compatible = "ti,tps61052";
		reg = <0x33>;

		regulator {
			regulator-min-microvolt = <5000000>;
			regulator-max-microvolt = <5000000>;
			regulator-always-on;
		};
	};
};

Example (GPIO + led operation):

#include <dt-bindings/leds/common.h>

i2c0 {
	tps61052@33 {
		compatible = "ti,tps61052";
		reg = <0x33>;

		led {
			color = <LED_COLOR_ID_WHITE>;
		};
	};
};
```

## Documentation/devicetree/bindings/mfd/tps6507x.txt
```
TPS6507x Power Management Integrated Circuit

Required properties:
- compatible: "ti,tps6507x"
- reg: I2C slave address
- regulators: This is the list of child nodes that specify the regulator
  initialization data for defined regulators. Not all regulators for the
  given device need to be present. The definition for each of these nodes
  is defined using the standard binding for regulators found at
  Documentation/devicetree/bindings/regulator/regulator.txt.
  The regulator is matched with the regulator-compatible.

  The valid regulator-compatible values are:
  tps6507x: vdcdc1, vdcdc2, vdcdc3, vldo1, vldo2
- xxx-supply: Input voltage supply regulator.
  These entries are required if regulators are enabled for a device.
  Missing of these properties can cause the regulator registration
  fails.
  If some of input supply is powered through battery or always-on
  supply then also it is require to have these parameters with proper
  node handle of always on power supply.
  tps6507x:
       vindcdc1_2-supply: VDCDC1 and VDCDC2 input.
       vindcdc3-supply  : VDCDC3 input.
       vldo1_2-supply   : VLDO1 and VLDO2 input.

Regulator Optional properties:
- defdcdc_default: It's property of DCDC2 and DCDC3 regulators.
			0: If defdcdc pin of DCDC2/DCDC3 is pulled to GND.
			1: If defdcdc pin of DCDC2/DCDC3 is driven HIGH.
  If this property is not defined, it defaults to 0 (not enabled).

Example:

	pmu: tps6507x@48 {
		compatible = "ti,tps6507x";
		reg = <0x48>;

		vindcdc1_2-supply = <&vbat>;
		vindcdc3-supply = <...>;
		vinldo1_2-supply = <...>;

		regulators {
			#address-cells = <1>;
			#size-cells = <0>;

			vdcdc1_reg: regulator@0 {
				regulator-compatible = "VDCDC1";
				reg = <0>;
				regulator-min-microvolt = <3150000>;
				regulator-max-microvolt = <3450000>;
				regulator-always-on;
				regulator-boot-on;
			};
			vdcdc2_reg: regulator@1 {
				regulator-compatible = "VDCDC2";
				reg = <1>;
				regulator-min-microvolt = <1710000>;
				regulator-max-microvolt = <3450000>;
				regulator-always-on;
				regulator-boot-on;
				defdcdc_default = <1>;
			};
			vdcdc3_reg: regulator@2 {
				regulator-compatible = "VDCDC3";
				reg = <2>;
				regulator-min-microvolt = <950000>
				regulator-max-microvolt = <1350000>;
				regulator-always-on;
				regulator-boot-on;
				defdcdc_default = <1>;
			};
			ldo1_reg: regulator@3 {
				regulator-compatible = "LDO1";
				reg = <3>;
				regulator-min-microvolt = <1710000>;
				regulator-max-microvolt = <1890000>;
				regulator-always-on;
				regulator-boot-on;
			};
			ldo2_reg: regulator@4 {
				regulator-compatible = "LDO2";
				reg = <4>;
				regulator-min-microvolt = <1140000>;
				regulator-max-microvolt = <1320000>;
				regulator-always-on;
				regulator-boot-on;
			};
		};

	};
```

## Documentation/devicetree/bindings/mfd/tps65086.txt
```
* TPS65086 Power Management Integrated Circuit (PMIC) bindings

Required properties:
 - compatible		: Should be "ti,tps65086".
 - reg			: I2C slave address.
 - interrupt-parent	: Phandle to the parent interrupt controller.
 - interrupts		: The interrupt line the device is connected to.
 - interrupt-controller	: Marks the device node as an interrupt controller.
 - #interrupt-cells	: The number of cells to describe an IRQ, should be 2.
			    The first cell is the IRQ number.
			    The second cell is the flags, encoded as trigger
			    masks from ../interrupt-controller/interrupts.txt.
 - gpio-controller      : Marks the device node as a GPIO Controller.
 - #gpio-cells          : Should be two.  The first cell is the pin number and
                            the second cell is used to specify flags.
                            See ../gpio/gpio.txt for more information.
 - regulators:          : List of child nodes that specify the regulator
                            initialization data. Child nodes must be named
                            after their hardware counterparts: buck[1-6],
                            ldoa[1-3], swa1, swb[1-2], and vtt. Each child
                            node is defined using the standard binding for
                            regulators and the optional regulator properties
                            defined below.

Optional regulator properties:
 - ti,regulator-step-size-25mv	: This is applicable for buck[1-6], set this
				    if the regulator is factory set with a 25mv
				    step voltage mapping.
 - ti,regulator-decay		: This is applicable for buck[1-6], set this if
				    the output needs to decay, default is for
				    the output to slew down.

Example:

	pmic: tps65086@5e {
		compatible = "ti,tps65086";
		reg = <0x5e>;
		interrupt-parent = <&gpio1>;
		interrupts = <28 IRQ_TYPE_LEVEL_LOW>;
		interrupt-controller;
		#interrupt-cells = <2>;
		gpio-controller;
		#gpio-cells = <2>;

		regulators {
			buck1 {
				regulator-name = "vcc1";
				regulator-min-microvolt = <1600000>;
				regulator-max-microvolt = <1600000>;
				regulator-boot-on;
				ti,regulator-decay;
				ti,regulator-step-size-25mv;
			};
		};
	};
```

## Documentation/devicetree/bindings/mfd/tps65910.txt
```
TPS65910 Power Management Integrated Circuit

Required properties:
- compatible: "ti,tps65910" or "ti,tps65911"
- reg: I2C slave address
- interrupts: the interrupt outputs of the controller
- #gpio-cells: number of cells to describe a GPIO, this should be 2.
  The first cell is the GPIO number.
  The second cell is used to specify additional options <unused>.
- gpio-controller: mark the device as a GPIO controller
- #interrupt-cells: the number of cells to describe an IRQ, this should be 2.
  The first cell is the IRQ number.
  The second cell is the flags, encoded as the trigger masks from
  Documentation/devicetree/bindings/interrupts.txt
- regulators: This is the list of child nodes that specify the regulator
  initialization data for defined regulators. Not all regulators for the given
  device need to be present. The definition for each of these nodes is defined
  using the standard binding for regulators found at
  Documentation/devicetree/bindings/regulator/regulator.txt.

  The valid names for regulators are:
  tps65910: vrtc, vio, vdd1, vdd2, vdd3, vdig1, vdig2, vpll, vdac, vaux1,
            vaux2, vaux33, vmmc
  tps65911: vrtc, vio, vdd1, vdd3, vddctrl, ldo1, ldo2, ldo3, ldo4, ldo5,
            ldo6, ldo7, ldo8

Optional properties:
- ti,vmbch-threshold: (tps65911) main battery charged threshold
  comparator. (see VMBCH_VSEL in TPS65910 datasheet)
- ti,vmbch2-threshold: (tps65911) main battery discharged threshold
  comparator. (see VMBCH_VSEL in TPS65910 datasheet)
- ti,en-ck32k-xtal: enable external 32-kHz crystal oscillator (see CK32K_CTRL
  in TPS6591X datasheet)
- ti,en-gpio-sleep: enable sleep control for gpios
  There should be 9 entries here, one for each gpio.

Regulator Optional properties:
- ti,regulator-ext-sleep-control: enable external sleep
  control through external inputs [0 (not enabled), 1 (EN1), 2 (EN2) or 4(EN3)]
  If this property is not defined, it defaults to 0 (not enabled).

Example:

	pmu: tps65910@d2 {
		compatible = "ti,tps65910";
		reg = <0xd2>;
		interrupt-parent = <&intc>;
		interrupts = < 0 118 0x04 >;

		#gpio-cells = <2>;
		gpio-controller;

		#interrupt-cells = <2>;
		interrupt-controller;

		ti,vmbch-threshold = 0;
		ti,vmbch2-threshold = 0;
		ti,en-ck32k-xtal;
		ti,en-gpio-sleep = <0 0 1 0 0 0 0 0 0>;

		regulators {
			vdd1_reg: vdd1 {
				regulator-min-microvolt = < 600000>;
				regulator-max-microvolt = <1500000>;
				regulator-always-on;
				regulator-boot-on;
				ti,regulator-ext-sleep-control = <0>;
			};
			vdd2_reg: vdd2 {
				regulator-min-microvolt = < 600000>;
				regulator-max-microvolt = <1500000>;
				regulator-always-on;
				regulator-boot-on;
				ti,regulator-ext-sleep-control = <4>;
			};
			vddctrl_reg: vddctrl {
				regulator-min-microvolt = < 600000>;
				regulator-max-microvolt = <1400000>;
				regulator-always-on;
				regulator-boot-on;
				ti,regulator-ext-sleep-control = <0>;
			};
			vio_reg: vio {
				regulator-min-microvolt = <1500000>;
				regulator-max-microvolt = <1800000>;
				regulator-always-on;
				regulator-boot-on;
				ti,regulator-ext-sleep-control = <1>;
			};
			ldo1_reg: ldo1 {
				regulator-min-microvolt = <1000000>;
				regulator-max-microvolt = <3300000>;
				ti,regulator-ext-sleep-control = <0>;
			};
			ldo2_reg: ldo2 {
				regulator-min-microvolt = <1050000>;
				regulator-max-microvolt = <1050000>;
				ti,regulator-ext-sleep-control = <0>;
			};
			ldo3_reg: ldo3 {
				regulator-min-microvolt = <1000000>;
				regulator-max-microvolt = <3300000>;
				ti,regulator-ext-sleep-control = <0>;
			};
			ldo4_reg: ldo4 {
				regulator-min-microvolt = <1000000>;
				regulator-max-microvolt = <3300000>;
				regulator-always-on;
				ti,regulator-ext-sleep-control = <0>;
			};
			ldo5_reg: ldo5 {
				regulator-min-microvolt = <1000000>;
				regulator-max-microvolt = <3300000>;
				ti,regulator-ext-sleep-control = <0>;
			};
			ldo6_reg: ldo6 {
				regulator-min-microvolt = <1200000>;
				regulator-max-microvolt = <1200000>;
				ti,regulator-ext-sleep-control = <0>;
			};
			ldo7_reg: ldo7 {
				regulator-min-microvolt = <1200000>;
				regulator-max-microvolt = <1200000>;
				regulator-always-on;
				regulator-boot-on;
				ti,regulator-ext-sleep-control = <1>;
			};
			ldo8_reg: ldo8 {
				regulator-min-microvolt = <1000000>;
				regulator-max-microvolt = <3300000>;
				regulator-always-on;
				ti,regulator-ext-sleep-control = <1>;
			};
		};
	};
```
