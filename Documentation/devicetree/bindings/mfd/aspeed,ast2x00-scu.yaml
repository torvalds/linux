## Documentation/devicetree/bindings/mfd/atmel-usart.txt
```
* Atmel Universal Synchronous Asynchronous Receiver/Transmitter (USART)

Required properties for USART:
- compatible: Should be one of the following:
	- "atmel,at91rm9200-usart"
	- "atmel,at91sam9260-usart"
	- "microchip,sam9x60-usart"
	- "atmel,at91rm9200-dbgu", "atmel,at91rm9200-usart"
	- "atmel,at91sam9260-dbgu", "atmel,at91sam9260-usart"
	- "microchip,sam9x60-dbgu", "microchip,sam9x60-usart"
- reg: Should contain registers location and length
- interrupts: Should contain interrupt
- clock-names: tuple listing input clock names.
	Required elements: "usart"
- clocks: phandles to input clocks.

Required properties for USART in SPI mode:
- #size-cells      : Must be <0>
- #address-cells   : Must be <1>
- cs-gpios: chipselects (internal cs not supported)
- atmel,usart-mode : Must be <AT91_USART_MODE_SPI> (found in dt-bindings/mfd/at91-usart.h)

Optional properties in serial and SPI mode:
- dma bindings for dma transfer:
	- dmas: DMA specifier, consisting of a phandle to DMA controller node,
		memory peripheral interface and USART DMA channel ID, FIFO configuration.
		The order of DMA channels is fixed. The first DMA channel must be TX
		associated channel and the second one must be RX associated channel.
		Refer to dma.txt and atmel-dma.txt for details.
	- dma-names: "tx" for TX channel.
		     "rx" for RX channel.
		     The order of dma-names is also fixed. The first name must be "tx"
		     and the second one must be "rx" as in the examples below.

Optional properties in serial mode:
- atmel,use-dma-rx: use of PDC or DMA for receiving data
- atmel,use-dma-tx: use of PDC or DMA for transmitting data
- {rts,cts,dtr,dsr,rng,dcd}-gpios: specify a GPIO for RTS/CTS/DTR/DSR/RI/DCD line respectively.
  It will use specified PIO instead of the peripheral function pin for the USART feature.
  If unsure, don't specify this property.
- atmel,fifo-size: maximum number of data the RX and TX FIFOs can store for FIFO
  capable USARTs.
- rs485-rts-delay, rs485-rx-during-tx, linux,rs485-enabled-at-boot-time: see rs485.txt

<chip> compatible description:
- at91rm9200:  legacy USART support
- at91sam9260: generic USART implementation for SAM9 SoCs

Example:
- use PDC:
	usart0: serial@fff8c000 {
		compatible = "atmel,at91sam9260-usart";
		reg = <0xfff8c000 0x4000>;
		interrupts = <7>;
		clocks = <&usart0_clk>;
		clock-names = "usart";
		atmel,use-dma-rx;
		atmel,use-dma-tx;
		rts-gpios = <&pioD 15 GPIO_ACTIVE_LOW>;
		cts-gpios = <&pioD 16 GPIO_ACTIVE_LOW>;
		dtr-gpios = <&pioD 17 GPIO_ACTIVE_LOW>;
		dsr-gpios = <&pioD 18 GPIO_ACTIVE_LOW>;
		dcd-gpios = <&pioD 20 GPIO_ACTIVE_LOW>;
		rng-gpios = <&pioD 19 GPIO_ACTIVE_LOW>;
	};

- use DMA:
	usart0: serial@f001c000 {
		compatible = "atmel,at91sam9260-usart";
		reg = <0xf001c000 0x100>;
		interrupts = <12 4 5>;
		clocks = <&usart0_clk>;
		clock-names = "usart";
		atmel,use-dma-rx;
		atmel,use-dma-tx;
		dmas = <&dma0 2 0x3>,
		       <&dma0 2 0x204>;
		dma-names = "tx", "rx";
		atmel,fifo-size = <32>;
	};

- SPI mode:
	#include <dt-bindings/mfd/at91-usart.h>

	spi0: spi@f001c000 {
		#address-cells = <1>;
		#size-cells = <0>;
		compatible = "atmel,at91rm9200-usart", "atmel,at91sam9260-usart";
		atmel,usart-mode = <AT91_USART_MODE_SPI>;
		reg = <0xf001c000 0x100>;
		interrupts = <12 IRQ_TYPE_LEVEL_HIGH 5>;
		clocks = <&usart0_clk>;
		clock-names = "usart";
		dmas = <&dma0 2 AT91_DMA_CFG_PER_ID(3)>,
		       <&dma0 2 (AT91_DMA_CFG_PER_ID(4) | AT91_DMA_CFG_FIFOCFG_ASAP)>;
		dma-names = "tx", "rx";
		cs-gpios = <&pioB 3 0>;
	};
```

## Documentation/devicetree/bindings/mfd/axp20x.txt
```
AXP family PMIC device tree bindings

The axp20x family current members :
axp152 (X-Powers)
axp202 (X-Powers)
axp209 (X-Powers)
axp221 (X-Powers)
axp223 (X-Powers)
axp803 (X-Powers)
axp806 (X-Powers)
axp809 (X-Powers)
axp813 (X-Powers)

The AXP813 is 2 chips packaged into 1. The 2 chips do not share anything
other than the packaging. Pins are routed separately. As such they should
be treated as separate entities. The other half is an AC100 RTC/codec
combo chip. Please see ./ac100.txt for its bindings.

Required properties:
- compatible: should be one of:
    * "x-powers,axp152"
    * "x-powers,axp202"
    * "x-powers,axp209"
    * "x-powers,axp221"
    * "x-powers,axp223"
    * "x-powers,axp803"
    * "x-powers,axp806"
    * "x-powers,axp809"
    * "x-powers,axp813"
- reg: The I2C slave address or RSB hardware address for the AXP chip
- interrupts: SoC NMI / GPIO interrupt connected to the PMIC's IRQ pin
- interrupt-controller: The PMIC has its own internal IRQs
- #interrupt-cells: Should be set to 1

Supported common regulator properties, see ../regulator/regulator.txt for
more information:
- regulator-ramp-delay: sets the ramp up delay in uV/us
			AXP20x/DCDC2: 1600, 800
			AXP20x/LDO3:  1600, 800
- regulator-soft-start:	enable the output at the lowest possible voltage and
			only then set the desired voltage
			AXP20x/LDO3: software-based implementation

Optional properties:
- x-powers,dcdc-freq: defines the work frequency of DC-DC in KHz
		      AXP152/20X: range:  750-1875, Default: 1.5 MHz
		      AXP22X/8XX: range: 1800-4050, Default: 3   MHz

- x-powers,drive-vbus-en: boolean, set this when the N_VBUSEN pin is
			  used as an output pin to control an external
			  regulator to drive the OTG VBus, rather then
			  as an input pin which signals whether the
			  board is driving OTG VBus or not.
			  (axp221 / axp223 / axp803/ axp813 only)

- x-powers,self-working-mode and
  x-powers,master-mode: Boolean (axp806 only). Set either of these when the
			PMIC is wired for self-working mode or master mode.
			If neither is set then slave mode is assumed.
			This corresponds to how the MODESET pin is wired.

- <input>-supply: a phandle to the regulator supply node. May be omitted if
		  inputs are unregulated, such as using the IPSOUT output
		  from the PMIC.

- regulators: A node that houses a sub-node for each regulator. Regulators
	      not used but preferred to be managed by the OS should be
	      listed as well.
	      See Documentation/devicetree/bindings/regulator/regulator.txt
	      for more information on standard regulator bindings.

Optional properties for DCDC regulators:
- x-powers,dcdc-workmode: 1 for PWM mode, 0 for AUTO (PWM/PFM) mode
			  Default: Current hardware setting
			  The DCDC regulators work in a mixed PWM/PFM mode,
			  using PFM under light loads and switching to PWM
			  for heavier loads. Forcing PWM mode trades efficiency
			  under light loads for lower output noise. This
			  probably makes sense for HiFi audio related
			  applications that aren't battery constrained.

AXP202/AXP209 regulators, type, and corresponding input supply names:

Regulator	  Type		  Supply Name		  Notes
---------	  ----		  -----------		  -----
DCDC2		: DC-DC buck	: vin2-supply
DCDC3		: DC-DC	buck	: vin3-supply
LDO1		: LDO		: acin-supply		: always on
LDO2		: LDO		: ldo24in-supply	: shared supply
LDO3		: LDO		: ldo3in-supply
LDO4		: LDO		: ldo24in-supply	: shared supply
LDO5		: LDO		: ldo5in-supply

AXP221/AXP223 regulators, type, and corresponding input supply names:

Regulator	  Type		  Supply Name		  Notes
---------	  ----		  -----------		  -----
DCDC1		: DC-DC buck	: vin1-supply
DCDC2		: DC-DC buck	: vin2-supply
DCDC3		: DC-DC	buck	: vin3-supply
DCDC4		: DC-DC	buck	: vin4-supply
DCDC5		: DC-DC	buck	: vin5-supply
DC1SW		: On/Off Switch	:			: DCDC1 secondary output
DC5LDO		: LDO		:			: input from DCDC5
ALDO1		: LDO		: aldoin-supply		: shared supply
ALDO2		: LDO		: aldoin-supply		: shared supply
ALDO3		: LDO		: aldoin-supply		: shared supply
DLDO1		: LDO		: dldoin-supply		: shared supply
DLDO2		: LDO		: dldoin-supply		: shared supply
DLDO3		: LDO		: dldoin-supply		: shared supply
DLDO4		: LDO		: dldoin-supply		: shared supply
ELDO1		: LDO		: eldoin-supply		: shared supply
ELDO2		: LDO		: eldoin-supply		: shared supply
ELDO3		: LDO		: eldoin-supply		: shared supply
LDO_IO0		: LDO		: ips-supply		: GPIO 0
LDO_IO1		: LDO		: ips-supply		: GPIO 1
RTC_LDO		: LDO		: ips-supply		: always on
DRIVEVBUS	: Enable output	: drivevbus-supply	: external regulator

AXP803 regulators, type, and corresponding input supply names:

Regulator	  Type		  Supply Name		  Notes
---------	  ----		  -----------		  -----
DCDC1		: DC-DC buck	: vin1-supply
DCDC2		: DC-DC buck	: vin2-supply		: poly-phase capable
DCDC3		: DC-DC	buck	: vin3-supply		: poly-phase capable
DCDC4		: DC-DC	buck	: vin4-supply
DCDC5		: DC-DC	buck	: vin5-supply		: poly-phase capable
DCDC6		: DC-DC	buck	: vin6-supply		: poly-phase capable
DC1SW		: On/Off Switch	:			: DCDC1 secondary output
ALDO1		: LDO		: aldoin-supply		: shared supply
ALDO2		: LDO		: aldoin-supply		: shared supply
ALDO3		: LDO		: aldoin-supply		: shared supply
DLDO1		: LDO		: dldoin-supply		: shared supply
DLDO2		: LDO		: dldoin-supply		: shared supply
DLDO3		: LDO		: dldoin-supply		: shared supply
DLDO4		: LDO		: dldoin-supply		: shared supply
ELDO1		: LDO		: eldoin-supply		: shared supply
ELDO2		: LDO		: eldoin-supply		: shared supply
ELDO3		: LDO		: eldoin-supply		: shared supply
FLDO1		: LDO		: fldoin-supply		: shared supply
FLDO2		: LDO		: fldoin-supply		: shared supply
LDO_IO0		: LDO		: ips-supply		: GPIO 0
LDO_IO1		: LDO		: ips-supply		: GPIO 1
RTC_LDO		: LDO		: ips-supply		: always on
DRIVEVBUS	: Enable output	: drivevbus-supply	: external regulator

AXP806 regulators, type, and corresponding input supply names:

Regulator	  Type		  Supply Name		  Notes
---------	  ----		  -----------		  -----
DCDCA		: DC-DC buck	: vina-supply		: poly-phase capable
DCDCB		: DC-DC buck	: vinb-supply		: poly-phase capable
DCDCC		: DC-DC	buck	: vinc-supply		: poly-phase capable
DCDCD		: DC-DC	buck	: vind-supply		: poly-phase capable
DCDCE		: DC-DC	buck	: vine-supply		: poly-phase capable
ALDO1		: LDO		: aldoin-supply		: shared supply
ALDO2		: LDO		: aldoin-supply		: shared supply
ALDO3		: LDO		: aldoin-supply		: shared supply
BLDO1		: LDO		: bldoin-supply		: shared supply
BLDO2		: LDO		: bldoin-supply		: shared supply
BLDO3		: LDO		: bldoin-supply		: shared supply
BLDO4		: LDO		: bldoin-supply		: shared supply
CLDO1		: LDO		: cldoin-supply		: shared supply
CLDO2		: LDO		: cldoin-supply		: shared supply
CLDO3		: LDO		: cldoin-supply		: shared supply
SW		: On/Off Switch : swin-supply

Additionally, the AXP806 DC-DC regulators support poly-phase arrangements
for higher output current. The possible groupings are: A+B, A+B+C, D+E.

AXP809 regulators, type, and corresponding input supply names:

Regulator	  Type		  Supply Name		  Notes
---------	  ----		  -----------		  -----
DCDC1		: DC-DC buck	: vin1-supply
DCDC2		: DC-DC buck	: vin2-supply
DCDC3		: DC-DC	buck	: vin3-supply
DCDC4		: DC-DC	buck	: vin4-supply
DCDC5		: DC-DC	buck	: vin5-supply
DC1SW		: On/Off Switch	:			: DCDC1 secondary output
DC5LDO		: LDO		:			: input from DCDC5
ALDO1		: LDO		: aldoin-supply		: shared supply
ALDO2		: LDO		: aldoin-supply		: shared supply
ALDO3		: LDO		: aldoin-supply		: shared supply
DLDO1		: LDO		: dldoin-supply		: shared supply
DLDO2		: LDO		: dldoin-supply		: shared supply
ELDO1		: LDO		: eldoin-supply		: shared supply
ELDO2		: LDO		: eldoin-supply		: shared supply
ELDO3		: LDO		: eldoin-supply		: shared supply
LDO_IO0		: LDO		: ips-supply		: GPIO 0
LDO_IO1		: LDO		: ips-supply		: GPIO 1
RTC_LDO		: LDO		: ips-supply		: always on
SW		: On/Off Switch : swin-supply

AXP813 regulators, type, and corresponding input supply names:

Regulator	  Type		  Supply Name		  Notes
---------	  ----		  -----------		  -----
DCDC1		: DC-DC buck	: vin1-supply
DCDC2		: DC-DC buck	: vin2-supply		: poly-phase capable
DCDC3		: DC-DC	buck	: vin3-supply		: poly-phase capable
DCDC4		: DC-DC	buck	: vin4-supply
DCDC5		: DC-DC	buck	: vin5-supply		: poly-phase capable
DCDC6		: DC-DC	buck	: vin6-supply		: poly-phase capable
DCDC7		: DC-DC	buck	: vin7-supply
ALDO1		: LDO		: aldoin-supply		: shared supply
ALDO2		: LDO		: aldoin-supply		: shared supply
ALDO3		: LDO		: aldoin-supply		: shared supply
DLDO1		: LDO		: dldoin-supply		: shared supply
DLDO2		: LDO		: dldoin-supply		: shared supply
DLDO3		: LDO		: dldoin-supply		: shared supply
DLDO4		: LDO		: dldoin-supply		: shared supply
ELDO1		: LDO		: eldoin-supply		: shared supply
ELDO2		: LDO		: eldoin-supply		: shared supply
ELDO3		: LDO		: eldoin-supply		: shared supply
FLDO1		: LDO		: fldoin-supply		: shared supply
FLDO2		: LDO		: fldoin-supply		: shared supply
FLDO3		: LDO		: fldoin-supply		: shared supply
LDO_IO0		: LDO		: ips-supply		: GPIO 0
LDO_IO1		: LDO		: ips-supply		: GPIO 1
RTC_LDO		: LDO		: ips-supply		: always on
SW		: On/Off Switch : swin-supply
DRIVEVBUS	: Enable output	: drivevbus-supply	: external regulator

Example:

axp209: pmic@34 {
	compatible = "x-powers,axp209";
	reg = <0x34>;
	interrupt-parent = <&nmi_intc>;
	interrupts = <0 IRQ_TYPE_LEVEL_LOW>;
	interrupt-controller;
	#interrupt-cells = <1>;

	regulators {
		x-powers,dcdc-freq = <1500>;

		vdd_cpu: dcdc2 {
			regulator-always-on;
			regulator-min-microvolt = <1000000>;
			regulator-max-microvolt = <1450000>;
			regulator-name = "vdd-cpu";
		};

		vdd_int_dll: dcdc3 {
			regulator-always-on;
			regulator-min-microvolt = <1000000>;
			regulator-max-microvolt = <1400000>;
			regulator-name = "vdd-int-dll";
		};

		vdd_rtc: ldo1 {
			regulator-always-on;
			regulator-min-microvolt = <1200000>;
			regulator-max-microvolt = <1400000>;
			regulator-name = "vdd-rtc";
		};

		avcc: ldo2 {
			regulator-always-on;
			regulator-min-microvolt = <2700000>;
			regulator-max-microvolt = <3300000>;
			regulator-name = "avcc";
		};

		ldo3 {
			/* unused but preferred to be managed by OS */
		};
	};
};
```

## Documentation/devicetree/bindings/mfd/bcm590xx.txt
```
-------------------------------
BCM590xx Power Management Units
-------------------------------

Required properties:
- compatible: "brcm,bcm59056"
- reg: I2C slave address
- interrupts: interrupt for the PMU. Generic interrupt client node bindings
  are described in interrupt-controller/interrupts.txt

------------------
Voltage Regulators
------------------

Optional child nodes:
- regulators: container node for regulators following the generic
  regulator binding in regulator/regulator.txt

  The valid regulator node names for BCM59056 are:
  	rfldo, camldo1, camldo2, simldo1, simldo2, sdldo, sdxldo,
	mmcldo1, mmcldo2, audldo, micldo, usbldo, vibldo,
	csr, iosr1, iosr2, msr, sdsr1, sdsr2, vsr

Example:
	pmu: bcm59056@8 {
		compatible = "brcm,bcm59056";
		reg = <0x08>;
		interrupts = <GIC_SPI 215 IRQ_TYPE_LEVEL_HIGH>;
		regulators {
			rfldo_reg: rfldo {
				regulator-min-microvolt = <1200000>;
				regulator-max-microvolt = <3300000>;
			};

			...
		};
	};
```
