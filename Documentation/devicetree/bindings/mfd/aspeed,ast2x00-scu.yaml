## Documentation/devicetree/bindings/mfd/bd9571mwv.txt
```
* ROHM BD9571MWV Power Management Integrated Circuit (PMIC) bindings

Required properties:
 - compatible		: Should be "rohm,bd9571mwv".
 - reg			: I2C slave address.
 - interrupt-parent	: Phandle to the parent interrupt controller.
 - interrupts		: The interrupt line the device is connected to.
 - interrupt-controller	: Marks the device node as an interrupt controller.
 - #interrupt-cells	: The number of cells to describe an IRQ, should be 2.
			    The first cell is the IRQ number.
			    The second cell is the flags, encoded as trigger
			    masks from ../interrupt-controller/interrupts.txt.
 - gpio-controller      : Marks the device node as a GPIO Controller.
 - #gpio-cells          : Should be two.  The first cell is the pin number and
                            the second cell is used to specify flags.
                            See ../gpio/gpio.txt for more information.
 - regulators:          : List of child nodes that specify the regulator
                            initialization data. Child nodes must be named
                            after their hardware counterparts:
			     - vd09
			     - vd18
			     - vd25
			     - vd33
			     - dvfs
			    Each child node is defined using the standard
			    binding for regulators.

Optional properties:
  - rohm,ddr-backup-power : Value to use for DDR-Backup Power (default 0).
			    This is a bitmask that specifies which DDR power
			    rails need to be kept powered when backup mode is
			    entered, for system suspend:
			      - bit 0: DDR0
			      - bit 1: DDR1
			      - bit 2: DDR0C
			      - bit 3: DDR1C
			    These bits match the KEEPON_DDR* bits in the
			    documentation for the "BKUP Mode Cnt" register.
  - rohm,rstbmode-level: The RSTB signal is configured for level mode, to
			 accommodate a toggle power switch (the RSTBMODE pin is
			 strapped low).
  - rohm,rstbmode-pulse: The RSTB signal is configured for pulse mode, to
			 accommodate a momentary power switch (the RSTBMODE pin
			 is strapped high).
			 The two properties above are mutually exclusive.

Example:

	pmic: pmic@30 {
		compatible = "rohm,bd9571mwv";
		reg = <0x30>;
		interrupt-parent = <&gpio2>;
		interrupts = <0 IRQ_TYPE_LEVEL_LOW>;
		interrupt-controller;
		#interrupt-cells = <2>;
		gpio-controller;
		#gpio-cells = <2>;
		rohm,ddr-backup-power = <0xf>;
		rohm,rstbmode-pulse;

		regulators {
			dvfs: dvfs {
				regulator-name = "dvfs";
				regulator-min-microvolt = <750000>;
				regulator-max-microvolt = <1030000>;
				regulator-boot-on;
				regulator-always-on;
			};
		};
	};
```

## Documentation/devicetree/bindings/mfd/bfticu.txt
```
KEYMILE bfticu Chassis Management FPGA

The bfticu is a multifunction device that manages the whole chassis.
Its main functionality is to collect IRQs from the whole chassis and signals
them to a single controller.

Required properties:
- compatible: "keymile,bfticu"
- interrupt-controller: the bfticu FPGA is an interrupt controller
- interrupts: the main IRQ line to signal the collected IRQs
- #interrupt-cells : is 2 and their usage is compliant to the 2 cells variant
  of Documentation/devicetree/bindings/interrupt-controller/interrupts.txt
- interrupt-parent: the parent IRQ ctrl the main IRQ is connected to
- reg: access on the parent local bus (chip select, offset in chip select, size)

Example:

	chassis-mgmt@3,0 {
		compatible = "keymile,bfticu";
		interrupt-controller;
		#interrupt-cells = <2>;
		reg = <3 0 0x100>;
		interrupt-parent = <&mpic>;
		interrupts = <6 1 0 0>;
	};
```

## Documentation/devicetree/bindings/mfd/bitmain,bm1880-sctrl.yaml
```yaml
# SPDX-License-Identifier: (GPL-2.0-only OR BSD-2-Clause)
%YAML 1.2
---
$id: http://devicetree.org/schemas/mfd/bitmain,bm1880-sctrl.yaml#
$schema: http://devicetree.org/meta-schemas/core.yaml#

title: Bitmain BM1880 System Controller

maintainers:
  - Manivannan Sadhasivam <mani@kernel.org>

properties:
  compatible:
    items:
      - const: bitmain,bm1880-sctrl
      - const: syscon
      - const: simple-mfd

  reg:
    maxItems: 1

  ranges: true

  '#address-cells':
    const: 1

  '#size-cells':
    const: 1

patternProperties:
  '^pinctrl@[0-9a-f]+$':
    type: object
    additionalProperties: true

    properties:
      compatible:
        contains:
          const: bitmain,bm1880-pinctrl

  '^clock-controller@[0-9a-f]+$':
    type: object
    additionalProperties: true

    properties:
      compatible:
        contains:
          const: bitmain,bm1880-clk

  '^reset-controller@[0-9a-f]+$':
    type: object
    additionalProperties: true

    properties:
      compatible:
        contains:
          const: bitmain,bm1880-reset

required:
  - compatible
  - reg
  - ranges
  - '#address-cells'
  - '#size-cells'

additionalProperties: false
...
```

## Documentation/devicetree/bindings/mfd/brcm,bcm59056.yaml
```yaml
# SPDX-License-Identifier: (GPL-2.0-only OR BSD-2-Clause)
%YAML 1.2
---
$id: http://devicetree.org/schemas/mfd/brcm,bcm59056.yaml#
$schema: http://devicetree.org/meta-schemas/core.yaml#

title: Broadcom BCM590xx Power Management Units

maintainers:
  - Artur Weber <aweber.kernel@gmail.com>

properties:
  compatible:
    enum:
      - brcm,bcm59054
      - brcm,bcm59056

  reg:
    maxItems: 1

  interrupts:
    maxItems: 1

  regulators:
    type: object

required:
  - compatible
  - reg
  - interrupts

additionalProperties: false

allOf:
  - if:
      properties:
        compatible:
          contains:
            const: brcm,bcm59054
    then:
      properties:
        regulators:
          $ref: /schemas/regulator/brcm,bcm59054.yaml#

  - if:
      properties:
        compatible:
          contains:
            const: brcm,bcm59056
    then:
      properties:
        regulators:
          $ref: /schemas/regulator/brcm,bcm59056.yaml#

examples:
  - |
    #include <dt-bindings/interrupt-controller/arm-gic.h>
    #include <dt-bindings/interrupt-controller/irq.h>

    i2c {
        #address-cells = <1>;
        #size-cells = <0>;

        pmic@8 {
            compatible = "brcm,bcm59056";
            reg = <0x08>;
            interrupts = <GIC_SPI 215 IRQ_TYPE_LEVEL_HIGH>;

            regulators {
                rfldo {
                    regulator-min-microvolt = <1200000>;
                    regulator-max-microvolt = <3300000>;
                };
            };
        };
    };
```

## Documentation/devicetree/bindings/mfd/brcm,bcm6318-gpio-sysctl.yaml
```yaml
# SPDX-License-Identifier: (GPL-2.0-only OR BSD-2-Clause)
%YAML 1.2
---
$id: http://devicetree.org/schemas/mfd/brcm,bcm6318-gpio-sysctl.yaml#
$schema: http://devicetree.org/meta-schemas/core.yaml#

title: Broadcom BCM6318 GPIO System Controller

maintainers:
  - Álvaro Fernández Rojas <noltari@gmail.com>
  - Jonas Gorski <jonas.gorski@gmail.com>

description:
  Broadcom BCM6318 SoC GPIO system controller which provides a register map
  for controlling the GPIO and pins of the SoC.

properties:
  "#address-cells": true

  "#size-cells": true

  compatible:
    items:
      - const: brcm,bcm6318-gpio-sysctl
      - const: syscon
      - const: simple-mfd

  ranges:
    maxItems: 1

  reg:
    maxItems: 1

patternProperties:
  "^gpio@[0-9a-f]+$":
    # Child node
    type: object
    $ref: /schemas/gpio/brcm,bcm63xx-gpio.yaml
    description:
      GPIO controller for the SoC GPIOs. This child node definition
      should follow the bindings specified in
      Documentation/devicetree/bindings/gpio/brcm,bcm63xx-gpio.yaml.

  "^pinctrl@[0-9a-f]+$":
    # Child node
    type: object
    $ref: /schemas/pinctrl/brcm,bcm6318-pinctrl.yaml
    description:
      Pin controller for the SoC pins. This child node definition
      should follow the bindings specified in
      Documentation/devicetree/bindings/pinctrl/brcm,bcm6318-pinctrl.yaml.

required:
  - "#address-cells"
  - compatible
  - ranges
  - reg
  - "#size-cells"

additionalProperties: false

examples:
  - |
    syscon@10000080 {
      #address-cells = <1>;
      #size-cells = <1>;
      compatible = "brcm,bcm6318-gpio-sysctl", "syscon", "simple-mfd";
      reg = <0x10000080 0x80>;
      ranges = <0 0x10000080 0x80>;

      gpio@0 {
        compatible = "brcm,bcm6318-gpio";
        reg-names = "dirout", "dat";
        reg = <0x0 0x8>, <0x8 0x8>;

        gpio-controller;
        gpio-ranges = <&pinctrl 0 0 50>;
        #gpio-cells = <2>;
      };

      pinctrl: pinctrl@10 {
        compatible = "brcm,bcm6318-pinctrl";
        reg = <0x18 0x10>, <0x54 0x18>;

        pinctrl_ephy0_spd_led: ephy0_spd_led-pins {
          function = "ephy0_spd_led";
          pins = "gpio0";
        };

        pinctrl_ephy1_spd_led: ephy1_spd_led-pins {
          function = "ephy1_spd_led";
          pins = "gpio1";
        };

        pinctrl_ephy2_spd_led: ephy2_spd_led-pins {
          function = "ephy2_spd_led";
          pins = "gpio2";
        };

        pinctrl_ephy3_spd_led: ephy3_spd_led-pins {
          function = "ephy3_spd_led";
          pins = "gpio3";
        };

        pinctrl_ephy0_act_led: ephy0_act_led-pins {
          function = "ephy0_act_led";
          pins = "gpio4";
        };

        pinctrl_ephy1_act_led: ephy1_act_led-pins {
          function = "ephy1_act_led";
          pins = "gpio5";
        };

        pinctrl_ephy2_act_led: ephy2_act_led-pins {
          function = "ephy2_act_led";
          pins = "gpio6";
        };

        pinctrl_ephy3_act_led: ephy3_act_led-pins {
          function = "ephy3_act_led";
          pins = "gpio7";
        };

        pinctrl_serial_led: serial_led-pins {
          pinctrl_serial_led_data: serial_led_data-pins {
            function = "serial_led_data";
            pins = "gpio6";
          };

          pinctrl_serial_led_clk: serial_led_clk-pins {
            function = "serial_led_clk";
            pins = "gpio7";
          };
        };

        pinctrl_inet_act_led: inet_act_led-pins {
          function = "inet_act_led";
          pins = "gpio8";
        };

        pinctrl_inet_fail_led: inet_fail_led-pins {
          function = "inet_fail_led";
          pins = "gpio9";
        };

        pinctrl_dsl_led: dsl_led-pins {
          function = "dsl_led";
          pins = "gpio10";
        };

        pinctrl_post_fail_led: post_fail_led-pins {
          function = "post_fail_led";
          pins = "gpio11";
        };

        pinctrl_wlan_wps_led: wlan_wps_led-pins {
          function = "wlan_wps_led";
          pins = "gpio12";
        };

        pinctrl_usb_pwron: usb_pwron-pins {
          function = "usb_pwron";
          pins = "gpio13";
        };

        pinctrl_usb_device_led: usb_device_led-pins {
          function = "usb_device_led";
          pins = "gpio13";
        };

        pinctrl_usb_active: usb_active-pins {
          function = "usb_active";
          pins = "gpio40";
        };
      };
    };
```

## Documentation/devicetree/bindings/mfd/brcm,bcm63268-gpio-sysctl.yaml
```yaml
# SPDX-License-Identifier: (GPL-2.0-only OR BSD-2-Clause)
%YAML 1.2
---
$id: http://devicetree.org/schemas/mfd/brcm,bcm63268-gpio-sysctl.yaml#
$schema: http://devicetree.org/meta-schemas/core.yaml#

title: Broadcom BCM63268 GPIO System Controller Device Tree Bindings

maintainers:
  - Álvaro Fernández Rojas <noltari@gmail.com>
  - Jonas Gorski <jonas.gorski@gmail.com>

description:
  Broadcom BCM63268 SoC GPIO system controller which provides a register map
  for controlling the GPIO and pins of the SoC.

properties:
  "#address-cells": true

  "#size-cells": true

  compatible:
    items:
      - const: brcm,bcm63268-gpio-sysctl
      - const: syscon
      - const: simple-mfd

  ranges:
    maxItems: 1

  reg:
    maxItems: 1

patternProperties:
  "^gpio@[0-9a-f]+$":
    # Child node
    type: object
    $ref: "../gpio/brcm,bcm6345-gpio.yaml"
    description:
      GPIO controller for the SoC GPIOs. This child node definition
      should follow the bindings specified in
      Documentation/devicetree/bindings/gpio/brcm,bcm6345-gpio.yaml.

  "^pinctrl@[0-9a-f]+$":
    # Child node
    type: object
    $ref: "../pinctrl/brcm,bcm63268-pinctrl.yaml"
    description:
      Pin controller for the SoC pins. This child node definition
      should follow the bindings specified in
      Documentation/devicetree/bindings/pinctrl/brcm,bcm63268-pinctrl.yaml.

required:
  - "#address-cells"
  - compatible
  - ranges
  - reg
  - "#size-cells"

additionalProperties: false

examples:
  - |
    syscon@100000c0 {
      #address-cells = <1>;
      #size-cells = <1>;
      compatible = "brcm,bcm63268-gpio-sysctl", "syscon", "simple-mfd";
      reg = <0x100000c0 0x80>;
      ranges = <0 0x100000c0 0x80>;

      gpio@0 {
        compatible = "brcm,bcm63268-gpio";
        reg-names = "dirout", "dat";
        reg = <0x0 0x8>, <0x8 0x8>;

        gpio-controller;
        gpio-ranges = <&pinctrl 0 0 52>;
        #gpio-cells = <2>;
      };

      pinctrl: pinctrl@10 {
        compatible = "brcm,bcm63268-pinctrl";
        reg = <0x10 0x4>, <0x18 0x8>, <0x38 0x4>;

        pinctrl_serial_led: serial_led-pins {
          pinctrl_serial_led_clk: serial_led_clk-pins {
            function = "serial_led_clk";
            pins = "gpio0";
          };

          pinctrl_serial_led_data: serial_led_data-pins {
            function = "serial_led_data";
            pins = "gpio1";
          };
        };

        pinctrl_hsspi_cs4: hsspi_cs4-pins {
          function = "hsspi_cs4";
          pins = "gpio16";
        };

        pinctrl_hsspi_cs5: hsspi_cs5-pins {
          function = "hsspi_cs5";
          pins = "gpio17";
        };

        pinctrl_hsspi_cs6: hsspi_cs6-pins {
          function = "hsspi_cs6";
          pins = "gpio8";
        };

        pinctrl_hsspi_cs7: hsspi_cs7-pins {
          function = "hsspi_cs7";
          pins = "gpio9";
        };

        pinctrl_adsl_spi: adsl_spi-pins {
          pinctrl_adsl_spi_miso: adsl_spi_miso-pins {
            function = "adsl_spi_miso";
            pins = "gpio18";
          };

          pinctrl_adsl_spi_mosi: adsl_spi_mosi-pins {
            function = "adsl_spi_mosi";
            pins = "gpio19";
          };
        };

        pinctrl_vreq_clk: vreq_clk-pins {
          function = "vreq_clk";
          pins = "gpio22";
        };

        pinctrl_pcie_clkreq_b: pcie_clkreq_b-pins {
          function = "pcie_clkreq_b";
          pins = "gpio23";
        };

        pinctrl_robosw_led_clk: robosw_led_clk-pins {
          function = "robosw_led_clk";
          pins = "gpio30";
        };

        pinctrl_robosw_led_data: robosw_led_data-pins {
          function = "robosw_led_data";
          pins = "gpio31";
        };

        pinctrl_nand: nand-pins {
          function = "nand";
          group = "nand_grp";
        };

        pinctrl_gpio35_alt: gpio35_alt-pins {
          function = "gpio35_alt";
          pin = "gpio35";
        };

        pinctrl_dectpd: dectpd-pins {
          function = "dectpd";
          group = "dectpd_grp";
        };

        pinctrl_vdsl_phy_override_0: vdsl_phy_override_0-pins {
          function = "vdsl_phy_override_0";
          group = "vdsl_phy_override_0_grp";
        };

        pinctrl_vdsl_phy_override_1: vdsl_phy_override_1-pins {
          function = "vdsl_phy_override_1";
          group = "vdsl_phy_override_1_grp";
        };

        pinctrl_vdsl_phy_override_2: vdsl_phy_override_2-pins {
          function = "vdsl_phy_override_2";
          group = "vdsl_phy_override_2_grp";
        };

        pinctrl_vdsl_phy_override_3: vdsl_phy_override_3-pins {
          function = "vdsl_phy_override_3";
          group = "vdsl_phy_override_3_grp";
        };

        pinctrl_dsl_gpio8: dsl_gpio8-pins {
          function = "dsl_gpio8";
          group = "dsl_gpio8";
        };

        pinctrl_dsl_gpio9: dsl_gpio9-pins {
          function = "dsl_gpio9";
          group = "dsl_gpio9";
        };
      };
    };
```
