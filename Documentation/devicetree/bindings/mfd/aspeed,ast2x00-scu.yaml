## Documentation/devicetree/bindings/mfd/aspeed-scu.txt
```
The Aspeed System Control Unit manages the global behaviour of the SoC,
configuring elements such as clocks, pinmux, and reset.

Required properties:
- compatible:	One of:
		"aspeed,ast2400-scu", "syscon", "simple-mfd"
		"aspeed,ast2500-scu", "syscon", "simple-mfd"

- reg:		contains the offset and length of the SCU memory region
- #clock-cells: should be set to <1> - the system controller is also a
	clock provider
- #reset-cells: should be set to <1> - the system controller is also a
	reset line provider

Example:

syscon: syscon@1e6e2000 {
	compatible = "aspeed,ast2400-scu", "syscon", "simple-mfd";
	reg = <0x1e6e2000 0x1a8>;
	#clock-cells = <1>;
	#reset-cells = <1>;
};

Silicon ID
-----------------

Families have unique hardware silicon identifiers within the SoC.

Required properties:

 - compatible:		"aspeed,silicon-id" or:
			"aspeed,ast2400-silicon-id" or
			"aspeed,ast2500-silicon-id" or
			"aspeed,ast2600-silicon-id"

 - reg:			offset and length of the silicon id information
			optionally, a second offset and length describes the unique chip id

			The reg should be the unique silicon id register, and
			not backwards compatible one in eg. the 2600.

Example:


silicon-id@7c {
        compatible = "aspeed,ast2500-silicon-id", "aspeed,silicon-id";
        reg = <0x7c 0x4 0x150 0x8>;
};
```

## Documentation/devicetree/bindings/mfd/atmel,at91sam9260-gpbr.yaml
```yaml
# SPDX-License-Identifier: (GPL-2.0-only OR BSD-2-Clause)
%YAML 1.2
---
$id: http://devicetree.org/schemas/mfd/atmel,at91sam9260-gpbr.yaml#
$schema: http://devicetree.org/meta-schemas/core.yaml#

title: Microchip AT91 General Purpose Backup Registers

maintainers:
  - Nicolas Ferre <nicolas.ferre@microchip.com>

description:
  The system controller embeds 256 bits of General Purpose Backup
  registers organized as 8 32-bit registers.

properties:
  compatible:
    oneOf:
      - items:
          - enum:
              - atmel,at91sam9260-gpbr
              - microchip,sama7d65-gpbr
          - const: syscon
      - items:
          - enum:
              - microchip,sam9x60-gpbr
              - microchip,sam9x7-gpbr
          - const: atmel,at91sam9260-gpbr
          - const: syscon

  reg:
    maxItems: 1

required:
  - compatible
  - reg

additionalProperties: false

examples:
  - |
    syscon@fffffd50 {
        compatible = "atmel,at91sam9260-gpbr", "syscon";
        reg = <0xfffffd50 0x10>;
    };
```

## Documentation/devicetree/bindings/mfd/atmel,at91sam9260-matrix.yaml
```yaml
# SPDX-License-Identifier: (GPL-2.0-only OR BSD-2-Clause)
%YAML 1.2
---
$id: http://devicetree.org/schemas/mfd/atmel,at91sam9260-matrix.yaml#
$schema: http://devicetree.org/meta-schemas/core.yaml#

title: Microchip AT91 Bus Matrix

maintainers:
  - Nicolas Ferre <nicolas.ferre@microchip.com>

description:
  The Bus Matrix (MATRIX) implements a multi-layer AHB, based on the
  AHB-Lite protocol, that enables parallel access paths between multiple
  masters and slaves in a system, thus increasing the overall bandwidth.

properties:
  compatible:
    oneOf:
      - items:
          - enum:
              - atmel,at91sam9260-matrix
              - atmel,at91sam9261-matrix
              - atmel,at91sam9263-matrix
              - atmel,at91sam9rl-matrix
              - atmel,at91sam9g45-matrix
              - atmel,at91sam9n12-matrix
              - atmel,at91sam9x5-matrix
              - atmel,sama5d3-matrix
          - const: syscon
      - items:
          - enum:
              - microchip,sam9x60-matrix
              - microchip,sam9x7-matrix
          - const: atmel,at91sam9x5-matrix
          - const: syscon

  reg:
    maxItems: 1

required:
  - compatible
  - reg

additionalProperties: false

examples:
  - |
    syscon@ffffec00 {
        compatible = "atmel,sama5d3-matrix", "syscon";
        reg = <0xffffec00 0x200>;
    };
```

## Documentation/devicetree/bindings/mfd/atmel,hlcdc.yaml
```yaml
# SPDX-License-Identifier: (GPL-2.0 OR BSD-2-Clause)
%YAML 1.2
---
$id: http://devicetree.org/schemas/mfd/atmel,hlcdc.yaml#
$schema: http://devicetree.org/meta-schemas/core.yaml#

title: Atmel's HLCD Controller

maintainers:
  - Nicolas Ferre <nicolas.ferre@microchip.com>
  - Alexandre Belloni <alexandre.belloni@bootlin.com>
  - Claudiu Beznea <claudiu.beznea@tuxon.dev>

description:
  The Atmel HLCDC (HLCD Controller) IP available on Atmel SoCs exposes two
  subdevices, a PWM chip and a Display Controller.

properties:
  compatible:
    enum:
      - atmel,at91sam9n12-hlcdc
      - atmel,at91sam9x5-hlcdc
      - atmel,sama5d2-hlcdc
      - atmel,sama5d3-hlcdc
      - atmel,sama5d4-hlcdc
      - microchip,sam9x60-hlcdc
      - microchip,sam9x75-xlcdc

  reg:
    maxItems: 1

  interrupts:
    maxItems: 1

  clocks:
    minItems: 3

  clock-names:
    items:
      - const: periph_clk
      - const: sys_clk
      - const: slow_clk
      - const: lvds_pll_clk
    minItems: 3

  display-controller:
    $ref: /schemas/display/atmel/atmel,hlcdc-display-controller.yaml

  pwm:
    $ref: /schemas/pwm/atmel,hlcdc-pwm.yaml

required:
  - compatible
  - reg
  - clocks
  - clock-names
  - interrupts

additionalProperties: false

examples:
  - |
    #include <dt-bindings/clock/at91.h>
    #include <dt-bindings/dma/at91.h>
    #include <dt-bindings/interrupt-controller/arm-gic.h>

    lcd_controller: lcd-controller@f0030000 {
      compatible = "atmel,sama5d3-hlcdc";
      reg = <0xf0030000 0x2000>;
      clocks = <&lcdc_clk>, <&lcdck>, <&clk32k>;
      clock-names = "periph_clk", "sys_clk", "slow_clk";
      interrupts = <36 IRQ_TYPE_LEVEL_HIGH 0>;

      display-controller {
        compatible = "atmel,hlcdc-display-controller";
        pinctrl-names = "default";
        pinctrl-0 = <&pinctrl_lcd_base &pinctrl_lcd_rgb888>;
        #address-cells = <1>;
        #size-cells = <0>;

        port@0 {
          #address-cells = <1>;
          #size-cells = <0>;
          reg = <0>;

          hlcdc_panel_output: endpoint@0 {
            reg = <0>;
            remote-endpoint = <&panel_input>;
          };
        };
      };

      pwm {
        compatible = "atmel,hlcdc-pwm";
        pinctrl-names = "default";
        pinctrl-0 = <&pinctrl_lcd_pwm>;
        #pwm-cells = <3>;
      };
    };
```

## Documentation/devicetree/bindings/mfd/atmel,sama5d2-flexcom.yaml
```yaml
# SPDX-License-Identifier: (GPL-2.0-only OR BSD-2-Clause)
%YAML 1.2
---
$id: http://devicetree.org/schemas/mfd/atmel,sama5d2-flexcom.yaml#
$schema: http://devicetree.org/meta-schemas/core.yaml#

title: Microchip Flexcom (Flexible Serial Communication Unit)

maintainers:
  - Kavyasree Kotagiri <kavyasree.kotagiri@microchip.com>

description:
  The Microchip Flexcom is just a wrapper which embeds a SPI controller,
  an I2C controller and an USART. Only one function can be used at a
  time and is chosen at boot time according to the device tree.

properties:
  compatible:
    oneOf:
      - const: atmel,sama5d2-flexcom
      - items:
          - const: microchip,sam9x7-flexcom
          - const: atmel,sama5d2-flexcom
      - items:
          - const: microchip,sama7g5-flexcom
          - const: atmel,sama5d2-flexcom


  reg:
    maxItems: 1

  clocks:
    maxItems: 1

  "#address-cells":
    const: 1

  "#size-cells":
    const: 1

  ranges:
    description:
      One range for the full I/O register region. (including USART,
      TWI and SPI registers).
    items:
      maxItems: 3

  atmel,flexcom-mode:
    description: |
      Specifies the flexcom mode as follows:
      1: USART
      2: SPI
      3: I2C.
    $ref: /schemas/types.yaml#/definitions/uint32
    enum: [1, 2, 3]

patternProperties:
  "^serial@[0-9a-f]+$":
    type: object
    description:
      Child node describing USART. See atmel-usart.txt for details
      of USART bindings.

  "^spi@[0-9a-f]+$":
    type: object
    description:
      Child node describing SPI. See ../spi/spi_atmel.txt for details
      of SPI bindings.

  "^i2c@[0-9a-f]+$":
    $ref: /schemas/i2c/atmel,at91sam-i2c.yaml
    description:
      Child node describing I2C.

required:
  - compatible
  - reg
  - clocks
  - "#address-cells"
  - "#size-cells"
  - ranges
  - atmel,flexcom-mode

additionalProperties: false

examples:
  - |
    #include <dt-bindings/interrupt-controller/arm-gic.h>

    flx0: flexcom@f8034000 {
        compatible = "atmel,sama5d2-flexcom";
        reg = <0xf8034000 0x200>;
        clocks = <&flx0_clk>;
        #address-cells = <1>;
        #size-cells = <1>;
        ranges = <0x0 0xf8034000 0x800>;
        atmel,flexcom-mode = <2>;
    };
...
```

## Documentation/devicetree/bindings/mfd/atmel-flexcom.txt
```
* Device tree bindings for Atmel Flexcom (Flexible Serial Communication Unit)

The Atmel Flexcom is just a wrapper which embeds a SPI controller, an I2C
controller and an USART. Only one function can be used at a time and is chosen
at boot time according to the device tree.

Required properties:
- compatible:		Should be "atmel,sama5d2-flexcom"
- reg:			Should be the offset/length value for Flexcom dedicated
			I/O registers (without USART, TWI or SPI registers).
- clocks:		Should be the Flexcom peripheral clock from PMC.
- #address-cells:	Should be <1>
- #size-cells:		Should be <1>
- ranges:		Should be one range for the full I/O register region
			(including USART, TWI and SPI registers).
- atmel,flexcom-mode:	Should be one of the following values:
			- <1> for USART
			- <2> for SPI
			- <3> for I2C

Required child:
A single available child device of type matching the "atmel,flexcom-mode"
property.

The phandle provided by the clocks property of the child is the same as one for
the Flexcom parent.

For other properties, please refer to the documentations of the respective
device:
- ../serial/atmel-usart.txt
- ../spi/spi_atmel.txt
- ../i2c/i2c-at91.txt

Example:

flexcom@f8034000 {
	compatible = "atmel,sama5d2-flexcom";
	reg = <0xf8034000 0x200>;
	clocks = <&flx0_clk>;
	#address-cells = <1>;
	#size-cells = <1>;
	ranges = <0x0 0xf8034000 0x800>;
	atmel,flexcom-mode = <2>;

	spi@400 {
		compatible = "atmel,at91rm9200-spi";
		reg = <0x400 0x200>;
		interrupts = <19 IRQ_TYPE_LEVEL_HIGH 7>;
		pinctrl-names = "default";
		pinctrl-0 = <&pinctrl_flx0_default>;
		#address-cells = <1>;
		#size-cells = <0>;
		clocks = <&flx0_clk>;
		clock-names = "spi_clk";
		atmel,fifo-size = <32>;

		flash@0 {
			compatible = "atmel,at25f512b";
			reg = <0>;
			spi-max-frequency = <20000000>;
		};
	};
};
```

## Documentation/devicetree/bindings/mfd/atmel-gpbr.txt
```
* Device tree bindings for Atmel GPBR (General Purpose Backup Registers)

The GPBR are a set of battery-backed registers.

Required properties:
- compatible:		Should be one of the following:
			"atmel,at91sam9260-gpbr", "syscon"
			"microchip,sam9x60-gpbr", "syscon"
- reg:			contains offset/length value of the GPBR memory
			region.

Example:

gpbr: gpbr@fffffd50 {
	compatible = "atmel,at91sam9260-gpbr", "syscon";
	reg = <0xfffffd50 0x10>;
};
```

## Documentation/devicetree/bindings/mfd/atmel-hlcdc.txt
```
Device-Tree bindings for Atmel's HLCDC (High LCD Controller) MFD driver

Required properties:
 - compatible: value should be one of the following:
   "atmel,at91sam9n12-hlcdc"
   "atmel,at91sam9x5-hlcdc"
   "atmel,sama5d2-hlcdc"
   "atmel,sama5d3-hlcdc"
   "atmel,sama5d4-hlcdc"
 - reg: base address and size of the HLCDC device registers.
 - clock-names: the name of the 3 clocks requested by the HLCDC device.
   Should contain "periph_clk", "sys_clk" and "slow_clk".
 - clocks: should contain the 3 clocks requested by the HLCDC device.
 - interrupts: should contain the description of the HLCDC interrupt line

The HLCDC IP exposes two subdevices:
 - a PWM chip: see ../pwm/atmel-hlcdc-pwm.txt
 - a Display Controller: see ../display/atmel/hlcdc-dc.txt

Example:

	hlcdc: hlcdc@f0030000 {
		compatible = "atmel,sama5d3-hlcdc";
		reg = <0xf0030000 0x2000>;
		clocks = <&lcdc_clk>, <&lcdck>, <&clk32k>;
		clock-names = "periph_clk","sys_clk", "slow_clk";
		interrupts = <36 IRQ_TYPE_LEVEL_HIGH 0>;
		status = "disabled";

		hlcdc-display-controller {
			compatible = "atmel,hlcdc-display-controller";
			pinctrl-names = "default";
			pinctrl-0 = <&pinctrl_lcd_base &pinctrl_lcd_rgb888>;
			#address-cells = <1>;
			#size-cells = <0>;

			port@0 {
				#address-cells = <1>;
				#size-cells = <0>;
				reg = <0>;

				hlcdc_panel_output: endpoint@0 {
					reg = <0>;
					remote-endpoint = <&panel_input>;
				};
			};
		};

		hlcdc_pwm: hlcdc-pwm {
			compatible = "atmel,hlcdc-pwm";
			pinctrl-names = "default";
			pinctrl-0 = <&pinctrl_lcd_pwm>;
			#pwm-cells = <3>;
		};
	};
```

## Documentation/devicetree/bindings/mfd/atmel-matrix.txt
```
* Device tree bindings for Atmel Bus Matrix

The Bus Matrix registers are used to configure Atmel SoCs internal bus
behavior (master/slave priorities, undefined burst length type, ...)

Required properties:
- compatible:		Should be one of the following
			"atmel,at91sam9260-matrix", "syscon"
			"atmel,at91sam9261-matrix", "syscon"
			"atmel,at91sam9263-matrix", "syscon"
			"atmel,at91sam9rl-matrix", "syscon"
			"atmel,at91sam9g45-matrix", "syscon"
			"atmel,at91sam9n12-matrix", "syscon"
			"atmel,at91sam9x5-matrix", "syscon"
			"atmel,sama5d3-matrix", "syscon"
- reg:			Contains offset/length value of the Bus Matrix
			memory region.

Example:

matrix: matrix@ffffec00 {
	compatible = "atmel,sama5d3-matrix", "syscon";
	reg = <0xffffec00 0x200>;
};
```

## Documentation/devicetree/bindings/mfd/atmel-smc.txt
```
* Device tree bindings for Atmel SMC (Static Memory Controller)

The SMC registers are used to configure Atmel EBI (External Bus Interface)
to interface with standard memory devices (NAND, NOR, SRAM or specialized
devices like FPGAs).

Required properties:
- compatible:		Should be one of the following
			"atmel,at91sam9260-smc", "syscon"
			"atmel,sama5d3-smc", "syscon"
			"atmel,sama5d2-smc", "syscon"
- reg:			Contains offset/length value of the SMC memory
			region.

Example:

smc: smc@ffffc000 {
	compatible = "atmel,sama5d3-smc", "syscon";
	reg = <0xffffc000 0x1000>;
};
```

## Documentation/devicetree/bindings/mfd/atmel-tcb.txt
```
* Device tree bindings for Atmel Timer Counter Blocks
- compatible: Should be "atmel,<chip>-tcb", "simple-mfd", "syscon".
  <chip> can be "at91rm9200" or "at91sam9x5"
- reg: Should contain registers location and length
- #address-cells: has to be 1
- #size-cells: has to be 0
- interrupts: Should contain all interrupts for the TC block
  Note that you can specify several interrupt cells if the TC
  block has one interrupt per channel.
- clock-names: tuple listing input clock names.
	Required elements: "t0_clk", "slow_clk"
	Optional elements: "t1_clk", "t2_clk"
- clocks: phandles to input clocks.

The TCB can expose multiple subdevices:
 * a timer
   - compatible: Should be "atmel,tcb-timer"
   - reg: Should contain the TCB channels to be used. If the
     counter width is 16 bits (at91rm9200-tcb), two consecutive
     channels are needed. Else, only one channel will be used.

Examples:

One interrupt per TC block:
	tcb0: timer@fff7c000 {
		compatible = "atmel,at91rm9200-tcb", "simple-mfd", "syscon";
		#address-cells = <1>;
		#size-cells = <0>;
		reg = <0xfff7c000 0x100>;
		interrupts = <18 4>;
		clocks = <&tcb0_clk>, <&clk32k>;
		clock-names = "t0_clk", "slow_clk";

		timer@0 {
			compatible = "atmel,tcb-timer";
			reg = <0>, <1>;
		};

		timer@2 {
			compatible = "atmel,tcb-timer";
			reg = <2>;
		};
	};

One interrupt per TC channel in a TC block:
	tcb1: timer@fffdc000 {
		compatible = "atmel,at91rm9200-tcb", "simple-mfd", "syscon";
		#address-cells = <1>;
		#size-cells = <0>;
		reg = <0xfffdc000 0x100>;
		interrupts = <26 4>, <27 4>, <28 4>;
		clocks = <&tcb1_clk>, <&clk32k>;
		clock-names = "t0_clk", "slow_clk";
	};
```
