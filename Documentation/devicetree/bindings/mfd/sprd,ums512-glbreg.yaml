## Documentation/devicetree/bindings/mfd/sun4i-gpadc.txt
```
Allwinner SoCs' GPADC Device Tree bindings
------------------------------------------
The Allwinner SoCs all have an ADC that can also act as a thermal sensor
and sometimes as a touchscreen controller.

Required properties:
  - compatible: "allwinner,sun8i-a33-ths",
  - reg: mmio address range of the chip,
  - #thermal-sensor-cells: shall be 0,
  - #io-channel-cells: shall be 0,

Example:
	ths: ths@01c25000 {
		compatible = "allwinner,sun8i-a33-ths";
		reg = <0x01c25000 0x100>;
		#thermal-sensor-cells = <0>;
		#io-channel-cells = <0>;
	};

sun4i, sun5i and sun6i SoCs are also supported via the older binding:

sun4i resistive touchscreen controller
--------------------------------------

Required properties:
 - compatible: "allwinner,sun4i-a10-ts", "allwinner,sun5i-a13-ts" or
   "allwinner,sun6i-a31-ts"
 - reg: mmio address range of the chip
 - interrupts: interrupt to which the chip is connected
 - #thermal-sensor-cells: shall be 0

Optional properties:
 - allwinner,ts-attached	 : boolean indicating that an actual touchscreen
				   is attached to the controller
 - allwinner,tp-sensitive-adjust : integer (4 bits)
				   adjust sensitivity of pen down detection
				   between 0 (least sensitive) and 15
				   (defaults to 15)
 - allwinner,filter-type	 : integer (2 bits)
				   select median and averaging filter
				   samples used for median / averaging filter
				   0: 4/2
				   1: 5/3
				   2: 8/4
				   3: 16/8
				   (defaults to 1)

Example:

	rtp: rtp@01c25000 {
		compatible = "allwinner,sun4i-a10-ts";
		reg = <0x01c25000 0x100>;
		interrupts = <29>;
		allwinner,ts-attached;
		#thermal-sensor-cells = <0>;
		/* sensitive/noisy touch panel */
		allwinner,tp-sensitive-adjust = <0>;
		allwinner,filter-type = <3>;
	};
```

## Documentation/devicetree/bindings/mfd/sun6i-prcm.txt
```
* Allwinner PRCM (Power/Reset/Clock Management) Multi-Functional Device

PRCM is an MFD device exposing several Power Management related devices
(like clks and reset controllers).

Required properties:
 - compatible: "allwinner,sun6i-a31-prcm" or "allwinner,sun8i-a23-prcm"
 - reg: The PRCM registers range

The prcm node may contain several subdevices definitions:
 - see Documentation/devicetree/clk/sunxi.txt for clock devices
 - see Documentation/devicetree/reset/allwinner,sunxi-clock-reset.txt for reset
   controller devices


Example:

	prcm: prcm@1f01400 {
		compatible = "allwinner,sun6i-a31-prcm";
		reg = <0x01f01400 0x200>;

		/* Put subdevices here */
		ar100: ar100_clk {
			compatible = "allwinner,sun6i-a31-ar100-clk";
			#clock-cells = <0>;
			clocks = <&osc32k>, <&osc24M>, <&pll6>, <&pll6>;
		};

		ahb0: ahb0_clk {
			compatible = "fixed-factor-clock";
			#clock-cells = <0>;
			clock-div = <1>;
			clock-mult = <1>;
			clocks = <&ar100_div>;
			clock-output-names = "ahb0";
		};

		apb0: apb0_clk {
			compatible = "allwinner,sun6i-a31-apb0-clk";
			#clock-cells = <0>;
			clocks = <&ahb0>;
			clock-output-names = "apb0";
		};

		apb0_gates: apb0_gates_clk {
			compatible = "allwinner,sun6i-a31-apb0-gates-clk";
			#clock-cells = <1>;
			clocks = <&apb0>;
			clock-output-names = "apb0_pio", "apb0_ir",
					"apb0_timer01", "apb0_p2wi",
					"apb0_uart", "apb0_1wire",
					"apb0_i2c";
		};

		apb0_rst: apb0_rst {
			compatible = "allwinner,sun6i-a31-clock-reset";
			#reset-cells = <1>;
		};
	};
```

## Documentation/devicetree/bindings/mfd/syscon-common.yaml
```yaml
# SPDX-License-Identifier: GPL-2.0
%YAML 1.2
---
$id: http://devicetree.org/schemas/mfd/syscon-common.yaml#
$schema: http://devicetree.org/meta-schemas/core.yaml#

title: System Controller Registers R/W Common Properties

description:
  System controller node represents a register region containing a set
  of miscellaneous registers. The registers are not cohesive enough to
  represent as any specific type of device. The typical use-case is
  for some other node's driver, or platform-specific code, to acquire
  a reference to the syscon node (e.g. by phandle, node path, or
  search using a specific compatible value), interrogate the node (or
  associated OS driver) to determine the location of the registers,
  and access the registers directly.

maintainers:
  - Lee Jones <lee@kernel.org>

select:
  properties:
    compatible:
      contains:
        const: syscon

  required:
    - compatible

properties:
  compatible:
    contains:
      const: syscon
    minItems: 2
    maxItems: 5  # Should be enough

  reg:
    maxItems: 1

  reg-io-width:
    description:
      The size (in bytes) of the IO accesses that should be performed
      on the device.
    enum: [1, 2, 4, 8]

required:
  - compatible
  - reg

allOf:
  - if:
      properties:
        compatible:
          contains:
            const: simple-mfd
    then:
      properties:
        compatible:
          minItems: 3
          maxItems: 5

additionalProperties: true

examples:
  - |
    syscon: syscon@1c00000 {
        compatible = "allwinner,sun8i-h3-system-controller", "syscon";
        reg = <0x01c00000 0x1000>;
    };
...
```

## Documentation/devicetree/bindings/mfd/syscon.txt
```
* System Controller Registers R/W driver

System controller node represents a register region containing a set
of miscellaneous registers. The registers are not cohesive enough to
represent as any specific type of device. The typical use-case is for
some other node's driver, or platform-specific code, to acquire a
reference to the syscon node (e.g. by phandle, node path, or search
using a specific compatible value), interrogate the node (or associated
OS driver) to determine the location of the registers, and access the
registers directly.

Required properties:
- compatible: Should contain "syscon".
- reg: the register region can be accessed from syscon

Optional property:
- reg-io-width: the size (in bytes) of the IO accesses that should be
  performed on the device.
- hwlocks: reference to a phandle of a hardware spinlock provider node.

Examples:
gpr: iomuxc-gpr@20e0000 {
	compatible = "fsl,imx6q-iomuxc-gpr", "syscon";
	reg = <0x020e0000 0x38>;
	hwlocks = <&hwlock1 1>;
};

hwlock1: hwspinlock@40500000 {
	...
	reg = <0x40500000 0x1000>;
	#hwlock-cells = <1>;
};
```

## Documentation/devicetree/bindings/mfd/syscon.yaml
```yaml
# SPDX-License-Identifier: GPL-2.0
%YAML 1.2
---
$id: http://devicetree.org/schemas/mfd/syscon.yaml#
$schema: http://devicetree.org/meta-schemas/core.yaml#

title: System Controller Devices

description: |
  System controller node represents a register region containing a set
  of miscellaneous registers. The registers are not cohesive enough to
  represent as any specific type of device. The typical use-case is
  for some other node's driver, or platform-specific code, to acquire
  a reference to the syscon node (e.g. by phandle, node path, or
  search using a specific compatible value), interrogate the node (or
  associated OS driver) to determine the location of the registers,
  and access the registers directly.

maintainers:
  - Lee Jones <lee@kernel.org>

# Need a select with all compatibles listed for compatibility with older
# dtschema (<2024.02), so this will not be selected for other schemas having
# syscon fallback.
select:
  properties:
    compatible:
      contains:
        enum:
          - al,alpine-sysfabric-servic
          - allwinner,sun8i-a83t-system-controller
          - allwinner,sun8i-h3-system-controller
          - allwinner,sun8i-v3s-system-controller
          - allwinner,sun50i-a64-system-controller
          - altr,l3regs
          - altr,sdr-ctl
          - amd,pensando-elba-syscon
          - amlogic,meson-mx-assist
          - amlogic,meson-mx-bootrom
          - amlogic,meson8-analog-top
          - amlogic,meson8b-analog-top
          - amlogic,meson8-pmu
          - amlogic,meson8b-pmu
          - apm,merlin-poweroff-mailbox
          - apm,mustang-poweroff-mailbox
          - apm,xgene-csw
          - apm,xgene-efuse
          - apm,xgene-mcb
          - apm,xgene-rb
          - apm,xgene-scu
          - atmel,sama5d2-sfrbu
          - atmel,sama5d3-nfc-io
          - atmel,sama5d3-sfrbu
          - atmel,sama5d4-sfrbu
          - axis,artpec6-syscon
          - brcm,cru-clkset
          - brcm,sr-cdru
          - brcm,sr-mhb
          - cirrus,ep7209-syscon1
          - cirrus,ep7209-syscon2
          - cirrus,ep7209-syscon3
          - cnxt,cx92755-uc
          - freecom,fsg-cs2-system-controller
          - fsl,imx93-aonmix-ns-syscfg
          - fsl,imx93-wakeupmix-syscfg
          - fsl,ls1088a-reset
          - fsl,vf610-anatop
          - fsl,vf610-mscm-cpucfg
          - hisilicon,dsa-subctrl
          - hisilicon,hi6220-sramctrl
          - hisilicon,hip04-ppe
          - hisilicon,pcie-sas-subctrl
          - hisilicon,peri-subctrl
          - hpe,gxp-sysreg
          - loongson,ls1b-syscon
          - loongson,ls1c-syscon
          - lsi,axxia-syscon
          - marvell,armada-3700-cpu-misc
          - marvell,armada-3700-nb-pm
          - marvell,armada-3700-avs
          - marvell,armada-3700-usb2-host-misc
          - marvell,dove-global-config
          - mediatek,mt2701-pctl-a-syscfg
          - mediatek,mt2712-pctl-a-syscfg
          - mediatek,mt6397-pctl-pmic-syscfg
          - mediatek,mt8135-pctl-a-syscfg
          - mediatek,mt8135-pctl-b-syscfg
          - mediatek,mt8173-pctl-a-syscfg
          - mediatek,mt8365-syscfg
          - microchip,lan966x-cpu-syscon
          - microchip,mpfs-sysreg-scb
          - microchip,sam9x60-sfr
          - microchip,sama7g5-ddr3phy
          - mscc,ocelot-cpu-syscon
          - mstar,msc313-pmsleep
          - nuvoton,ma35d1-sys
          - nuvoton,wpcm450-shm
          - rockchip,px30-qos
          - rockchip,rk3036-qos
          - rockchip,rk3066-qos
          - rockchip,rk3128-qos
          - rockchip,rk3228-qos
          - rockchip,rk3288-qos
          - rockchip,rk3368-qos
          - rockchip,rk3399-qos
          - rockchip,rk3568-qos
          - rockchip,rk3576-qos
          - rockchip,rk3588-qos
          - rockchip,rv1126-qos
          - st,spear1340-misc
          - stericsson,nomadik-pmu
          - starfive,jh7100-sysmain
          - ti,am62-opp-efuse-table
          - ti,am62-usb-phy-ctrl
          - ti,am625-dss-oldi-io-ctrl
          - ti,am62p-cpsw-mac-efuse
          - ti,am654-dss-oldi-io-ctrl
          - ti,j784s4-acspcie-proxy-ctrl
          - ti,j784s4-pcie-ctrl
          - ti,keystone-pllctrl
  required:
    - compatible

properties:
  compatible:
    items:
      - enum:
          - al,alpine-sysfabric-service
          - allwinner,sun8i-a83t-system-controller
          - allwinner,sun8i-h3-system-controller
          - allwinner,sun8i-v3s-system-controller
          - allwinner,sun50i-a64-system-controller
          - altr,l3regs
          - altr,sdr-ctl
          - amd,pensando-elba-syscon
          - amlogic,meson-mx-assist
          - amlogic,meson-mx-bootrom
          - amlogic,meson8-analog-top
          - amlogic,meson8b-analog-top
          - amlogic,meson8-pmu
          - amlogic,meson8b-pmu
          - apm,merlin-poweroff-mailbox
          - apm,mustang-poweroff-mailbox
          - apm,xgene-csw
          - apm,xgene-efuse
          - apm,xgene-mcb
          - apm,xgene-rb
          - apm,xgene-scu
          - atmel,sama5d2-sfrbu
          - atmel,sama5d3-nfc-io
          - atmel,sama5d3-sfrbu
          - atmel,sama5d4-sfrbu
          - axis,artpec6-syscon
          - brcm,cru-clkset
          - brcm,sr-cdru
          - brcm,sr-mhb
          - cirrus,ep7209-syscon1
          - cirrus,ep7209-syscon2
          - cirrus,ep7209-syscon3
          - cnxt,cx92755-uc
          - freecom,fsg-cs2-system-controller
          - fsl,imx93-aonmix-ns-syscfg
          - fsl,imx93-wakeupmix-syscfg
          - fsl,ls1088a-reset
          - fsl,vf610-anatop
          - fsl,vf610-mscm-cpucfg
          - hisilicon,dsa-subctrl
          - hisilicon,hi6220-sramctrl
          - hisilicon,hip04-ppe
          - hisilicon,pcie-sas-subctrl
          - hisilicon,peri-subctrl
          - hpe,gxp-sysreg
          - loongson,ls1b-syscon
          - loongson,ls1c-syscon
          - lsi,axxia-syscon
          - marvell,armada-3700-cpu-misc
          - marvell,armada-3700-nb-pm
          - marvell,armada-3700-avs
          - marvell,armada-3700-usb2-host-misc
          - marvell,dove-global-config
          - mediatek,mt2701-pctl-a-syscfg
          - mediatek,mt2712-pctl-a-syscfg
          - mediatek,mt6397-pctl-pmic-syscfg
          - mediatek,mt8135-pctl-a-syscfg
          - mediatek,mt8135-pctl-b-syscfg
          - mediatek,mt8173-pctl-a-syscfg
          - mediatek,mt8365-syscfg
          - microchip,lan966x-cpu-syscon
          - microchip,mpfs-sysreg-scb
          - microchip,sam9x60-sfr
          - microchip,sama7g5-ddr3phy
          - mscc,ocelot-cpu-syscon
          - mstar,msc313-pmsleep
          - nuvoton,ma35d1-sys
          - nuvoton,wpcm450-shm
          - rockchip,px30-qos
          - rockchip,rk3036-qos
          - rockchip,rk3066-qos
          - rockchip,rk3128-qos
          - rockchip,rk3228-qos
          - rockchip,rk3288-qos
          - rockchip,rk3368-qos
          - rockchip,rk3399-qos
          - rockchip,rk3568-qos
          - rockchip,rk3576-qos
          - rockchip,rk3588-qos
          - rockchip,rv1126-qos
          - st,spear1340-misc
          - stericsson,nomadik-pmu
          - starfive,jh7100-sysmain
          - ti,am62-opp-efuse-table
          - ti,am62-usb-phy-ctrl
          - ti,am625-dss-oldi-io-ctrl
          - ti,am62p-cpsw-mac-efuse
          - ti,am654-dss-oldi-io-ctrl
          - ti,j784s4-pcie-ctrl
          - ti,keystone-pllctrl
      - const: syscon

  reg:
    maxItems: 1

  resets:
    maxItems: 1

required:
  - compatible
  - reg

allOf:
  - $ref: syscon-common.yaml#

unevaluatedProperties: false

examples:
  - |
    syscon: syscon@1c00000 {
        compatible = "allwinner,sun8i-h3-system-controller", "syscon";
        reg = <0x01c00000 0x1000>;
    };
...
```
