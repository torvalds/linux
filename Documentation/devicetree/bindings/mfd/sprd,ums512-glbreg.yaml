## Documentation/devicetree/bindings/mfd/sprd,ums512-glbreg.yaml
```yaml
# SPDX-License-Identifier: (GPL-2.0-only OR BSD-2-Clause)
# Copyright 2022 Unisoc Inc.
%YAML 1.2
---
$id: http://devicetree.org/schemas/mfd/sprd,ums512-glbreg.yaml#
$schema: http://devicetree.org/meta-schemas/core.yaml#

title: Unisoc System Global Register

maintainers:
  - Orson Zhai <orsonzhai@gmail.com>
  - Baolin Wang <baolin.wang7@gmail.com>
  - Chunyan Zhang <zhang.lyra@gmail.com>

description:
  Unisoc system global registers provide register map
  for clocks and some multimedia modules of the SoC.

properties:
  compatible:
    items:
      - const: sprd,ums512-glbregs
      - const: syscon
      - const: simple-mfd

  "#address-cells":
    const: 1

  "#size-cells":
    const: 1

  ranges:
    maxItems: 1

  reg:
    maxItems: 1

patternProperties:
  "^clock-controller@[0-9a-f]+$":
    type: object
    $ref: /schemas/clock/sprd,ums512-clk.yaml#
    description:
      Clock controller for the SoC clocks.

required:
  - compatible
  - reg

additionalProperties: false

examples:
  - |
    ap_apb_regs: syscon@71000000 {
      compatible = "sprd,ums512-glbregs", "syscon", "simple-mfd";
      reg = <0x71000000 0x3000>;
      #address-cells = <1>;
      #size-cells = <1>;
      ranges = <0 0x71000000 0x3000>;

      clock-controller@0 {
        compatible = "sprd,ums512-apahb-gate";
        reg = <0x0 0x2000>;
        #clock-cells = <1>;
      };
    };

  - |
    ap_intc5_regs: syscon@32360000 {
      compatible = "sprd,ums512-glbregs", "syscon", "simple-mfd";
      reg = <0x32360000 0x1000>;
    };
```

## Documentation/devicetree/bindings/mfd/st,stm32-lptimer.yaml
```yaml
# SPDX-License-Identifier: (GPL-2.0-only OR BSD-2-Clause)
%YAML 1.2
---
$id: http://devicetree.org/schemas/mfd/st,stm32-lptimer.yaml#
$schema: http://devicetree.org/meta-schemas/core.yaml#

title: STMicroelectronics STM32 Low-Power Timers bindings

description: |
  The STM32 Low-Power Timer (LPTIM) is a 16-bit timer that provides several
  functions
   - PWM output (with programmable prescaler, configurable polarity)
   - Trigger source for STM32 ADC/DAC (LPTIM_OUT)
   - Several counter modes:
     - quadrature encoder to detect angular position and direction of rotary
       elements, from IN1 and IN2 input signals.
     - simple counter from IN1 input signal.

maintainers:
  - Fabrice Gasnier <fabrice.gasnier@st.com>

properties:
  compatible:
    const: st,stm32-lptimer

  reg:
    maxItems: 1

  clocks:
    maxItems: 1

  clock-names:
    items:
      - const: mux

  "#address-cells":
    const: 1

  "#size-cells":
    const: 0

  pwm:
    type: object

    properties:
      compatible:
        const: st,stm32-pwm-lp

      "#pwm-cells":
        const: 3

    required:
      - "#pwm-cells"
      - compatible

patternProperties:
  "^trigger@[0-9]+$":
    type: object

    properties:
      compatible:
        const: st,stm32-lptimer-trigger

      reg:
        description: Identify trigger hardware block.
        items:
         minimum: 0
         maximum: 2

    required:
      - compatible
      - reg

  counter:
    type: object

    properties:
      compatible:
        const: st,stm32-lptimer-counter

    required:
      - compatible

required:
  - "#address-cells"
  - "#size-cells"
  - compatible
  - reg
  - clocks
  - clock-names

additionalProperties: false

examples:
  - |
    #include <dt-bindings/clock/stm32mp1-clks.h>
    timer@40002400 {
      compatible = "st,stm32-lptimer";
      reg = <0x40002400 0x400>;
      clocks = <&timer_clk>;
      clock-names = "mux";
      #address-cells = <1>;
      #size-cells = <0>;

      pwm {
        compatible = "st,stm32-pwm-lp";
        #pwm-cells = <3>;
      };

      trigger@0 {
        compatible = "st,stm32-lptimer-trigger";
        reg = <0>;
      };

      counter {
        compatible = "st,stm32-lptimer-counter";
      };
    };

...
```

## Documentation/devicetree/bindings/mfd/st,stm32-timers.yaml
```yaml
# SPDX-License-Identifier: (GPL-2.0-only OR BSD-2-Clause)
%YAML 1.2
---
$id: http://devicetree.org/schemas/mfd/st,stm32-timers.yaml#
$schema: http://devicetree.org/meta-schemas/core.yaml#

title: STMicroelectronics STM32 Timers bindings

description: |
  This hardware block provides 3 types of timer along with PWM functionality:
    - advanced-control timers consist of a 16-bit auto-reload counter driven
      by a programmable prescaler, break input feature, PWM outputs and
      complementary PWM outputs channels.
    - general-purpose timers consist of a 16-bit or 32-bit auto-reload counter
      driven by a programmable prescaler and PWM outputs.
    - basic timers consist of a 16-bit auto-reload counter driven by a
      programmable prescaler.

maintainers:
  - Benjamin Gaignard <benjamin.gaignard@st.com>
  - Fabrice Gasnier <fabrice.gasnier@st.com>

properties:
  compatible:
    const: st,stm32-timers

  reg:
    maxItems: 1

  clocks:
    maxItems: 1

  clock-names:
    items:
      - const: int

  reset:
    maxItems: 1

  dmas:
    minItems: 1
    maxItems: 7

  dma-names:
    items:
      enum: [ ch1, ch2, ch3, ch4, up, trig, com ]
    minItems: 1
    maxItems: 7

  "#address-cells":
    const: 1

  "#size-cells":
    const: 0

  pwm:
    type: object

    properties:
      compatible:
        const: st,stm32-pwm

      "#pwm-cells":
        const: 3

      st,breakinput:
        description:
          One or two <index level filter> to describe break input
          configurations.
        $ref: /schemas/types.yaml#/definitions/uint32-matrix
        items:
          items:
            - description: |
                "index" indicates on which break input (0 or 1) the
                configuration should be applied.
              enum: [0, 1]
            - description: |
                "level" gives the active level (0=low or 1=high) of the
                input signal for this configuration
              enum: [0, 1]
            - description: |
                "filter" gives the filtering value (up to 15) to be applied.
              maximum: 15
        minItems: 1
        maxItems: 2

    required:
      - "#pwm-cells"
      - compatible

patternProperties:
  "^timer@[0-9]+$":
    type: object

    properties:
      compatible:
        enum:
          - st,stm32-timer-trigger
          - st,stm32h7-timer-trigger

      reg:
        description: Identify trigger hardware block.
        items:
          minimum: 0
          maximum: 16

    required:
      - compatible
      - reg

  counter:
    type: object

    properties:
      compatible:
        const: st,stm32-timer-counter

    required:
      - compatible

required:
  - "#address-cells"
  - "#size-cells"
  - compatible
  - reg
  - clocks
  - clock-names

additionalProperties: false

examples:
  - |
    #include <dt-bindings/clock/stm32mp1-clks.h>
    timers2: timer@40000000 {
      #address-cells = <1>;
      #size-cells = <0>;
      compatible = "st,stm32-timers";
      reg = <0x40000000 0x400>;
      clocks = <&rcc TIM2_K>;
      clock-names = "int";
      dmas = <&dmamux1 18 0x400 0x1>,
             <&dmamux1 19 0x400 0x1>,
             <&dmamux1 20 0x400 0x1>,
             <&dmamux1 21 0x400 0x1>,
             <&dmamux1 22 0x400 0x1>;
      dma-names = "ch1", "ch2", "ch3", "ch4", "up";
      pwm {
        compatible = "st,stm32-pwm";
        #pwm-cells = <3>;
        st,breakinput = <0 1 5>;
      };
      timer@1 {
        compatible = "st,stm32-timer-trigger";
        reg = <1>;
      };
      counter {
        compatible = "st,stm32-timer-counter";
      };
    };

...
```

## Documentation/devicetree/bindings/mfd/st,stmfx.yaml
```yaml
# SPDX-License-Identifier: (GPL-2.0-only OR BSD-2-Clause)
%YAML 1.2
---
$id: http://devicetree.org/schemas/mfd/st,stmfx.yaml#
$schema: http://devicetree.org/meta-schemas/core.yaml#

title: STMicroelectonics Multi-Function eXpander (STMFX) bindings

description: ST Multi-Function eXpander (STMFX) is a slave controller using I2C for
               communication with the main MCU. Its main features are GPIO expansion,
               main MCU IDD measurement (IDD is the amount of current that flows
               through VDD) and resistive touchscreen controller.

maintainers:
  - Amelie Delaunay <amelie.delaunay@st.com>

properties:
  compatible:
    const: st,stmfx-0300

  reg:
    enum: [ 0x42, 0x43 ]

  interrupts:
    maxItems: 1

  drive-open-drain: true

  vdd-supply:
    maxItems: 1

  pinctrl:
    type: object

    properties:
      compatible:
        const: st,stmfx-0300-pinctrl

      "#gpio-cells":
        const: 2

      "#interrupt-cells":
        const: 2

      gpio-controller: true

      interrupt-controller: true

      gpio-ranges:
        description: if all STMFX pins[24:0] are available (no other STMFX function in use),
                     you should use gpio-ranges = <&stmfx_pinctrl 0 0 24>;
                     if agpio[3:0] are not available (STMFX Touchscreen function in use),
                     you should use gpio-ranges = <&stmfx_pinctrl 0 0 16>, <&stmfx_pinctrl 20 20 4>;
                     if agpio[7:4] are not available (STMFX IDD function in use),
                     you should use gpio-ranges = <&stmfx_pinctrl 0 0 20>;
        maxItems: 1

    patternProperties:
      "^[a-zA-Z]*-pins$":
        type: object

        allOf:
          - $ref: ../pinctrl/pinmux-node.yaml

        properties:
          pins: true
          bias-disable: true
          bias-pull-up: true
          bias-pull-pin-default: true
          bias-pull-down: true
          drive-open-drain: true
          drive-push-pull: true
          output-high: true
          output-low: true

    additionalProperties: false

    required:
      - compatible
      - "#gpio-cells"
      - "#interrupt-cells"
      - gpio-controller
      - interrupt-controller
      - gpio-ranges

additionalProperties: false

required:
  - compatible
  - reg
  - interrupts

examples:
  - |
    #include <dt-bindings/interrupt-controller/arm-gic.h>
    i2c {
      #address-cells = <1>;
      #size-cells = <0>;
      stmfx@42 {
        compatible = "st,stmfx-0300";
        reg = <0x42>;
        interrupts = <8 IRQ_TYPE_EDGE_RISING>;
        interrupt-parent = <&gpioi>;
        vdd-supply = <&v3v3>;

        stmfx_pinctrl: pinctrl {
          compatible = "st,stmfx-0300-pinctrl";
          #gpio-cells = <2>;
          #interrupt-cells = <2>;
          gpio-controller;
          interrupt-controller;
          gpio-ranges = <&stmfx_pinctrl 0 0 24>;

          joystick_pins: joystick-pins {
            pins = "gpio0", "gpio1", "gpio2", "gpio3", "gpio4";
            drive-push-pull;
            bias-pull-up;
          };
        };
      };
    };
...
```
