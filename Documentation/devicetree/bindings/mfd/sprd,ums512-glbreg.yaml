## Documentation/devicetree/bindings/mfd/stericsson,db8500-prcmu.yaml
```yaml
# SPDX-License-Identifier: (GPL-2.0 OR BSD-2-Clause)
%YAML 1.2
---
$id: http://devicetree.org/schemas/mfd/stericsson,db8500-prcmu.yaml#
$schema: http://devicetree.org/meta-schemas/core.yaml#

title: ST-Ericsson DB8500 PRCMU - Power Reset and Control Management Unit

maintainers:
  - Linus Walleij <linus.walleij@linaro.org>

description:
  The DB8500 Power Reset and Control Management Unit is an XP70 8-bit
  microprocessor that is embedded in the always-on power domain of the
  DB8500 SoCs to manage the low power states, powering up and down parts
  of the silicon, and controlling reset of different IP blocks.

properties:
  $nodename:
    pattern: '^prcmu@[0-9a-f]+$'

  compatible:
    description: The device is compatible both to the device-specific
      compatible "stericsson,db8500-prcmu" and "syscon". The latter
      compatible is needed for the device to be exposed as a system
      controller so that arbitrary registers can be access by
      different operating system components.
    items:
      - const: stericsson,db8500-prcmu
      - const: syscon

  reg:
    items:
      - description: Main PRCMU register area
      - description: PRCMU TCPM register area
      - description: PRCMU TCDM register area

  reg-names:
    items:
      - const: prcmu
      - const: prcmu-tcpm
      - const: prcmu-tcdm

  interrupts:
    maxItems: 1

  '#address-cells':
    const: 1

  '#size-cells':
    const: 1

  ranges: true

  interrupt-controller: true

  '#interrupt-cells':
    const: 2

  db8500-prcmu-regulators:
    description: Node describing the DB8500 regulators. These are mainly
      power rails inside the silicon but some of those are also routed
      out to external pins.
    type: object

    properties:
      compatible:
        const: stericsson,db8500-prcmu-regulator

      db8500_vape:
        description: The voltage for the application processor, the
          main voltage domain for the chip.
        type: object
        $ref: /schemas/regulator/regulator.yaml#
        unevaluatedProperties: false

      db8500_varm:
        description: The voltage for the ARM Cortex-A9 CPU.
        type: object
        $ref: /schemas/regulator/regulator.yaml#
        unevaluatedProperties: false

      db8500_vmodem:
        description: The voltage for the modem subsystem.
        type: object
        $ref: /schemas/regulator/regulator.yaml#
        unevaluatedProperties: false

      db8500_vpll:
        description: The voltage for the phase locked loop clocks.
        type: object
        $ref: /schemas/regulator/regulator.yaml#
        unevaluatedProperties: false

      db8500_vsmps1:
        description: Also known as VIO12, is a step-down voltage regulator
          for 1.2V I/O. SMPS means System Management Power Source.
        type: object
        $ref: /schemas/regulator/regulator.yaml#
        unevaluatedProperties: false

      db8500_vsmps2:
        description: Also known as VIO18, is a step-down voltage regulator
          for 1.8V I/O. SMPS means System Management Power Source.
        type: object
        $ref: /schemas/regulator/regulator.yaml#
        unevaluatedProperties: false

      db8500_vsmps3:
        description: This is a step-down voltage regulator
          for 0.87 thru 1.875V I/O. SMPS means System Management Power Source.
        type: object
        $ref: /schemas/regulator/regulator.yaml#
        unevaluatedProperties: false

      db8500_vrf1:
        description: RF transceiver voltage regulator.
        type: object
        $ref: /schemas/regulator/regulator.yaml#
        unevaluatedProperties: false

      db8500_sva_mmdsp:
        description: Smart Video Accelerator (SVA) multimedia DSP (MMDSP)
          voltage regulator. This is the voltage for the accelerator DSP
          for video encoding and decoding.
        type: object
        $ref: /schemas/regulator/regulator.yaml#
        unevaluatedProperties: false

      db8500_sva_mmdsp_ret:
        description: Smart Video Accelerator (SVA) multimedia DSP (MMDSP)
          voltage regulator for retention mode.
        type: object
        $ref: /schemas/regulator/regulator.yaml#
        unevaluatedProperties: false

      db8500_sva_pipe:
        description: Smart Video Accelerator (SVA) multimedia DSP (MMDSP)
          voltage regulator for the data pipe.
        type: object
        $ref: /schemas/regulator/regulator.yaml#
        unevaluatedProperties: false

      db8500_sia_mmdsp:
        description: Smart Image Accelerator (SIA) multimedia DSP (MMDSP)
          voltage regulator. This is the voltage for the accelerator DSP
          for image encoding and decoding.
        type: object
        $ref: /schemas/regulator/regulator.yaml#
        unevaluatedProperties: false

      db8500_sia_mmdsp_ret:
        description: Smart Image Accelerator (SIA) multimedia DSP (MMDSP)
          voltage regulator for retention mode.
        type: object
        $ref: /schemas/regulator/regulator.yaml#
        unevaluatedProperties: false

      db8500_sia_pipe:
        description: Smart Image Accelerator (SIA) multimedia DSP (MMDSP)
          voltage regulator for the data pipe.
        type: object
        $ref: /schemas/regulator/regulator.yaml#
        unevaluatedProperties: false

      db8500_sga:
        description: Smart Graphics Accelerator (SGA) voltage regulator.
          This is in effect controlling the power to the MALI400 3D
          accelerator block.
        type: object
        $ref: /schemas/regulator/regulator.yaml#
        unevaluatedProperties: false

      db8500_b2r2_mcde:
        description: Blit Blend Rotate and Rescale (B2R2), and Multi-Channel
          Display Engine (MCDE) voltage regulator. These are two graphics
          blocks.
        type: object
        $ref: /schemas/regulator/regulator.yaml#
        unevaluatedProperties: false

      db8500_esram12:
        description: Embedded Static RAM (ESRAM) 1 and 2 voltage regulator.
        type: object
        $ref: /schemas/regulator/regulator.yaml#
        unevaluatedProperties: false

      db8500_esram12_ret:
        description: Embedded Static RAM (ESRAM) 1 and 2 voltage regulator for
          retention mode.
        type: object
        $ref: /schemas/regulator/regulator.yaml#
        unevaluatedProperties: false

      db8500_esram34:
        description: Embedded Static RAM (ESRAM) 3 and 4 voltage regulator.
        type: object
        $ref: /schemas/regulator/regulator.yaml#
        unevaluatedProperties: false

      db8500_esram34_ret:
        description: Embedded Static RAM (ESRAM) 3 and 4 voltage regulator for
          retention mode.
        type: object
        $ref: /schemas/regulator/regulator.yaml#
        unevaluatedProperties: false

    required:
      - compatible
      - db8500_vape
      - db8500_varm
      - db8500_vmodem
      - db8500_vpll
      - db8500_vsmps1
      - db8500_vsmps2
      - db8500_vsmps3
      - db8500_vrf1
      - db8500_sva_mmdsp
      - db8500_sva_mmdsp_ret
      - db8500_sva_pipe
      - db8500_sia_mmdsp
      - db8500_sia_mmdsp_ret
      - db8500_sia_pipe
      - db8500_sga
      - db8500_b2r2_mcde
      - db8500_esram12
      - db8500_esram12_ret
      - db8500_esram34
      - db8500_esram34_ret

    additionalProperties: false

patternProperties:
  "^thermal@[0-9a-f]+$":
    description: Node describing the DB8500 thermal control functions.
      This binds to an operating system driver that monitors the
      temperature of the SoC.
    type: object

    properties:
      compatible:
        const: stericsson,db8500-thermal

      reg:
        maxItems: 1

      interrupts:
        items:
          - description: Hotmon low interrupt (falling temperature)
          - description: Hotmon high interrupt (rising temperature)

      interrupt-names:
        items:
          - const: IRQ_HOTMON_LOW
          - const: IRQ_HOTMON_HIGH

      '#thermal-sensor-cells':
        const: 0

    additionalProperties: false

  "^prcmu-timer-4@[0-9a-f]+$":
    description: Node describing the externally visible timer 4 in the
      PRCMU block. This timer is interesting to the operating system
      since even thought it has a very low resolution (32768 Hz) it is
      always on, and thus provides a consistent monotonic timeline for
      the system.
    type: object

    properties:
      compatible:
        const: stericsson,db8500-prcmu-timer-4

      reg:
        maxItems: 1

    additionalProperties: false

  "^ab850[05]$":
    description: Node describing the Analog Baseband 8500 mixed-signals
      ASIC AB8500 and subcomponents. The AB8500 is accessed through the
      PRCMU and hence it appears here. This component has a separate
      set of devicetree bindings. The AB8505 is a newer version of the
      same ASIC.
    type: object
    $ref: stericsson,ab8500.yaml#

required:
  - compatible
  - reg
  - '#address-cells'
  - '#size-cells'
  - ranges
  - interrupts
  - interrupt-controller
  - '#interrupt-cells'
  - db8500-prcmu-regulators

additionalProperties: false
```

## Documentation/devicetree/bindings/mfd/stm32-lptimer.txt
```
STMicroelectronics STM32 Low-Power Timer

The STM32 Low-Power Timer (LPTIM) is a 16-bit timer that provides several
functions:
- PWM output (with programmable prescaler, configurable polarity)
- Quadrature encoder, counter
- Trigger source for STM32 ADC/DAC (LPTIM_OUT)

Required properties:
- compatible:		Must be "st,stm32-lptimer".
- reg:			Offset and length of the device's register set.
- clocks:		Phandle to the clock used by the LP Timer module.
- clock-names:		Must be "mux".
- #address-cells:	Should be '<1>'.
- #size-cells:		Should be '<0>'.

Optional subnodes:
- pwm:			See ../pwm/pwm-stm32-lp.txt
- counter:		See ../counter/stm32-lptimer-cnt.txt
- trigger:		See ../iio/timer/stm32-lptimer-trigger.txt

Example:

	timer@40002400 {
		compatible = "st,stm32-lptimer";
		reg = <0x40002400 0x400>;
		clocks = <&timer_clk>;
		clock-names = "mux";
		#address-cells = <1>;
		#size-cells = <0>;

		pwm {
			compatible = "st,stm32-pwm-lp";
			pinctrl-names = "default";
			pinctrl-0 = <&lppwm1_pins>;
		};

		trigger@0 {
			compatible = "st,stm32-lptimer-trigger";
			reg = <0>;
		};

		counter {
			compatible = "st,stm32-lptimer-counter";
			pinctrl-names = "default";
			pinctrl-0 = <&lptim1_in_pins>;
		};
	};
```

## Documentation/devicetree/bindings/mfd/stm32-timers.txt
```
STM32 Timers driver bindings

This IP provides 3 types of timer along with PWM functionality:
- advanced-control timers consist of a 16-bit auto-reload counter driven by a programmable
  prescaler, break input feature, PWM outputs and complementary PWM ouputs channels.
- general-purpose timers consist of a 16-bit or 32-bit auto-reload counter driven by a
  programmable prescaler and PWM outputs.
- basic timers consist of a 16-bit auto-reload counter driven by a programmable prescaler.

Required parameters:
- compatible: must be "st,stm32-timers"

- reg:			Physical base address and length of the controller's
			registers.
- clock-names:		Set to "int".
- clocks: 		Phandle to the clock used by the timer module.
			For Clk properties, please refer to ../clock/clock-bindings.txt

Optional parameters:
- resets:		Phandle to the parent reset controller.
			See ../reset/st,stm32-rcc.txt
- dmas:			List of phandle to dma channels that can be used for
			this timer instance. There may be up to 7 dma channels.
- dma-names:		List of dma names. Must match 'dmas' property. Valid
			names are: "ch1", "ch2", "ch3", "ch4", "up", "trig",
			"com".

Optional subnodes:
- pwm:			See ../pwm/pwm-stm32.txt
- timer:		See ../iio/timer/stm32-timer-trigger.txt
- counter:		See ../counter/stm32-timer-cnt.txt

Example:
	timers@40010000 {
		#address-cells = <1>;
		#size-cells = <0>;
		compatible = "st,stm32-timers";
		reg = <0x40010000 0x400>;
		clocks = <&rcc 0 160>;
		clock-names = "int";

		pwm {
			compatible = "st,stm32-pwm";
			pinctrl-0	= <&pwm1_pins>;
			pinctrl-names	= "default";
		};

		timer@0 {
			compatible = "st,stm32-timer-trigger";
			reg = <0>;
		};

		counter {
			compatible = "st,stm32-timer-counter";
			pinctrl-names = "default";
			pinctrl-0 = <&tim1_in_pins>;
		};
	};

Example with all dmas:
	timer@40010000 {
		...
		dmas = <&dmamux1 11 0x400 0x0>,
		       <&dmamux1 12 0x400 0x0>,
		       <&dmamux1 13 0x400 0x0>,
		       <&dmamux1 14 0x400 0x0>,
		       <&dmamux1 15 0x400 0x0>,
		       <&dmamux1 16 0x400 0x0>,
		       <&dmamux1 17 0x400 0x0>;
		dma-names = "ch1", "ch2", "ch3", "ch4", "up", "trig", "com";
		...
		child nodes...
	};
```

## Documentation/devicetree/bindings/mfd/stmfx.txt
```
STMicroelectonics Multi-Function eXpander (STMFX) Core bindings

ST Multi-Function eXpander (STMFX) is a slave controller using I2C for
communication with the main MCU. Its main features are GPIO expansion, main
MCU IDD measurement (IDD is the amount of current that flows through VDD) and
resistive touchscreen controller.

Required properties:
- compatible: should be "st,stmfx-0300".
- reg: I2C slave address of the device.
- interrupts: interrupt specifier triggered by MFX_IRQ_OUT signal.
  Please refer to ../interrupt-controller/interrupt.txt

Optional properties:
- drive-open-drain: configure MFX_IRQ_OUT as open drain.
- vdd-supply: phandle of the regulator supplying STMFX.

Example:

	stmfx: stmfx@42 {
		compatible = "st,stmfx-0300";
		reg = <0x42>;
		interrupts = <8 IRQ_TYPE_EDGE_RISING>;
		interrupt-parent = <&gpioi>;
		vdd-supply = <&v3v3>;
	};

Please refer to ../pinctrl/pinctrl-stmfx.txt for STMFX GPIO expander function bindings.
```

## Documentation/devicetree/bindings/mfd/stmpe.txt
```
* ST Microelectronics STMPE Multi-Functional Device

STMPE is an MFD device which may expose the following inbuilt devices: gpio,
keypad, touchscreen, adc, pwm, rotator.

Required properties:
 - compatible			: "st,stmpe[610|801|811|1600|1601|2401|2403]"
 - reg				: I2C/SPI address of the device

Optional properties:
 - interrupts			: The interrupt outputs from the controller
 - interrupt-controller		: Marks the device node as an interrupt controller
 - wakeup-source		: Marks the input device as wakable
 - st,autosleep-timeout		: Valid entries (ms); 4, 16, 32, 64, 128, 256, 512 and 1024
 - irq-gpio			: If present, which GPIO to use for event IRQ

Optional properties for devices with touch and ADC (STMPE811|STMPE610):
 - st,sample-time		: ADC conversion time in number of clock.
					0 -> 36 clocks		4 -> 80 clocks (recommended)
					1 -> 44 clocks		5 -> 96 clocks
					2 -> 56 clocks		6 -> 124 clocks
					3 -> 64 clocks
 - st,mod-12b			: ADC Bit mode
					0 -> 10bit ADC		1 -> 12bit ADC
 - st,ref-sel			: ADC reference source
					0 -> internal		1 -> external
 - st,adc-freq			: ADC Clock speed
					0 -> 1.625 MHz		2 || 3 -> 6.5 MHz
					1 -> 3.25 MHz

Example:

	stmpe1601: stmpe1601@40 {
		compatible = "st,stmpe1601";
		reg = <0x40>;
		interrupts = <26 0x4>;
		interrupt-parent = <&gpio6>;
		interrupt-controller;

		wakeup-source;
		st,autosleep-timeout = <1024>;
	};
```
