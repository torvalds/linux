## Documentation/devicetree/bindings/mfd/tc3589x.txt
```
* Toshiba TC3589x multi-purpose expander

The Toshiba TC3589x series are I2C-based MFD devices which may expose the
following built-in devices: gpio, keypad, rotator (vibrator), PWM (for
e.g. LEDs or vibrators) The included models are:

- TC35890
- TC35892
- TC35893
- TC35894
- TC35895
- TC35896

Required properties:
 - compatible : must be "toshiba,tc35890", "toshiba,tc35892", "toshiba,tc35893",
   "toshiba,tc35894", "toshiba,tc35895" or "toshiba,tc35896"
 - reg : I2C address of the device
 - interrupts : the interrupt on the parent the controller is connected to
 - interrupt-controller : marks the device node as an interrupt controller
 - #interrupt-cells : should be <1>, the first cell is the IRQ offset on this
   TC3589x interrupt controller.

Optional nodes:

- GPIO
  This GPIO module inside the TC3589x has 24 (TC35890, TC35892) or 20
  (other models) GPIO lines.
 - compatible : must be "toshiba,tc3589x-gpio"
 - interrupts : interrupt on the parent, which must be the tc3589x MFD device
 - interrupt-controller : marks the device node as an interrupt controller
 - #interrupt-cells : should be <2>, the first cell is the IRQ offset on this
   TC3589x GPIO interrupt controller, the second cell is the interrupt flags
   in accordance with <dt-bindings/interrupt-controller/irq.h>. The following
   flags are valid:
   - IRQ_TYPE_LEVEL_LOW
   - IRQ_TYPE_LEVEL_HIGH
   - IRQ_TYPE_EDGE_RISING
   - IRQ_TYPE_EDGE_FALLING
   - IRQ_TYPE_EDGE_BOTH
 - gpio-controller : marks the device node as a GPIO controller
 - #gpio-cells : should be <2>, the first cell is the GPIO offset on this
   GPIO controller, the second cell is the flags.

- Keypad
  This keypad is the same on all variants, supporting up to 96 different
  keys. The linux-specific properties are modeled on those already existing
  in other input drivers.
 - compatible : must be "toshiba,tc3589x-keypad"
 - debounce-delay-ms : debounce interval in milliseconds
 - keypad,num-rows : number of rows in the matrix, see
   bindings/input/matrix-keymap.txt
 - keypad,num-columns : number of columns in the matrix, see
   bindings/input/matrix-keymap.txt
 - linux,keymap: the definition can be found in
   bindings/input/matrix-keymap.txt
 - linux,no-autorepeat: do no enable autorepeat feature.
 - wakeup-source: use any event on keypad as wakeup event.
		  (Legacy property supported: "linux,wakeup")

Example:

tc35893@44 {
	compatible = "toshiba,tc35893";
	reg = <0x44>;
	interrupt-parent = <&gpio6>;
	interrupts = <26 IRQ_TYPE_EDGE_RISING>;

	interrupt-controller;
	#interrupt-cells = <1>;

	tc3589x_gpio {
		compatible = "toshiba,tc3589x-gpio";
		interrupts = <0>;

		interrupt-controller;
		#interrupt-cells = <2>;
		gpio-controller;
		#gpio-cells = <2>;
	};
	tc3589x_keypad {
		compatible = "toshiba,tc3589x-keypad";
		interrupts = <6>;
		debounce-delay-ms = <4>;
		keypad,num-columns = <8>;
		keypad,num-rows = <8>;
		linux,no-autorepeat;
		linux,keymap = <0x0301006b
				0x04010066
				0x06040072
				0x040200d7
				0x0303006a
				0x0205000e
				0x0607008b
				0x0500001c
				0x0403000b
				0x03040034
				0x05020067
				0x0305006c
				0x040500e7
				0x0005009e
				0x06020073
				0x01030039
				0x07060069
				0x050500d9>;
		wakeup-source;
	};
};
```

## Documentation/devicetree/bindings/mfd/ti,am3359-tscadc.yaml
```yaml
# SPDX-License-Identifier: (GPL-2.0-only OR BSD-2-Clause)
%YAML 1.2
---
$id: http://devicetree.org/schemas/mfd/ti,am3359-tscadc.yaml#
$schema: http://devicetree.org/meta-schemas/core.yaml#

title: TI AM3359 Touchscreen controller/ADC

maintainers:
  - Miquel Raynal <miquel.raynal@bootlin.com>

properties:
  compatible:
    oneOf:
      - const: ti,am3359-tscadc
      - items:
          - const: ti,am654-tscadc
          - const: ti,am3359-tscadc
      - const: ti,am4372-magadc

  reg:
    maxItems: 1

  interrupts:
    maxItems: 1

  clocks:
    maxItems: 1

  clock-names:
    const: fck

  dmas:
    items:
      - description: DMA controller phandle and request line for FIFO0
      - description: DMA controller phandle and request line for FIFO1

  dma-names:
    items:
      - const: fifo0
      - const: fifo1

  adc:
    type: object
    description: ADC child

  tsc:
    type: object
    description: Touchscreen controller child

  mag:
    type: object
    description: Magnetic reader

required:
  - compatible
  - reg
  - interrupts
  - clocks
  - clock-names
  - dmas
  - dma-names

additionalProperties: false

examples:
  - |
    #include <dt-bindings/interrupt-controller/arm-gic.h>

    tscadc@0 {
        compatible = "ti,am3359-tscadc";
        reg = <0x0 0x1000>;
        interrupts = <GIC_SPI 16 IRQ_TYPE_LEVEL_HIGH>;
        clocks = <&adc_tsc_fck>;
        clock-names = "fck";
        dmas = <&edma 53 0>, <&edma 57 0>;
        dma-names = "fifo0", "fifo1";

        tsc {
        };

        adc {
        };
    };
```

## Documentation/devicetree/bindings/mfd/ti,bq25703a.yaml
```yaml
# SPDX-License-Identifier: (GPL-2.0-only OR BSD-2-Clause)
%YAML 1.2
---
$id: http://devicetree.org/schemas/mfd/ti,bq25703a.yaml#
$schema: http://devicetree.org/meta-schemas/core.yaml#

title: BQ257xx Charger Manager/Buck/Boost Converter

maintainers:
  - Chris Morgan <macromorgan@hotmail.com>

properties:
  compatible:
    enum:
      - ti,bq25703a
      - ti,bq25792

  reg:
    const: 0x6b

  input-current-limit-microamp:
    description:
      Maximum total input current allowed used for both charging and
      powering the device.
    minimum: 50000
    maximum: 6400000

  interrupts:
    maxItems: 1

  monitored-battery:
    description:
      A minimum of constant-charge-current-max-microamp,
      constant-charge-voltage-max-microvolt, and
      voltage-min-design-microvolt are required.

  regulators:
    type: object
    additionalProperties: false
    description:
      Boost converter regulator output of bq257xx.

    properties:
      vbus:
        type: object
        $ref: /schemas/regulator/regulator.yaml
        additionalProperties: false

        properties:
          regulator-name: true
          regulator-min-microamp:
            minimum: 0
            maximum: 6350000
          regulator-max-microamp:
            minimum: 0
            maximum: 6350000
          regulator-min-microvolt:
            minimum: 2800000
            maximum: 22000000
          regulator-max-microvolt:
            minimum: 2800000
            maximum: 22000000
          enable-gpios:
            description:
              The BQ25703 may require both a register write and a GPIO
              toggle to enable the boost regulator.

        required:
          - regulator-name
          - regulator-min-microamp
          - regulator-max-microamp
          - regulator-min-microvolt
          - regulator-max-microvolt

allOf:
  - $ref: /schemas/power/supply/power-supply.yaml#
  - if:
      properties:
        compatible:
          const: ti,bq25703a
    then:
      properties:
        input-current-limit-microamp:
          minimum: 50000
          maximum: 6400000
          default: 3250000
        regulators:
          properties:
            vbus:
              properties:
                regulator-min-microamp:
                  minimum: 0
                  maximum: 6350000
                regulator-max-microamp:
                  minimum: 0
                  maximum: 6350000
                regulator-min-microvolt:
                  minimum: 4480000
                  maximum: 20800000
                regulator-max-microvolt:
                  minimum: 4480000
                  maximum: 20800000
  - if:
      properties:
        compatible:
          const: ti,bq25792
    then:
      properties:
        input-current-limit-microamp:
          minimum: 100000
          maximum: 3300000
          default: 3000000
        regulators:
          properties:
            vbus:
              properties:
                regulator-min-microamp:
                  minimum: 0
                  maximum: 3320000
                regulator-max-microamp:
                  minimum: 0
                  maximum: 3320000
                regulator-min-microvolt:
                  minimum: 2800000
                  maximum: 22000000
                regulator-max-microvolt:
                  minimum: 2800000
                  maximum: 22000000

unevaluatedProperties: false

required:
  - compatible
  - reg
  - input-current-limit-microamp
  - monitored-battery
  - power-supplies

examples:
  - |
    #include <dt-bindings/gpio/gpio.h>
    #include <dt-bindings/interrupt-controller/irq.h>
    #include <dt-bindings/pinctrl/rockchip.h>
    i2c {
        #address-cells = <1>;
        #size-cells = <0>;

        bq25703: charger@6b {
            compatible = "ti,bq25703a";
            reg = <0x6b>;
            input-current-limit-microamp = <5000000>;
            interrupt-parent = <&gpio0>;
            interrupts = <RK_PD5 IRQ_TYPE_LEVEL_LOW>;
            monitored-battery = <&battery>;
            power-supplies = <&fusb302>;

            regulators {
                usb_otg_vbus: vbus {
                    enable-gpios = <&gpio4 RK_PA6 GPIO_ACTIVE_HIGH>;
                    regulator-max-microamp = <960000>;
                    regulator-max-microvolt = <5088000>;
                    regulator-min-microamp = <512000>;
                    regulator-min-microvolt = <4992000>;
                    regulator-name = "usb_otg_vbus";
                };
            };
        };
    };

...
```

## Documentation/devicetree/bindings/mfd/ti,j721e-system-controller.yaml
```yaml
# SPDX-License-Identifier: (GPL-2.0-only OR BSD-2-Clause)
# Copyright (C) 2020 Texas Instruments Incorporated - http://www.ti.com/
%YAML 1.2
---
$id: http://devicetree.org/schemas/mfd/ti,j721e-system-controller.yaml#
$schema: http://devicetree.org/meta-schemas/core.yaml#

title: TI J721e System Controller Registers R/W Device Tree Bindings

description: |
  This represents the Control Module registers (CTRL_MMR0) on the SoC.
  System controller node represents a register region containing a set
  of miscellaneous registers. The registers are not cohesive enough to
  represent as any specific type of device. The typical use-case is
  for some other node's driver, or platform-specific code, to acquire
  a reference to the syscon node (e.g. by phandle, node path, or
  search using a specific compatible value), interrogate the node (or
  associated OS driver) to determine the location of the registers,
  and access the registers directly.

maintainers:
  - Kishon Vijay Abraham I <kishon@ti.com>
  - Roger Quadros <rogerq@kernel.org>

properties:
  compatible:
    items:
      - enum:
          - ti,j721e-system-controller
      - const: syscon
      - const: simple-mfd

  reg:
    maxItems: 1

  "#address-cells":
    const: 1

  "#size-cells":
    const: 1

  ranges: true

patternProperties:
  # Optional children
  "^mux-controller@[0-9a-f]+$":
    type: object
    description:
      This is the SERDES lane control mux.

  "^clock-controller@[0-9a-f]+$":
    type: object
    $ref: /schemas/clock/ti,am654-ehrpwm-tbclk.yaml#
    description:
      Clock provider for TI EHRPWM nodes.

required:
  - compatible
  - reg
  - "#address-cells"
  - "#size-cells"
  - ranges

additionalProperties: false

examples:
  - |
    scm_conf: scm-conf@100000 {
        compatible = "ti,j721e-system-controller", "syscon", "simple-mfd";
        reg = <0x00100000 0x1c000>;
        #address-cells = <1>;
        #size-cells = <1>;
        ranges;

        serdes_ln_ctrl: mux-controller@4080 {
            compatible = "mmio-mux";
            reg = <0x00004080 0x50>;

            #mux-control-cells = <1>;
            mux-reg-masks =
                <0x4080 0x3>, <0x4084 0x3>, /* SERDES0 lane0/1 select */
                <0x4090 0x3>, <0x4094 0x3>, /* SERDES1 lane0/1 select */
                <0x40a0 0x3>, <0x40a4 0x3>, /* SERDES2 lane0/1 select */
                <0x40b0 0x3>, <0x40b4 0x3>, /* SERDES3 lane0/1 select */
                <0x40c0 0x3>, <0x40c4 0x3>, <0x40c8 0x3>, <0x40cc 0x3>;
                /* SERDES4 lane0/1/2/3 select */
        };

        clock-controller@4140 {
            compatible = "ti,am654-ehrpwm-tbclk", "syscon";
            reg = <0x4140 0x18>;
            #clock-cells = <1>;
        };
    };
...
```

## Documentation/devicetree/bindings/mfd/ti,lp8732.yaml
```yaml
# SPDX-License-Identifier: GPL-2.0 OR BSD-2-Clause
%YAML 1.2
---
$id: http://devicetree.org/schemas/mfd/ti,lp8732.yaml#
$schema: http://devicetree.org/meta-schemas/core.yaml#

title: TI LP873X Power Management Integrated Circuit

maintainers:
  - J Keerthy <j-keerthy@ti.com>

description:
  PMIC with two high-current buck converters and two linear regulators.

properties:
  compatible:
    enum:
      - ti,lp8732
      - ti,lp8733

  reg:
    maxItems: 1

  gpio-controller: true

  '#gpio-cells':
    const: 2

  regulators:
    description:
      List of child nodes that specify the regulator initialization data.
    type: object
    patternProperties:
      "^buck[01]|ldo[01]$":
        type: object
        $ref: /schemas/regulator/regulator.yaml#
        unevaluatedProperties: false
    additionalProperties: false

patternProperties:
  '^(buck[01]|ldo[01])-in-supply$':
    description: Phandle to parent supply of each regulator populated under regulators node.

required:
  - compatible
  - reg
  - regulators
  - buck0-in-supply
  - buck1-in-supply
  - ldo0-in-supply
  - ldo1-in-supply

additionalProperties: false

examples:
  - |
    i2c {
        #address-cells = <1>;
        #size-cells = <0>;

        pmic: pmic@60 {
            compatible = "ti,lp8733";
            reg = <0x60>;
            gpio-controller;
            #gpio-cells = <2>;

            buck0-in-supply = <&vsys_3v3>;
            buck1-in-supply = <&vsys_3v3>;
            ldo0-in-supply = <&vsys_3v3>;
            ldo1-in-supply = <&vsys_3v3>;

            regulators {
                buck0: buck0 {
                    regulator-name = "buck0";
                    regulator-min-microvolt = <800000>;
                    regulator-max-microvolt = <1400000>;
                    regulator-min-microamp = <1500000>;
                    regulator-max-microamp = <4000000>;
                    regulator-ramp-delay = <10000>;
                    regulator-always-on;
                    regulator-boot-on;
                };

                buck1: buck1 {
                    regulator-name = "buck1";
                    regulator-min-microvolt = <800000>;
                    regulator-max-microvolt = <1400000>;
                    regulator-min-microamp = <1500000>;
                    regulator-max-microamp = <4000000>;
                    regulator-ramp-delay = <10000>;
                    regulator-boot-on;
                    regulator-always-on;
                };

                ldo0: ldo0 {
                    regulator-name = "ldo0";
                    regulator-min-microvolt = <800000>;
                    regulator-max-microvolt = <3000000>;
                    regulator-boot-on;
                    regulator-always-on;
                };

                ldo1: ldo1 {
                    regulator-name = "ldo1";
                    regulator-min-microvolt = <800000>;
                    regulator-max-microvolt = <3000000>;
                    regulator-always-on;
                    regulator-boot-on;
                };
            };
        };
    };
```
