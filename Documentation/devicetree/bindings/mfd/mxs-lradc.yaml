## Documentation/devicetree/bindings/mfd/realtek,rtd1xxx.yaml
```yaml
# SPDX-License-Identifier: GPL-2.0-only OR BSD-2-Clause
%YAML 1.2
---
$id: http://devicetree.org/schemas/mfd/realtek,rtd1xxx.yaml#
$schema: http://devicetree.org/meta-schemas/core.yaml#

title: Realtek RTD1xxx system controllers

maintainers:
  - Andreas Färber <afaerber@suse.de>

properties:
  compatible:
    items:
      - enum:
          - realtek,rtd1293-crt
          - realtek,rtd1293-iso
          - realtek,rtd1293-misc
          - realtek,rtd1293-sb2
          - realtek,rtd1293-scpu-wrapper
          - realtek,rtd1295-crt
          - realtek,rtd1295-iso
          - realtek,rtd1295-misc
          - realtek,rtd1295-sb2
          - realtek,rtd1295-scpu-wrapper
          - realtek,rtd1296-crt
          - realtek,rtd1296-iso
          - realtek,rtd1296-misc
          - realtek,rtd1296-sb2
          - realtek,rtd1296-scpu-wrapper
          - realtek,rtd1395-crt
          - realtek,rtd1395-iso
          - realtek,rtd1395-misc
          - realtek,rtd1395-sb2
          - realtek,rtd1395-scpu-wrapper
          - realtek,rtd1619-crt
          - realtek,rtd1619-iso
          - realtek,rtd1619-misc
          - realtek,rtd1619-sb2
          - realtek,rtd1619-scpu-wrapper
      - const: syscon
      - const: simple-mfd

  reg:
    maxItems: 1

  reg-io-width:
    const: 4

  ranges: true

  '#address-cells':
    const: 1

  '#size-cells':
    const: 1

patternProperties:
  '@[0-9a-f]+$':
    type: object

    required:
      - compatible

required:
  - compatible
  - reg

additionalProperties: false
```

## Documentation/devicetree/bindings/mfd/renesas,r2a11302ft.yaml
```yaml
# SPDX-License-Identifier: (GPL-2.0 OR BSD-2-Clause)
%YAML 1.2
---
$id: http://devicetree.org/schemas/mfd/renesas,r2a11302ft.yaml#
$schema: http://devicetree.org/meta-schemas/core.yaml#

title: Renesas R2A11302FT Power Supply ICs for R-Car

maintainers:
  - Wolfram Sang <wsa+renesas@sang-engineering.com>

description: |
  The Renesas R2A11302FT PMIC is used with Renesas R-Car Gen1/Gen2
  based SoCs.

  FIXME: The binding is incomplete and resembles the information gathered
  so far.

properties:
  compatible:
    const: renesas,r2a11302ft

  reg:
    maxItems: 1

  spi-max-frequency:
    maximum: 6000000

  spi-cpol: true

  spi-cpha: true

required:
  - compatible
  - reg
  - spi-cpol
  - spi-cpha

allOf:
  - $ref: /schemas/spi/spi-peripheral-props.yaml#

unevaluatedProperties: false

examples:
  - |
    spi {
        #address-cells = <1>;
        #size-cells = <0>;

        pmic@0 {
            compatible = "renesas,r2a11302ft";
            reg = <0>;
            spi-max-frequency = <6000000>;
            spi-cpol;
            spi-cpha;
        };
    };
...
```

## Documentation/devicetree/bindings/mfd/retu.txt
```
* Device tree bindings for Analkia Retu and Tahvo multi-function device

Retu and Tahvo are a multi-function devices found on Analkia Internet
Tablets (770, N800 and N810). The Retu chip provides watchdog timer
and power button control functionalities while Tahvo chip provides
USB transceiver functionality.

Required properties:
- compatible:		"analkia,retu" or "analkia,tahvo"
- reg:			Specifies the CBUS slave address of the ASIC chip
- interrupts: 		The interrupt line the device is connected to

Example:

cbus0 {
	compatible = "i2c-cbus-gpio";
	...
	retu: retu@1 {
		compatible = "analkia,retu";
		interrupt-parent = <&gpio4>;
		interrupts = <12 IRQ_TYPE_EDGE_RISING>;
		reg = <0x1>;
	};
};
```

## Documentation/devicetree/bindings/mfd/richtek,rt4831.yaml
```yaml
# SPDX-License-Identifier: (GPL-2.0-only OR BSD-2-Clause)
%YAML 1.2
---
$id: http://devicetree.org/schemas/mfd/richtek,rt4831.yaml#
$schema: http://devicetree.org/meta-schemas/core.yaml#

title: Richtek RT4831 DSV and Backlight Integrated IC

maintainers:
  - ChiYuan Huang <cy_huang@richtek.com>

description: |
  RT4831 is a multifunctional device that can provide power to the LCD display
  and LCD backlight.

  For Display Bias Voltage DSVP and DSVN, the output range is about 4V to 6.5V.
  It's sufficient to meet the current LCD power requirement.

  For the LCD backlight, it can provide four channel WLED driving capability.
  Each channel driving current is up to 30mA

  Datasheet is available at
  https://www.richtek.com/assets/product_file/RT4831A/DS4831A-05.pdf

properties:
  compatible:
    const: richtek,rt4831

  reg:
    description: I2C device address.
    maxItems: 1

  enable-gpios:
    description: |
      GPIO to enable/disable the chip. It is optional.
      Some usage directly tied this pin to follow VIO 1.8V power on sequence.
    maxItems: 1

  regulators:
    $ref: ../regulator/richtek,rt4831-regulator.yaml

  backlight:
    $ref: ../leds/backlight/richtek,rt4831-backlight.yaml

required:
  - compatible
  - reg

additionalProperties: false

examples:
  - |
    #include <dt-bindings/leds/rt4831-backlight.h>
    i2c {
      #address-cells = <1>;
      #size-cells = <0>;

      rt4831@11 {
        compatible = "richtek,rt4831";
        reg = <0x11>;

        regulators {
          DSVLCM {
            regulator-min-microvolt = <4000000>;
            regulator-max-microvolt = <7150000>;
            regulator-allow-bypass;
          };
          DSVP {
            regulator-name = "rt4831-dsvp";
            regulator-min-microvolt = <4000000>;
            regulator-max-microvolt = <6500000>;
            regulator-boot-on;
          };
          DSVN {
            regulator-name = "rt4831-dsvn";
            regulator-min-microvolt = <4000000>;
            regulator-max-microvolt = <6500000>;
            regulator-boot-on;
          };
        };

        backlight {
          compatible = "richtek,rt4831-backlight";
          default-brightness = <1024>;
          max-brightness = <2048>;
          richtek,bled-ovp-sel = /bits/ 8 <RT4831_BLOVPLVL_21V>;
          richtek,channel-use = /bits/ 8 <RT4831_BLED_ALLCHEN>;
        };
      };
    };
```
