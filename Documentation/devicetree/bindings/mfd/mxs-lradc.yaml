## Documentation/devicetree/bindings/mfd/nxp,pf1550.yaml
```yaml
# SPDX-License-Identifier: GPL-2.0-only OR BSD-2-Clause
%YAML 1.2
---
$id: http://devicetree.org/schemas/mfd/nxp,pf1550.yaml#
$schema: http://devicetree.org/meta-schemas/core.yaml#

title: NXP PF1550 Power Management IC

maintainers:
  - Samuel Kayode <samuel.kayode@savoirfairelinux.com>

description:
  PF1550 PMIC provides battery charging and power supply for low power IoT and
  wearable applications. This device consists of an i2c controlled MFD that
  includes regulators, battery charging and an onkey/power button.

$ref: /schemas/power/supply/power-supply.yaml

properties:
  compatible:
    const: nxp,pf1550

  reg:
    maxItems: 1

  interrupts:
    maxItems: 1

  wakeup-source: true

  regulators:
    type: object
    additionalProperties: false

    patternProperties:
      "^(ldo[1-3]|sw[1-3]|vrefddr)$":
        type: object
        $ref: /schemas/regulator/regulator.yaml
        description:
          regulator configuration for ldo1-3, buck converters(sw1-3)
          and DDR termination reference voltage (vrefddr)
        unevaluatedProperties: false

  monitored-battery:
    description: |
      A phandle to a monitored battery node that contains a valid value
      for:
      constant-charge-voltage-max-microvolt.

  nxp,thermal-regulation-celsius:
    description:
      Temperature threshold for thermal regulation of charger in celsius.
    enum: [ 80, 95, 110, 125 ]

  nxp,min-system-microvolt:
    description:
      System specific lower limit voltage.
    enum: [ 3500000, 3700000, 4300000 ]

  nxp,disable-key-power:
    type: boolean
    description:
      Disable power-down using a long key-press. The onkey driver will remove
      support for the KEY_POWER key press when triggered using a long press of
      the onkey.

required:
  - compatible
  - reg
  - interrupts

unevaluatedProperties: false

examples:
  - |
    #include <dt-bindings/interrupt-controller/irq.h>
    #include <dt-bindings/input/linux-event-codes.h>

    battery: battery-cell {
        compatible = "simple-battery";
        constant-charge-voltage-max-microvolt = <4400000>;
    };

    i2c {
        #address-cells = <1>;
        #size-cells = <0>;

        pmic@8 {
            compatible = "nxp,pf1550";
            reg = <0x8>;

            interrupt-parent = <&gpio1>;
            interrupts = <2 IRQ_TYPE_LEVEL_LOW>;
            wakeup-source;
            monitored-battery = <&battery>;
            nxp,min-system-microvolt = <4300000>;
            nxp,thermal-regulation-celsius = <80>;

            regulators {
                sw1_reg: sw1 {
                    regulator-name = "sw1";
                    regulator-min-microvolt = <600000>;
                    regulator-max-microvolt = <1387500>;
                    regulator-always-on;
                    regulator-ramp-delay = <6250>;

                    regulator-state-mem {
                        regulator-on-in-suspend;
                        regulator-suspend-min-microvolt = <1270000>;
                    };
                };

                sw2_reg: sw2 {
                    regulator-name = "sw2";
                    regulator-min-microvolt = <600000>;
                    regulator-max-microvolt = <1387500>;
                    regulator-always-on;

                    regulator-state-mem {
                        regulator-on-in-suspend;
                    };
                };

                sw3_reg: sw3 {
                    regulator-name = "sw3";
                    regulator-min-microvolt = <1800000>;
                    regulator-max-microvolt = <3300000>;
                    regulator-always-on;

                    regulator-state-mem {
                        regulator-on-in-suspend;
                    };
                };

                vldo1_reg: ldo1 {
                    regulator-name = "ldo1";
                    regulator-min-microvolt = <750000>;
                    regulator-max-microvolt = <3300000>;
                    regulator-always-on;

                    regulator-state-mem {
                        regulator-off-in-suspend;
                    };
                };

                vldo2_reg: ldo2 {
                    regulator-name = "ldo2";
                    regulator-min-microvolt = <1800000>;
                    regulator-max-microvolt = <3300000>;
                    regulator-always-on;
                };

                vldo3_reg: ldo3 {
                    regulator-name = "ldo3";
                    regulator-min-microvolt = <750000>;
                    regulator-max-microvolt = <3300000>;
                    regulator-always-on;
                };
            };
        };
    };
```

## Documentation/devicetree/bindings/mfd/omap-usb-host.txt
```
OMAP HS USB Host

Required properties:

- compatible: should be "ti,usbhs-host"
- reg: should contain one register range i.e. start and length
- ti,hwmods: must contain "usb_host_hs"

Optional properties:

- num-ports: number of USB ports. Usually this is automatically detected
  from the IP's revision register but can be overridden by specifying
  this property. A maximum of 3 ports are supported at the moment.

- portN-mode: String specifying the port mode for port N, where N can be
  from 1 to 3. If the port mode is not specified, that port is treated
  as unused. When specified, it must be one of the following.
	"ehci-phy",
        "ehci-tll",
        "ehci-hsic",
        "ohci-phy-6pin-datse0",
        "ohci-phy-6pin-dpdm",
        "ohci-phy-3pin-datse0",
        "ohci-phy-4pin-dpdm",
        "ohci-tll-6pin-datse0",
        "ohci-tll-6pin-dpdm",
        "ohci-tll-3pin-datse0",
        "ohci-tll-4pin-dpdm",
        "ohci-tll-2pin-datse0",
        "ohci-tll-2pin-dpdm",

- single-ulpi-bypass: Must be present if the controller contains a single
  ULPI bypass control bit. e.g. OMAP3 silicon <= ES2.1

- clocks: a list of phandles and clock-specifier pairs, one for each entry in
  clock-names.

- clock-names: should include:
  For OMAP3
  * "usbhost_120m_fck" - 120MHz Functional clock.

  For OMAP4+
  * "refclk_60m_int" - 60MHz internal reference clock for UTMI clock mux
  * "refclk_60m_ext_p1" - 60MHz external ref. clock for Port 1's UTMI clock mux.
  * "refclk_60m_ext_p2" - 60MHz external ref. clock for Port 2's UTMI clock mux
  * "utmi_p1_gfclk" - Port 1 UTMI clock mux.
  * "utmi_p2_gfclk" - Port 2 UTMI clock mux.
  * "usb_host_hs_utmi_p1_clk" - Port 1 UTMI clock gate.
  * "usb_host_hs_utmi_p2_clk" - Port 2 UTMI clock gate.
  * "usb_host_hs_utmi_p3_clk" - Port 3 UTMI clock gate.
  * "usb_host_hs_hsic480m_p1_clk" - Port 1 480MHz HSIC clock gate.
  * "usb_host_hs_hsic480m_p2_clk" - Port 2 480MHz HSIC clock gate.
  * "usb_host_hs_hsic480m_p3_clk" - Port 3 480MHz HSIC clock gate.
  * "usb_host_hs_hsic60m_p1_clk" - Port 1 60MHz HSIC clock gate.
  * "usb_host_hs_hsic60m_p2_clk" - Port 2 60MHz HSIC clock gate.
  * "usb_host_hs_hsic60m_p3_clk" - Port 3 60MHz HSIC clock gate.

Required properties if child node exists:

- #address-cells: Must be 1
- #size-cells: Must be 1
- ranges: must be present

Properties for children:

The OMAP HS USB Host subsystem contains EHCI and OHCI controllers.
See Documentation/devicetree/bindings/usb/generic-ehci.yaml and
Documentation/devicetree/bindings/usb/generic-ohci.yaml.

Example for OMAP4:

usbhshost: usbhshost@4a064000 {
	compatible = "ti,usbhs-host";
	reg = <0x4a064000 0x800>;
	ti,hwmods = "usb_host_hs";
	#address-cells = <1>;
	#size-cells = <1>;
	ranges;

	usbhsohci: ohci@4a064800 {
		compatible = "ti,ohci-omap3";
		reg = <0x4a064800 0x400>;
		interrupt-parent = <&gic>;
		interrupts = <0 76 0x4>;
	};

	usbhsehci: ehci@4a064c00 {
		compatible = "ti,ehci-omap";
		reg = <0x4a064c00 0x400>;
		interrupt-parent = <&gic>;
		interrupts = <0 77 0x4>;
	};
};

&usbhshost {
	port1-mode = "ehci-phy";
	port2-mode = "ehci-tll";
	port3-mode = "ehci-phy";
};

&usbhsehci {
	phys = <&hsusb1_phy 0 &hsusb3_phy>;
};
```

## Documentation/devicetree/bindings/mfd/omap-usb-tll.txt
```
OMAP HS USB Host TLL (Transceiver-Less Interface)

Required properties:

- compatible : should be "ti,usbhs-tll"
- reg : should contain one register range i.e. start and length
- interrupts : should contain the TLL module's interrupt
- ti,hwmod : must contain "usb_tll_hs"

Optional properties:

- clocks: a list of phandles and clock-specifier pairs, one for each entry in
  clock-names.

- clock-names: should include:
  * "usb_tll_hs_usb_ch0_clk" - USB TLL channel 0 clock
  * "usb_tll_hs_usb_ch1_clk" - USB TLL channel 1 clock
  * "usb_tll_hs_usb_ch2_clk" - USB TLL channel 2 clock

Example:

	usbhstll: usbhstll@4a062000 {
		compatible = "ti,usbhs-tll";
		reg = <0x4a062000 0x1000>;
		interrupts = <78>;
		ti,hwmods = "usb_tll_hs";
	  };
```

## Documentation/devicetree/bindings/mfd/palmas.txt
```
* palmas device tree bindings

The TI palmas family current members :-
twl6035 (palmas)
twl6037 (palmas)
tps65913 (palmas)
tps65914 (palmas)
tps659038
tps65917

Required properties:
- compatible : Should be from the list
  ti,twl6035
  ti,twl6036
  ti,twl6037
  ti,tps65913
  ti,tps65914
  ti,tps80036
  ti,tps659038
  ti,tps65917
and also the generic series names
  ti,palmas
- interrupt-controller : palmas has its own internal IRQs
- #interrupt-cells : should be set to 2 for IRQ number and flags
  The first cell is the IRQ number.
  The second cell is the flags, encoded as the trigger masks from
  Documentation/devicetree/bindings/interrupt-controller/interrupts.txt
- interrupt-parent : The parent interrupt controller.

Optional properties:
  ti,mux-padX : set the pad register X (1-2) to the correct muxing for the
		hardware, if not set will use muxing in OTP.

Example:

palmas {
	compatible = "ti,twl6035", "ti,palmas";
	reg = <0x48>
	interrupt-parent = <&intc>;
	interrupt-controller;
	#interrupt-cells = <2>;

	ti,mux-pad1 = <0>;
	ti,mux-pad2 = <0>;

	#address-cells = <1>;
	#size-cells = <0>;

	pmic {
		compatible = "ti,twl6035-pmic", "ti,palmas-pmic";
		....
	};
}
```

## Documentation/devicetree/bindings/mfd/qcom,pm8008.yaml
```yaml
# SPDX-License-Identifier: GPL-2.0-only OR BSD-2-Clause
%YAML 1.2
---
$id: http://devicetree.org/schemas/mfd/qcom,pm8008.yaml#
$schema: http://devicetree.org/meta-schemas/core.yaml#

title: Qualcomm Technologies, Inc. PM8008 PMIC

maintainers:
  - Guru Das Srinagesh <quic_gurus@quicinc.com>

description: |
  Qualcomm Technologies, Inc. PM8008 is a dedicated camera PMIC that integrates
  all the necessary power management, housekeeping, and interface support
  functions into a single IC.

properties:
  compatible:
    const: qcom,pm8008

  reg:
    maxItems: 1

  interrupts:
    maxItems: 1

  reset-gpios:
    maxItems: 1

  vdd-l1-l2-supply: true
  vdd-l3-l4-supply: true
  vdd-l5-supply: true
  vdd-l6-supply: true
  vdd-l7-supply: true

  gpio-controller: true

  "#gpio-cells":
    const: 2

  gpio-ranges:
    maxItems: 1

  interrupt-controller: true

  "#interrupt-cells":
    const: 2

  "#thermal-sensor-cells":
    const: 0

  pinctrl:
    type: object
    additionalProperties: false
    patternProperties:
      "-state$":
        type: object

        allOf:
          - $ref: /schemas/pinctrl/pinmux-node.yaml
          - $ref: /schemas/pinctrl/pincfg-node.yaml

        properties:
          pins:
            items:
              pattern: "^gpio[12]$"

          function:
            items:
              - enum:
                  - normal

        required:
          - pins
          - function

        additionalProperties: false

  regulators:
    type: object
    additionalProperties: false
    patternProperties:
      "^ldo[1-7]$":
        type: object
        $ref: /schemas/regulator/regulator.yaml#
        unevaluatedProperties: false

required:
  - compatible
  - reg
  - interrupts
  - vdd-l1-l2-supply
  - vdd-l3-l4-supply
  - vdd-l5-supply
  - vdd-l6-supply
  - vdd-l7-supply
  - gpio-controller
  - "#gpio-cells"
  - gpio-ranges
  - interrupt-controller
  - "#interrupt-cells"
  - "#thermal-sensor-cells"

additionalProperties: false

examples:
  - |
    #include <dt-bindings/gpio/gpio.h>
    #include <dt-bindings/interrupt-controller/irq.h>

    i2c {
      #address-cells = <1>;
      #size-cells = <0>;

      pm8008: pmic@8 {
        compatible = "qcom,pm8008";
        reg = <0x8>;

        interrupt-parent = <&tlmm>;
        interrupts = <32 IRQ_TYPE_EDGE_RISING>;

        reset-gpios = <&tlmm 42 GPIO_ACTIVE_LOW>;

        vdd-l1-l2-supply = <&vreg_s8b_1p2>;
        vdd-l3-l4-supply = <&vreg_s1b_1p8>;
        vdd-l5-supply = <&vreg_bob>;
        vdd-l6-supply = <&vreg_bob>;
        vdd-l7-supply = <&vreg_bob>;

        gpio-controller;
        #gpio-cells = <2>;
        gpio-ranges = <&pm8008 0 0 2>;

        interrupt-controller;
        #interrupt-cells = <2>;

        #thermal-sensor-cells = <0>;

        pinctrl {
          gpio-keys-state {
            pins = "gpio1";
            function = "normal";
          };
        };

        regulators {
          ldo1 {
            regulator-name = "vreg_l1";
            regulator-min-microvolt = <950000>;
            regulator-max-microvolt = <1300000>;
          };
        };
      };
    };

...
```

## Documentation/devicetree/bindings/mfd/qcom,pm8xxx.txt
```
Qualcomm PM8xxx PMIC multi-function devices

PROPERTIES

- compatible:
	Usage: required
	Value type: <string>
	Definition: must be one of:
		    "qcom,pm8058"
		    "qcom,pm8921"

- #address-cells:
	Usage: required
	Value type: <u32>
	Definition: must be 1

- #size-cells:
	Usage: required
	Value type: <u32>
	Definition: must be 0

- interrupts:
	Usage: required
	Value type: <prop-encoded-array>
	Definition: specifies the interrupt that indicates a subdevice
		    has generated an interrupt (summary interrupt). The
		    format of the specifier is defined by the binding document
		    describing the node's interrupt parent.

- #interrupt-cells:
	Usage: required
	Value type : <u32>
	Definition: must be 2. Specifies the number of cells needed to encode
		    an interrupt source. The 1st cell contains the interrupt
		    number. The 2nd cell is the trigger type and level flags
		    encoded as follows:

			1 = low-to-high edge triggered
			2 = high-to-low edge triggered
			4 = active high level-sensitive
			8 = active low level-sensitive

- interrupt-controller:
	Usage: required
	Value type: <empty>
	Definition: identifies this node as an interrupt controller

EXAMPLE

	pmicintc: pmic@0 {
		compatible = "qcom,pm8921";
		interrupts = <104 8>;
		#interrupt-cells = <2>;
		interrupt-controller;
		#address-cells = <1>;
		#size-cells = <0>;

		pwrkey {
			compatible = "qcom,pm8921-pwrkey";
			interrupt-parent = <&pmicintc>;
			interrupts = <50 1>, <51 1>;
		};
	};
```
