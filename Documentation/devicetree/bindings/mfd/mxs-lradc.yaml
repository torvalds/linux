## Documentation/devicetree/bindings/mfd/mxs-lradc.yaml
```yaml
# SPDX-License-Identifier: (GPL-2.0-only OR BSD-2-Clause)
%YAML 1.2
---
$id: http://devicetree.org/schemas/mfd/mxs-lradc.yaml#
$schema: http://devicetree.org/meta-schemas/core.yaml#

title: Freescale MXS Low-Resolution ADC (LRADC)

maintainers:
  - Dario Binacchi <dario.binacchi@amarulasolutions.com>

description:
  The LRADC provides 16 physical channels of 12-bit resolution for
  analog-to-digital conversion and includes an integrated 4-wire/5-wire
  touchscreen controller.

properties:
  compatible:
    items:
      - enum:
          - fsl,imx23-lradc
          - fsl,imx28-lradc

  reg:
    maxItems: 1

  clocks:
    minItems: 1

  interrupts:
    minItems: 9
    maxItems: 13

  fsl,lradc-touchscreen-wires:
    $ref: /schemas/types.yaml#/definitions/uint32
    enum: [4, 5]
    description: >
      Number of wires used to connect the touchscreen to LRADC.

      If this property is not present, then the touchscreen is disabled.

  fsl,ave-ctrl:
    $ref: /schemas/types.yaml#/definitions/uint32
    minimum: 1
    maximum: 32
    default: 4
    description:
      Number of samples per direction to calculate an average value.

  fsl,ave-delay:
    $ref: /schemas/types.yaml#/definitions/uint32
    minimum: 2
    maximum: 2048
    default: 2
    description: >
      Delay between consecutive samples.

      It is used if 'fsl,ave-ctrl' > 1, counts at 2 kHz and its default value (2)
      is 1 ms.

  fsl,settling:
    $ref: /schemas/types.yaml#/definitions/uint32
    minimum: 1
    maximum: 2047
    default: 10
    description: >
      Delay between plate switch to next sample.

      It counts at 2 kHz and its default (10) is 5 ms.

  "#io-channel-cells":
    const: 1

required:
  - compatible
  - reg
  - clocks
  - interrupts

if:
  properties:
    compatible:
      contains:
        enum:
          - fsl,imx23-lradc
then:
  properties:
    interrupts:
      items:
        - description: channel 0
        - description: channel 1
        - description: channel 2
        - description: channel 3
        - description: channel 4
        - description: channel 5
        - description: touchscreen
        - description: channel 6
        - description: channel 7
    fsl,lradc-touchscreen-wires:
      const: 4
else:
  properties:
    interrupts:
      items:
        - description: threshold 0
        - description: threshold 1
        - description: channel 0
        - description: channel 1
        - description: channel 2
        - description: channel 3
        - description: channel 4
        - description: channel 5
        - description: button 0
        - description: button 1
        - description: touchscreen
        - description: channel 6
        - description: channel 7

additionalProperties: false

examples:
  - |
    lradc@80050000 {
        compatible = "fsl,imx23-lradc";
        reg = <0x80050000 0x2000>;
        interrupts = <36>, <37>, <38>, <39>, <40>,
                     <41>, <42>, <43>, <44>;
        clocks = <&clks 26>;
        #io-channel-cells = <1>;
        fsl,lradc-touchscreen-wires = <4>;
        fsl,ave-ctrl = <4>;
        fsl,ave-delay = <2>;
        fsl,settling = <10>;
    };
```

## Documentation/devicetree/bindings/mfd/netronix,ntxec.yaml
```yaml
# SPDX-License-Identifier: (GPL-2.0-only OR BSD-2-Clause)
%YAML 1.2
---
$id: http://devicetree.org/schemas/mfd/netronix,ntxec.yaml#
$schema: http://devicetree.org/meta-schemas/core.yaml#

title: Netronix Embedded Controller

maintainers:
  - Jonathan Neuschäfer <j.neuschaefer@gmx.net>

description: |
  This EC is found in e-book readers of multiple brands (e.g. Kobo, Tolino), and
  is typically implemented as a TI MSP430 microcontroller.

properties:
  compatible:
    const: netronix,ntxec

  reg:
    items:
      - description: The I2C address of the EC

  system-power-controller:
    type: boolean
    description: See Documentation/devicetree/bindings/power/power-controller.txt

  interrupts:
    minItems: 1
    description:
      The EC can signal interrupts via a GPIO line

  "#pwm-cells":
    const: 2
    description: |
      Number of cells in a PWM specifier.

      The following PWM channels are supported:
        - 0: The PWM channel controlled by registers 0xa1-0xa7

required:
  - compatible
  - reg

additionalProperties: false

examples:
  - |
    #include <dt-bindings/interrupt-controller/irq.h>
    i2c {
            #address-cells = <1>;
            #size-cells = <0>;

            ec: embedded-controller@43 {
                    pinctrl-names = "default";
                    pinctrl-0 = <&pinctrl_ntxec>;

                    compatible = "netronix,ntxec";
                    reg = <0x43>;
                    system-power-controller;
                    interrupt-parent = <&gpio4>;
                    interrupts = <11 IRQ_TYPE_EDGE_FALLING>;
                    #pwm-cells = <2>;
            };
    };

    backlight {
            compatible = "pwm-backlight";
            pwms = <&ec 0 50000>;
            power-supply = <&backlight_regulator>;
    };

    backlight_regulator: regulator-dummy {
            compatible = "regulator-fixed";
            regulator-name = "backlight";
    };
```

## Documentation/devicetree/bindings/mfd/nxp,bbnsm.yaml
```yaml
# SPDX-License-Identifier: (GPL-2.0-only OR BSD-2-Clause)
%YAML 1.2
---
$id: http://devicetree.org/schemas/mfd/nxp,bbnsm.yaml#
$schema: http://devicetree.org/meta-schemas/core.yaml#

title: NXP Battery-Backed Non-Secure Module

maintainers:
  - Jacky Bai <ping.bai@nxp.com>

description: |
  NXP BBNSM serves as non-volatile logic and storage for the system.
  it Intergrates RTC & ON/OFF control.
  The RTC can retain its state and continues counting even when the
  main chip is power down. A time alarm is generated once the most
  significant 32 bits of the real-time counter match the value in the
  Time Alarm register.
  The ON/OFF logic inside the BBNSM allows for connecting directly to
  a PMIC or other voltage regulator device. both smart PMIC mode and
  Dumb PMIC mode supported.

properties:
  compatible:
    items:
      - enum:
          - nxp,imx93-bbnsm
      - const: syscon
      - const: simple-mfd

  reg:
    maxItems: 1

  rtc:
    type: object
    $ref: /schemas/rtc/rtc.yaml#

    properties:
      compatible:
        enum:
          - nxp,imx93-bbnsm-rtc

      interrupts:
        maxItems: 1

      start-year: true

    required:
      - compatible
      - interrupts

    additionalProperties: false

  pwrkey:
    type: object
    $ref: /schemas/input/input.yaml#

    properties:
      compatible:
        enum:
          - nxp,imx93-bbnsm-pwrkey

      interrupts:
        maxItems: 1

      linux,code: true

    required:
      - compatible
      - interrupts

    additionalProperties: false

required:
  - compatible
  - reg
  - rtc
  - pwrkey

additionalProperties: false

examples:
  - |
    #include <dt-bindings/input/linux-event-codes.h>
    #include <dt-bindings/interrupt-controller/arm-gic.h>

    bbnsm: bbnsm@44440000 {
        compatible = "nxp,imx93-bbnsm", "syscon", "simple-mfd";
        reg = <0x44440000 0x10000>;

        bbnsm_rtc: rtc {
            compatible = "nxp,imx93-bbnsm-rtc";
            interrupts = <GIC_SPI 73 IRQ_TYPE_LEVEL_HIGH>;
        };

        bbnsm_pwrkey: pwrkey {
            compatible = "nxp,imx93-bbnsm-pwrkey";
            interrupts = <GIC_SPI 73 IRQ_TYPE_LEVEL_HIGH>;
            linux,code = <KEY_POWER>;
        };
    };
```

## Documentation/devicetree/bindings/mfd/nxp,lpc1850-creg.yaml
```yaml
# SPDX-License-Identifier: (GPL-2.0-only OR BSD-2-Clause)
%YAML 1.2
---
$id: http://devicetree.org/schemas/mfd/nxp,lpc1850-creg.yaml#
$schema: http://devicetree.org/meta-schemas/core.yaml#

title: The NXP LPC18xx/43xx CREG (Configuration Registers) block

maintainers:
  - Frank Li <Frank.Li@nxp.com>

properties:
  compatible:
    items:
      - enum:
          - nxp,lpc1850-creg
      - const: syscon
      - const: simple-mfd

  reg:
    maxItems: 1

  clocks:
    maxItems: 1

  resets:
    maxItems: 1

  clock-controller:
    type: object
    description:
      The NXP LPC18xx/43xx CREG (Configuration Registers) block contains
      control registers for two low speed clocks. One of the clocks is a
      32 kHz oscillator driver with power up/down and clock gating. Next
      is a fixed divider that creates a 1 kHz clock from the 32 kHz osc.

      These clocks are used by the RTC and the Event Router peripherals.
      The 32 kHz can also be routed to other peripherals to enable low
      power modes.

    properties:
      compatible:
        const: nxp,lpc1850-creg-clk

      clocks:
        maxItems: 1

      '#clock-cells':
        const: 1
        description: |
          0            1 kHz clock
          1           32 kHz Oscillator

    required:
      - compatible
      - clocks
      - '#clock-cells'

    additionalProperties: false

  phy:
    type: object
    description: the internal USB OTG PHY in NXP LPC18xx and LPC43xx SoCs
    properties:
      compatible:
        const: nxp,lpc1850-usb-otg-phy

      clocks:
        maxItems: 1

      '#phy-cells':
        const: 0

    required:
      - compatible
      - clocks
      - '#phy-cells'

    additionalProperties: false

  dma-mux:
    type: object
    description: NXP LPC18xx/43xx DMA MUX (DMA request router)
    properties:
      compatible:
        const: nxp,lpc1850-dmamux

      '#dma-cells':
        const: 3
        description: |
          Should be set to <3>.
          * 1st cell contain the master dma request signal
          * 2nd cell contain the mux value (0-3) for the peripheral
          * 3rd cell contain either 1 or 2 depending on the AHB  master used.

      dma-requests:
        $ref: /schemas/types.yaml#/definitions/uint32
        maximum: 64
        description: Number of DMA requests the controller can handle

      dma-masters:
        $ref: /schemas/types.yaml#/definitions/phandle
        description: phandle pointing to the DMA controller

    required:
      - compatible
      - '#dma-cells'
      - dma-masters

    additionalProperties: false

required:
  - compatible
  - reg
  - clocks
  - resets

additionalProperties: false

examples:
  - |
    #include <dt-bindings/clock/lpc18xx-ccu.h>

    syscon@40043000 {
        compatible = "nxp,lpc1850-creg", "syscon", "simple-mfd";
        reg = <0x40043000 0x1000>;
        clocks = <&ccu1 CLK_CPU_CREG>;
        resets = <&rgu 5>;

        clock-controller {
            compatible = "nxp,lpc1850-creg-clk";
            clocks = <&xtal32>;
            #clock-cells = <1>;
        };

        phy {
            compatible = "nxp,lpc1850-usb-otg-phy";
            clocks = <&ccu1 CLK_USB0>;
            #phy-cells = <0>;
        };

        dma-mux {
            compatible = "nxp,lpc1850-dmamux";
            #dma-cells = <3>;
            dma-requests = <64>;
            dma-masters = <&dmac>;
        };
    };
```

## Documentation/devicetree/bindings/mfd/nxp,lpc3220-scb.yaml
```yaml
# SPDX-License-Identifier: (GPL-2.0-only OR BSD-2-Clause)
%YAML 1.2
---
$id: http://devicetree.org/schemas/mfd/nxp,lpc3220-scb.yaml#
$schema: http://devicetree.org/meta-schemas/core.yaml#

title: NXP LPC32xx System Control Block

maintainers:
  - Vladimir Zapolskiy <vz@mleia.com>

description:
  NXP LPC32xx SoC series have a System Control Block, which serves for
  a multitude of purposes including clock management, DMA muxes, storing
  SoC unique ID etc.

properties:
  compatible:
    items:
      - enum:
          - nxp,lpc3220-scb
      - const: syscon
      - const: simple-mfd

  reg:
    maxItems: 1

  ranges: true

  "#address-cells":
    const: 1

  "#size-cells":
    const: 1

patternProperties:
  "^clock-controller@[0-9a-f]+$":
    $ref: /schemas/clock/nxp,lpc3220-clk.yaml#

  "^dma-router@[0-9a-f]+$":
    $ref: /schemas/dma/nxp,lpc3220-dmamux.yaml#

required:
  - compatible
  - reg
  - "#address-cells"
  - "#size-cells"

additionalProperties: false

examples:
  - |
    syscon@400040000 {
        compatible = "nxp,lpc3220-scb", "syscon", "simple-mfd";
        reg = <0x40004000 0x1000>;
        #address-cells = <1>;
        #size-cells = <1>;
        ranges = <0 0x40004000 0x1000>;

        clock-controller@0 {
            compatible = "nxp,lpc3220-clk";
            reg = <0x0 0x114>;
            clocks = <&xtal_32k>, <&xtal>;
            clock-names = "xtal_32k", "xtal";
            #clock-cells = <1>;
        };

        dma-router@78 {
            compatible = "nxp,lpc3220-dmamux";
            reg = <0x78 0x8>;
            dma-masters = <&dma>;
            #dma-cells = <3>;
        };
    };
```
