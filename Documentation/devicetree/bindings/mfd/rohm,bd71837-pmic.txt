## Documentation/devicetree/bindings/mfd/s2mpa01.txt
```
* Samsung S2MPA01 Voltage and Current Regulator

The Samsung S2MPA01 is a multi-function device which includes high
efficiency buck converters including Dual-Phase buck converter, various LDOs,
and an RTC. It is interfaced to the host controller using an I2C interface.
Each sub-block is addressed by the host system using different I2C slave
addresses.

Required properties:
- compatible: Should be "samsung,s2mpa01-pmic".
- reg: Specifies the I2C slave address of the PMIC block. It should be 0x66.

Optional properties:
- interrupt-parent: Specifies the phandle of the interrupt controller to which
  the interrupts from s2mpa01 are delivered to.
- interrupts: An interrupt specifier for the sole interrupt generated by the
  device.

Optional nodes:
- regulators: The regulators of s2mpa01 that have to be instantiated should be
  included in a sub-node named 'regulators'. Regulator nodes and constraints
  included in this sub-node use the standard regulator bindings which are
  documented elsewhere.

Properties for BUCK regulator nodes:
- regulator-ramp-delay: ramp delay in uV/us. May be 6250, 12500
  (default), 25000, or 50000. May be 0 for disabling the ramp delay on
  BUCK{1,2,3,4}.

 In the absence of the regulator-ramp-delay property, the default ramp
 delay will be used.

  NOTE: Some BUCKs share the ramp rate setting i.e. same ramp value will be set
  for a particular group of BUCKs. So provide same regulator-ramp-delay=<value>.

  The following BUCKs share ramp settings:
  * 1 and 6
  * 2 and 4
  * 8, 9, and 10

The following are the names of the regulators that the s2mpa01 PMIC block
supports. Note: The 'n' in LDOn and BUCKn represents the LDO or BUCK number
as per the datasheet of s2mpa01.

	- LDOn
		  - valid values for n are 1 to 26
		  - Example: LDO1, LD02, LDO26
	- BUCKn
		  - valid values for n are 1 to 10.
		  - Example: BUCK1, BUCK2, BUCK9

Example:

	s2mpa01_pmic@66 {
		compatible = "samsung,s2mpa01-pmic";
		reg = <0x66>;

		regulators {
			ldo1_reg: LDO1 {
				regulator-name = "VDD_ALIVE";
				regulator-min-microvolt = <1000000>;
				regulator-max-microvolt = <1000000>;
			};

			ldo2_reg: LDO2 {
				regulator-name = "VDDQ_MMC2";
				regulator-min-microvolt = <2800000>;
				regulator-max-microvolt = <2800000>;
				regulator-always-on;
			};

			buck1_reg: BUCK1 {
				regulator-name = "vdd_mif";
				regulator-min-microvolt = <950000>;
				regulator-max-microvolt = <1350000>;
				regulator-always-on;
				regulator-boot-on;
			};

			buck2_reg: BUCK2 {
				regulator-name = "vdd_arm";
				regulator-min-microvolt = <950000>;
				regulator-max-microvolt = <1350000>;
				regulator-always-on;
				regulator-boot-on;
				regulator-ramp-delay = <50000>;
			};
		};
	};
```

## Documentation/devicetree/bindings/mfd/s2mps11.txt
```
* Samsung S2MPS11/13/14/15 and S2MPU02 Voltage and Current Regulator

The Samsung S2MPS11 is a multi-function device which includes voltage and
current regulators, RTC, charger controller and other sub-blocks. It is
interfaced to the host controller using an I2C interface. Each sub-block is
addressed by the host system using different I2C slave addresses.

Required properties:
- compatible: Should be one of the following
	- "samsung,s2mps11-pmic"
	- "samsung,s2mps13-pmic"
	- "samsung,s2mps14-pmic"
	- "samsung,s2mps15-pmic"
	- "samsung,s2mpu02-pmic".
- reg: Specifies the I2C slave address of the pmic block. It should be 0x66.

Optional properties:
- interrupt-parent: Specifies the phandle of the interrupt controller to which
  the interrupts from s2mps11 are delivered to.
- interrupts: Interrupt specifiers for interrupt sources.
- samsung,s2mps11-wrstbi-ground: Indicates that WRSTBI pin of PMIC is pulled
  down. When the system is suspended it will always go down thus triggerring
  unwanted buck warm reset (setting buck voltages to default values).
- samsung,s2mps11-acokb-ground: Indicates that ACOKB pin of S2MPS11 PMIC is
  connected to the ground so the PMIC must manually set PWRHOLD bit in CTRL1
  register to turn off the power. Usually the ACOKB is pulled up to VBATT so
  when PWRHOLD pin goes low, the rising ACOKB will trigger power off.

Optional nodes:
- clocks: s2mps11, s2mps13, s2mps15 and s5m8767 provide three(AP/CP/BT) buffered 32.768
  KHz outputs, so to register these as clocks with common clock framework
  instantiate a sub-node named "clocks". It uses the common clock binding
  documented in :
  [Documentation/devicetree/bindings/clock/clock-bindings.txt]
  The s2mps14 provides two (AP/BT) buffered 32.768 KHz outputs.
  - #clock-cells: should be 1.

  - The following is the list of clocks generated by the controller. Each clock
    is assigned an identifier and client nodes use this identifier to specify
    the clock which they consume.
    Clock               ID           Devices
    ----------------------------------------------------------
    32KhzAP		0            S2MPS11, S2MPS13, S2MPS14, S2MPS15, S5M8767
    32KhzCP		1            S2MPS11, S2MPS13, S2MPS15, S5M8767
    32KhzBT		2            S2MPS11, S2MPS13, S2MPS14, S2MPS15, S5M8767

  - compatible: Should be one of: "samsung,s2mps11-clk", "samsung,s2mps13-clk",
		"samsung,s2mps14-clk", "samsung,s5m8767-clk"
    The s2msp15 uses the same compatible as s2mps13, as both provides similar clocks.

- regulators: The regulators of s2mps11 that have to be instantiated should be
included in a sub-node named 'regulators'. Regulator nodes included in this
sub-node should be of the format as listed below.

	regulator_name {
		[standard regulator constraints....];
	};

 regulator-ramp-delay for BUCKs = [6250/12500/25000(default)/50000] uV/us

 BUCK[2/3/4/6] supports disabling ramp delay on hardware, so explicitly
 regulator-ramp-delay = <0> can be used for them to disable ramp delay.
 In the absence of the regulator-ramp-delay property, the default ramp
 delay will be used.

NOTE: Some BUCKs share the ramp rate setting i.e. same ramp value will be set
for a particular group of BUCKs. So provide same regulator-ramp-delay<value>.
Grouping of BUCKs sharing ramp rate setting is as follow : BUCK[1, 6],
BUCK[3, 4], and BUCK[7, 8, 10]

On S2MPS14 the LDO10, LDO11 and LDO12 can be configured to external control
over GPIO. To turn this feature on this property must be added to the regulator
sub-node:
	- samsung,ext-control-gpios: GPIO specifier for one GPIO
		controlling this regulator (enable/disable);
Example:
	LDO12 {
		regulator-name = "V_EMMC_2.8V";
		regulator-min-microvolt = <2800000>;
		regulator-max-microvolt = <2800000>;
		samsung,ext-control-gpios = <&gpk0 2 0>;
	};


The regulator constraints inside the regulator nodes use the standard regulator
bindings which are documented elsewhere.

The following are the names of the regulators that the s2mps11 pmic block
supports. Note: The 'n' in LDOn and BUCKn represents the LDO or BUCK number
as per the datasheet of s2mps11.

	- LDOn
		  - valid values for n are:
			- S2MPS11: 1 to 38
			- S2MPS13: 1 to 40
			- S2MPS14: 1 to 25
			- S2MPS15: 1 to 27
			- S2MPU02: 1 to 28
		  - Example: LDO1, LDO2, LDO28
	- BUCKn
		  - valid values for n are:
			- S2MPS11: 1 to 10
			- S2MPS13: 1 to 10
			- S2MPS14: 1 to 5
			- S2MPS15: 1 to 10
			- S2MPU02: 1 to 7
		  - Example: BUCK1, BUCK2, BUCK9

Example:

	s2mps11_pmic@66 {
		compatible = "samsung,s2mps11-pmic";
		reg = <0x66>;

		s2m_osc: clocks {
			compatible = "samsung,s2mps11-clk";
			#clock-cells = <1>;
			clock-output-names = "xx", "yy", "zz";
		};

		regulators {
			ldo1_reg: LDO1 {
				regulator-name = "VDD_ABB_3.3V";
				regulator-min-microvolt = <3300000>;
				regulator-max-microvolt = <3300000>;
			};

			ldo2_reg: LDO2 {
				regulator-name = "VDD_ALIVE_1.1V";
				regulator-min-microvolt = <1100000>;
				regulator-max-microvolt = <1100000>;
				regulator-always-on;
			};

			buck1_reg: BUCK1 {
				regulator-name = "vdd_mif";
				regulator-min-microvolt = <950000>;
				regulator-max-microvolt = <1350000>;
				regulator-always-on;
				regulator-boot-on;
			};

			buck2_reg: BUCK2 {
				regulator-name = "vdd_arm";
				regulator-min-microvolt = <950000>;
				regulator-max-microvolt = <1350000>;
				regulator-always-on;
				regulator-boot-on;
				regulator-ramp-delay = <50000>;
			};
		};
	};
```

## Documentation/devicetree/bindings/mfd/samsung,exynos5433-lpass.txt
```
Samsung Exynos SoC Low Power Audio Subsystem (LPASS)

Required properties:

 - compatible		: "samsung,exynos5433-lpass"
 - reg			: should contain the LPASS top SFR region location
			  and size
 - samsung,pmu-syscon	: the phandle to the Power Management Unit node
 - #address-cells	: should be 1
 - #size-cells		: should be 1
 - ranges		: must be present

Each IP block of the Low Power Audio Subsystem should be specified as
an optional sub-node. For "samsung,exynos5433-lpass" compatible this includes:
UART, SLIMBUS, PCM, I2S, DMAC, Timers 0...4, VIC, WDT 0...1 devices.

Bindings of the sub-nodes are described in:
  ../serial/samsung_uart.txt
  ../sound/samsung-i2s.txt
  ../dma/arm-pl330.txt


Example:

audio-subsystem {
	compatible = "samsung,exynos5433-lpass";
	reg = <0x11400000 0x100>, <0x11500000 0x08>;
	samsung,pmu-syscon = <&pmu_system_controller>;
	#address-cells = <1>;
	#size-cells = <1>;
	ranges;

	adma: adma@11420000 {
		compatible = "arm,pl330", "arm,primecell";
		reg = <0x11420000 0x1000>;
		interrupts = <0 73 0>;
		clocks = <&cmu_aud CLK_ACLK_DMAC>;
		clock-names = "apb_pclk";
		#dma-cells = <1>;
		#dma-channels = <8>;
		#dma-requests = <32>;
	};

	i2s0: i2s0@11440000 {
		compatible = "samsung,exynos7-i2s";
		reg = <0x11440000 0x100>;
		dmas = <&adma 0 &adma 2>;
		dma-names = "tx", "rx";
		interrupts = <0 70 0>;
		clocks = <&cmu_aud CLK_PCLK_AUD_I2S>,
			 <&cmu_aud CLK_SCLK_AUD_I2S>,
			 <&cmu_aud CLK_SCLK_I2S_BCLK>;
		clock-names = "iis", "i2s_opclk0", "i2s_opclk1";
		pinctrl-names = "default";
		pinctrl-0 = <&i2s0_bus>;
		status = "disabled";
	};

	serial_3: serial@11460000 {
		compatible = "samsung,exynos5433-uart";
		reg = <0x11460000 0x100>;
		interrupts = <0 67 0>;
		clocks = <&cmu_aud CLK_PCLK_AUD_UART>,
			 <&cmu_aud CLK_SCLK_AUD_UART>;
		clock-names = "uart", "clk_uart_baud0";
		pinctrl-names = "default";
		pinctrl-0 = <&uart_aud_bus>;
		status = "disabled";
	};
 };
```

## Documentation/devicetree/bindings/mfd/samsung,exynos5433-lpass.yaml
```yaml
# SPDX-License-Identifier: (GPL-2.0-only OR BSD-2-Clause)
%YAML 1.2
---
$id: http://devicetree.org/schemas/mfd/samsung,exynos5433-lpass.yaml#
$schema: http://devicetree.org/meta-schemas/core.yaml#

title: Samsung Exynos SoC Low Power Audio Subsystem (LPASS)

maintainers:
  - Krzysztof Kozlowski <krzk@kernel.org>
  - Sylwester Nawrocki <s.nawrocki@samsung.com>

properties:
  compatible:
    const: samsung,exynos5433-lpass

  '#address-cells':
    const: 1

  clocks:
    maxItems: 1

  clock-names:
    items:
      - const: sfr0_ctrl

  power-domains:
    maxItems: 1

  ranges: true

  reg:
    minItems: 2
    maxItems: 2

  '#size-cells':
    const: 1

patternProperties:
  "^dma-controller@[0-9a-f]+$":
    $ref: /schemas/dma/arm,pl330.yaml

  "^i2s@[0-9a-f]+$":
    $ref: /schemas/sound/samsung-i2s.yaml

  "^serial@[0-9a-f]+$":
    $ref: /schemas/serial/samsung_uart.yaml

required:
  - compatible
  - '#address-cells'
  - clocks
  - clock-names
  - ranges
  - reg
  - '#size-cells'

additionalProperties: false

examples:
  - |
    #include <dt-bindings/clock/exynos5433.h>
    #include <dt-bindings/interrupt-controller/arm-gic.h>

    audio-subsystem@11400000 {
        compatible = "samsung,exynos5433-lpass";
        reg = <0x11400000 0x100>, <0x11500000 0x08>;
        clocks = <&cmu_aud CLK_PCLK_SFR0_CTRL>;
        clock-names = "sfr0_ctrl";
        power-domains = <&pd_aud>;
        #address-cells = <1>;
        #size-cells = <1>;
        ranges;

        dma-controller@11420000 {
            compatible = "arm,pl330", "arm,primecell";
            reg = <0x11420000 0x1000>;
            interrupts = <GIC_SPI 73 IRQ_TYPE_LEVEL_HIGH>;
            clocks = <&cmu_aud CLK_ACLK_DMAC>;
            clock-names = "apb_pclk";
            #dma-cells = <1>;
            dma-channels = <8>;
            dma-requests = <32>;
            power-domains = <&pd_aud>;
        };

        i2s@11440000 {
            compatible = "samsung,exynos7-i2s";
            reg = <0x11440000 0x100>;
            dmas = <&adma 0>, <&adma 2>;
            dma-names = "tx", "rx";
            interrupts = <GIC_SPI 70 IRQ_TYPE_LEVEL_HIGH>;
            #address-cells = <1>;
            #size-cells = <0>;
            clocks = <&cmu_aud CLK_PCLK_AUD_I2S>,
                     <&cmu_aud CLK_SCLK_AUD_I2S>,
                     <&cmu_aud CLK_SCLK_I2S_BCLK>;
            clock-names = "iis", "i2s_opclk0", "i2s_opclk1";
            #clock-cells = <1>;
            pinctrl-names = "default";
            pinctrl-0 = <&i2s0_bus>;
            power-domains = <&pd_aud>;
            #sound-dai-cells = <1>;
        };

        serial@11460000 {
            compatible = "samsung,exynos5433-uart";
            reg = <0x11460000 0x100>;
            interrupts = <GIC_SPI 67 IRQ_TYPE_LEVEL_HIGH>;
            clocks = <&cmu_aud CLK_PCLK_AUD_UART>,
                     <&cmu_aud CLK_SCLK_AUD_UART>;
            clock-names = "uart", "clk_uart_baud0";
            pinctrl-names = "default";
            pinctrl-0 = <&uart_aud_bus>;
            power-domains = <&pd_aud>;
        };
    };
```
