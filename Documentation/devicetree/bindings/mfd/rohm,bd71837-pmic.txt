## Documentation/devicetree/bindings/mfd/samsung,s2dos05.yaml
```yaml
# SPDX-License-Identifier: (GPL-2.0 OR BSD-2-Clause)
%YAML 1.2
---
$id: http://devicetree.org/schemas/mfd/samsung,s2dos05.yaml#
$schema: http://devicetree.org/meta-schemas/core.yaml#

title: Samsung S2DOS05 Power Management IC

maintainers:
  - Dzmitry Sankouski <dsankouski@gmail.com>

description:
  This is a device tree bindings for S2DOS family of Power Management IC (PMIC).

  The S2DOS05 is a companion power management IC for the panel and touchscreen
  in smart phones. Provides voltage regulators and
  ADC for power/current measurements.

  Regulator section has 4 LDO and 1 BUCK regulators and also
  provides ELVDD, ELVSS, AVDD lines.

properties:
  compatible:
    const: samsung,s2dos05

  reg:
    maxItems: 1

  regulators:
    patternProperties:
      "^buck|ldo[1-4]$":
        type: object
        $ref: /schemas/regulator/regulator.yaml#
        unevaluatedProperties: false

        required:
          - regulator-name

    additionalProperties: false

required:
  - compatible
  - reg
  - regulators

additionalProperties: false

examples:
  - |
    i2c {
        #address-cells = <1>;
        #size-cells = <0>;

        pmic@60 {
            compatible = "samsung,s2dos05";
            reg = <0x60>;

            regulators {
                ldo1 {
                    regulator-active-discharge = <1>;
                    regulator-min-microvolt = <1500000>;
                    regulator-max-microvolt = <2000000>;
                    regulator-name = "ldo1";
                };

                ldo2 {
                    regulator-active-discharge = <1>;
                    regulator-boot-on;
                    regulator-min-microvolt = <1800000>;
                    regulator-max-microvolt = <1800000>;
                    regulator-name = "ldo2";
                };

                ldo3 {
                    regulator-active-discharge = <1>;
                    regulator-boot-on;
                    regulator-min-microvolt = <3000000>;
                    regulator-max-microvolt = <3000000>;
                    regulator-name = "ldo3";
                };

                ldo4 {
                    regulator-active-discharge = <1>;
                    regulator-min-microvolt = <2700000>;
                    regulator-max-microvolt = <3775000>;
                    regulator-name = "ldo4";
                };

                buck {
                    regulator-active-discharge = <1>;
                    regulator-min-microvolt = <850000>;
                    regulator-max-microvolt = <2100000>;
                    regulator-name = "buck";
                };
            };
        };
    };

...
```

## Documentation/devicetree/bindings/mfd/samsung,s2mpa01.yaml
```yaml
# SPDX-License-Identifier: GPL-2.0-only OR BSD-2-Clause
%YAML 1.2
---
$id: http://devicetree.org/schemas/mfd/samsung,s2mpa01.yaml#
$schema: http://devicetree.org/meta-schemas/core.yaml#

title: Samsung S2MPA01 Power Management IC

maintainers:
  - Krzysztof Kozlowski <krzysztof.kozlowski@canonical.com>

description: |
  This is a part of device tree bindings for S2M and S5M family of Power
  Management IC (PMIC).

  The Samsung S2MPA01 is a Power Management IC which includes voltage
  and current regulators, RTC, clock outputs and other sub-blocks.

properties:
  compatible:
    const: samsung,s2mpa01-pmic

  interrupts:
    maxItems: 1

  reg:
    maxItems: 1

  regulators:
    $ref: ../regulator/samsung,s2mpa01.yaml
    description:
      List of child nodes that specify the regulators.

  wakeup-source: true

required:
  - compatible
  - reg
  - regulators

additionalProperties: false

examples:
  - |
    #include <dt-bindings/interrupt-controller/irq.h>

    i2c {
        #address-cells = <1>;
        #size-cells = <0>;

        pmic@66 {
            compatible = "samsung,s2mpa01-pmic";
            reg = <0x66>;

            regulators {
                ldo1_reg: LDO1 {
                    regulator-name = "VDD_ALIVE";
                    regulator-min-microvolt = <1000000>;
                    regulator-max-microvolt = <1000000>;
                };

                ldo2_reg: LDO2 {
                    regulator-name = "VDDQ_MMC2";
                    regulator-min-microvolt = <2800000>;
                    regulator-max-microvolt = <2800000>;
                    regulator-always-on;
                };

                // ...

                buck1_reg: BUCK1 {
                    regulator-name = "vdd_mif";
                    regulator-min-microvolt = <950000>;
                    regulator-max-microvolt = <1350000>;
                    regulator-always-on;
                    regulator-boot-on;
                };

                buck2_reg: BUCK2 {
                    regulator-name = "vdd_arm";
                    regulator-min-microvolt = <950000>;
                    regulator-max-microvolt = <1350000>;
                    regulator-always-on;
                    regulator-boot-on;
                    regulator-ramp-delay = <50000>;
                };

                // ...
            };
        };
    };
```

## Documentation/devicetree/bindings/mfd/samsung,s2mpg10-pmic.yaml
```yaml
# SPDX-License-Identifier: GPL-2.0-only OR BSD-2-Clause
%YAML 1.2
---
$id: http://devicetree.org/schemas/mfd/samsung,s2mpg10-pmic.yaml#
$schema: http://devicetree.org/meta-schemas/core.yaml#

title: Samsung S2MPG10 Power Management IC

maintainers:
  - André Draszik <andre.draszik@linaro.org>

description: |
  This is part of the device tree bindings for the S2MPG10 Power Management IC
  (PMIC).

  The Samsung S2MPG10 is a Power Management IC for mobile applications with buck
  converters, various LDOs, power meters, RTC, clock outputs, and additional
  GPIO interfaces and is typically complemented by S2MPG10 PMIC in a main/sub
  configuration as the main PMIC.

properties:
  compatible:
    const: samsung,s2mpg10-pmic

  clocks:
    $ref: /schemas/clock/samsung,s2mps11.yaml
    description:
      Child node describing clock provider.

  interrupts:
    maxItems: 1

  regulators:
    type: object
    $ref: /schemas/regulator/samsung,s2mpg10-regulator.yaml
    description:
      List of child nodes that specify the regulators.

  system-power-controller: true

  wakeup-source: true

patternProperties:
  "^vinb([1-9]|10)m-supply$":
    description:
      Phandle to the power supply for each buck rail of this PMIC. There is a
      1:1 mapping of supply to rail, e.g. vinb1m-supply supplies buck1m.

  "^vinl([1-9]|1[0-5])m-supply$":
    description: |
      Phandle to the power supply for one or multiple LDO rails of this PMIC.
      The mapping of supply to rail(s) is as follows:
        vinl1m - ldo13m
        vinl2m - ldo15m
        vinl3m - ldo1m, ldo5m, ldo7m
        vinl4m - ldo3m, ldo8m
        vinl5m - ldo16m
        vinl6m - ldo17m
        vinl7m - ldo6m, ldo11m, ldo24m, ldo28m
        vinl8m - ldo12m
        vinl9m - ldo2m, ldo4m
        vinl10m - ldo9m, ldo14m, ldo18m, 19m, ldo20m, ldo25m
        vinl11m - ldo23m, ldo31m
        vinl12m - ldo29m
        vinl13m - ldo30m
        vinl14m - ldo21m
        vinl15m - ldo10m, ldo22m, ldo26m, ldo27m

required:
  - compatible
  - interrupts
  - regulators

additionalProperties: false

examples:
  - |
    #include <dt-bindings/gpio/gpio.h>
    #include <dt-bindings/interrupt-controller/irq.h>
    #include <dt-bindings/regulator/samsung,s2mpg10-regulator.h>

    pmic {
        compatible = "samsung,s2mpg10-pmic";
        interrupts-extended = <&gpa0 6 IRQ_TYPE_LEVEL_LOW>;
        pinctrl-names = "default";
        pinctrl-0 = <&pmic_int>;
        system-power-controller;
        wakeup-source;

        vinl3m-supply = <&buck8m>;

        clocks {
            compatible = "samsung,s2mpg10-clk";
            #clock-cells = <1>;
            clock-output-names = "rtc32k_ap", "peri32k1", "peri32k2";
        };

        regulators {
            buck8m {
                regulator-name = "vdd_mif";
                regulator-min-microvolt = <450000>;
                regulator-max-microvolt = <1300000>;
                regulator-ramp-delay = <6250>;
            };

            ldo1m {
                regulator-name = "vdd_ldo1";
                regulator-min-microvolt = <700000>;
                regulator-max-microvolt = <1300000>;
            };

            ldo20m {
                regulator-name = "vdd_dmics";
                regulator-min-microvolt = <700000>;
                regulator-max-microvolt = <1300000>;
                regulator-always-on;
                samsung,ext-control = <S2MPG10_EXTCTRL_LDO20M_EN2>;
            };
        };
    };
```

## Documentation/devicetree/bindings/mfd/samsung,s2mpg11-pmic.yaml
```yaml
# SPDX-License-Identifier: GPL-2.0-only OR BSD-2-Clause
%YAML 1.2
---
$id: http://devicetree.org/schemas/mfd/samsung,s2mpg11-pmic.yaml#
$schema: http://devicetree.org/meta-schemas/core.yaml#

title: Samsung S2MPG11 Power Management IC

maintainers:
  - André Draszik <andre.draszik@linaro.org>

description: |
  This is part of the device tree bindings for the S2MPG11 Power Management IC
  (PMIC).

  The Samsung S2MPG11 is a Power Management IC for mobile applications with buck
  converters, various LDOs, power meters, NTC thermistor inputs, and additional
  GPIO interfaces and typically complements an S2MPG10 PMIC in a main/sub
  configuration as the sub-PMIC.

properties:
  compatible:
    const: samsung,s2mpg11-pmic

  interrupts:
    maxItems: 1

  regulators:
    type: object
    $ref: /schemas/regulator/samsung,s2mpg11-regulator.yaml
    description:
      List of child nodes that specify the regulators.

  wakeup-source: true

patternProperties:
  "^vinb(([1-9]|10)s|[abd])-supply$":
    description:
      Phandle to the power supply for each buck rail of this PMIC. There is a
      1:1 mapping of numbered supply to rail, e.g. vinb1s-supply supplies
      buck1s. The remaining mapping is as follows
        vinba - bucka
        vinbb - buck boost
        vinbd - buckd

  "^vinl[1-6]s-supply$":
    description: |
      Phandle to the power supply for one or multiple LDO rails of this PMIC.
      The mapping of supply to rail(s) is as follows
        vinl1s - ldo1s, ldo2s
        vinl2s - ldo8s, ldo9s
        vinl3s - ldo3s, ldo5s, ldo7s, ldo15s
        vinl4s - ldo10s, ldo11s, ldo12s, ldo14s
        vinl5s - ldo4s, ldo6s
        vinl6s - ldo13s

required:
  - compatible
  - interrupts
  - regulators

additionalProperties: false

examples:
  - |
    #include <dt-bindings/gpio/gpio.h>
    #include <dt-bindings/interrupt-controller/irq.h>
    #include <dt-bindings/regulator/samsung,s2mpg10-regulator.h>

    pmic {
        compatible = "samsung,s2mpg11-pmic";
        interrupts-extended = <&gpa0 7 IRQ_TYPE_LEVEL_LOW>;
        pinctrl-names = "default";
        pinctrl-0 = <&pmic_int>;
        wakeup-source;

        vinl1s-supply = <&buck8m>;
        vinl2s-supply = <&buck6s>;

        regulators {
            buckd {
                regulator-name = "vcc_ufs";
                regulator-ramp-delay = <6250>;
                enable-gpios = <&gpp0 1 GPIO_ACTIVE_HIGH>;
                samsung,ext-control = <S2MPG11_EXTCTRL_UFS_EN>;
            };
        };
    };
```
