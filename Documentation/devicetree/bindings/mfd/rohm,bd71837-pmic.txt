## Documentation/devicetree/bindings/mfd/rohm,bd9576-pmic.yaml
```yaml
# SPDX-License-Identifier: GPL-2.0-only OR BSD-2-Clause
%YAML 1.2
---
$id: http://devicetree.org/schemas/mfd/rohm,bd9576-pmic.yaml#
$schema: http://devicetree.org/meta-schemas/core.yaml#

title: ROHM BD9576MUF and BD9573MUF Power Management Integrated Circuit

maintainers:
  - Matti Vaittinen <mazziesaccount@gmail.com>

description: |
  BD9576MUF and BD9573MUF are power management ICs primarily intended for
  powering the R-Car series processors.
  The IC provides 6 power outputs with configurable sequencing and safety
  monitoring. A watchdog logic with slow ping/windowed modes is also included.

properties:
  compatible:
    enum:
      - rohm,bd9576
      - rohm,bd9573

  reg:
    description:
      I2C slave address.
    maxItems: 1

  interrupts:
    maxItems: 1

  rohm,vout1-en-low:
    description:
      BD9576 and BD9573 VOUT1 regulator enable state can be individually
      controlled by a GPIO. This is dictated by state of vout1-en pin during
      the PMIC startup. If vout1-en is LOW during PMIC startup then the VOUT1
      enable state is controlled via this pin. Set this property if vout1-en
      is wired to be down at PMIC start-up.
    type: boolean

  rohm,vout1-en-gpios:
    description:
      GPIO specifier to specify the GPIO connected to vout1-en for vout1 ON/OFF
      state control.
    maxItems: 1

  rohm,ddr-sel-low:
    description:
      The BD9576 and BD9573 output voltage for DDR can be selected by setting
      the ddr-sel pin low or high. Set this property if ddr-sel is grounded.
    type: boolean

  rohm,watchdog-enable-gpios:
    description: The GPIO line used to enable the watchdog.
    maxItems: 1

  rohm,watchdog-ping-gpios:
    description: The GPIO line used to ping the watchdog.
    maxItems: 1

  rohm,hw-timeout-ms:
    maxItems: 2
    description:
      Watchdog timeout in milliseconds. If single value is given it is
      the maximum timeout. Eg. if pinging watchdog is not done within this time
      limit the watchdog will be triggered. If two values are given watchdog
      is configured in "window mode". Then first value is limit for short-ping
      Eg. if watchdog is pinged sooner than that the watchdog will trigger.
      When two values is given the second value is the maximum timeout.
      # (HW) minimum for short timeout is 2ms, maximum 220 ms.
      # (HW) minimum for max timeout is 4ms, maximum 4416 ms.

  regulators:
    $ref: /schemas/regulator/rohm,bd9576-regulator.yaml
    description:
      List of child nodes that specify the regulators.

required:
  - compatible
  - reg
  - regulators

additionalProperties: false

examples:
  - |
    #include <dt-bindings/gpio/gpio.h>
    #include <dt-bindings/leds/common.h>
    i2c {
        #address-cells = <1>;
        #size-cells = <0>;
        pmic: pmic@30 {
            compatible = "rohm,bd9576";
            reg = <0x30>;
            rohm,vout1-en-low;
            rohm,vout1-en-gpios = <&gpio2 6 GPIO_ACTIVE_HIGH>;
            rohm,ddr-sel-low;
            rohm,watchdog-enable-gpios = <&gpio2 6 GPIO_ACTIVE_HIGH>;
            rohm,watchdog-ping-gpios = <&gpio2 7 GPIO_ACTIVE_HIGH>;
            rohm,hw-timeout-ms = <150>, <2300>;

            regulators {
                boost1: regulator-vd50 {
                    regulator-name = "VD50";
                };
                buck1: regulator-vd18 {
                    regulator-name = "VD18";
                };
                buck2: regulator-vdddr {
                    regulator-name = "VDDDR";
                };
                buck3: regulator-vd10 {
                    regulator-name = "VD10";
                };
                ldo: regulator-voutl1 {
                    regulator-name = "VOUTL1";
                };
                sw: regulator-vouts1 {
                    regulator-name = "VOUTS1";
                };
            };
        };
    };
```

## Documentation/devicetree/bindings/mfd/rohm,bd96801-pmic.yaml
```yaml
# SPDX-License-Identifier: GPL-2.0-only OR BSD-2-Clause
%YAML 1.2
---
$id: http://devicetree.org/schemas/mfd/rohm,bd96801-pmic.yaml#
$schema: http://devicetree.org/meta-schemas/core.yaml#

title: ROHM BD96801 Scalable Power Management Integrated Circuit

maintainers:
  - Matti Vaittinen <matti.vaittinen@fi.rohmeurope.com>

description:
  BD96801 is an automotive grade single-chip power management IC.
  It integrates 4 buck converters and 3 LDOs with safety features like
  over-/under voltage and over current detection and a watchdog.

properties:
  compatible:
    const: rohm,bd96801

  reg:
    maxItems: 1

  interrupts:
    description:
      The PMIC provides intb and errb IRQ lines. The errb IRQ line is used
      for fatal IRQs which will cause the PMIC to shut down power outputs.
      In many systems this will shut down the SoC contolling the PMIC and
      connecting/handling the errb can be omitted. However, there are cases
      where the SoC is not powered by the PMIC or has a short time backup
      energy to handle shutdown of critical hardware. In that case it may be
      useful to connect the errb and handle errb events.
    minItems: 1
    maxItems: 2

  interrupt-names:
    minItems: 1
    items:
      - enum: [intb, errb]
      - const: errb

  rohm,hw-timeout-ms:
    description:
      Watchdog timeout value(s). First walue is timeout limit. Second value is
      optional value for 'too early' watchdog ping if window timeout mode is
      to be used.
    minItems: 1
    maxItems: 2

  rohm,wdg-action:
    description:
      Whether the watchdog failure must turn off the regulator power outputs or
      just toggle the INTB line.
    enum:
      - prstb
      - intb-only

  timeout-sec:
    maxItems: 2

  regulators:
    $ref: /schemas/regulator/rohm,bd96801-regulator.yaml
    description:
      List of child nodes that specify the regulators.

required:
  - compatible
  - reg
  - interrupts
  - interrupt-names
  - regulators

additionalProperties: false

examples:
  - |
    #include <dt-bindings/interrupt-controller/irq.h>
    #include <dt-bindings/leds/common.h>
    i2c {
        #address-cells = <1>;
        #size-cells = <0>;
        pmic: pmic@60 {
            reg = <0x60>;
            compatible = "rohm,bd96801";
            interrupt-parent = <&gpio1>;
            interrupts = <29 IRQ_TYPE_LEVEL_LOW>, <6 IRQ_TYPE_LEVEL_LOW>;
            interrupt-names = "intb", "errb";

            regulators {
                buck1 {
                    regulator-name = "buck1";
                    regulator-ramp-delay = <1250>;
                    /* 0.5V min INITIAL - 150 mV tune */
                    regulator-min-microvolt = <350000>;
                    /* 3.3V + 150mV tune */
                    regulator-max-microvolt = <3450000>;

                    /* These can be set only when PMIC is in STBY */
                    rohm,initial-voltage-microvolt = <500000>;
                    regulator-ov-error-microvolt = <230000>;
                    regulator-uv-error-microvolt = <230000>;
                    regulator-temp-protection-kelvin = <1>;
                    regulator-temp-warn-kelvin = <0>;
                };
                buck2 {
                    regulator-name = "buck2";
                    regulator-min-microvolt = <350000>;
                    regulator-max-microvolt = <3450000>;

                    rohm,initial-voltage-microvolt = <3000000>;
                    regulator-ov-error-microvolt = <18000>;
                    regulator-uv-error-microvolt = <18000>;
                    regulator-temp-protection-kelvin = <1>;
                    regulator-temp-warn-kelvin = <1>;
                };
                buck3 {
                    regulator-name = "buck3";
                    regulator-min-microvolt = <350000>;
                    regulator-max-microvolt = <3450000>;

                    rohm,initial-voltage-microvolt = <600000>;
                    regulator-ov-warn-microvolt = <18000>;
                    regulator-uv-warn-microvolt = <18000>;
                    regulator-temp-protection-kelvin = <1>;
                    regulator-temp-error-kelvin = <0>;
                };
                buck4 {
                    regulator-name = "buck4";
                    regulator-min-microvolt = <350000>;
                    regulator-max-microvolt = <3450000>;

                    rohm,initial-voltage-microvolt = <600000>;
                    regulator-ov-warn-microvolt = <18000>;
                    regulator-uv-warn-microvolt = <18000>;
                    regulator-temp-protection-kelvin = <1>;
                    regulator-temp-error-kelvin = <0>;
                };
                ldo5 {
                    regulator-name = "ldo5";
                    regulator-min-microvolt = <300000>;
                    regulator-max-microvolt = <3300000>;

                    rohm,initial-voltage-microvolt = <500000>;
                    regulator-ov-error-microvolt = <36000>;
                    regulator-uv-error-microvolt = <34000>;
                    regulator-temp-protection-kelvin = <1>;
                    regulator-temp-warn-kelvin = <0>;
                };
                ldo6 {
                    regulator-name = "ldo6";
                    regulator-min-microvolt = <300000>;
                    regulator-max-microvolt = <3300000>;

                    rohm,initial-voltage-microvolt = <300000>;
                    regulator-ov-error-microvolt = <36000>;
                    regulator-uv-error-microvolt = <34000>;
                    regulator-temp-protection-kelvin = <1>;
                    regulator-temp-warn-kelvin = <0>;
                };
                ldo7 {
                    regulator-name = "ldo7";
                    regulator-min-microvolt = <300000>;
                    regulator-max-microvolt = <3300000>;

                    rohm,initial-voltage-microvolt = <500000>;
                    regulator-ov-error-microvolt = <36000>;
                    regulator-uv-error-microvolt = <34000>;
                    regulator-temp-protection-kelvin = <1>;
                    regulator-temp-warn-kelvin = <0>;
                };
            };
        };
    };
```

## Documentation/devicetree/bindings/mfd/rohm,bd96802-pmic.yaml
```yaml
# SPDX-License-Identifier: GPL-2.0-only OR BSD-2-Clause
%YAML 1.2
---
$id: http://devicetree.org/schemas/mfd/rohm,bd96802-pmic.yaml#
$schema: http://devicetree.org/meta-schemas/core.yaml#

title: ROHM BD96802 / BD96806 Scalable Power Management Integrated Circuit

maintainers:
  - Matti Vaittinen <matti.vaittinen@fi.rohmeurope.com>

description: |
  BD96802Qxx-C and BD96806 are automotive grade configurable Power Management
  Integrated Circuits supporting Functional Safety features for application
  processors, SoCs and FPGAs

properties:
  compatible:
    enum:
      - rohm,bd96802
      - rohm,bd96806

  reg:
    maxItems: 1

  interrupts:
    description:
      The PMIC provides intb and errb IRQ lines. The errb IRQ line is used
      for fatal IRQs which will cause the PMIC to shut down power outputs.
      In many systems this will shut down the SoC contolling the PMIC and
      connecting/handling the errb can be omitted. However, there are cases
      where the SoC is not powered by the PMIC or has a short time backup
      energy to handle shutdown of critical hardware. In that case it may be
      useful to connect the errb and handle errb events.
    minItems: 1
    maxItems: 2

  interrupt-names:
    minItems: 1
    items:
      - enum: [intb, errb]
      - const: errb

  regulators:
    $ref: ../regulator/rohm,bd96802-regulator.yaml
    description:
      List of child nodes that specify the regulators.

required:
  - compatible
  - reg
  - interrupts
  - interrupt-names
  - regulators

additionalProperties: false

examples:
  - |
    #include <dt-bindings/interrupt-controller/irq.h>
    #include <dt-bindings/leds/common.h>
    i2c {
        #address-cells = <1>;
        #size-cells = <0>;
        pmic: pmic@62 {
            reg = <0x62>;
            compatible = "rohm,bd96802";
            interrupt-parent = <&gpio1>;
            interrupts = <29 IRQ_TYPE_LEVEL_LOW>, <6 IRQ_TYPE_LEVEL_LOW>;
            interrupt-names = "intb", "errb";

            regulators {
                buck1 {
                    regulator-name = "buck1";
                    regulator-ramp-delay = <1250>;
                    /* 0.5V min INITIAL - 150 mV tune */
                    regulator-min-microvolt = <350000>;
                    /* 3.3V + 150mV tune */
                    regulator-max-microvolt = <3450000>;

                    /* These can be set only when PMIC is in STBY */
                    rohm,initial-voltage-microvolt = <500000>;
                    regulator-ov-error-microvolt = <230000>;
                    regulator-uv-error-microvolt = <230000>;
                    regulator-temp-protection-kelvin = <1>;
                    regulator-temp-warn-kelvin = <0>;
                };
                buck2 {
                    regulator-name = "buck2";
                    regulator-min-microvolt = <350000>;
                    regulator-max-microvolt = <3450000>;

                    rohm,initial-voltage-microvolt = <3000000>;
                    regulator-ov-error-microvolt = <18000>;
                    regulator-uv-error-microvolt = <18000>;
                    regulator-temp-protection-kelvin = <1>;
                    regulator-temp-warn-kelvin = <1>;
                };
            };
        };
    };
```

## Documentation/devicetree/bindings/mfd/rt5025.txt
```
Richtek RT5025 Multi-functional device

The RT5025 are Integrated Power Management Chips.
These chips are connected to an i2c bus.


Required properties:
- compatible : Must be "rt,rt5025";
- interrupts : This i2c device has an IRQ line connected to the main SoC
- interrupt-parent : The parent interrupt controller.

Optional node:
- Child nodes contain in the RT5025. The twl family is made of several variants
  that support a different number of features.


Example:
rt5025@35 {
	compatible = "rt,rt5025";
	reg = <0x35>;
	interrupt-parent = <&msmgpio>;
	interrupts = <73 0>;

	rt5025_dcdc1: regulator_0 {
		compatible = "rt,rt5025-dcdc1";
		cell-index = <0>;
		regulator-name = "rt5025-dcdc1";
		regulator-min-microvolt = < 700000>;
		regulator-max-microvolt = <2275000>;
		rt,ramp_sel = <0x00>;
		rt,allow_mode_mask;
		qcom,comsumer-supplies = "rt5025-dcdc1", "";
	};

	rt5025-charger {
		compatible = "rt,rt5025-charger";
		rt,te_en;
		//rt,screenon_adjust;
		rt,iprec = <0x00>;
		rt,ieoc = <0x00>;
		rt,vprec = <0x05>;
		rt,vdpm = <0x02>;
		rt,chg_volt = <4200>;
		rt,acchg_icc = <2000>;
		rt,usbtachg_icc = <2000>;
		rt,usbchg_icc = <500>;
		rt,screenon_icc = <500>;
		rt,temp = <0 150 500 600>;
		rt,temp_scalar = <0x30 0x2b 0x28 0x22 0x15 0x10 0x10 0x0d>;
	};

	rt5025_gpiop: rt5025-gpio {
		compatible = "rt,rt5025-gpio";
		gpio-controller;
		#gpio-cells = <2>;
		rt,ngpio = <3>;
	};

	rt5025-irq {
		compatible = "rt,rt5025-irq";
		rt,irq-gpio = <&msmgpio 73 0x00>;
	};

	rt5025-misc {
		compatible = "rt,rt5025-misc";
		rt,system_lv = <0x02>;
		rt,shdn_lpress = <0x01>;
		rt,start_lpress = <0x00>;
		rt,syslv_enshutdown;
	};

	rt5025-debug {
		compatible = "rt,rt5025-debug";
	};
```
