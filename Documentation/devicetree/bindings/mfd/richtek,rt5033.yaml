## Documentation/devicetree/bindings/mfd/ricoh619.txt
```
ricoh619 Power Management Integrated Circuit

Required properties:
- compatible: "rockchip,ricoh619" 
- reg: I2C slave address
- gpios: the interrupt pin\ sleep pin \dc_dec pin
  use gpio get IRQ number
  get adp plug in or out
- regulators: This is the list of child nodes that specify the regulator
  initialization data for defined regulators. Not all regulators for the given
  device need to be present. The definition for each of these nodes is defined
  using the standard binding for regulators found at
  Documentation/devicetree/bindings/regulator/regulator.txt.
  The regulator is matched with the regulator-compatible.

  The valid regulator-compatible values are:
  ricoh619: ricoh619_dc1, ricoh619_dc2, ricoh619_dc3, ricoh619_dc4, ricoh619_dc5,ricoh619_ldo1, ricoh619_ldo2, ricoh619_ldo3, ricoh619_ldo4, ricoh619_ldo5, ricoh619_ldo6,
            ricoh619_ldo7, ricoh619_ldo8,ricoh619_ldo9,ricoh619_ldo10,ricoh619_ldortc1,ricoh619_ldortc2

Optional properties:
- gpios: 
	gpios 0 :irq pin gpio
	gpios 1 :sleep pin gpio
	gpios 2 :dc det pin
- regulator-initial-mode: default mode to set on startup
- regulator-initial-state: suspend state to set at init
- regulator-state-mem, regulator-state-disk, regulator-state-standby:
	defines regulator suspend to memory, suspend to disk (hibernate) and standby respectively.
	have following sub-constarints:
	- regulator-state-uv: suspend voltage
	- regulator-state-mode: suspend regulator operating mode
	- regulator-state-enabled: is regulator enabled in this suspend state
	- regulator-state-disabled: is the regulator disbled in this suspend state
-regulator-initial-mode and regulator-state-mode is set as:
	REGULATOR_MODE_FAST			0x1
	REGULATOR_MODE_NORMAL			0x2
	REGULATOR_MODE_IDLE			0x4
	REGULATOR_MODE_STANDBY			0x8
 
Example:

	ricoh619: ricoh619@32 {
		reg = <0x32>;
		status = "okay";
	};

	gpios =<&gpio0 GPIO_A4 GPIO_ACTIVE_HIGH>,<&gpio0 GPIO_B3 GPIO_ACTIVE_LOW>,<&gpio0 GPIO_B0 GPIO_ACTIVE_HIGH>;
	ricoh619,system-power-controller;  //support power off

&ricoh619 {
	compatible = "ricoh,ricoh619";
	
	regulators {
		#address-cells = <1>;
		#size-cells = <0>;	

		regulators {
		ricoh619_dcdc1_reg: regulator@0 {
			regulator-name = "vdd_logic";
			regulator-min-microvolt = < 700000>;
			regulator-max-microvolt = <1500000>;
			regulator-initial-mode = <0x2>;
			regulator-initial-state = <3>;
			regulator-state-mem {
				regulator-state-mode = <0x2>;
				regulator-state-enabled;
				regulator-state-uv = <900000>;
			};	
		};
		ricoh619_dcdc2_reg: regulator@1 {
			regulator-name = "ricoh619_dcdc2";
			regulator-min-microvolt = <1200000>;
			regulator-max-microvolt = <1200000>;
			regulator-initial-mode = <0x2>;
			regulator-initial-state = <3>;
			regulator-state-mem {
				regulator-state-mode = <0x2>;
				regulator-state-enabled;
				regulator-state-uv = <1200000>;
			};	
		};
		ricoh619_dcdc3_reg: regulator@2 {
			regulator-name = "ricoh619_dcdc3";
			regulator-min-microvolt = < 1200000>;
			regulator-max-microvolt = <1200000>;
			regulator-initial-mode = <0x2>;
			regulator-initial-state = <3>;
			regulator-state-mem {
				regulator-state-mode = <0x2>;
				regulator-state-enabled;
				regulator-state-uv = <1200000>;
			};	
		};
		ricoh619_dcdc4_reg: regulator@3 {
			regulator-name = "ricoh619_dcdc4";
			regulator-min-microvolt = < 3300000>;
			regulator-max-microvolt = <3300000>;
			regulator-initial-mode = <0x2>;
			regulator-initial-state = <3>;
			regulator-state-mem {
				regulator-state-mode = <0x2>;
				regulator-state-enabled;
				regulator-state-uv = <2800000>;
			};	
		};
		ricoh619_dcdc5_reg: regulator@4 {
			regulator-name = "ricoh619_dcdc5";
			regulator-min-microvolt = < 2000000>;
			regulator-max-microvolt = <2000000>;
			regulator-initial-mode = <0x2>;
			regulator-initial-state = <3>;
			regulator-state-mem {
				regulator-state-mode = <0x2>;
				regulator-state-enabled;
				regulator-state-uv = <2000000>;
			};	
		};
		ricoh619_ldo1_reg: regulator@5  {
			regulator-name = "ricoh619_ldo1";
			regulator-min-microvolt = <3300000>;
			regulator-max-microvolt = <3300000>;
			regulator-initial-state = <3>;
			regulator-state-mem {
				regulator-state-enabled;
				regulator-state-uv = <3300000>;
			};	
		};
		ricoh619_ldo2_reg: regulator@6  {
			regulator-name = "ricoh619_ldo2";
			regulator-min-microvolt = <3300000>;
			regulator-max-microvolt = <3300000>;
			regulator-initial-state = <3>;
			regulator-state-mem {
				regulator-state-enabled;
				regulator-state-uv = <3300000>;
			};
		};
		ricoh619_ldo3_reg: regulator@7  {
			regulator-name = "ricoh619_ldo3";
			regulator-min-microvolt = <3300000>;
			regulator-max-microvolt = <3300000>;
			regulator-initial-state = <3>;
			regulator-state-mem {
				regulator-state-enabled;
				regulator-state-uv = <3300000>;
			};
		};
		ricoh619_ldo4_reg: regulator@8  {
			regulator-name = "vcc_sd";
			regulator-min-microvolt = <3300000>;
			regulator-max-microvolt = <3300000>;
			regulator-initial-state = <3>;
			regulator-state-mem {
				regulator-state-enabled;
				regulator-state-uv = <3300000>;
			};
		};
		ricoh619_ldo5_reg: regulator@9  {
			regulator-name = "ricoh619_ldo5";
			regulator-min-microvolt = <3300000>;
			regulator-max-microvolt = <3300000>;
			regulator-initial-state = <3>;
			regulator-state-mem {
				regulator-state-enabled;
				regulator-state-uv = <3300000>;
			};
		};
		ricoh619_ldo6_reg: regulator@10  {
			regulator-name = "ricoh619_ldo6";
			regulator-min-microvolt = <1800000>;
			regulator-max-microvolt = <1800000>;
			regulator-initial-state = <3>;
			regulator-state-mem {
				regulator-state-enabled;
				regulator-state-uv = <1800000>;
			};
		};
		ricoh619_ldo7_reg: regulator@11  {
			regulator-name = "ricoh619_ldo7";
			regulator-min-microvolt = <1000000>;
			regulator-max-microvolt = <1000000>;
			regulator-initial-state = <3>;
			regulator-state-mem {
				regulator-state-enabled;
				regulator-state-uv = <3300000>;
			};
		};
		ricoh619_ldo8_reg: regulator@12  {
			regulator-name = "ricoh619_ldo8";
			regulator-min-microvolt = <1800000>;
			regulator-max-microvolt = <1800000>;
			regulator-initial-state = <3>;
			regulator-state-mem {
				regulator-state-enabled;
				regulator-state-uv = <3300000>;
			};
		};
		ricoh619_ldo9_reg: regulator@13  {
			regulator-name = "ricoh619_ldo9";
			regulator-min-microvolt = <1000000>;
			regulator-max-microvolt = <1000000>;
			regulator-initial-state = <3>;
			regulator-state-mem {
				regulator-state-enabled;
				regulator-state-uv = <3300000>;
			};
		};
		ricoh619_ldo10_reg: regulator@14  {
			regulator-name = "ricoh619_ldo10";
			regulator-min-microvolt = <1800000>;
			regulator-max-microvolt = <1800000>;
			regulator-initial-state = <3>;
			regulator-state-mem {
				regulator-state-enabled;
				regulator-state-uv = <3300000>;
			};
		};
		ricoh619_ldortc1_reg: regulator@15  {
			regulator-name = "ricoh619_ldortc1";
			regulator-min-microvolt = < 3300000>;
			regulator-max-microvolt = <3300000>;
		};
		ricoh619_ldortc2_reg: regulator@16  {
			regulator-name = "ricoh619_ldortc2";
			regulator-min-microvolt = < 3300000>;
			regulator-max-microvolt = <3300000>;
		};
	};
};
```

## Documentation/devicetree/bindings/mfd/rk1000-core.txt
```
RK1000 Multi-functional device

The RK1000-CORE are RK1000 control register block.
The chip is connected to an i2c bus.


Required properties:
- compatible : "rockchip,rk1000-ctl"
- reg: I2C slave address
- reset-gpios : the reset pin
- clocks : phandle and clock specifier
- clock-names : "mclk"

Example:
	rk1000-ctl@40 {
		compatible = "rockchip,rk1000-ctl";
		reg = <0x40>;
		reset-gpios = <&gpio0 1 GPIO_ACTIVE_LOW>;
		clocks = <&cru SCLK_I2S_8CH_OUT>;
		clock-names = "mclk";
		pinctrl-names = "default";
		pinctrl-0 = <&i2s_8ch_bus>;
		status = "okay";
	};
```

## Documentation/devicetree/bindings/mfd/rk618.txt
```
Device-Tree bindings for Rockchip RK618 MFD driver

Required properties:
 - compatible: value should be one of the following:
   "rockchip,rk618"
 - reg: I2C device address.
 - clocks: phandle to the clkin clock provider
 - clock-names: Must be "clkin"
 - reset-gpios: a GPIO spec for the reset pin

Optional properties:
 - power-supply: regulator to provide the supply voltage
 - enable-gpios: a GPIO spec for the enable pin

Example:

&i2c5 {
	status = "okay";

	rk618: rk618@50 {
		compatible = "rockchip,rk618";
		reg = <0x50>;
		pinctrl-names = "default", "sleep";
		pinctrl-0 = <&i2s_8ch_mclk &lcdc_lcdc &state_video_phy_ttl>;
		pinctrl-1 = <&lcdc_gpio>;
		clocks = <&cru SCLK_I2S_8CH_OUT>;
		clock-names = "clkin";
		reset-gpios = <&gpio3 14 GPIO_ACTIVE_LOW>;
	};
};
```

## Documentation/devicetree/bindings/mfd/rk805.txt
```
RK805 Power Management Integrated Circuit

Required properties:
- compatible: "rockchip,rk805"
- reg: I2C slave address
- interrupt-parent: The parent interrupt controller.
- interrupts: the interrupt outputs of the controller.

Optional properties:
- rockchip,system-power-controller: Telling whether or not this pmic is controlling
  the system power.
- gpio-controller: Specifies that the node is a gpio controller when you attemp to
  use the OUT1 or OUT2 pin of RK805 by GPIO general interface.
- #gpio-cells: Should be two. The first cell is the GPIO number and the second cell
  is used to specify the GPIO polarity.
- wakeup-source: Flag to indicate this device can wake system (suspend/resume)
- vcc1-supply:  The input supply for RK805_DCDC_REG1
- vcc2-supply:  The input supply for RK805_DCDC_REG2
- vcc3-supply:  The input supply for RK805_DCDC_REG3
- vcc4-supply:  The input supply for RK805_DCDC_REG4
- vcc5-supply:  The input supply for RK805_LDO_REG1, RK805_LDO_REG2
- vcc6-supply:  The input supply for RK805_LDO_REG3

Regulators: All the regulators of RK805 to be instantiated shall be
listed in a child node named 'regulators'. Each regulator is represented
by a child node of the 'regulators' node.

	regulator-name {
		/* standard regulator bindings here */
	};

Following regulators of the RK805 PMIC block are supported. Note that
the 'n' in regulator name, as in RK805_DCDC_REGn or RK805_LDOn, represents the DCDC
or LDO number as described in RK805 datasheet.

	- RK805_DCDC_REGn
		- valid values for n are 1 to 4.
	- RK805_LDO_REGn
		- valid values for n are 1 to 3.

Standard regulator bindings are used inside regulator subnodes. Check
  Documentation/devicetree/bindings/regulator/regulator.txt
for more details

Gpio, Rtc, Pwrkey: the node are represented like below. When you attemp to enable
  the module, setting the "status" to be "okay", otherwise "disabled".

		rtc {
			status = "okay";
		};

		pwrkey {
			status = "okay";
		};

		gpio {
			status = "okay";
		};

Example:
	rk805: pmic@1c {
		compatible = "rockchip,rk805";
		status = "okay";
		reg = <0x18>;
		interrupt-parent = <&gpio2>;
		interrupts = <6 IRQ_TYPE_LEVEL_LOW>;
		pinctrl-names = "default";
		pinctrl-0 = <&pmic_int_l>;
		rockchip,system-power-controller;
		wakeup-source;
		gpio-controller;
		#gpio-cells = <2>;

		vcc1-supply = <&vcc_sys>;
		vcc2-supply = <&vcc_sys>;
		vcc3-supply = <&vcc_sys>;
		vcc4-supply = <&vcc_sys>;
		vcc5-supply = <&vcc_sys>;
		vcc6-supply = <&vcc_sys>;

		rtc {
			status = "okay";
		};

		pwrkey {
			status = "okay";
		};

		gpio {
			status = "okay";
		};

		regulators {
			compatible = "rk805-regulator";
			#address-cells = <1>;
			#size-cells = <0>;

			vdd_logic: RK805_DCDC1@0 {
				regulator-compatible = "RK805_DCDC1";
				regulator-name = "vdd_logic";
				regulator-min-microvolt = <712500>;
				regulator-max-microvolt = <1450000>;
				regulator-initial-mode = <0x1>;
				regulator-ramp-delay = <12500>;
				regulator-boot-on;
				regulator-always-on;
				regulator-state-mem {
					regulator-mode = <0x2>;
					regulator-on-in-suspend;
					regulator-suspend-microvolt = <1000000>;
				};
			};

			vdd_arm: RK805_DCDC2@1 {
				regulator-compatible = "RK805_DCDC2";
				regulator-name = "vdd_arm";
				regulator-min-microvolt = <712500>;
				regulator-max-microvolt = <1450000>;
				regulator-initial-mode = <0x1>;
				regulator-ramp-delay = <12500>;
				regulator-boot-on;
				regulator-always-on;
				regulator-state-mem {
					regulator-mode = <0x2>;
					regulator-on-in-suspend;
					regulator-suspend-microvolt = <950000>;
				};
			};

			vcc_ddr: RK805_DCDC3@2 {
				regulator-compatible = "RK805_DCDC3";
				regulator-name = "vcc_ddr";
				regulator-initial-mode = <0x1>;
				regulator-boot-on;
				regulator-always-on;
				regulator-state-mem {
					regulator-mode = <0x2>;
					regulator-on-in-suspend;
				};
			};

			vcc_io: RK805_DCDC4@3 {
				regulator-compatible = "RK805_DCDC4";
				regulator-name = "vcc_io";
				regulator-min-microvolt = <3300000>;
				regulator-max-microvolt = <3300000>;
				regulator-initial-mode = <0x1>;
				regulator-boot-on;
				regulator-always-on;
				regulator-state-mem {
					regulator-mode = <0x2>;
					regulator-on-in-suspend;
					regulator-suspend-microvolt = <3300000>;
				};
			};

			vdd_18: RK805_LDO1@4 {
				regulator-compatible = "RK805_LDO1";
				regulator-name = "vdd_18";
				regulator-min-microvolt = <1800000>;
				regulator-max-microvolt = <1800000>;
				regulator-boot-on;
				regulator-always-on;
				regulator-state-mem {
					regulator-on-in-suspend;
					regulator-suspend-microvolt = <1800000>;
				};
			};

			vcc_18emmc: RK805_LDO2@5 {
				regulator-compatible = "RK805_LDO2";
				regulator-name = "vcc_18emmc";
				regulator-min-microvolt = <1800000>;
				regulator-max-microvolt = <1800000>;
				regulator-boot-on;
				regulator-always-on;
				regulator-state-mem {
					regulator-on-in-suspend;
					regulator-suspend-microvolt = <1800000>;
				};
			};

			vdd_10: RK805_LDO3@6 {
				regulator-compatible = "RK805_LDO3";
				regulator-name = "vdd_10";
				regulator-min-microvolt = <1000000>;
				regulator-max-microvolt = <1000000>;
				regulator-boot-on;
				regulator-always-on;
				regulator-state-mem {
					regulator-on-in-suspend;
					regulator-suspend-microvolt = <1000000>;
				};
			};
		};
	};
```
