## Documentation/devicetree/bindings/mfd/rn5t618.txt
```
* Ricoh RN5T567/RN5T618 PMIC

Ricoh RN5T567/RN5T618/RC5T619 is a power management IC family which
integrates 3 to 5 step-down DCDC converters, 7 to 10 low-dropout regulators,
GPIOs, and a watchdog timer. It can be controlled through an I2C interface.
The RN5T618/RC5T619 provides additionally a Li-ion battery charger,
fuel gauge, and an ADC.
The RC5T619 additionnally includes USB charger detection and an RTC.

Required properties:
 - compatible: must be one of
		"ricoh,rn5t567"
		"ricoh,rn5t618"
		"ricoh,rc5t619"
 - reg: the I2C slave address of the device

Optional properties:
 - interrupts: interrupt mapping for IRQ
   See Documentation/devicetree/bindings/interrupt-controller/interrupts.txt
 - system-power-controller:
   See Documentation/devicetree/bindings/power/power-controller.txt

Sub-nodes:
 - regulators: the node is required if the regulator functionality is
   needed. The valid regulator names are: DCDC1, DCDC2, DCDC3, DCDC4
   (RN5T567/RC5T619), LDO1, LDO2, LDO3, LDO4, LDO5, LDO6, LDO7, LDO8,
   LDO9, LDO10, LDORTC1 and LDORTC2.
   LDO7-10 are specific to RC5T619.
   The common bindings for each individual regulator can be found in:
   Documentation/devicetree/bindings/regulator/regulator.txt

Example:

	pmic@32 {
		compatible = "ricoh,rn5t618";
		reg = <0x32>;
		interrupt-parent = <&gpio5>;
		interrupts = <11 IRQ_TYPE_EDGE_FALLING>;
		system-power-controller;

		regulators {
			DCDC1 {
				regulator-min-microvolt = <1050000>;
				regulator-max-microvolt = <1050000>;
			};

			DCDC2 {
				regulator-min-microvolt = <1175000>;
				regulator-max-microvolt = <1175000>;
			};
		};
	};
```

## Documentation/devicetree/bindings/mfd/rockchip,rk801.yaml
```yaml
# SPDX-License-Identifier: GPL-2.0-only OR BSD-2-Clause
%YAML 1.2
---
$id: http://devicetree.org/schemas/mfd/rockchip,rk801.yaml#
$schema: http://devicetree.org/meta-schemas/core.yaml#

title: RK801 Power Management Integrated Circuit

maintainers:
  - Joseph Chen <chenjh@rock-chips.com>

description: |
  Rockchip RK801 series PMIC. This device consists of an i2c controlled MFD
  that includes multiple switchable regulators.

properties:
  compatible:
    enum:
      - rockchip,rk801

  reg:
    maxItems: 1

  interrupts:
    maxItems: 1

  system-power-controller:
    type: boolean
    description:
      Telling whether or not this PMIC is controlling the system power.

  wakeup-source:
    type: boolean
    description:
      Device can be used as a wakeup source.

  vcc1-supply:
    description:
      The input supply for dcdc1.

  vcc2-supply:
    description:
      The input supply for dcdc2.

  vcc3-supply:
    description:
      The input supply for dcdc3.

  vcc4-supply:
    description:
      The input supply for dcdc4.

  vcc5-supply:
    description:
      The input supply for ldo1.

  vcc6-supply:
    description:
      The input supply for ldo2.

  vcc7-supply:
    description:
      The input supply for switch.

  regulators:
    type: object
    patternProperties:
      "^(dcdc[1-4]|ldo[1-2]|switch)$":
        type: object
        $ref: /schemas/regulator/regulator.yaml#
        unevaluatedProperties: false
    additionalProperties: false

required:
  - compatible
  - reg
  - interrupts

additionalProperties: false

examples:
  - |
    #include <dt-bindings/pinctrl/rockchip.h>
    #include <dt-bindings/interrupt-controller/irq.h>
    #include <dt-bindings/gpio/gpio.h>

    i2c {
        #address-cells = <1>;
        #size-cells = <0>;

        rk801: pmic@27 {
            compatible = "rockchip,rk801";
            reg = <0x27>;
            interrupt-parent = <&gpio0>;
            interrupts = <RK_PC0 IRQ_TYPE_LEVEL_LOW>;
            pinctrl-names = "default";
            pinctrl-0 = <&pmic_int_l>;
            system-power-controller;
            wakeup-source;

            vcc1-supply = <&vcc_sys>;
            vcc2-supply = <&vcc_sys>;
            vcc3-supply = <&vcc_sys>;
            vcc4-supply = <&vcc_sys>;
            vcc5-supply = <&vcc3v3_sys>;
            vcc6-supply = <&vcc3v3_sys>;
            vcc7-supply = <&vcc3v3_sys>;

            regulators {
                vdd_cpu: dcdc1 {
                    regulator-name = "vdd_cpu";
                    regulator-min-microvolt = <500000>;
                    regulator-max-microvolt = <1500000>;
                    regulator-initial-mode = <0x1>;
                    regulator-boot-on;
                    regulator-always-on;
                    regulator-state-mem {
                        regulator-mode = <0x2>;
                        regulator-off-in-suspend;
                        regulator-suspend-microvolt = <950000>;
                    };
                };

                vcc3v3_sys: dcdc2 {
                    regulator-name = "vcc3v3_sys";
                    regulator-min-microvolt = <3300000>;
                    regulator-max-microvolt = <3300000>;
                    regulator-initial-mode = <0x1>;
                    regulator-boot-on;
                    regulator-always-on;
                    regulator-state-mem {
                        regulator-mode = <0x2>;
                        regulator-on-in-suspend;
                        regulator-suspend-microvolt = <3300000>;
                    };
                };

                vcc_ddr: dcdc3 {
                    regulator-name = "vcc_ddr";
                    regulator-boot-on;
                    regulator-always-on;
                    regulator-state-mem {
                        regulator-mode = <0x2>;
                        regulator-on-in-suspend;
                    };
                };

                vdd_logic: dcdc4 {
                    regulator-name = "vdd_logic";
                    regulator-min-microvolt = <500000>;
                    regulator-max-microvolt = <1500000>;
                    regulator-initial-mode = <0x1>;
                    regulator-boot-on;
                    regulator-always-on;
                    regulator-state-mem {
                        regulator-mode = <0x2>;
                        regulator-off-in-suspend;
                        regulator-suspend-microvolt = <900000>;
                    };
                };

                vdd0v9_sys: ldo1 {
                    regulator-name = "vdd0v9_sys";
                    regulator-min-microvolt = <900000>;
                    regulator-max-microvolt = <900000>;
                    regulator-boot-on;
                    regulator-always-on;
                    regulator-state-mem {
                        regulator-off-in-suspend;
                        regulator-suspend-microvolt = <900000>;
                    };
                };

                vcc_1v8: ldo2 {
                    regulator-name = "vcc_1v8";
                    regulator-min-microvolt = <1800000>;
                    regulator-max-microvolt = <1800000>;
                    regulator-boot-on;
                    regulator-always-on;
                    regulator-state-mem {
                        regulator-off-in-suspend;
                        regulator-suspend-microvolt = <1800000>;
                    };
                };

                vcc_3v3: switch {
                    regulator-name = "vcc_3v3";
                    regulator-boot-on;
                    regulator-always-on;
                    regulator-state-mem {
                        regulator-off-in-suspend;
                        regulator-suspend-microvolt = <3300000>;
                    };
                };
            };
        };
    };
```

## Documentation/devicetree/bindings/mfd/rockchip,rk805.yaml
```yaml
# SPDX-License-Identifier: GPL-2.0-only OR BSD-2-Clause
%YAML 1.2
---
$id: http://devicetree.org/schemas/mfd/rockchip,rk805.yaml#
$schema: http://devicetree.org/meta-schemas/core.yaml#

title: RK805 Power Management Integrated Circuit

maintainers:
  - Chris Zhong <zyw@rock-chips.com>
  - Zhang Qing <zhangqing@rock-chips.com>

description: |
  Rockchip RK805 series PMIC. This device consists of an i2c controlled MFD
  that includes multiple switchable regulators.

properties:
  compatible:
    enum:
      - rockchip,rk805

  reg:
    maxItems: 1

  interrupts:
    maxItems: 1

  '#clock-cells':
    description:
      See <dt-bindings/clock/rockchip,rk808.h> for clock IDs.
    minimum: 0
    maximum: 1

  clock-output-names:
    description:
      From common clock binding to override the default output clock name.

  gpio-controller: true

  '#gpio-cells':
    const: 2

  rockchip,system-power-controller:
    type: boolean
    deprecated: true
    description:
      Telling whether or not this PMIC is controlling the system power.

  system-power-controller: true

  wakeup-source:
    type: boolean
    description:
      Device can be used as a wakeup source.

  vcc1-supply:
    description:
      The input supply for DCDC_REG1.

  vcc2-supply:
    description:
      The input supply for DCDC_REG2.

  vcc3-supply:
    description:
      The input supply for DCDC_REG3.

  vcc4-supply:
    description:
      The input supply for DCDC_REG4.

  vcc5-supply:
    description:
      The input supply for LDO_REG1 and LDO_REG2.

  vcc6-supply:
    description:
      The input supply for LDO_REG3.

  regulators:
    type: object
    patternProperties:
      "^(DCDC_REG[1-4]|LDO_REG[1-3])$":
        type: object
        $ref: /schemas/regulator/regulator.yaml#
        unevaluatedProperties: false
    unevaluatedProperties: false

allOf:
  - if:
      properties:
        '#clock-cells':
          const: 0

    then:
      properties:
        clock-output-names:
          maxItems: 1

    else:
      properties:
        clock-output-names:
          maxItems: 2

required:
  - compatible
  - reg
  - interrupts
  - "#clock-cells"

additionalProperties: false

examples:
  - |
    #include <dt-bindings/pinctrl/rockchip.h>
    #include <dt-bindings/interrupt-controller/irq.h>
    #include <dt-bindings/gpio/gpio.h>
    i2c {
        #address-cells = <1>;
        #size-cells = <0>;

        pmic@18 {
            compatible = "rockchip,rk805";
            reg = <0x18>;
            interrupt-parent = <&gpio2>;
            interrupts = <RK_PA6 IRQ_TYPE_LEVEL_LOW>;
            pinctrl-names = "default";
            pinctrl-0 = <&pmic_int_l>;
            rockchip,system-power-controller;
            wakeup-source;
            #clock-cells = <0>;

            vcc1-supply = <&vcc_sys>;
            vcc2-supply = <&vcc_sys>;
            vcc3-supply = <&vcc_sys>;
            vcc4-supply = <&vcc_sys>;
            vcc5-supply = <&vcc_io>;
            vcc6-supply = <&vcc_io>;

            regulators {
                vdd_logic: DCDC_REG1 {
                    regulator-name = "vdd_logic";
                    regulator-min-microvolt = <700000>;
                    regulator-max-microvolt = <1350000>;
                    regulator-always-on;
                    regulator-boot-on;
                    regulator-state-mem {
                        regulator-on-in-suspend;
                        regulator-suspend-microvolt = <1000000>;
                    };
                };

                vdd_arm: DCDC_REG2 {
                    regulator-name = "vdd_arm";
                    regulator-min-microvolt = <700000>;
                    regulator-max-microvolt = <1350000>;
                    regulator-always-on;
                    regulator-boot-on;
                    regulator-state-mem {
                        regulator-on-in-suspend;
                        regulator-suspend-microvolt = <950000>;
                    };
                };

                vcc_ddr: DCDC_REG3 {
                    regulator-name = "vcc_ddr";
                    regulator-always-on;
                    regulator-boot-on;
                    regulator-state-mem {
                        regulator-on-in-suspend;
                    };
                };

                vcc_io: DCDC_REG4 {
                    regulator-name = "vcc_io";
                    regulator-min-microvolt = <3300000>;
                    regulator-max-microvolt = <3300000>;
                    regulator-always-on;
                    regulator-boot-on;
                    regulator-state-mem {
                        regulator-on-in-suspend;
                        regulator-suspend-microvolt = <3300000>;
                    };
                };

                vdd_18: LDO_REG1 {
                    regulator-name = "vdd_18";
                    regulator-min-microvolt = <1800000>;
                    regulator-max-microvolt = <1800000>;
                    regulator-always-on;
                    regulator-boot-on;
                    regulator-state-mem {
                        regulator-on-in-suspend;
                        regulator-suspend-microvolt = <1800000>;
                    };
                };

                vcc18_emmc: LDO_REG2 {
                    regulator-name = "vcc_18emmc";
                    regulator-min-microvolt = <1800000>;
                    regulator-max-microvolt = <1800000>;
                    regulator-always-on;
                    regulator-boot-on;
                    regulator-state-mem {
                        regulator-on-in-suspend;
                        regulator-suspend-microvolt = <1800000>;
                    };
                };

                vdd_11: LDO_REG3 {
                    regulator-name = "vdd_11";
                    regulator-min-microvolt = <1100000>;
                    regulator-max-microvolt = <1100000>;
                    regulator-always-on;
                    regulator-boot-on;
                    regulator-state-mem {
                        regulator-on-in-suspend;
                        regulator-suspend-microvolt = <1100000>;
                    };
                };
            };
        };
    };
```
