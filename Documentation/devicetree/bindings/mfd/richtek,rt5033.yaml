## Documentation/devicetree/bindings/mfd/richtek,rt5033.yaml
```yaml
# SPDX-License-Identifier: (GPL-2.0 OR BSD-2-Clause)
%YAML 1.2
---
$id: http://devicetree.org/schemas/mfd/richtek,rt5033.yaml#
$schema: http://devicetree.org/meta-schemas/core.yaml#

title: Richtek RT5033 Power Management Integrated Circuit

maintainers:
  - Jakob Hauser <jahau@rocketmail.com>

description:
  RT5033 is a multifunction device which includes battery charger, fuel gauge,
  flash LED current source, LDO and synchronous Buck converter for portable
  applications. It is interfaced to host controller using I2C interface. The
  battery fuel gauge uses a separate I2C bus.

properties:
  compatible:
    const: richtek,rt5033

  reg:
    maxItems: 1

  interrupts:
    maxItems: 1

  regulators:
    description:
      The regulators of RT5033 have to be instantiated under a sub-node named
      "regulators". For SAFE_LDO voltage there is only one value of 4.9 V. LDO
      voltage ranges from 1.2 V to 3.0 V in 0.1 V steps. BUCK voltage ranges
      from 1.0 V to 3.0 V in 0.1 V steps.
    type: object
    patternProperties:
      "^(SAFE_LDO|LDO|BUCK)$":
        type: object
        $ref: /schemas/regulator/regulator.yaml#
        unevaluatedProperties: false
    additionalProperties: false

  charger:
    type: object
    $ref: /schemas/power/supply/richtek,rt5033-charger.yaml#

required:
  - compatible
  - reg
  - interrupts

additionalProperties: false

examples:
  - |
    #include <dt-bindings/interrupt-controller/irq.h>

    battery: battery {
        compatible = "simple-battery";
        precharge-current-microamp = <450000>;
        constant-charge-current-max-microamp = <1000000>;
        charge-term-current-microamp = <150000>;
        precharge-upper-limit-microvolt = <3500000>;
        constant-charge-voltage-max-microvolt = <4350000>;
    };

    extcon {
        usb_con: connector {
            compatible = "usb-b-connector";
            label = "micro-USB";
            type = "micro";
        };
    };

    i2c {
        #address-cells = <1>;
        #size-cells = <0>;

        i2c@0 {
            #address-cells = <1>;
            #size-cells = <0>;
            reg = <0>;

            fuel-gauge@35 {
                compatible = "richtek,rt5033-battery";
                reg = <0x35>;

                interrupt-parent = <&msmgpio>;
                interrupts = <121 IRQ_TYPE_EDGE_FALLING>;

                pinctrl-names = "default";
                pinctrl-0 = <&fg_alert_default>;

                power-supplies = <&rt5033_charger>;
            };
        };

        i2c@1 {
            #address-cells = <1>;
            #size-cells = <0>;
            reg = <1>;

            pmic@34 {
                compatible = "richtek,rt5033";
                reg = <0x34>;

                interrupt-parent = <&msmgpio>;
                interrupts = <62 IRQ_TYPE_EDGE_FALLING>;

                pinctrl-names = "default";
                pinctrl-0 = <&pmic_int_default>;

                regulators {
                    safe_ldo_reg: SAFE_LDO {
                        regulator-name = "SAFE_LDO";
                        regulator-min-microvolt = <4900000>;
                        regulator-max-microvolt = <4900000>;
                        regulator-always-on;
                    };
                    ldo_reg: LDO {
                        regulator-name = "LDO";
                        regulator-min-microvolt = <2800000>;
                        regulator-max-microvolt = <2800000>;
                    };
                    buck_reg: BUCK {
                        regulator-name = "BUCK";
                        regulator-min-microvolt = <1200000>;
                        regulator-max-microvolt = <1200000>;
                    };
                };

                rt5033_charger: charger {
                    compatible = "richtek,rt5033-charger";
                    monitored-battery = <&battery>;
                    richtek,usb-connector = <&usb_con>;
                };
            };
        };
    };
```

## Documentation/devicetree/bindings/mfd/richtek,rt5120.yaml
```yaml
# SPDX-License-Identifier: GPL-2.0-only OR BSD-2-Clause
%YAML 1.2
---
$id: http://devicetree.org/schemas/mfd/richtek,rt5120.yaml#
$schema: http://devicetree.org/meta-schemas/core.yaml#

title: Richtek RT5120 PMIC

maintainers:
  - ChiYuan Huang <cy_huang@richtek.com>

description: |
  The RT5120 provides four high-efficiency buck converters and one LDO voltage
  regulator. The device is targeted at providingthe processor voltage, memory,
  I/O, and peripheral rails in home entertainment devices. The I2C interface is
  used for dynamic voltage scaling of the processor voltage, power rails on/off
  sequence control, operation mode selection.

properties:
  compatible:
    enum:
      - richtek,rt5120

  reg:
    maxItems: 1

  interrupts:
    maxItems: 1

  interrupt-controller: true

  "#interrupt-cells":
    const: 1

  wakeup-source: true

  richtek,enable-undervolt-hiccup:
    type: boolean
    description: |
      If used, under voltage protection trigger hiccup behavior, else latchup as
      default

  richtek,enable-overvolt-hiccup:
    type: boolean
    description:
      Like as 'enable-uv-hiccup', it configures over voltage protection to
      hiccup, else latchup as default

  vin1-supply:
    description: phandle for buck1 input power source

  vin2-supply:
    description: phandle for buck2 input power source

  vin3-supply:
    description: phandle for buck3 input power source

  vin4-supply:
    description: phandle for buck4 input power source

  vinldo-supply:
    description: phandle for ldo input power source

  regulators:
    type: object

    patternProperties:
      "^buck[1-4]$":
        type: object
        $ref: /schemas/regulator/regulator.yaml#
        unevaluatedProperties: false

        properties:
          regulator-allowed-modes:
            description: |
              Used to specify the allowed buck converter operating mode
              mode mapping:
                0: auto mode
                1: force pwm mode
            items:
              enum: [0, 1]

      "^(ldo|exten)$":
        type: object
        $ref: /schemas/regulator/regulator.yaml#
        unevaluatedProperties: false

    additionalProperties: false

  powerkey:
    type: object
    description:
      PON key that connected to RT5120 PMIC.

    properties:
      compatible:
        enum:
          - richtek,rt5120-pwrkey

    required:
      - compatible

    additionalProperties: false

required:
  - compatible
  - reg
  - interrupts
  - '#interrupt-cells'
  - interrupt-controller
  - regulators
  - powerkey

additionalProperties: false

examples:
  - |
    #include <dt-bindings/interrupt-controller/irq.h>

    i2c {
      #address-cells = <1>;
      #size-cells = <0>;

      pmic@62 {
        compatible = "richtek,rt5120";
        reg = <0x62>;
        interrupts-extended = <&gpio_intc 32 IRQ_TYPE_LEVEL_LOW>;
        interrupt-controller;
        #interrupt-cells = <1>;
        wakeup-source;

        regulators {
          buck1 {
            regulator-name = "rt5120-buck1";
            regulator-min-microvolt = <600000>;
            regulator-max-microvolt = <1393750>;
            regulator-allowed-modes = <0 1>;
            regulator-boot-on;
          };
          buck2 {
            regulator-name = "rt5120-buck2";
            regulator-min-microvolt = <1100000>;
            regulator-max-microvolt = <1100000>;
            regulator-allowed-modes = <0 1>;
            regulator-always-on;
          };
          buck3 {
            regulator-name = "rt5120-buck3";
            regulator-min-microvolt = <1800000>;
            regulator-max-microvolt = <1800000>;
            regulator-allowed-modes = <0 1>;
            regulator-always-on;
          };
          buck4 {
            regulator-name = "rt5120-buck4";
            regulator-min-microvolt = <3300000>;
            regulator-max-microvolt = <3300000>;
            regulator-allowed-modes = <0 1>;
            regulator-always-on;
          };
          ldo {
            regulator-name = "rt5120-ldo";
            regulator-min-microvolt = <1800000>;
            regulator-max-microvolt = <1800000>;
            regulator-always-on;
          };
          exten {
            regulator-name = "rt5120-exten";
            regulator-min-microvolt = <3000000>;
            regulator-max-microvolt = <3000000>;
            regulator-always-on;
          };
        };
        powerkey {
          compatible = "richtek,rt5120-pwrkey";
        };
      };
    };
```

## Documentation/devicetree/bindings/mfd/ricoh,rn5t618.yaml
```yaml
# SPDX-License-Identifier: GPL-2.0
%YAML 1.2
---
$id: http://devicetree.org/schemas/mfd/ricoh,rn5t618.yaml#
$schema: http://devicetree.org/meta-schemas/core.yaml#

title: Ricoh RN5T567/RN5T618/RC5T619 PMIC

maintainers:
  - Andreas Kemnade <andreas@kemnade.info>

description: |
  Ricoh RN5T567/RN5T618/RC5T619 is a power management IC family which
  integrates 3 to 5 step-down DCDC converters, 7 to 10 low-dropout regulators,
  GPIOs, and a watchdog timer. It can be controlled through an I2C interface.
  The RN5T618/RC5T619 provides additionally a Li-ion battery charger,
  fuel gauge, and an ADC.
  The RC5T619 additionally includes USB charger detection and an RTC.

allOf:
  - if:
      properties:
        compatible:
          contains:
            const: ricoh,rn5t567
    then:
      properties:
        regulators:
          patternProperties:
            "^(DCDC[1-4]|LDO[1-5]|LDORTC[12])$":
              $ref: /schemas/regulator/regulator.yaml
          additionalProperties: false
  - if:
      properties:
        compatible:
          contains:
            const: ricoh,rn5t618
    then:
      properties:
        regulators:
          patternProperties:
            "^(DCDC[1-3]|LDO[1-5]|LDORTC[12])$":
              $ref: /schemas/regulator/regulator.yaml
          additionalProperties: false
  - if:
      properties:
        compatible:
          contains:
            const: ricoh,rc5t619
    then:
      properties:
        regulators:
          patternProperties:
            "^(DCDC[1-5]|LDO[1-9]|LDO10|LDORTC[12])$":
              $ref: /schemas/regulator/regulator.yaml
          additionalProperties: false

properties:
  compatible:
    enum:
      - ricoh,rn5t567
      - ricoh,rn5t618
      - ricoh,rc5t619

  reg:
    maxItems: 1

  interrupts:
    maxItems: 1

  system-power-controller:
    type: boolean
    description: |
      See Documentation/devicetree/bindings/power/power-controller.txt

  regulators:
    type: object

additionalProperties: false

required:
  - compatible
  - reg

examples:
  - |
    #include <dt-bindings/interrupt-controller/irq.h>
    i2c {
      #address-cells = <1>;
      #size-cells = <0>;

      pmic@32 {
        compatible = "ricoh,rn5t618";
        reg = <0x32>;
        interrupt-parent = <&gpio5>;
        interrupts = <11 IRQ_TYPE_EDGE_FALLING>;
        system-power-controller;

        regulators {
          DCDC1 {
            regulator-min-microvolt = <1050000>;
            regulator-max-microvolt = <1050000>;
          };

          DCDC2 {
            regulator-min-microvolt = <1175000>;
            regulator-max-microvolt = <1175000>;
          };
        };
      };
    };
```
