## Documentation/devicetree/bindings/video/rockchip_mpp.txt
```
Device-Tree bindings for Rockchip MPP Service.

Required properties:
- compatible: the value must be "rockchip,mpp-service"

- rockchip,taskqueue-count: the value of queue nodes for task running
	the value must be between 1 and 8

- rockchip,resetgroup-count: the value of reset clk groups for device reset
	the value must be between 1 and 8

Example:
	mpp_srv: mpp_srv {
		compatible = "rockchip,mpp-service";
		rockchip,taskqueue-count = <1>;
		rockchip,resetgroup-count = <1>;
		status = "disabled";
	};
```

## Documentation/devicetree/bindings/video/rockchip_rga.txt
```
device-tree bindings for rockchip 2D raster graphic acceleration controller (RGA)

RGA is a standalone 2D raster graphic acceleration unit. It accelerates 2D
graphics operations, such as point/line drawing, image scaling, rotation,
BitBLT, alpha blending and image blur/sharpness.

Required properties:
- compatible: value should be one of the following
		"rockchip,rga2";
		"rockchip,rk312x-rga";

- interrupts: RGA interrupt specifier.

- clocks: phandle to RGA sclk/hclk/aclk clocks

- clock-names: should be "aclk", "hclk" and "sclk"

- status: the dsi host status;
	<disabled>: open the dsi host;
	<okay>:close the dsi host;

Optional Properties:
- dma-coherent: When import dma_buf to rga driver, dma_map_sg will always do cpu cache sync, it cause low performance.Actually we don't want to do cpu cache sync on this context,So set rga device with dma-coherent to skip cpu cache sync.

Example:
SoC-specific DT entry:
	rga: rga@ff680000 {
		compatible = "rockchip,rga2";
		reg = <0xff680000 0x10000>;
		interrupts = <GIC_SPI 55 IRQ_TYPE_LEVEL_HIGH>;
		clocks = <&cru ACLK_RGA>, <&cru HCLK_RGA>, <&cru SCLK_RGA_CORE>;
		clock-names = "aclk", "hclk", "sclk";
		dma-coherent;
		status = "disabled";
	};
```

## Documentation/devicetree/bindings/video/samsung-fimd.txt
```
Device-Tree bindings for Samsung SoC display controller (FIMD)

FIMD (Fully Interactive Mobile Display) is the Display Controller for the
Samsung series of SoCs which transfers the image data from a video memory
buffer to an external LCD interface.

Required properties:
- compatible: value should be one of the following
		"samsung,s3c2443-fimd"; /* for S3C24XX SoCs */
		"samsung,s3c6400-fimd"; /* for S3C64XX SoCs */
		"samsung,s5pv210-fimd"; /* for S5PV210 SoC */
		"samsung,exynos4210-fimd"; /* for Exynos4 SoCs */
		"samsung,exynos5250-fimd"; /* for Exynos5 SoCs */

- reg: physical base address and length of the FIMD registers set.

- interrupt-parent: should be the phandle of the fimd controller's
		parent interrupt controller.

- interrupts: should contain a list of all FIMD IP block interrupts in the
		 order: FIFO Level, VSYNC, LCD_SYSTEM. The interrupt specifier
		 format depends on the interrupt controller used.

- interrupt-names: should contain the interrupt names: "fifo", "vsync",
	"lcd_sys", in the same order as they were listed in the interrupts
        property.

- pinctrl-0: pin control group to be used for this controller.

- pinctrl-names: must contain a "default" entry.

- clocks: must include clock specifiers corresponding to entries in the
         clock-names property.

- clock-names: list of clock names sorted in the same order as the clocks
               property. Must contain "sclk_fimd" and "fimd".

Optional Properties:
- samsung,power-domain: a phandle to FIMD power domain node.
- samsung,invert-vden: video enable signal is inverted
- samsung,invert-vclk: video clock signal is inverted
- display-timings: timing settings for FIMD, as described in document [1].
		Can be used in case timings cannot be provided otherwise
		or to override timings provided by the panel.

The device node can contain 'port' child nodes according to the bindings defined
in [2]. The following are properties specific to those nodes:
- reg: (required) port index, can be:
		0 - for CAMIF0 input,
		1 - for CAMIF1 input,
		2 - for CAMIF2 input,
		3 - for parallel output,
		4 - for write-back interface

[1]: Documentation/devicetree/bindings/video/display-timing.txt
[2]: Documentation/devicetree/bindings/media/video-interfaces.txt

Example:

SoC specific DT entry:

	fimd@11c00000 {
		compatible = "samsung,exynos4210-fimd";
		interrupt-parent = <&combiner>;
		reg = <0x11c00000 0x20000>;
		interrupt-names = "fifo", "vsync", "lcd_sys";
		interrupts = <11 0>, <11 1>, <11 2>;
		clocks = <&clock 140>, <&clock 283>;
		clock-names = "sclk_fimd", "fimd";
		samsung,power-domain = <&pd_lcd0>;
		status = "disabled";
	};

Board specific DT entry:

	fimd@11c00000 {
		pinctrl-0 = <&lcd_clk &lcd_data24 &pwm1_out>;
		pinctrl-names = "default";
		status = "okay";
	};
```

## Documentation/devicetree/bindings/video/simple-framebuffer-sunxi.txt
```
Sunxi specific Simple Framebuffer bindings

This binding documents sunxi specific extensions to the simple-framebuffer
bindings. The sunxi simplefb u-boot code relies on the devicetree containing
pre-populated simplefb nodes.

These extensions are intended so that u-boot can select the right node based
on which pipeline is being used. As such they are solely intended for
firmware / bootloader use, and the OS should ignore them.

Required properties:
- compatible: "allwinner,simple-framebuffer"
- allwinner,pipeline, one of:
  "de_be0-lcd0"
  "de_be1-lcd1"
  "de_be0-lcd0-hdmi"
  "de_be1-lcd1-hdmi"

Example:

chosen {
	#address-cells = <1>;
	#size-cells = <1>;
	ranges;

	framebuffer@0 {
		compatible = "allwinner,simple-framebuffer", "simple-framebuffer";
		allwinner,pipeline = "de_be0-lcd0-hdmi";
		clocks = <&pll5 1>, <&ahb_gates 36>, <&ahb_gates 43>,
			 <&ahb_gates 44>;
		status = "disabled";
	};
};
```

## Documentation/devicetree/bindings/video/simple-framebuffer.txt
```
Simple Framebuffer

A simple frame-buffer describes a frame-buffer setup by firmware or
the bootloader, with the assumption that the display hardware has already
been set up to scan out from the memory pointed to by the reg property.

Required properties:
- compatible: "simple-framebuffer"
- reg: Should contain the location and size of the framebuffer memory.
- width: The width of the framebuffer in pixels.
- height: The height of the framebuffer in pixels.
- stride: The number of bytes in each line of the framebuffer.
- format: The format of the framebuffer surface. Valid values are:
  - r5g6b5 (16-bit pixels, d[15:11]=r, d[10:5]=g, d[4:0]=b).
  - a8b8g8r8 (32-bit pixels, d[31:24]=a, d[23:16]=b, d[15:8]=g, d[7:0]=r).

Optional properties:
- clocks : List of clocks used by the framebuffer. Clocks listed here
           are expected to already be configured correctly. The OS must
           ensure these clocks are not modified or disabled while the
           simple framebuffer remains active.

Example:

	framebuffer {
		compatible = "simple-framebuffer";
		reg = <0x1d385000 (1600 * 1200 * 2)>;
		width = <1600>;
		height = <1200>;
		stride = <(1600 * 2)>;
		format = "r5g6b5";
	};
```

## Documentation/devicetree/bindings/video/ssd1289fb.txt
```
* Solomon SSD1289 Framebuffer Driver

Required properties:
  - compatible: Should be "solomon,ssd1289fb". The only supported bus for
    now is lbc.
  - reg: Should contain address of the controller on the LBC bus. The detail
    was described in Documentation/devicetree/bindings/powerpc/fsl/lbc.txt

Examples:
display@2,0 {
	compatible = "solomon,ssd1289fb";
	reg = <0x2 0x0000 0x0004>;
};
```

## Documentation/devicetree/bindings/video/ssd1307fb.txt
```
* Solomon SSD1307 Framebuffer Driver

Required properties:
  - compatible: Should be "solomon,<chip>fb-<bus>". The only supported bus for
    now is i2c, and the supported chips are ssd1305, ssd1306 and ssd1307.
  - reg: Should contain address of the controller on the I2C bus. Most likely
         0x3c or 0x3d
  - pwm: Should contain the pwm to use according to the OF device tree PWM
         specification [0]. Only required for the ssd1307.
  - reset-gpios: Should contain the GPIO used to reset the OLED display
  - solomon,height: Height in pixel of the screen driven by the controller
  - solomon,width: Width in pixel of the screen driven by the controller
  - solomon,page-offset: Offset of pages (band of 8 pixels) that the screen is
    mapped to.

Optional properties:
  - reset-active-low: Is the reset gpio is active on physical low?
  - solomon,segment-no-remap: Display needs normal (non-inverted) data column
                              to segment mapping
  - solomon,com-seq: Display uses sequential COM pin configuration
  - solomon,com-lrremap: Display uses left-right COM pin remap
  - solomon,com-invdir: Display uses inverted COM pin scan direction
  - solomon,com-offset: Number of the COM pin wired to the first display line
  - solomon,prechargep1: Length of deselect period (phase 1) in clock cycles.
  - solomon,prechargep2: Length of precharge period (phase 2) in clock cycles.
                         This needs to be the higher, the higher the capacitance
                         of the OLED's pixels is

[0]: Documentation/devicetree/bindings/pwm/pwm.txt

Examples:
ssd1307: oled@3c {
        compatible = "solomon,ssd1307fb-i2c";
        reg = <0x3c>;
        pwms = <&pwm 4 3000>;
        reset-gpios = <&gpio2 7>;
        reset-active-low;
};

ssd1306: oled@3c {
        compatible = "solomon,ssd1306fb-i2c";
        reg = <0x3c>;
        pwms = <&pwm 4 3000>;
        reset-gpios = <&gpio2 7>;
        reset-active-low;
        solomon,com-lrremap;
        solomon,com-invdir;
        solomon,com-offset = <32>;
};
```

## Documentation/devicetree/bindings/video/ti,dra7-dss.txt
```
Texas Instruments DRA7x Display Subsystem
=========================================

See Documentation/devicetree/bindings/video/ti,omap-dss.txt for generic
description about OMAP Display Subsystem bindings.

DSS Core
--------

Required properties:
- compatible: "ti,dra7-dss"
- reg: address and length of the register spaces for 'dss'
- ti,hwmods: "dss_core"
- clocks: handle to fclk
- clock-names: "fck"
- syscon: phandle to control module core syscon node

Optional properties:

Some DRA7xx SoCs have one dedicated video PLL, some have two. These properties
can be used to describe the video PLLs:

- reg: address and length of the register spaces for 'pll1_clkctrl',
  'pll1', 'pll2_clkctrl', 'pll2'
- clocks: handle to video1 pll clock and video2 pll clock
- clock-names: "video1_clk" and "video2_clk"

Required nodes:
- DISPC

Optional nodes:
- DSS Submodules: HDMI
- Video port for DPI output

DPI Endpoint required properties:
- data-lines: number of lines used


DISPC
-----

Required properties:
- compatible: "ti,dra7-dispc"
- reg: address and length of the register space
- ti,hwmods: "dss_dispc"
- interrupts: the DISPC interrupt
- clocks: handle to fclk
- clock-names: "fck"

HDMI
----

Required properties:
- compatible: "ti,dra7-hdmi"
- reg: addresses and lengths of the register spaces for 'wp', 'pll', 'phy',
       'core'
- reg-names: "wp", "pll", "phy", "core"
- interrupts: the HDMI interrupt line
- ti,hwmods: "dss_hdmi"
- vdda-supply: vdda power supply
- clocks: handles to fclk and pll clock
- clock-names: "fck", "sys_clk"

Optional nodes:
- Video port for HDMI output

HDMI Endpoint optional properties:
- lanes: list of 8 pin numbers for the HDMI lanes: CLK+, CLK-, D0+, D0-,
  D1+, D1-, D2+, D2-. (default: 0,1,2,3,4,5,6,7)
```

## Documentation/devicetree/bindings/video/ti,omap3-dss.txt
```
Texas Instruments OMAP3 Display Subsystem
=========================================

See Documentation/devicetree/bindings/video/ti,omap-dss.txt for generic
description about OMAP Display Subsystem bindings.

DSS Core
--------

Required properties:
- compatible: "ti,omap3-dss"
- reg: address and length of the register space
- ti,hwmods: "dss_core"
- clocks: handle to fclk
- clock-names: "fck"

Optional nodes:
- Video ports:
	- Port 0: DPI output
	- Port 1: SDI output

DPI Endpoint required properties:
- data-lines: number of lines used

SDI Endpoint required properties:
- datapairs: number of datapairs used


DISPC
-----

Required properties:
- compatible: "ti,omap3-dispc"
- reg: address and length of the register space
- ti,hwmods: "dss_dispc"
- interrupts: the DISPC interrupt
- clocks: handle to fclk
- clock-names: "fck"


RFBI
----

Required properties:
- compatible: "ti,omap3-rfbi"
- reg: address and length of the register space
- ti,hwmods: "dss_rfbi"
- clocks: handles to fclk and iclk
- clock-names: "fck", "ick"


VENC
----

Required properties:
- compatible: "ti,omap3-venc"
- reg: address and length of the register space
- ti,hwmods: "dss_venc"
- vdda-supply: power supply for DAC
- clocks: handle to fclk
- clock-names: "fck"

VENC Endpoint required properties:
- ti,invert-polarity: invert the polarity of the video signal
- ti,channels: 1 for composite, 2 for s-video


DSI
---

Required properties:
- compatible: "ti,omap3-dsi"
- reg: addresses and lengths of the register spaces for 'proto', 'phy' and 'pll'
- reg-names: "proto", "phy", "pll"
- interrupts: the DSI interrupt line
- ti,hwmods: "dss_dsi1"
- vdd-supply: power supply for DSI
- clocks: handles to fclk and pll clock
- clock-names: "fck", "sys_clk"

DSI Endpoint required properties:
- lanes: list of pin numbers for the DSI lanes: CLK+, CLK-, DATA0+, DATA0-,
  DATA1+, DATA1-, ...
```

## Documentation/devicetree/bindings/video/ti,omap5-dss.txt
```
Texas Instruments OMAP5 Display Subsystem
=========================================

See Documentation/devicetree/bindings/video/ti,omap-dss.txt for generic
description about OMAP Display Subsystem bindings.

DSS Core
--------

Required properties:
- compatible: "ti,omap5-dss"
- reg: address and length of the register space
- ti,hwmods: "dss_core"
- clocks: handle to fclk
- clock-names: "fck"

Required nodes:
- DISPC

Optional nodes:
- DSS Submodules: RFBI, DSI, HDMI
- Video port for DPI output

DPI Endpoint required properties:
- data-lines: number of lines used


DISPC
-----

Required properties:
- compatible: "ti,omap5-dispc"
- reg: address and length of the register space
- ti,hwmods: "dss_dispc"
- interrupts: the DISPC interrupt
- clocks: handle to fclk
- clock-names: "fck"


RFBI
----

Required properties:
- compatible: "ti,omap5-rfbi"
- reg: address and length of the register space
- ti,hwmods: "dss_rfbi"
- clocks: handles to fclk and iclk
- clock-names: "fck", "ick"

Optional nodes:
- Video port for RFBI output
- RFBI controlled peripherals


DSI
---

Required properties:
- compatible: "ti,omap5-dsi"
- reg: addresses and lengths of the register spaces for 'proto', 'phy' and 'pll'
- reg-names: "proto", "phy", "pll"
- interrupts: the DSI interrupt line
- ti,hwmods: "dss_dsi1" or "dss_dsi2"
- vdd-supply: power supply for DSI
- clocks: handles to fclk and pll clock
- clock-names: "fck", "sys_clk"

Optional nodes:
- Video port for DSI output
- DSI controlled peripherals

DSI Endpoint required properties:
- lanes: list of pin numbers for the DSI lanes: CLK+, CLK-, DATA0+, DATA0-,
  DATA1+, DATA1-, ...


HDMI
----

Required properties:
- compatible: "ti,omap5-hdmi"
- reg: addresses and lengths of the register spaces for 'wp', 'pll', 'phy',
       'core'
- reg-names: "wp", "pll", "phy", "core"
- interrupts: the HDMI interrupt line
- ti,hwmods: "dss_hdmi"
- vdda-supply: vdda power supply
- clocks: handles to fclk and pll clock
- clock-names: "fck", "sys_clk"

Optional nodes:
- Video port for HDMI output

HDMI Endpoint optional properties:
- lanes: list of 8 pin numbers for the HDMI lanes: CLK+, CLK-, D0+, D0-,
  D1+, D1-, D2+, D2-. (default: 0,1,2,3,4,5,6,7)
```
