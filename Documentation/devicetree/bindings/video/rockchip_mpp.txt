## Documentation/devicetree/bindings/video/ti,tpd12s015.txt
```
TPD12S015 HDMI level shifter and ESD protection chip
====================================================

Required properties:
- compatible: "ti,tpd12s015"

Optional properties:
- gpios: CT CP HPD, LS OE and HPD gpios

Required nodes:
- Video port 0 for HDMI input
- Video port 1 for HDMI output

Example
-------

tpd12s015: encoder@1 {
	compatible = "ti,tpd12s015";

	gpios = <&gpio2 28 GPIO_ACTIVE_HIGH>,	/* 60, CT CP HPD */
		<&gpio2 9 GPIO_ACTIVE_HIGH>,	/* 41, LS OE */
		<&gpio2 31 GPIO_ACTIVE_HIGH>;	/* 63, HPD */

	ports {
		#address-cells = <1>;
		#size-cells = <0>;

		port@0 {
			reg = <0>;

			tpd12s015_in: endpoint@0 {
				remote-endpoint = <&hdmi_out>;
			};
		};

		port@1 {
			reg = <1>;

			tpd12s015_out: endpoint@0 {
				remote-endpoint = <&hdmi_connector_in>;
			};
		};
	};
};
```

## Documentation/devicetree/bindings/video/tpo,td043mtea1.txt
```
TPO TD043MTEA1 Panel
====================

Required properties:
- compatible: "tpo,td043mtea1"
- reset-gpios: panel reset gpio

Optional properties:
- label: a symbolic name for the panel

Required nodes:
- Video port for DPI input

Example
-------

lcd-panel: panel@0 {
	compatible = "tpo,td043mtea1";
	reg = <0>;
	spi-max-frequency = <100000>;
	spi-cpol;
	spi-cpha;

	label = "lcd";

	reset-gpios = <&gpio7 7 0>;

	port {
		lcd_in: endpoint {
			remote-endpoint = <&dpi_out>;
		};
	};
};
```

## Documentation/devicetree/bindings/video/via,vt8500-fb.txt
```
VIA VT8500 Framebuffer
-----------------------------------------------------

Required properties:
- compatible : "via,vt8500-fb"
- reg : Should contain 1 register ranges(address and length)
- interrupts : framebuffer controller interrupt
- bits-per-pixel : bit depth of framebuffer (16 or 32)

Required subnodes:
- display-timings: see display-timing.txt for information

Example:

	fb@d8050800 {
		compatible = "via,vt8500-fb";
		reg = <0xd800e400 0x400>;
		interrupts = <12>;
		bits-per-pixel = <16>;

		display-timings {
			native-mode = <&timing0>;
			timing0: 800x480 {
				clock-frequency = <0>; /* unused but required */
				hactive = <800>;
				vactive = <480>;
				hfront-porch = <40>;
				hback-porch = <88>;
				hsync-len = <0>;
				vback-porch = <32>;
				vfront-porch = <11>;
				vsync-len = <1>;
			};
		};
	};
```

## Documentation/devicetree/bindings/video/wm,wm8505-fb.txt
```
Wondermedia WM8505 Framebuffer
-----------------------------------------------------

Required properties:
- compatible : "wm,wm8505-fb"
- reg : Should contain 1 register ranges(address and length)
- via,display: a phandle pointing to the display node

Required nodes:
- display: a display node is required to initialize the lcd panel
	This should be in the board dts. See definition in
	Documentation/devicetree/bindings/video/via,vt8500-fb.txt
- default-mode: a videomode node as specified in
	Documentation/devicetree/bindings/video/via,vt8500-fb.txt

Example:

	fb@d8050800 {
		compatible = "wm,wm8505-fb";
		reg = <0xd8050800 0x200>;
		display = <&display>;
		default-mode = <&mode0>;
	};
```

## Documentation/devicetree/bindings/virtio/iommu.txt
```
* virtio IOMMU PCI device

When virtio-iommu uses the PCI transport, its programming interface is
discovered dynamically by the PCI probing infrastructure. However the
device tree statically describes the relation between IOMMU and DMA
masters. Therefore, the PCI root complex that hosts the virtio-iommu
contains a child node representing the IOMMU device explicitly.

Required properties:

- compatible:	Should be "virtio,pci-iommu"
- reg:		PCI address of the IOMMU. As defined in the PCI Bus
		Binding reference [1], the reg property is a five-cell
		address encoded as (phys.hi phys.mid phys.lo size.hi
		size.lo). phys.hi should contain the device's BDF as
		0b00000000 bbbbbbbb dddddfff 00000000. The other cells
		should be zero.
- #iommu-cells:	Each platform DMA master managed by the IOMMU is assigned
		an endpoint ID, described by the "iommus" property [2].
		For virtio-iommu, #iommu-cells must be 1.

Notes:

- DMA from the IOMMU device isn't managed by another IOMMU. Therefore the
  virtio-iommu node doesn't have an "iommus" property, and is omitted from
  the iommu-map property of the root complex.

Example:

pcie@10000000 {
	compatible = "pci-host-ecam-generic";
	...

	/* The IOMMU programming interface uses slot 00:01.0 */
	iommu0: iommu@0008 {
		compatible = "virtio,pci-iommu";
		reg = <0x00000800 0 0 0 0>;
		#iommu-cells = <1>;
	};

	/*
	 * The IOMMU manages all functions in this PCI domain except
	 * itself. Omit BDF 00:01.0.
	 */
	iommu-map = <0x0 &iommu0 0x0 0x8>
		    <0x9 &iommu0 0x9 0xfff7>;
};

pcie@20000000 {
	compatible = "pci-host-ecam-generic";
	...
	/*
	 * The IOMMU also manages all functions from this domain,
	 * with endpoint IDs 0x10000 - 0x1ffff
	 */
	iommu-map = <0x0 &iommu0 0x10000 0x10000>;
};

ethernet@fe001000 {
	...
	/* The IOMMU manages this platform device with endpoint ID 0x20000 */
	iommus = <&iommu0 0x20000>;
};

[1] Documentation/devicetree/bindings/pci/pci.txt
[2] Documentation/devicetree/bindings/iommu/iommu.txt
```

## Documentation/devicetree/bindings/virtio/mmio.txt
```
* virtio memory mapped device

See https://ozlabs.org/~rusty/virtio-spec/ for more details.

Required properties:

- compatible:	"virtio,mmio" compatibility string
- reg:		control registers base address and size including configuration space
- interrupts:	interrupt generated by the device

Required properties for virtio-iommu:

- #iommu-cells:	When the node corresponds to a virtio-iommu device, it is
		linked to DMA masters using the "iommus" or "iommu-map"
		properties [1][2]. #iommu-cells specifies the size of the
		"iommus" property. For virtio-iommu #iommu-cells must be
		1, each cell describing a single endpoint ID.

Optional properties:

- iommus:	If the device accesses memory through an IOMMU, it should
		have an "iommus" property [1]. Since virtio-iommu itself
		does not access memory through an IOMMU, the "virtio,mmio"
		node cannot have both an "#iommu-cells" and an "iommus"
		property.

Example:

	virtio_block@3000 {
		compatible = "virtio,mmio";
		reg = <0x3000 0x100>;
		interrupts = <41>;

		/* Device has endpoint ID 23 */
		iommus = <&viommu 23>
	}

	viommu: iommu@3100 {
		compatible = "virtio,mmio";
		reg = <0x3100 0x100>;
		interrupts = <42>;

		#iommu-cells = <1>
	}

[1] Documentation/devicetree/bindings/iommu/iommu.txt
[2] Documentation/devicetree/bindings/pci/pci-iommu.txt
```

## Documentation/devicetree/bindings/virtio/mmio.yaml
```yaml
# SPDX-License-Identifier: (GPL-2.0-only OR BSD-2-Clause)
%YAML 1.2
---
$id: http://devicetree.org/schemas/virtio/mmio.yaml#
$schema: http://devicetree.org/meta-schemas/core.yaml#

title: virtio memory mapped devices

maintainers:
  - Jean-Philippe Brucker <jean-philippe@linaro.org>

description:
  See https://www.oasis-open.org/committees/tc_home.php?wg_abbrev=virtio for
  more details.

properties:
  compatible:
    const: virtio,mmio

  reg:
    maxItems: 1

  dma-coherent: true

  interrupts:
    maxItems: 1

  '#iommu-cells':
    description: Required when the node corresponds to a virtio-iommu device.
    const: 1

  iommus:
    description: Required for devices making accesses thru an IOMMU.
    maxItems: 1

  wakeup-source:
    type: boolean
    description: Required for setting irq of a virtio_mmio device as wakeup source.

required:
  - compatible
  - reg
  - interrupts

additionalProperties:
  type: object

examples:
  - |
    virtio@3000 {
        compatible = "virtio,mmio";
        reg = <0x3000 0x100>;
        interrupts = <41>;

        /* Device has endpoint ID 23 */
        iommus = <&viommu 23>;
    };

    viommu: iommu@3100 {
        compatible = "virtio,mmio";
        reg = <0x3100 0x100>;
        interrupts = <42>;

        #iommu-cells = <1>;
    };

...
```

## Documentation/devicetree/bindings/virtio/pci-iommu.yaml
```yaml
# SPDX-License-Identifier: (GPL-2.0-only OR BSD-2-Clause)
%YAML 1.2
---
$id: http://devicetree.org/schemas/virtio/pci-iommu.yaml#
$schema: http://devicetree.org/meta-schemas/core.yaml#

title: virtio-iommu device using the virtio-pci transport

maintainers:
  - Jean-Philippe Brucker <jean-philippe@linaro.org>

description: |
  When virtio-iommu uses the PCI transport, its programming interface is
  discovered dynamically by the PCI probing infrastructure. However the
  device tree statically describes the relation between IOMMU and DMA
  masters. Therefore, the PCI root complex that hosts the virtio-iommu
  contains a child node representing the IOMMU device explicitly.

  DMA from the IOMMU device isn't managed by another IOMMU. Therefore the
  virtio-iommu node doesn't have an "iommus" property, and is omitted from
  the iommu-map property of the root complex.

allOf:
  - $ref: /schemas/pci/pci-device.yaml#

properties:
  # If compatible is present, it should contain the vendor and device ID
  # according to the PCI Bus Binding specification. Since PCI provides
  # built-in identification methods, compatible is not actually required.
  compatible:
    oneOf:
      - items:
          - const: virtio,pci-iommu
          - const: pci1af4,1057
      - items:
          - const: pci1af4,1057

  reg:
    maxItems: 1

  '#iommu-cells':
    const: 1

required:
  - compatible
  - reg
  - '#iommu-cells'

additionalProperties: false

examples:
  - |
    bus {
        #address-cells = <2>;
        #size-cells = <2>;

        pcie@40000000 {
            device_type = "pci";
            #address-cells = <3>;
            #size-cells = <2>;
            reg = <0x0 0x40000000  0x0 0x1000000>;
            ranges = <0x02000000 0x0 0x41000000  0x0 0x41000000  0x0 0x0f000000>;

            /*
             * The IOMMU manages all functions in this PCI domain except
             * itself. Omit BDF 00:01.0.
             */
            iommu-map = <0x0 &iommu0 0x0 0x8
                         0x9 &iommu0 0x9 0xfff7>;

            /* The IOMMU programming interface uses slot 00:01.0 */
            iommu0: iommu@1,0 {
                compatible = "pci1af4,1057";
                reg = <0x800 0 0 0 0>;
                #iommu-cells = <1>;
            };
        };

        pcie@50000000 {
            device_type = "pci";
            #address-cells = <3>;
            #size-cells = <2>;
            reg = <0x0 0x50000000  0x0 0x1000000>;
            ranges = <0x02000000 0x0 0x51000000  0x0 0x51000000  0x0 0x0f000000>;

            /*
             * The IOMMU also manages all functions from this domain,
             * with endpoint IDs 0x10000 - 0x1ffff
             */
            iommu-map = <0x0 &iommu0 0x10000 0x10000>;
        };

        ethernet {
            /* The IOMMU manages this platform device with endpoint ID 0x20000 */
            iommus = <&iommu0 0x20000>;
        };
    };

...
```

## Documentation/devicetree/bindings/virtio/virtio-device.yaml
```yaml
# SPDX-License-Identifier: (GPL-2.0-only OR BSD-2-Clause)
%YAML 1.2
---
$id: http://devicetree.org/schemas/virtio/virtio-device.yaml#
$schema: http://devicetree.org/meta-schemas/core.yaml#

title: Virtio device

maintainers:
  - Viresh Kumar <viresh.kumar@linaro.org>

description:
  These bindings are applicable to virtio devices irrespective of the bus they
  are bound to, like mmio or pci.

# We need a select here so we don't match all nodes with 'virtio,mmio'
properties:
  compatible:
    pattern: "^virtio,device[0-9a-f]{1,8}$"
    description: Virtio device nodes.
      "virtio,deviceID", where ID is the virtio device id. The textual
      representation of ID shall be in lower case hexadecimal with leading
      zeroes suppressed.

required:
  - compatible

additionalProperties: true

examples:
  - |
    virtio@3000 {
        compatible = "virtio,mmio";
        reg = <0x3000 0x100>;
        interrupts = <43>;

        i2c {
            compatible = "virtio,device22";
        };
    };
...
```

## Documentation/devicetree/bindings/w1/amd,axi-1wire-host.yaml
```yaml
# SPDX-License-Identifier: (GPL-2.0-only OR BSD-2-Clause)
%YAML 1.2
---
$id: http://devicetree.org/schemas/w1/amd,axi-1wire-host.yaml#
$schema: http://devicetree.org/meta-schemas/core.yaml#

title: AMD AXI 1-wire bus host for programmable logic

maintainers:
  - Kris Chaplin <kris.chaplin@amd.com>

properties:
  compatible:
    const: amd,axi-1wire-host

  reg:
    maxItems: 1

  clocks:
    maxItems: 1

  interrupts:
    maxItems: 1

required:
  - compatible
  - reg
  - clocks
  - interrupts

additionalProperties: false

examples:
  - |
    #include <dt-bindings/interrupt-controller/arm-gic.h>

    onewire@a0000000 {
        compatible = "amd,axi-1wire-host";
        reg = <0xa0000000 0x10000>;
        clocks = <&zynqmp_clk 0x47>;
        interrupts = <GIC_SPI 0x59 IRQ_TYPE_LEVEL_HIGH>;
    };

...
```

## Documentation/devicetree/bindings/w1/fsl-imx-owire.txt
```
* Freescale i.MX One wire bus master controller

Required properties:
- compatible : should be "fsl,imx21-owire"
- reg : Address and length of the register set for the device

Optional properties:
- clocks : phandle of clock that supplies the module (required if platform
		clock bindings use device tree)

Example:

- From imx53.dtsi:
owire: owire@63fa4000 {
	compatible = "fsl,imx53-owire", "fsl,imx21-owire";
	reg = <0x63fa4000 0x4000>;
	clocks = <&clks 159>;
};
```

## Documentation/devicetree/bindings/w1/fsl-imx-owire.yaml
```yaml
# SPDX-License-Identifier: (GPL-2.0-only OR BSD-2-Clause)
%YAML 1.2
---
$id: http://devicetree.org/schemas/w1/fsl-imx-owire.yaml#
$schema: http://devicetree.org/meta-schemas/core.yaml#

title: Freescale i.MX One wire bus master controller

maintainers:
  - Martin Fuzzey <mfuzzey@parkeon.com>

properties:
  compatible:
    oneOf:
      - const: fsl,imx21-owire
      - items:
          - enum:
              - fsl,imx27-owire
              - fsl,imx50-owire
              - fsl,imx51-owire
              - fsl,imx53-owire
          - const: fsl,imx21-owire

  reg:
    maxItems: 1

  interrupts:
    maxItems: 1

  clocks:
    maxItems: 1

required:
  - compatible
  - reg

additionalProperties: false

examples:
  - |
    #include <dt-bindings/clock/imx5-clock.h>

    owire@63fa4000 {
        compatible = "fsl,imx53-owire", "fsl,imx21-owire";
        reg = <0x63fa4000 0x4000>;
        interrupts = <88>;
        clocks = <&clks IMX5_CLK_OWIRE_GATE>;
    };
```

## Documentation/devicetree/bindings/w1/maxim,ds2482.yaml
```yaml
# SPDX-License-Identifier: (GPL-2.0-only OR BSD-2-Clause)
%YAML 1.2
---
$id: http://devicetree.org/schemas/w1/maxim,ds2482.yaml#
$schema: http://devicetree.org/meta-schemas/core.yaml#

title: Maxim One wire bus master controller

maintainers:
  - Stefan Wahren <stefan.wahren@chargebyte.com>

description: |
  I2C to 1-wire bridges

  https://www.analog.com/media/en/technical-documentation/data-sheets/ds2482-100.pdf
  https://www.analog.com/media/en/technical-documentation/data-sheets/DS2482-800.pdf
  https://www.analog.com/media/en/technical-documentation/data-sheets/DS2484.pdf

properties:
  compatible:
    enum:
      - maxim,ds2482
      - maxim,ds2484

  reg:
    maxItems: 1

required:
  - compatible
  - reg

additionalProperties:
  type: object

examples:
  - |
    i2c {
      #address-cells = <1>;
      #size-cells = <0>;
      onewire@18 {
        compatible = "maxim,ds2484";
        reg = <0x18>;
      };
    };
```

## Documentation/devicetree/bindings/w1/omap-hdq.txt
```
* OMAP HDQ One wire bus master controller

Required properties:
- compatible : should be "ti,omap3-1w" or "ti,am4372-hdq"
- reg : Address and length of the register set for the device
- interrupts : interrupt line.
- ti,hwmods : "hdq1w"

Optional properties:
- ti,mode: should be "hdq": HDQ mode  "1w": one-wire mode.
	   If not specified HDQ mode is implied.

Example:

- From omap3.dtsi
  hdqw1w: 1w@480b2000 {
	compatible = "ti,omap3-1w";
	reg = <0x480b2000 0x1000>;
	interrupts = <58>;
	ti,hwmods = "hdq1w";
	ti,mode = "hdq";
  };
```
