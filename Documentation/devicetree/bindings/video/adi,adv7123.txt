## Documentation/devicetree/bindings/video/exynos_hdmiphy.txt
```
Device-Tree bindings for hdmiphy driver

Required properties:
- compatible: value should be one of the following:
	1) "samsung,exynos5-hdmiphy" <DEPRECATED>
	2) "samsung,exynos4210-hdmiphy".
	3) "samsung,exynos4212-hdmiphy".
- reg: Physical address of the hdmiphy device.
- phy-power-control: this child node represents phy power control
	register which is inside the pmu block (power management unit).

Example:

	hdmiphy {
		compatible = "samsung,exynos4210-hdmiphy";
		reg = <0x38>;

		phy-power-control {
			reg = <0x10040700 0x04>;
		};
	};
```

## Documentation/devicetree/bindings/video/exynos_mixer.txt
```
Device-Tree bindings for mixer driver

Required properties:
- compatible: value should be one of the following:
	1) "samsung,exynos5-mixer" <DEPRECATED>
	2) "samsung,exynos4210-mixer"
	3) "samsung,exynos5250-mixer"
	4) "samsung,exynos5420-mixer"

- reg: physical base address of the mixer and length of memory mapped
	region.
- interrupts: interrupt number to the cpu.

Example:

	mixer {
		compatible = "samsung,exynos5250-mixer";
		reg = <0x14450000 0x10000>;
		interrupts = <0 94 0>;
	};
```

## Documentation/devicetree/bindings/video/hdmi-connector.txt
```
HDMI Connector
==============

Required properties:
- compatible: "hdmi-connector"
- type: the HDMI connector type: "a", "b", "c", "d" or "e"

Optional properties:
- label: a symbolic name for the connector
- hpd-gpios: HPD GPIO number

Required nodes:
- Video port for HDMI input

Example
-------

hdmi0: connector@1 {
	compatible = "hdmi-connector";
	label = "hdmi";

	type = "a";

	port {
		hdmi_connector_in: endpoint {
			remote-endpoint = <&tpd12s015_out>;
		};
	};
};
```

## Documentation/devicetree/bindings/video/panel-dpi.txt
```
Generic MIPI DPI Panel
======================

Required properties:
- compatible: "panel-dpi"

Optional properties:
- label: a symbolic name for the panel
- enable-gpios: panel enable gpio

Required nodes:
- "panel-timing" containing video timings
  (Documentation/devicetree/bindings/video/display-timing.txt)
- Video port for DPI input

Example
-------

lcd0: display@0 {
        compatible = "samsung,lte430wq-f0c", "panel-dpi";
        label = "lcd";

        port {
            lcd_in: endpoint {
                    remote-endpoint = <&dpi_out>;
            };
        };

        panel-timing {
                clock-frequency = <9200000>;
                hactive = <480>;
                vactive = <272>;
                hfront-porch = <8>;
                hback-porch = <4>;
                hsync-len = <41>;
                vback-porch = <2>;
                vfront-porch = <4>;
                vsync-len = <10>;

                hsync-active = <0>;
                vsync-active = <0>;
                de-active = <1>;
                pixelclk-active = <1>;
        };
};
```

## Documentation/devicetree/bindings/video/panel-dsi-cm.txt
```
Generic MIPI DSI Command Mode Panel
===================================

Required properties:
- compatible: "panel-dsi-cm"

Optional properties:
- label: a symbolic name for the panel
- reset-gpios: panel reset gpio
- te-gpios: panel TE gpio

Required nodes:
- Video port for DSI input

Example
-------

lcd0: display {
	compatible = "tpo,taal", "panel-dsi-cm";
	label = "lcd0";

	reset-gpios = <&gpio4 6 GPIO_ACTIVE_HIGH>;

	port {
		lcd0_in: endpoint {
			remote-endpoint = <&dsi1_out_ep>;
		};
	};
};
```

## Documentation/devicetree/bindings/video/rockchip-drm.txt
```
Rockchip DRM master device
================================

The Rockchip DRM master device is a virtual device needed to list all
vop devices or other display interface nodes that comprise the
graphics subsystem.

Required properties:
- compatible: Should be "rockchip,display-subsystem"
- ports: Should contain a list of phandles pointing to display interface port
  of vop devices. vop definitions as defined in
  Documentation/devicetree/bindings/video/rockchip-vop.txt

example:

display-subsystem {
	compatible = "rockchip,display-subsystem";
	ports = <&vopl_out>, <&vopb_out>;
};
```

## Documentation/devicetree/bindings/video/rockchip-lvds.txt
```
Rockchip RK3288 LVDS interface
================================

Required properties:
- compatible: "rockchip,rk3288-lvds";

- reg: physical base address of the controller and length
	of memory mapped region.
- clocks: must include clock specifiers corresponding to entries in the
	clock-names property.
- clock-names: must contain "pclk_lvds"

- avdd1v0-supply: regulator phandle for 1.0V analog power
- avdd1v8-supply: regulator phandle for 1.8V analog power
- avdd3v3-supply: regulator phandle for 3.3V analog power

- rockchip,grf: phandle to the general register files syscon

- rockchip,data-mapping: should be "vesa" or "jeida",
	This describes how the color bits are laid out in the
	serialized LVDS signal.
- rockchip,data-width : should be <18> or <24>;
- rockchip,output: should be "rgb", "lvds" or "duallvds",
	This describes the output face.

Required nodes:

The lvds has two video ports as described by
	Documentation/devicetree/bindings/media/video-interfaces.txt.
Their connections are modeled using the OF graph bindings specified in
	Documentation/devicetree/bindings/graph.txt.

- video port 0 for the VOP inputs
- video port 1 for either a panel or subsequent encoder

Example:
	lvds: lvds@ff96c000 {
		compatible = "rockchip,rk3288-lvds";
		rockchip,grf = <&grf>;
		reg = <0xff96c000 0x4000>;
		clocks = <&cru PCLK_LVDS_PHY>;
		clock-names = "pclk_lvds";
		avdd1v0-supply = <&vdd10_lcd>;
		avdd1v8-supply = <&vcc18_lcd>;
		avdd3v3-supply = <&vcca_33>;
		rockchip,data-mapping = "jeida";
		rockchip,data-width = <24>;
		rockchip,output = "rgb";
		ports {
			#address-cells = <1>;
			#size-cells = <0>;

			lvds_in: port@0 {
				reg = <0>;

				lvds_in_vopb: endpoint@0 {
					reg = <0>;
					remote-endpoint = <&vopb_out_lvds>;
				};
				lvds_in_vopl: endpoint@1 {
					reg = <1>;
					remote-endpoint = <&vopl_out_lvds>;
				};
			};

			lvds_out: port@1 {
				reg = <1>;

				lvds_out_panel: endpoint {
					remote-endpoint = <&panel_in>;
				};
			};
		};
	};
```

## Documentation/devicetree/bindings/video/rockchip_codec.txt
```
Device-Tree bindings for Rockchip Video Codec.

Required properties:
- compatible: There are several vcodec IP inside rockchip chips.
	Decoder should be one of following:
		"rockchip,vpu-decoder-v1",
		"rockchip,avs-plus-decoder",
		"rockchip,vpu-decoder-v2",
		"rockchip,vpu-decoder-px30",
		"rockchip,vpu-decoder-rk3288",
		"rockchip,vpu-decoder-rk3368",
		"rockchip,hevc-decoder",
		"rockchip,hevc-decoder-px30",
		"rockchip,hevc-decoder-rk3368",
		"rockchip,rkv-decoder-v1",
		"rockchip,rkv-decoder-v2",
		"rockchip,rkv-decoder-rk3399",
		"rockchip,rkv-decoder-rk3328",
		"rockchip,rkv-jpeg-decoder-v1",
	Encoder should be one of following:
		"rockchip,vpu-encoder-v1",
		"rockchip,vpu-encoder-v2",
		"rockchip,vpu-encoder-px30",
		"rockchip,rkv-encoder-v1",
		"rockchip,rkv-encoder-v2",
		"rockchip,rkv-encoder-rv1108",
		"rockchip,hevc-encoder-v22",

- rockchip,srv: The pointer of service device node.
	the value must be the name of service device, like <&mpp_srv>.

- rockchip,taskqueue-node: The taskqueue node number of current device working.
	the value must between 0 and rockchip,taskqueue-count

- rockchip,resetgroup-node: The resetgroup node number of current reset group.
	If two devices have the same reset clk, they should in the same reset group.
	the value must between 0 and rockchip,resetgroup-count

- reset-name: The name of reset clk.
	If two devices have the same reset clk, the reset-name should stay the same
	and add "shared_" prefix.

Example:

DT entry:

	vdpu: vdpu@ff650400 {
		compatible = "rockchip,vpu-decoder-v2";
		reg = <0x0 0xff650400 0x0 0x400>;
		interrupts = <GIC_SPI 113 IRQ_TYPE_LEVEL_HIGH 0>;
		interrupt-names = "irq_dec";
		clocks = <&cru ACLK_VCODEC>, <&cru HCLK_VCODEC>;
		clock-names = "aclk_vcodec", "hclk_vcodec";
		resets = <&cru SRST_H_VCODEC>, <&cru SRST_A_VCODEC>;
		reset-names = "shared_video_h", "shared_video_a";
		iommus = <&vpu_mmu>;
		power-domains = <&power RK3399_PD_VCODEC>;
		rockchip,srv = <&mpp_srv>;
		rockchip,taskqueue-node = <0>;
		rockchip,resetgroup-node = <0>;
		status = "disabled";
	};

	vepu: vepu@ff650000 {
		compatible = "rockchip,vpu-encoder-v2";
		reg = <0x0 0xff650000 0x0 0x400>;
		interrupts = <GIC_SPI 114 IRQ_TYPE_LEVEL_HIGH 0>;
		interrupt-names = "irq_enc";
		clocks = <&cru ACLK_VCODEC>, <&cru HCLK_VCODEC>;
		clock-names = "aclk_vcodec", "hclk_vcodec";
		resets = <&cru SRST_H_VCODEC>, <&cru SRST_A_VCODEC>;
		reset-names = "shared_video_h", "shared_video_a";
		iommus = <&vpu_mmu>;
		rockchip,srv = <&mpp_srv>;
		rockchip,taskqueue-node = <0>;
		rockchip,resetgroup-node = <0>;
		power-domains = <&power RK3399_PD_VCODEC>;
		status = "disabled";
	};

	vpu_mmu: iommu@ff650800 {
		compatible = "rockchip,iommu";
		reg = <0x0 0xff650800 0x0 0x40>;
		interrupts = <GIC_SPI 115 IRQ_TYPE_LEVEL_HIGH 0>;
		interrupt-names = "vpu_mmu";
		clocks = <&cru ACLK_VCODEC>, <&cru HCLK_VCODEC>;
		clock-names = "aclk", "iface";
		power-domains = <&power RK3399_PD_VCODEC>;
		#iommu-cells = <0>;
		status = "disabled";
	};
```

## Documentation/devicetree/bindings/video/rockchip_enc.txt
```
Device-Tree bindings for Rockchip Encoder.

Required properties:
- compatible: There are several encoder IP inside rockchip chips. The value
	should be one of "rockchip,rkvenc", "rockchip,vepu", "rockchip,h265e"

Example:

DT entry:
	vepu: vepu@ff340000 {
		compatible = "rockchip,rk3328-vepu", "rockchip,vepu";
		rockchip,grf = <&grf>;
		iommu_enabled = <1>;
		iommus = <&vepu_mmu>;
		reg = <0x0 0xff340000 0x0 0x400>;
		interrupts = <GIC_SPI 97 IRQ_TYPE_LEVEL_HIGH>;
		clocks = <&cru ACLK_VPU>, <&cru HCLK_VPU>;
		clock-names = "aclk_vcodec", "hclk_vcodec";
		resets = <&cru SRST_RKVENC_H264_H>,
			<&cru SRST_RKVENC_H264_A>;
		reset-names = "video_h", "video_a";
		rockchip,srv = <&venc_srv>;
		mode_bit = <11>;
		mode_ctrl = <0x40c>;
		name = "vepu";
		allocator = <1>;
		status = "disabled";
	};
```

## Documentation/devicetree/bindings/video/rockchip_fb.txt
```
Device-Tree bindings for Rockchip framebuffer.
 
Required properties:
- compatible: value should be "rockchip,rk-fb".
- rockchip,disp-mode: DUAL :for dual lcdc and dual display;
					  ONE_DUAL : for one lcdc and dual display.

Example:

DT entry:
	fb: fb{
		compatible = "rockchip,rk-fb";
		rockchip,disp-mode = <DUAL>;
	};
 
Device-Tree bindings for RockChip screen driver

Required properties:
- compatible: value should be "rockchip,screen"
- display-timings: value should be disp_timings, which defined in
		lcd-xxx.dtsi file,the file should include by your board dts

Example:
	creen: rk_screen{
                        compatible = "rockchip,screen";
			display-timings = <&disp_timings>;
        };

/*
 * RockChip. LCD_B101ew05 lcd-b101ew05.dtsi
 *
 */

/ {

                disp_timings: display-timings {
                        native-mode = <&timing0>;
                        timing0: timing0 {
                                screen-type = <SCREEN_LVDS>;
                                lvds-format = <LVDS_8BIT_2>;
                                out-face    = <OUT_D888_P666>;
                                clock-frequency = <71000000>;
                                hactive = <1280>;
                                vactive = <800>;
                                hback-porch = <100>;
                                hfront-porch = <18>;
                                vback-porch = <8>;
                                vfront-porch = <6>;
                                hsync-len = <10>;
                                vsync-len = <2>;
                                hsync-active = <0>;
                                vsync-active = <0>;
                                de-active = <0>;
                                pixelclk-active = <0>;
                                swap-rb = <0>;
                                swap-rg = <0>;
                                swap-gb = <0>;
                        };
               };
};




note: reference for display-timing.txt for display-timing bindings
```

## Documentation/devicetree/bindings/video/rockchip_hdmi.txt
```
Device-Tree bindings for rockchip hdmi driver

Required properties:
- compatible: value should be following:
	"rockchip,rk3036-hdmi",
	"rockchip,rk3066-hdmi",
	"rockchip,rk312x-hdmi",
	"rockchip,rk3288-hdmi",
	"rockchip,rk3368-hdmi",
	"rockchip,rk3399-hdmi",
- reg: physical base address of the hdmi and length of memory mapped
        region.
- interrupts: interrupt number to the cpu.
- pinctrl-names: must contain a "default" entry.
- pinctrl-0: pin control group to be used for this controller.
- pinctrl-1: pin control group to be used for gpio.
- clocks: must include clock specifiers corresponding to entries in the
        clock-names property.
- clocks-names: list of clock names sorted in the same order as the clocks
               property. Must contain "pclk_hdmi" and "hdcp_clk_hdmi".
- rockchip,hdmi_audio_source: hdmi audio source that is described as follow
	<0>: hdmi audio source from the I2S interface
	<1>: hdmi audio source from the SPDIF interface				
- rockchip,hdmi_video_source: hdmi video source that is described as follow
	<DISPLAY_SOURCE_LCDC0> hdmi video source from LCDC0/VOP0
	<DISPLAY_SOURCE_LCDC1> hdmi video source from LCDC1/VOP1
- rockchip,hdcp_enable: hdmi hdcp function is described as follow
	<0>: hdcp function is disabled.
	<1>: hdcp function is enabled.
- rockchip,cec_enable: hdmi cec function is described as follow
	<0>: cec function is disabled.
	<1>: cec function is enabled.
- rockchip,defaultmode: hdmi default output video mode.
Example:

	hdmi: hdmi@ff980000 {
                compatible = "rockchip,rk3288-hdmi";
                reg = <0xff980000 0x20000>;
                interrupts = <GIC_SPI 103 IRQ_TYPE_LEVEL_HIGH>;
                pinctrl-names = "default", "gpio";
                pinctrl-0 = <&i2c5_sda &i2c5_scl>;
                pinctrl-1 = <&i2c5_gpio>;
                clocks = <&clk_gates16 9>, <&clk_gates5 12>;
                clock-names = "pclk_hdmi", "hdcp_clk_hdmi";
		rockchip,hdmi_video_source = <DISPLAY_SOURCE_LCDC0>;
		rockchip,hdmi_audio_source = <0>;
		rockchip,hdcp_enable = <0>;
		rockchip,cec_enable = <0>;
        };
```
