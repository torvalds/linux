## Documentation/devicetree/bindings/video/rockchip_lcdc.txt
```
Device-Tree bindings for Rockchip SoC display controller (VOP / LCDC)
VOP (Video Output Process) / LCDC is the Display Controller for the
ROCKCHIP series of SoCs which transfers the image data from a video memory
buffer to an external LCD interface.

Required properties:
- compatible: value should be one of the following
		"rockchip,rk3288-lcdc"; /* for RK3288 SoCs */
		"rockchip,rk3368-lcdc"; /* for RK3368 SoCs */
		"rockchip,rk322x-lcdc"; /* for RK322X SoCs */
		"rockchip,rk3399-lcdc"; /* for RK3399 SoCs */
- rockchip,prop: set the lcdc as primary or extend display.
- rochchip,pwr18: set the controller IO voltage,0 is 3.3v,1 is 1.8v.
- reg: physical base address and length of the LCDC registers set.
- interrupts: interrupt number to the cpu and interrupt proterties.
- pinctrl-names: must contain a "default" entry.
- pinctrl-0: pin control group to be used for this controller.
- pinctrl-1: pin control group to be used for gpio.
- clocks: must include clock specifiers corresponding to entries in the
         clock-names property.
- clock-names: list of clock names sorted in the same order as the clocks
               property..

Optional Properties:
- rockchip,debug: printk debug message.
- rockchip,mirror: the lcdc mirror function.
- lcd_en:lcd_en: contain power control for lcd.
	- rockchip,power_type: power type,GPIO or REGULATOR.
	- gpios: pin number for gpio.
	- rockchip,delay: delay time after set power.

Example:

SoC specific DT entry:
	lcdc1: lcdc@ff940000 {
		compatible = "rockchip,rk3288-lcdc";
		rockchip,prop = <PRMRY>;
		rochchip,pwr18 = <0>;
		reg = <0xff940000 0x10000>;
		interrupts = <GIC_SPI 16 IRQ_TYPE_LEVEL_HIGH>;
		pinctrl-names = "default", "gpio";
		pinctrl-0 = <&lcdc0_lcdc>;
		pinctrl-1 = <&lcdc0_gpio>;		
		status = "disabled";
		clocks = <&clk_gates15 7>, <&dclk_lcdc1>, <&clk_gates15 8>, <&pd_vop1>;
		clock-names = "aclk_lcdc", "dclk_lcdc", "hclk_lcdc", "pd_lcdc";
	};


Board specific DT entry:

&lcdc1 {
	status = "okay";
	power_ctr: power_ctr {
		rockchip,debug = <0>;
		rockchip,mirror = <NO_MIRROR>;
		lcd_en:lcd_en {
			rockchip,power_type = <GPIO>;
			gpios = <&gpio7 GPIO_A3 GPIO_ACTIVE_HIGH>;
			rockchip,delay = <10>;
		};	
		lcd_cs:lcd_cs {
			rockchip,power_type = <GPIO>;
			gpios = <&gpio7 GPIO_A4 GPIO_ACTIVE_HIGH>;
			rockchip,delay = <10>;
		};
	};
};
```

## Documentation/devicetree/bindings/video/rockchip_lvds.txt
```
The Rockchip display port interface should be configured based on
the type of panel connected to it.
 
Required properties:
- compatible: value should be "rockchip,rk32-lvds".
- reg: physical base address and length of the LVDS registers set.
- interrupts: interrupt number to the cpu and interrupt proterties.
- clocks: must include clock specifiers corresponding to entries in the
         clock-names property.
- clock-names: list of clock names sorted in the same order as the clocks
               property..

Example:

SoC specific DT entry:
	lvds: lvds@ff96c000 {
		compatible = "rockchip,rk32-lvds";
		reg = <0xff96c000 0x4000>;
		clocks = <&clk_gates16 7>;
		clock-names = "pclk_lvds";
        };
        
```

## Documentation/devicetree/bindings/video/rockchip_mipidsi.txt
```
Device-Tree bindings for rockchip mipi dsi driver

Required properties:
- compatible: value should be "rockchip,rk32-dsi".
- rockchip,prop: dsi number.
- reg: physical base address of the hdmi and length of memory mapped
        region.
- interrupts: interrupt number to the cpu.

- clocks: must include clock specifiers corresponding to entries in the
        clock-names property.
- clocks-names: list of clock names sorted in the same order as the clocks
               property. Must contain "pclk_hdmi" and "hdcp_clk_hdmi".
- status: the dsi host status;
	<disabled>: open the dsi host;
	<okay>:close the dsi host;

Example:

	dsihost0: mipi@ff960000{
		compatible = "rockchip,rk32-dsi";
		rockchip,prop = <0>;
		reg = <0xff960000 0x4000>;
		interrupts = <GIC_SPI 19 IRQ_TYPE_LEVEL_HIGH>;
		clocks = <&clk_gates5 15>, <&clk_gates16 4> , <&pd_mipidsi>;
		clock-names = "clk_mipi_24m", "pclk_mipi_dsi", "pd_mipi_dsi";
		status = "okay";
	};

	dsihost1: mipi@ff964000{
		compatible = "rockchip,rk32-dsi";
		rockchip,prop = <1>;
		reg = <0xff964000 0x4000>;
		interrupts = <GIC_SPI 20 IRQ_TYPE_LEVEL_HIGH>;
		clocks = <&clk_gates5 15>, <&clk_gates16 5>, <&pd_mipidsi>;
		clock-names = "clk_mipi_24m", "pclk_mipi_dsi", "pd_mipi_dsi";
		status = "okay"; 
	};
```

## Documentation/devicetree/bindings/video/rockchip_mipidsi_lcd.txt
```
Device-Tree bindings for rockchip mipi dsi lcd driver

Required properties:
 - rockchip,screen_init: Whether you need this screen initialization.
	<0>: Don't need to be initialized.
	<1>: Do need to be initialized.
	
 - rockchip,dsi_lane: mipi lcd data lane number.

 - rockchip,dsi_hs_clk: mipi lcd high speed clock.

 - rockchip,mipi_dsi_num: mipi lcd dsi number.

 - mipi_lcd_rst:mipi_lcd_rst: Should specify pin control groups used for reset this lcd.

 - mipi_lcd_en:mipi_lcd_en: Should specify pin control groups used for enable this lcd.

 - rockchip,gpios: gpio pin

 - rockchip,delay: delay the millisecond.

 - rockchip,cmd_debug : debug the cammands.
	<0>: close the debug;
	<1>: open the debug;
	
 - rockchip,on-cmds1: write cammand to mipi lcd.

- rockchip,cmd_type:
	<LPDT>: close the debug;
	<HSDT>: open the debug;
	
 - rockchip,dsi_id: write cammand to mipi lcd(left and right).
	<0>: left dsi;
	<1>: right dsi;
	<2>: left and right dsis;
	
 - rockchip,cmd: cammand context.
 	The first parameter was data type;
 	The second parameter was index(register);
 	The third and ... parameter are cammand context;

 - rockchip,cmd_delay: delay the millisecond.

 - screen-type: mipi lcd type.
 	<SCREEN_DUAL_MIPI>: Dual channel mipi lcd. 
 	<SCREEN_MIPI>: single channel mipi lcd. 
 	
 - lvds-format:No relationship.
 
 - out-face: DPI color coding as follows:
 	<OUT_P888>:24bit
 	<OUT_P666>:18bit
 	<OUT_P565>:16bit
 	
 - hactive, vactive: display resolution
 - hfront-porch, hback-porch, hsync-len: horizontal display timing parameters
   in pixels
   vfront-porch, vback-porch, vsync-len: vertical display timing parameters in
   lines
 - clock-frequency: display clock in Hz

 - swap-rb :exchange of red and blue.
 - swap-rg :exchange of red and green.
 - swap-gb :exchange of green and blue.
 
 - hsync-active: hsync pulse is active low/high/ignored
 - vsync-active: vsync pulse is active low/high/ignored
 - de-active: data-enable pulse is active low/high/ignored
 - pixelclk-active: with
			- active high = drive pixel data on rising edge/
					sample data on falling edge
			- active low  = drive pixel data on falling edge/
					sample data on rising edge
			- ignored     = ignored
 - interlaced (bool): boolean to enable interlaced mode
 - doublescan (bool): boolean to enable doublescan mode

All the optional properties that are not bool follow the following logic:
    <1>: high active
    <0>: low active
    omitted: not used on hardware

There are different ways of describing the capabilities of a display. The
devicetree representation corresponds to the one commonly found in datasheets
for displays. If a display supports multiple signal timings, the native-mode
can be specified.

The parameters are defined as:

  +----------+-------------------------------------+----------+-------+
  |          |        仾                            |          |       |
  |          |        |vback_porch                 |          |       |
  |          |        伀                            |          |       |
  +----------#######################################----------+-------+
  |          #        仾                            #          |       |
  |          #        |                            #          |       |
  |  hback   #        |                            #  hfront  | hsync |
  |   porch  #        |       hactive              #  porch   |  len  |
  |<-------->#<-------+--------------------------->#<-------->|<----->|
  |          #        |                            #          |       |
  |          #        |vactive                     #          |       |
  |          #        |                            #          |       |
  |          #        伀                            #          |       |
  +----------#######################################----------+-------+
  |          |        仾                            |          |       |
  |          |        |vfront_porch                |          |       |
  |          |        伀                            |          |       |
  +----------+-------------------------------------+----------+-------+
  |          |        仾                            |          |       |
  |          |        |vsync_len                   |          |       |
  |          |        伀                            |          |       |
  +----------+-------------------------------------+----------+-------+


Example:

{
		/* about mipi */
		disp_mipi_init: mipi_dsi_init{
					rockchip,screen_init	= <1>;
					rockchip,dsi_lane		= <4>;
					rockchip,dsi_hs_clk		= <1020>;
					rockchip,mipi_dsi_num	= <2>;
		};
		disp_mipi_power_ctr: mipi_power_ctr {
					mipi_lcd_rst:mipi_lcd_rst{
							rockchip,gpios = <&gpio7 GPIO_B2 GPIO_ACTIVE_HIGH>;
							rockchip,delay = <10>;
					};
					/*mipi_lcd_en:mipi_lcd_en {
							rockchip,gpios = <&gpio6 GPIO_A7 GPIO_ACTIVE_HIGH>;
							rockchip,delay = <10>;
					};*/
		};
		disp_mipi_init_cmds: screen-on-cmds {
					rockchip,cmd_debug = <0>;
                    rockchip,on-cmds1 {
							rockchip,cmd_type = <LPDT>;
							rockchip,dsi_id = <2>;
							rockchip,cmd = <0x05 0x01>; //set soft reset
							rockchip,cmd_delay = <10>;
					};
		};

		disp_timings: display-timings {
                        native-mode = <&timing0>;
                        timing0: timing0 {
				screen-type = <SCREEN_DUAL_MIPI>;
				lvds-format = <LVDS_8BIT_2>;
				out-face    = <OUT_P888>;
				clock-frequency = <285000000>;
				hactive = <2560>;
				vactive = <1600>;
				
				hsync-len = <38>;//19
				hback-porch = <80>;//40
				hfront-porch = <246>;//123
				
				vsync-len = <4>;
				vback-porch = <4>;
				vfront-porch = <12>;
				
				hsync-active = <0>;
				vsync-active = <0>;
				de-active = <0>;
				pixelclk-active = <0>;
				swap-rb = <0>;
				swap-rg = <0>;
				swap-gb = <0>;
                     	};
               };
};
```
