## Documentation/devicetree/bindings/video/adi,adv7123.txt
```
Analog Device ADV7123 Video DAC
-------------------------------

The ADV7123 is a digital-to-analog converter that outputs VGA signals from a
parallel video input.

Required properties:

- compatible: Should be "adi,adv7123"

Optional properties:

- psave-gpios: Power save control GPIO

Required nodes:

The ADV7123 has two video ports. Their connections are modeled using the OF
graph bindings specified in Documentation/devicetree/bindings/graph.txt.

- Video port 0 for DPI input
- Video port 1 for VGA output


Example
-------

	adv7123: encoder@0 {
		compatible = "adi,adv7123";

		ports {
			#address-cells = <1>;
			#size-cells = <0>;

			port@0 {
				reg = <0>;

				adv7123_in: endpoint@0 {
					remote-endpoint = <&dpi_out>;
				};
			};

			port@1 {
				reg = <1>;

				adv7123_out: endpoint@0 {
					remote-endpoint = <&vga_connector_in>;
				};
			};
		};
	};
```

## Documentation/devicetree/bindings/video/adi,adv7511.txt
```
Analog Device ADV7511(W)/13 HDMI Encoders
-----------------------------------------

The ADV7511, ADV7511W and ADV7513 are HDMI audio and video transmitters
compatible with HDMI 1.4 and DVI 1.0. They support color space conversion,
S/PDIF, CEC and HDCP.

Required properties:

- compatible: Should be one of "adi,adv7511", "adi,adv7511w" or "adi,adv7513"
- reg: I2C slave address

The ADV7511 supports a large number of input data formats that differ by their
color depth, color format, clock mode, bit justification and random
arrangement of components on the data bus. The combination of the following
properties describe the input and map directly to the video input tables of the
ADV7511 datasheet that document all the supported combinations.

- adi,input-depth: Number of bits per color component at the input (8, 10 or
  12).
- adi,input-colorspace: The input color space, one of "rgb", "yuv422" or
  "yuv444".
- adi,input-clock: The input clock type, one of "1x" (one clock cycle per
  pixel), "2x" (two clock cycles per pixel), "ddr" (one clock cycle per pixel,
  data driven on both edges).

The following input format properties are required except in "rgb 1x" and
"yuv444 1x" modes, in which case they must not be specified.

- adi,input-style: The input components arrangement variant (1, 2 or 3), as
  listed in the input format tables in the datasheet.
- adi,input-justification: The input bit justification ("left", "evenly",
  "right").

Optional properties:

- interrupts: Specifier for the ADV7511 interrupt
- pd-gpios: Specifier for the GPIO connected to the power down signal

- adi,clock-delay: Video data clock delay relative to the pixel clock, in ps
  (-1200 ps .. 1600 ps). Defaults to no delay.
- adi,embedded-sync: The input uses synchronization signals embedded in the
  data stream (similar to BT.656). Defaults to separate H/V synchronization
  signals.

Required nodes:

The ADV7511 has two video ports. Their connections are modelled using the OF
graph bindings specified in Documentation/devicetree/bindings/graph.txt.

- Video port 0 for the RGB or YUV input
- Video port 1 for the HDMI output


Example
-------

	adv7511w: hdmi@39 {
		compatible = "adi,adv7511w";
		reg = <39>;
		interrupt-parent = <&gpio3>;
		interrupts = <29 IRQ_TYPE_EDGE_FALLING>;

		adi,input-depth = <8>;
		adi,input-colorspace = "rgb";
		adi,input-clock = "1x";
		adi,input-style = <1>;
		adi,input-justification = "evenly";

		ports {
			#address-cells = <1>;
			#size-cells = <0>;

			port@0 {
				reg = <0>;
				adv7511w_in: endpoint {
					remote-endpoint = <&dpi_out>;
				};
			};

			port@1 {
				reg = <1>;
				adv7511_out: endpoint {
					remote-endpoint = <&hdmi_connector_in>;
				};
			};
		};
	};
```

## Documentation/devicetree/bindings/video/altvipfb.txt
```
Altera Video and Image Processing(VIP) Frame Reader bindings

Required properties:
- compatible: "altr,vip-frame-reader-9.1" or "altr,vip-frame-reader-1.0"
- reg: Physical base address and length of the framebuffer controller's
  registers.
- max-width: The width of the framebuffer in pixels.
- max-height: The height of the framebuffer in pixels.
- bits-per-color: only "8" is currently supported
- mem-word-width = the bus width of the avalon master port on the frame reader

Example:

alt_vip_vfr_0: vip@0xff260000 {
	compatible = "altr,vip-frame-reader-1.0";
	reg = <0xff260000 0x00000080>;
	max-width = <1024>;
	max-height = <768>;
	bits-per-color = <8>;
	mem-word-width = <128>;
};
```

## Documentation/devicetree/bindings/video/analog-tv-connector.txt
```
Analog TV Connector
===================

Required properties:
- compatible: "composite-video-connector" or "svideo-connector"

Optional properties:
- label: a symbolic name for the connector

Required nodes:
- Video port for TV input

Example
-------

tv: connector {
	compatible = "composite-video-connector";
	label = "tv";

	port {
		tv_connector_in: endpoint {
			remote-endpoint = <&venc_out>;
		};
	};
};
```

## Documentation/devicetree/bindings/video/backlight/pwm-backlight.txt
```
pwm-backlight bindings

Required properties:
  - compatible: "pwm-backlight"
  - pwms: OF device-tree PWM specification (see PWM binding[0])
  - brightness-levels: Array of distinct brightness levels. Typically these
      are in the range from 0 to 255, but any range starting at 0 will do.
      The actual brightness level (PWM duty cycle) will be interpolated
      from these values. 0 means a 0% duty cycle (darkest/off), while the
      last value in the array represents a 100% duty cycle (brightest).
  - default-brightness-level: the default brightness level (index into the
      array defined by the "brightness-levels" property)

Optional properties:
  - pwm-names: a list of names for the PWM devices specified in the
               "pwms" property (see PWM binding[0])
  - enable-gpios: contains a single GPIO specifier for the GPIO which enables
                  and disables the backlight (see GPIO binding[1])

[0]: Documentation/devicetree/bindings/pwm/pwm.txt
[1]: Documentation/devicetree/bindings/gpio/gpio.txt

Example:

	backlight {
		compatible = "pwm-backlight";
		pwms = <&pwm 0 5000000>;

		brightness-levels = <0 4 8 16 32 64 128 255>;
		default-brightness-level = <6>;

		enable-gpios = <&gpio 58 0>;
	};
```

## Documentation/devicetree/bindings/video/bridge/anx7814.txt
```
Analogix ANX7814 SlimPort (Full-HD Transmitter)
-----------------------------------------------

The ANX7814 is an ultra-low power Full-HD (1080p60) SlimPort transmitter
designed for portable devices.

Required properties:

 - compatible		: "analogix,anx7814"
 - reg			: I2C address of the device
 - interrupt-parent	: Should be the phandle of the interrupt controller
			  that services interrupts for this device
 - interrupts		: Should contain the INTP interrupt
 - hpd-gpios		: Which GPIO to use for hpd
 - pd-gpios		: Which GPIO to use for power down
 - reset-gpios		: Which GPIO to use for reset

Optional properties:

 - dvdd10-supply	: Regulator for 1.0V digital core power.
 - Video port for HDMI input, using the DT bindings defined in [1].

[1]: Documentation/devicetree/bindings/media/video-interfaces.txt

Example:

	anx7814: anx7814@38 {
		compatible = "analogix,anx7814";
		reg = <0x38>;
		interrupt-parent = <&gpio0>;
		interrupts = <99 IRQ_TYPE_LEVEL_LOW>;   /* INTP */
		hpd-gpios = <&pio 36 GPIO_ACTIVE_HIGH>;
		pd-gpios = <&pio 33 GPIO_ACTIVE_HIGH>;
		reset-gpios = <&pio 98 GPIO_ACTIVE_HIGH>;
		port {
			anx7814_in: endpoint {
				remote-endpoint = <&hdmi0_out>;
			};
		};
	};
```

## Documentation/devicetree/bindings/video/bridge/ps8622.txt
```
ps8622-bridge bindings

Required properties:
	- compatible: "parade,ps8622" or "parade,ps8625"
	- reg: first i2c address of the bridge
	- sleep-gpios: OF device-tree gpio specification for PD_ pin.
	- reset-gpios: OF device-tree gpio specification for RST_ pin.

Optional properties:
	- lane-count: number of DP lanes to use
	- use-external-pwm: backlight will be controlled by an external PWM
	- video interfaces: Device node can contain video interface port
			    nodes for panel according to [1].

[1]: Documentation/devicetree/bindings/media/video-interfaces.txt

Example:
	lvds-bridge@48 {
		compatible = "parade,ps8622";
		reg = <0x48>;
		sleep-gpios = <&gpc3 6 1 0 0>;
		reset-gpios = <&gpc3 1 1 0 0>;
		lane-count = <1>;
		ports {
			port@0 {
				bridge_out: endpoint {
					remote-endpoint = <&panel_in>;
				};
			};
		};
	};
```

## Documentation/devicetree/bindings/video/exynos_dp.txt
```
The Exynos display port interface should be configured based on
the type of panel connected to it.

We use two nodes:
	-dp-controller node
	-dptx-phy node(defined inside dp-controller node)

For the DP-PHY initialization, we use the dptx-phy node.
Required properties for dptx-phy: deprecated, use phys and phy-names
	-reg: deprecated
		Base address of DP PHY register.
	-samsung,enable-mask: deprecated
		The bit-mask used to enable/disable DP PHY.

For the Panel initialization, we read data from dp-controller node.
Required properties for dp-controller:
	-compatible:
		should be "samsung,exynos5-dp".
	-reg:
		physical base address of the controller and length
		of memory mapped region.
	-interrupts:
		interrupt combiner values.
	-clocks:
		from common clock binding: handle to dp clock.
	-clock-names:
		from common clock binding: Shall be "dp".
	-interrupt-parent:
		phandle to Interrupt combiner node.
	-phys:
		from general PHY binding: the phandle for the PHY device.
	-phy-names:
		from general PHY binding: Should be "dp".
	-samsung,color-space:
		input video data format.
			COLOR_RGB = 0, COLOR_YCBCR422 = 1, COLOR_YCBCR444 = 2
	-samsung,dynamic-range:
		dynamic range for input video data.
			VESA = 0, CEA = 1
	-samsung,ycbcr-coeff:
		YCbCr co-efficients for input video.
			COLOR_YCBCR601 = 0, COLOR_YCBCR709 = 1
	-samsung,color-depth:
		number of bits per colour component.
			COLOR_6 = 0, COLOR_8 = 1, COLOR_10 = 2, COLOR_12 = 3
	-samsung,link-rate:
		link rate supported by the panel.
			LINK_RATE_1_62GBPS = 0x6, LINK_RATE_2_70GBPS = 0x0A
	-samsung,lane-count:
		number of lanes supported by the panel.
			LANE_COUNT1 = 1, LANE_COUNT2 = 2, LANE_COUNT4 = 4
	- display-timings: timings for the connected panel as described by
		Documentation/devicetree/bindings/video/display-timing.txt

Optional properties for dp-controller:
	-interlaced:
		interlace scan mode.
			Progressive if defined, Interlaced if not defined
	-vsync-active-high:
		VSYNC polarity configuration.
			High if defined, Low if not defined
	-hsync-active-high:
		HSYNC polarity configuration.
			High if defined, Low if not defined
	-samsung,hpd-gpio:
		Hotplug detect GPIO.
			Indicates which GPIO should be used for hotplug
			detection
	-video interfaces: Device node can contain video interface port
			    nodes according to [1].

[1]: Documentation/devicetree/bindings/media/video-interfaces.txt

Example:

SOC specific portion:
	dp-controller {
		compatible = "samsung,exynos5-dp";
		reg = <0x145b0000 0x10000>;
		interrupts = <10 3>;
		interrupt-parent = <&combiner>;
		clocks = <&clock 342>;
		clock-names = "dp";

		phys = <&dp_phy>;
		phy-names = "dp";
	};

Board Specific portion:
	dp-controller {
		samsung,color-space = <0>;
		samsung,dynamic-range = <0>;
		samsung,ycbcr-coeff = <0>;
		samsung,color-depth = <1>;
		samsung,link-rate = <0x0a>;
		samsung,lane-count = <4>;

		display-timings {
			native-mode = <&lcd_timing>;
			lcd_timing: 1366x768 {
				clock-frequency = <70589280>;
				hactive = <1366>;
				vactive = <768>;
				hfront-porch = <40>;
				hback-porch = <40>;
				hsync-len = <32>;
				vback-porch = <10>;
				vfront-porch = <12>;
				vsync-len = <6>;
			};
		};

		ports {
			port@0 {
				dp_out: endpoint {
					remote-endpoint = <&bridge_in>;
				};
			};
		};
	};
```

## Documentation/devicetree/bindings/video/exynos_dsim.txt
```
Exynos MIPI DSI Master

Required properties:
  - compatible: value should be one of the following
		"samsung,exynos4210-mipi-dsi" /* for Exynos4 SoCs */
		"samsung,exynos5410-mipi-dsi" /* for Exynos5410/5420/5440 SoCs */
  - reg: physical base address and length of the registers set for the device
  - interrupts: should contain DSI interrupt
  - clocks: list of clock specifiers, must contain an entry for each required
    entry in clock-names
  - clock-names: should include "bus_clk"and "pll_clk" entries
  - phys: list of phy specifiers, must contain an entry for each required
    entry in phy-names
  - phy-names: should include "dsim" entry
  - vddcore-supply: MIPI DSIM Core voltage supply (e.g. 1.1V)
  - vddio-supply: MIPI DSIM I/O and PLL voltage supply (e.g. 1.8V)
  - samsung,pll-clock-frequency: specifies frequency of the "pll_clk" clock
  - #address-cells, #size-cells: should be set respectively to <1> and <0>
    according to DSI host bindings (see MIPI DSI bindings [1])

Optional properties:
  - samsung,power-domain: a phandle to DSIM power domain node

Child nodes:
  Should contain DSI peripheral nodes (see MIPI DSI bindings [1]).

Video interfaces:
  Device node can contain video interface port nodes according to [2].
  The following are properties specific to those nodes:

  port node:
    - reg: (required) can be 0 for input RGB/I80 port or 1 for DSI port;

  endpoint node of DSI port (reg = 1):
    - samsung,burst-clock-frequency: specifies DSI frequency in high-speed burst
      mode
    - samsung,esc-clock-frequency: specifies DSI frequency in escape mode

[1]: Documentation/devicetree/bindings/mipi/dsi/mipi-dsi-bus.txt
[2]: Documentation/devicetree/bindings/media/video-interfaces.txt

Example:

	dsi@11C80000 {
		compatible = "samsung,exynos4210-mipi-dsi";
		reg = <0x11C80000 0x10000>;
		interrupts = <0 79 0>;
		clocks = <&clock 286>, <&clock 143>;
		clock-names = "bus_clk", "pll_clk";
		phys = <&mipi_phy 1>;
		phy-names = "dsim";
		vddcore-supply = <&vusb_reg>;
		vddio-supply = <&vmipi_reg>;
		samsung,power-domain = <&pd_lcd0>;
		#address-cells = <1>;
		#size-cells = <0>;
		samsung,pll-clock-frequency = <24000000>;

		panel@1 {
			reg = <0>;
			...
			port {
				panel_ep: endpoint {
					remote-endpoint = <&dsi_ep>;
				};
			};
		};

		ports {
			#address-cells = <1>;
			#size-cells = <0>;

			port@1 {
				dsi_ep: endpoint {
					reg = <0>;
					samsung,burst-clock-frequency = <500000000>;
					samsung,esc-clock-frequency = <20000000>;
					remote-endpoint = <&panel_ep>;
				};
			};
		};
	};
```

## Documentation/devicetree/bindings/video/exynos_hdmi.txt
```
Device-Tree bindings for drm hdmi driver

Required properties:
- compatible: value should be one among the following:
	1) "samsung,exynos5-hdmi" <DEPRECATED>
	2) "samsung,exynos4210-hdmi"
	3) "samsung,exynos4212-hdmi"
- reg: physical base address of the hdmi and length of memory mapped
	region.
- interrupts: interrupt number to the cpu.
- hpd-gpio: following information about the hotplug gpio pin.
	a) phandle of the gpio controller node.
	b) pin number within the gpio controller.
	c) optional flags and pull up/down.
- clocks: list of clock IDs from SoC clock driver.
	a) hdmi: Gate of HDMI IP bus clock.
	b) sclk_hdmi: Gate of HDMI special clock.
	c) sclk_pixel: Pixel special clock, one of the two possible inputs of
		HDMI clock mux.
	d) sclk_hdmiphy: HDMI PHY clock output, one of two possible inputs of
		HDMI clock mux.
	e) mout_hdmi: It is required by the driver to switch between the 2
		parents i.e. sclk_pixel and sclk_hdmiphy. If hdmiphy is stable
		after configuration, parent is set to sclk_hdmiphy else
		sclk_pixel.
- clock-names: aliases as per driver requirements for above clock IDs:
	"hdmi", "sclk_hdmi", "sclk_pixel", "sclk_hdmiphy" and "mout_hdmi".
- ddc: phandle to the hdmi ddc node
- phy: phandle to the hdmi phy node

Example:

	hdmi {
		compatible = "samsung,exynos4212-hdmi";
		reg = <0x14530000 0x100000>;
		interrupts = <0 95 0>;
		hpd-gpio = <&gpx3 7 1>;
		ddc = <&hdmi_ddc_node>;
		phy = <&hdmi_phy_node>;
	};
```
