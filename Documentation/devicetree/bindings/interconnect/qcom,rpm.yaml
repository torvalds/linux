## Documentation/devicetree/bindings/interconnect/qcom,shikra.yaml
```yaml
# SPDX-License-Identifier: (GPL-2.0 OR BSD-2-Clause)
%YAML 1.2
---
$id: http://devicetree.org/schemas/interconnect/qcom,shikra.yaml#
$schema: http://devicetree.org/meta-schemas/core.yaml#

title: Qualcomm Shikra Network-On-Chip interconnect

maintainers:
  - Raviteja Laggyshetty <raviteja.laggyshetty@oss.qualcomm.com>

description:
  The Qualcomm Shikra interconnect providers support adjusting the
  bandwidth requirements between the various NoC fabrics.

properties:
  compatible:
    enum:
      - qcom,shikra-config-noc
      - qcom,shikra-mem-noc-core
      - qcom,shikra-sys-noc

  reg:
    maxItems: 1

  clocks:
    minItems: 1
    maxItems: 4

  clock-names:
    minItems: 1
    maxItems: 4

# Child node's properties
patternProperties:
  '^interconnect-[a-z0-9]+$':
    type: object
    description:
      The interconnect providers do not have a separate QoS register space,
      but share parent's space.

    $ref: qcom,rpm-common.yaml#

    properties:
      compatible:
        enum:
          - qcom,shikra-clk-virt
          - qcom,shikra-mc-virt
          - qcom,shikra-mmrt-virt
          - qcom,shikra-mmnrt-virt

    required:
      - compatible

    unevaluatedProperties: false

required:
  - compatible
  - reg

allOf:
  - $ref: qcom,rpm-common.yaml#
  - if:
      properties:
        compatible:
          const: qcom,shikra-mem-noc-core

    then:
      properties:
        clocks:
          items:
            - description: GPU-NoC AXI clock

        clock-names:
          items:
            - const: gpu_axi
      patternProperties:
        '^interconnect-[a-z0-9]+$': false

  - if:
      properties:
        compatible:
          const: qcom,shikra-sys-noc

    then:
      properties:
        clocks:
          items:
            - description: EMAC0-NoC AXI clock.
            - description: EMAC1-NoC AXI clock.
            - description: USB2-NoC AXI clock.
            - description: USB3-NoC AXI clock.

        clock-names:
          items:
            - const: emac0_axi
            - const: emac1_axi
            - const: usb2_axi
            - const: usb3_axi

  - if:
      properties:
        compatible:
          const: qcom,shikra-config-noc

    then:
      properties:
        clocks: false
        clock-names: false
      patternProperties:
        '^interconnect-[a-z0-9]+$': false

unevaluatedProperties: false

examples:
  - |
    interconnect@1880000 {
        compatible = "qcom,shikra-sys-noc";
        reg = <0x01880000 0x6a080>;
        #interconnect-cells = <2>;
        clocks = <&gcc_emac0_axi_sys_noc_clk>,
                 <&gcc_emac1_axi_sys_noc_clk>,
                 <&gcc_sys_noc_usb2_prim_axi_clk>,
                 <&gcc_sys_noc_usb3_prim_axi_clk>;
        clock-names = "emac0_axi",
                      "emac1_axi",
                      "usb2_axi",
                      "usb3_axi";

        interconnect-clk {
            compatible = "qcom,shikra-clk-virt";
            #interconnect-cells = <2>;
        };
    };
```

## Documentation/devicetree/bindings/interconnect/qcom,sm6115.yaml
```yaml
# SPDX-License-Identifier: (GPL-2.0 OR BSD-2-Clause)
%YAML 1.2
---
$id: http://devicetree.org/schemas/interconnect/qcom,sm6115.yaml#
$schema: http://devicetree.org/meta-schemas/core.yaml#

title: Qualcomm SM6115 Network-On-Chip interconnect

maintainers:
  - Konrad Dybcio <konradybcio@kernel.org>

description:
  The Qualcomm SM6115 interconnect providers support adjusting the
  bandwidth requirements between the various NoC fabrics.

properties:
  compatible:
    enum:
      - qcom,sm6115-bimc
      - qcom,sm6115-cnoc
      - qcom,sm6115-snoc

  reg:
    maxItems: 1

  clocks:
    minItems: 1
    maxItems: 4

  clock-names:
    minItems: 1
    maxItems: 4

# Child node's properties
patternProperties:
  '^interconnect-[a-z0-9]+$':
    type: object
    description:
      The interconnect providers do not have a separate QoS register space,
      but share parent's space.

    $ref: qcom,rpm-common.yaml#

    properties:
      compatible:
        enum:
          - qcom,sm6115-clk-virt
          - qcom,sm6115-mmrt-virt
          - qcom,sm6115-mmnrt-virt

    required:
      - compatible

    unevaluatedProperties: false

required:
  - compatible
  - reg

allOf:
  - $ref: qcom,rpm-common.yaml#
  - if:
      properties:
        compatible:
          const: qcom,sm6115-cnoc

    then:
      properties:
        clocks:
          items:
            - description: USB-NoC AXI clock

        clock-names:
          items:
            - const: usb_axi

  - if:
      properties:
        compatible:
          const: qcom,sm6115-snoc

    then:
      properties:
        clocks:
          items:
            - description: CPU-NoC AXI clock.
            - description: UFS-NoC AXI clock.
            - description: USB-NoC AXI clock.
            - description: IPA clock.

        clock-names:
          items:
            - const: cpu_axi
            - const: ufs_axi
            - const: usb_axi
            - const: ipa

  - if:
      properties:
        compatible:
          enum:
            - qcom,sm6115-bimc
            - qcom,sm6115-clk-virt
            - qcom,sm6115-mmrt-virt
            - qcom,sm6115-mmnrt-virt

    then:
      properties:
        clocks: false
        clock-names: false

unevaluatedProperties: false

examples:
  - |
    #include <dt-bindings/clock/qcom,gcc-sm6115.h>
    #include <dt-bindings/clock/qcom,rpmcc.h>

    snoc: interconnect@1880000 {
        compatible = "qcom,sm6115-snoc";
        reg = <0x01880000 0x60200>;
        clocks = <&gcc GCC_SYS_NOC_CPUSS_AHB_CLK>,
                 <&gcc GCC_SYS_NOC_UFS_PHY_AXI_CLK>,
                 <&gcc GCC_SYS_NOC_USB3_PRIM_AXI_CLK>,
                 <&rpmcc RPM_SMD_IPA_CLK>;
        clock-names = "cpu_axi",
                      "ufs_axi",
                      "usb_axi",
                      "ipa";
        #interconnect-cells = <1>;

        qup_virt: interconnect-clk {
            compatible = "qcom,sm6115-clk-virt";
            #interconnect-cells = <1>;
        };

        mmnrt_virt: interconnect-mmnrt {
            compatible = "qcom,sm6115-mmnrt-virt";
            #interconnect-cells = <1>;
        };

        mmrt_virt: interconnect-mmrt {
            compatible = "qcom,sm6115-mmrt-virt";
            #interconnect-cells = <1>;
        };
    };

    cnoc: interconnect@1900000 {
        compatible = "qcom,sm6115-cnoc";
        reg = <0x01900000 0x8200>;
        #interconnect-cells = <1>;
    };
```

## Documentation/devicetree/bindings/interconnect/qcom,sm6350-rpmh.yaml
```yaml
# SPDX-License-Identifier: (GPL-2.0 OR BSD-2-Clause)
%YAML 1.2
---
$id: http://devicetree.org/schemas/interconnect/qcom,sm6350-rpmh.yaml#
$schema: http://devicetree.org/meta-schemas/core.yaml#

title: Qualcomm SM6350 RPMh Network-On-Chip Interconnect

maintainers:
  - Luca Weiss <luca.weiss@fairphone.com>

description:
  Qualcomm RPMh-based interconnect provider on SM6350.

properties:
  compatible:
    enum:
      - qcom,sm6350-aggre1-noc
      - qcom,sm6350-aggre2-noc
      - qcom,sm6350-config-noc
      - qcom,sm6350-dc-noc
      - qcom,sm6350-gem-noc
      - qcom,sm6350-mmss-noc
      - qcom,sm6350-npu-noc
      - qcom,sm6350-system-noc

  reg:
    maxItems: 1

  clocks:
    minItems: 1
    maxItems: 2

patternProperties:
  '^interconnect-[a-z0-9\-]+$':
    type: object
    description:
      The interconnect providers do not have a separate QoS register space,
      but share parent's space.
    $ref: qcom,rpmh-common.yaml#

    properties:
      compatible:
        enum:
          - qcom,sm6350-clk-virt
          - qcom,sm6350-compute-noc

    required:
      - compatible

    unevaluatedProperties: false

required:
  - compatible
  - reg

allOf:
  - $ref: qcom,rpmh-common.yaml#
  - if:
      properties:
        compatible:
          contains:
            enum:
              - qcom,sm6350-aggre1-noc
    then:
      properties:
        clocks:
          items:
            - description: aggre UFS PHY AXI clock

  - if:
      properties:
        compatible:
          contains:
            enum:
              - qcom,sm6350-aggre2-noc
    then:
      properties:
        clocks:
          items:
            - description: aggre USB3 PRIM AXI clock
            - description: RPMH CC IPA clock

  - if:
      properties:
        compatible:
          contains:
            enum:
              - qcom,sm6350-aggre1-noc
              - qcom,sm6350-aggre2-noc
    then:
      required:
        - clocks
    else:
      properties:
        clocks: false

unevaluatedProperties: false

examples:
  - |
    #include <dt-bindings/clock/qcom,gcc-sm6350.h>
    #include <dt-bindings/clock/qcom,rpmh.h>

    config_noc: interconnect@1500000 {
        compatible = "qcom,sm6350-config-noc";
        reg = <0x01500000 0x28000>;
        #interconnect-cells = <2>;
        qcom,bcm-voters = <&apps_bcm_voter>;
    };

    aggre2_noc: interconnect@1700000 {
        compatible = "qcom,sm6350-aggre2-noc";
        reg = <0x01700000 0x1f880>;
        #interconnect-cells = <2>;
        qcom,bcm-voters = <&apps_bcm_voter>;
        clocks = <&gcc GCC_AGGRE_USB3_PRIM_AXI_CLK>,
                 <&rpmhcc RPMH_IPA_CLK>;

        compute_noc: interconnect-compute-noc {
            compatible = "qcom,sm6350-compute-noc";
            #interconnect-cells = <2>;
            qcom,bcm-voters = <&apps_bcm_voter>;
        };
    };
```

## Documentation/devicetree/bindings/interconnect/qcom,sm7150-rpmh.yaml
```yaml
# SPDX-License-Identifier: (GPL-2.0-only OR BSD-2-Clause)
%YAML 1.2
---
$id: http://devicetree.org/schemas/interconnect/qcom,sm7150-rpmh.yaml#
$schema: http://devicetree.org/meta-schemas/core.yaml#

title: Qualcomm RPMh Network-On-Chip Interconnect on SM7150

maintainers:
  - Danila Tikhonov <danila@jiaxyga.com>

description: |
  RPMh interconnect providers support system bandwidth requirements through
  RPMh hardware accelerators known as Bus Clock Manager (BCM).

  See also:: include/dt-bindings/interconnect/qcom,sm7150-rpmh.h

allOf:
  - $ref: qcom,rpmh-common.yaml#

properties:
  compatible:
    enum:
      - qcom,sm7150-aggre1-noc
      - qcom,sm7150-aggre2-noc
      - qcom,sm7150-compute-noc
      - qcom,sm7150-config-noc
      - qcom,sm7150-dc-noc
      - qcom,sm7150-gem-noc
      - qcom,sm7150-mc-virt
      - qcom,sm7150-mmss-noc
      - qcom,sm7150-system-noc

  reg:
    maxItems: 1

# Child node's properties
patternProperties:
  '^interconnect-[0-9]+$':
    type: object
    description:
      The interconnect providers do not have a separate QoS register space,
      but share parent's space.

    allOf:
      - $ref: qcom,rpmh-common.yaml#

    properties:
      compatible:
        enum:
          - qcom,sm7150-camnoc-virt

    required:
      - compatible

    unevaluatedProperties: false

required:
  - compatible
  - reg

unevaluatedProperties: false

examples:
  - |
    mc_virt: interconnect@1380000 {
        compatible = "qcom,sm7150-mc-virt";
        reg = <0x01380000 0x40000>;
        #interconnect-cells = <2>;
        qcom,bcm-voters = <&apps_bcm_voter>;
    };

    system_noc: interconnect@1620000 {
        compatible = "qcom,sm7150-system-noc";
        reg = <0x01620000 0x40000>;
        #interconnect-cells = <2>;
        qcom,bcm-voters = <&apps_bcm_voter>;

        camnoc_virt: interconnect-0 {
            compatible = "qcom,sm7150-camnoc-virt";
            #interconnect-cells = <2>;
            qcom,bcm-voters = <&apps_bcm_voter>;
        };
    };
```

## Documentation/devicetree/bindings/interconnect/qcom,sm8450-rpmh.yaml
```yaml
# SPDX-License-Identifier: GPL-2.0-only OR BSD-2-Clause
%YAML 1.2
---
$id: http://devicetree.org/schemas/interconnect/qcom,sm8450-rpmh.yaml#
$schema: http://devicetree.org/meta-schemas/core.yaml#

title: Qualcomm RPMh Network-On-Chip Interconnect on SM8450

maintainers:
  - Bjorn Andersson <andersson@kernel.org>
  - Konrad Dybcio <konradybcio@kernel.org>

description: |
  RPMh interconnect providers support system bandwidth requirements through
  RPMh hardware accelerators known as Bus Clock Manager (BCM).

  See also: include/dt-bindings/interconnect/qcom,sm8450.h

properties:
  compatible:
    enum:
      - qcom,sm8450-aggre1-noc
      - qcom,sm8450-aggre2-noc
      - qcom,sm8450-clk-virt
      - qcom,sm8450-config-noc
      - qcom,sm8450-gem-noc
      - qcom,sm8450-lpass-ag-noc
      - qcom,sm8450-mc-virt
      - qcom,sm8450-mmss-noc
      - qcom,sm8450-nsp-noc
      - qcom,sm8450-pcie-anoc
      - qcom,sm8450-system-noc

  reg:
    maxItems: 1

  clocks:
    minItems: 1
    maxItems: 4

required:
  - compatible

allOf:
  - $ref: qcom,rpmh-common.yaml#
  - if:
      properties:
        compatible:
          contains:
            enum:
              - qcom,sm8450-clk-virt
              - qcom,sm8450-mc-virt
    then:
      properties:
        reg: false
    else:
      required:
        - reg

  - if:
      properties:
        compatible:
          contains:
            enum:
              - qcom,sm8450-aggre1-noc
    then:
      properties:
        clocks:
          items:
            - description: aggre UFS PHY AXI clock
            - description: aggre USB3 PRIM AXI clock

  - if:
      properties:
        compatible:
          contains:
            enum:
              - qcom,sm8450-aggre2-noc
    then:
      properties:
        clocks:
          items:
            - description: aggre-NOC PCIe 0 AXI clock
            - description: aggre-NOC PCIe 1 AXI clock
            - description: aggre UFS PHY AXI clock
            - description: RPMH CC IPA clock

  - if:
      properties:
        compatible:
          contains:
            enum:
              - qcom,sm8450-aggre1-noc
              - qcom,sm8450-aggre2-noc
    then:
      required:
        - clocks
    else:
      properties:
        clocks: false

unevaluatedProperties: false

examples:
  - |
    #include <dt-bindings/clock/qcom,gcc-sm8450.h>
    #include <dt-bindings/clock/qcom,rpmh.h>

    interconnect-0 {
        compatible = "qcom,sm8450-clk-virt";
        #interconnect-cells = <2>;
        qcom,bcm-voters = <&apps_bcm_voter>;
    };

    interconnect@1700000 {
        compatible = "qcom,sm8450-aggre2-noc";
        reg = <0x01700000 0x31080>;
        #interconnect-cells = <2>;
        qcom,bcm-voters = <&apps_bcm_voter>;
        clocks = <&gcc GCC_AGGRE_NOC_PCIE_0_AXI_CLK>,
                 <&gcc GCC_AGGRE_NOC_PCIE_1_AXI_CLK>,
                 <&gcc GCC_AGGRE_UFS_PHY_AXI_CLK>,
                 <&rpmhcc RPMH_IPA_CLK>;
    };
```
