## Documentation/devicetree/bindings/interconnect/qcom,sc7280-rpmh.yaml
```yaml
# SPDX-License-Identifier: GPL-2.0-only OR BSD-2-Clause
%YAML 1.2
---
$id: http://devicetree.org/schemas/interconnect/qcom,sc7280-rpmh.yaml#
$schema: http://devicetree.org/meta-schemas/core.yaml#

title: Qualcomm RPMh Network-On-Chip Interconnect on SC7280

maintainers:
  - Bjorn Andersson <andersson@kernel.org>
  - Konrad Dybcio <konradybcio@kernel.org>

description: |
  RPMh interconnect providers support system bandwidth requirements through
  RPMh hardware accelerators known as Bus Clock Manager (BCM).

  See also:: include/dt-bindings/interconnect/qcom,sc7280.h

properties:
  compatible:
    enum:
      - qcom,sc7280-aggre1-noc
      - qcom,sc7280-aggre2-noc
      - qcom,sc7280-clk-virt
      - qcom,sc7280-cnoc2
      - qcom,sc7280-cnoc3
      - qcom,sc7280-dc-noc
      - qcom,sc7280-gem-noc
      - qcom,sc7280-lpass-ag-noc
      - qcom,sc7280-mc-virt
      - qcom,sc7280-mmss-noc
      - qcom,sc7280-nsp-noc
      - qcom,sc7280-system-noc

  reg:
    maxItems: 1

  clocks:
    minItems: 1
    maxItems: 2

required:
  - compatible

allOf:
  - $ref: qcom,rpmh-common.yaml#
  - if:
      properties:
        compatible:
          contains:
            enum:
              - qcom,sc7280-clk-virt
    then:
      properties:
        reg: false
    else:
      required:
        - reg

  - if:
      properties:
        compatible:
          contains:
            enum:
              - qcom,sc7280-aggre1-noc
    then:
      properties:
        clocks:
          items:
            - description: aggre UFS PHY AXI clock
            - description: aggre USB3 PRIM AXI clock

  - if:
      properties:
        compatible:
          contains:
            enum:
              - qcom,sc7280-aggre2-noc
    then:
      properties:
        clocks:
          items:
            - description: RPMH CC IPA clock

  - if:
      properties:
        compatible:
          contains:
            enum:
              - qcom,sc7280-aggre1-noc
              - qcom,sc7280-aggre2-noc
    then:
      required:
        - clocks
    else:
      properties:
        clocks: false

unevaluatedProperties: false

examples:
  - |
    #include <dt-bindings/clock/qcom,gcc-sc7280.h>
    interconnect {
        compatible = "qcom,sc7280-clk-virt";
        #interconnect-cells = <2>;
        qcom,bcm-voters = <&apps_bcm_voter>;
    };

    interconnect@9100000 {
        reg = <0x9100000 0xe2200>;
        compatible = "qcom,sc7280-gem-noc";
        #interconnect-cells = <2>;
        qcom,bcm-voters = <&apps_bcm_voter>;
    };

    interconnect@16e0000 {
        reg = <0x016e0000 0x1c080>;
        compatible = "qcom,sc7280-aggre1-noc";
        #interconnect-cells = <2>;
        qcom,bcm-voters = <&apps_bcm_voter>;
        clocks = <&gcc GCC_AGGRE_UFS_PHY_AXI_CLK>,
                 <&gcc GCC_AGGRE_USB3_PRIM_AXI_CLK>;
    };
```

## Documentation/devicetree/bindings/interconnect/qcom,sc8280xp-rpmh.yaml
```yaml
# SPDX-License-Identifier: GPL-2.0-only OR BSD-2-Clause
%YAML 1.2
---
$id: http://devicetree.org/schemas/interconnect/qcom,sc8280xp-rpmh.yaml#
$schema: http://devicetree.org/meta-schemas/core.yaml#

title: Qualcomm RPMh Network-On-Chip Interconnect on SC8280XP

maintainers:
  - Bjorn Andersson <andersson@kernel.org>
  - Konrad Dybcio <konradybcio@kernel.org>

description: |
  RPMh interconnect providers support system bandwidth requirements through
  RPMh hardware accelerators known as Bus Clock Manager (BCM).

  See also: include/dt-bindings/interconnect/qcom,sc8280xp.h

properties:
  compatible:
    enum:
      - qcom,sc8280xp-aggre1-noc
      - qcom,sc8280xp-aggre2-noc
      - qcom,sc8280xp-clk-virt
      - qcom,sc8280xp-config-noc
      - qcom,sc8280xp-dc-noc
      - qcom,sc8280xp-gem-noc
      - qcom,sc8280xp-lpass-ag-noc
      - qcom,sc8280xp-mc-virt
      - qcom,sc8280xp-mmss-noc
      - qcom,sc8280xp-nspa-noc
      - qcom,sc8280xp-nspb-noc
      - qcom,sc8280xp-system-noc

  reg:
    maxItems: 1

  clocks:
    minItems: 7
    maxItems: 8

required:
  - compatible

allOf:
  - $ref: qcom,rpmh-common.yaml#
  - if:
      properties:
        compatible:
          contains:
            enum:
              - qcom,sc8280xp-clk-virt
              - qcom,sc8280xp-mc-virt
    then:
      properties:
        reg: false
        clocks: false
    else:
      required:
        - reg

  - if:
      properties:
        compatible:
          contains:
            enum:
              - qcom,sc8280xp-aggre1-noc
    then:
      properties:
        clocks:
          items:
            - description: aggre UFS PHY AXI clock
            - description: aggre USB3 PRIM AXI clock
            - description: aggre USB3 SEC AXI clock
            - description: aggre USB3 MP AXI clock
            - description: aggre USB4 AXI clock
            - description: aggre USB4 1 AXI clock
            - description: aggre USB NOC SOUTH AXI clock
            - description: RPMH CC IPA clock

  - if:
      properties:
        compatible:
          contains:
            enum:
              - qcom,sc8280xp-aggre2-noc
    then:
      properties:
        clocks:
          items:
            - description: aggre NOC PCIE0 tunnel AXI clock
            - description: aggre NOC PCIE1 tunnel AXI clock
            - description: aggre NOC PCIE 4 AXI clock
            - description: aggre NOC PCIE SOUTH SF AXI clock
            - description: aggre UFS CARD AXI clock
            - description: DDRSS GPU AXI clock
            - description: DDRSS PCIE SF TBU clock

  - if:
      properties:
        compatible:
          contains:
            enum:
              - qcom,sc8280xp-aggre1-noc
              - qcom,sc8280xp-aggre2-noc
    then:
      required:
        - clocks
    else:
      properties:
        clocks: false

unevaluatedProperties: false

examples:
  - |
    #include <dt-bindings/clock/qcom,gcc-sc8280xp.h>
    #include <dt-bindings/clock/qcom,rpmh.h>

    interconnect {
        compatible = "qcom,sc8280xp-clk-virt";
        #interconnect-cells = <2>;
        qcom,bcm-voters = <&apps_bcm_voter>;
    };

    interconnect@9100000 {
        compatible = "qcom,sc8280xp-gem-noc";
        reg = <0x9100000 0xb8400>;
        #interconnect-cells = <2>;
        qcom,bcm-voters = <&apps_bcm_voter>;
    };

    interconnect@16c0000 {
        compatible = "qcom,sc8280xp-aggre1-noc";
        reg = <0x16c0000 0x3af80>;
        #interconnect-cells = <2>;
        qcom,bcm-voters = <&apps_bcm_voter>;
        clocks = <&gcc GCC_AGGRE_UFS_PHY_AXI_CLK>,
                 <&gcc GCC_AGGRE_USB3_PRIM_AXI_CLK>,
                 <&gcc GCC_AGGRE_USB3_SEC_AXI_CLK>,
                 <&gcc GCC_AGGRE_USB3_MP_AXI_CLK>,
                 <&gcc GCC_AGGRE_USB4_AXI_CLK>,
                 <&gcc GCC_AGGRE_USB4_1_AXI_CLK>,
                 <&gcc GCC_AGGRE_USB_NOC_SOUTH_AXI_CLK>,
                 <&rpmhcc RPMH_IPA_CLK>;
    };
```

## Documentation/devicetree/bindings/interconnect/qcom,sdm660.yaml
```yaml
# SPDX-License-Identifier: (GPL-2.0 OR BSD-2-Clause)
%YAML 1.2
---
$id: http://devicetree.org/schemas/interconnect/qcom,sdm660.yaml#
$schema: http://devicetree.org/meta-schemas/core.yaml#

title: Qualcomm SDM660 Network-On-Chip interconnect

maintainers:
  - Konrad Dybcio <konradybcio@kernel.org>

description: |
  The Qualcomm SDM660 interconnect providers support adjusting the
  bandwidth requirements between the various AnalC fabrics.

properties:
  compatible:
    enum:
      - qcom,sdm660-a2analc
      - qcom,sdm660-bimc
      - qcom,sdm660-canalc
      - qcom,sdm660-ganalc
      - qcom,sdm660-manalc
      - qcom,sdm660-sanalc

  reg:
    maxItems: 1

  clock-names:
    minItems: 1
    maxItems: 5

  clocks:
    minItems: 1
    maxItems: 5

required:
  - compatible
  - reg

unevaluatedProperties: false

allOf:
  - $ref: qcom,rpm-common.yaml#
  - if:
      properties:
        compatible:
          const: qcom,sdm660-manalc

    then:
      properties:
        clocks:
          items:
            - description: CPU-AnalC High-performance Bus Clock.

        clock-names:
          const: iface

  - if:
      properties:
        compatible:
          const: qcom,sdm660-a2analc

    then:
      properties:
        clocks:
          items:
            - description: IPA Clock.
            - description: UFS AXI Clock.
            - description: Aggregate2 UFS AXI Clock.
            - description: Aggregate2 USB3 AXI Clock.
            - description: Config AnalC USB2 AXI Clock.

        clock-names:
          items:
            - const: ipa
            - const: ufs_axi
            - const: aggre2_ufs_axi
            - const: aggre2_usb3_axi
            - const: cfg_analc_usb2_axi

examples:
  - |
    #include <dt-bindings/clock/qcom,gcc-sdm660.h>
    #include <dt-bindings/clock/qcom,mmcc-sdm660.h>
    #include <dt-bindings/clock/qcom,rpmcc.h>

    bimc: interconnect@1008000 {
        compatible = "qcom,sdm660-bimc";
        reg = <0x01008000 0x78000>;
        #interconnect-cells = <1>;
    };

    a2analc: interconnect@1704000 {
        compatible = "qcom,sdm660-a2analc";
        reg = <0x01704000 0xc100>;
        #interconnect-cells = <1>;
        clocks = <&rpmcc RPM_SMD_IPA_CLK>,
                 <&gcc GCC_UFS_AXI_CLK>,
                 <&gcc GCC_AGGRE2_UFS_AXI_CLK>,
                 <&gcc GCC_AGGRE2_USB3_AXI_CLK>,
                 <&gcc GCC_CFG_ANALC_USB2_AXI_CLK>;
        clock-names = "ipa",
                      "ufs_axi",
                      "aggre2_ufs_axi",
                      "aggre2_usb3_axi",
                      "cfg_analc_usb2_axi";
    };
```

## Documentation/devicetree/bindings/interconnect/qcom,sdm845.txt
```
Qualcomm SDM845 Network-On-Chip interconnect driver binding
-----------------------------------------------------------

SDM845 interconnect providers support system bandwidth requirements through
RPMh hardware accelerators known as Bus Clock Manager (BCM). The provider is
able to communicate with the BCM through the Resource State Coordinator (RSC)
associated with each execution environment. Provider nodes must reside within
an RPMh device node pertaining to their RSC and each provider maps to a single
RPMh resource.

Required properties :
- compatible : shall contain only one of the following:
			"qcom,sdm845-rsc-hlos"
- #interconnect-cells : should contain 1

Examples:

apps_rsc: rsc {
	rsc_hlos: interconnect {
		compatible = "qcom,sdm845-rsc-hlos";
		#interconnect-cells = <1>;
	};
};
```

## Documentation/devicetree/bindings/interconnect/qcom,sdm845.yaml
```yaml
# SPDX-License-Identifier: (GPL-2.0 OR BSD-2-Clause)
%YAML 1.2
---
$id: http://devicetree.org/schemas/interconnect/qcom,sdm845.yaml#
$schema: http://devicetree.org/meta-schemas/core.yaml#

title: Qualcomm SDM845 Network-On-Chip Interconnect

maintainers:
  - Georgi Djakov <georgi.djakov@linaro.org>

description: |
   SDM845 interconnect providers support system bandwidth requirements through
   RPMh hardware accelerators known as Bus Clock Manager (BCM). The provider is
   able to communicate with the BCM through the Resource State Coordinator (RSC)
   associated with each execution environment. Provider nodes must point to at
   least one RPMh device child node pertaining to their RSC and each provider
   can map to multiple RPMh resources.

properties:
  reg:
    maxItems: 1

  compatible:
    enum:
      - qcom,sdm845-aggre1-noc
      - qcom,sdm845-aggre2-noc
      - qcom,sdm845-config-noc
      - qcom,sdm845-dc-noc
      - qcom,sdm845-gladiator-noc
      - qcom,sdm845-mem-noc
      - qcom,sdm845-mmss-noc
      - qcom,sdm845-system-noc

  '#interconnect-cells':
    const: 1

  qcom,bcm-voters:
    $ref: /schemas/types.yaml#/definitions/phandle-array
    description: |
      List of phandles to qcom,bcm-voter nodes that are required by
      this interconnect to send RPMh commands.

  qcom,bcm-voter-names:
    $ref: /schemas/types.yaml#/definitions/string-array
    description: |
      Names for each of the qcom,bcm-voters specified.

required:
  - compatible
  - reg
  - '#interconnect-cells'
  - qcom,bcm-voters

additionalProperties: false

examples:
  - |
      #include <dt-bindings/interconnect/qcom,sdm845.h>

      mem_noc: interconnect@1380000 {
             compatible = "qcom,sdm845-mem-noc";
             reg = <0x01380000 0x27200>;
             #interconnect-cells = <1>;
             qcom,bcm-voters = <&apps_bcm_voter>;
      };

      mmss_noc: interconnect@1740000 {
             compatible = "qcom,sdm845-mmss-noc";
             reg = <0x01740000 0x1c1000>;
             #interconnect-cells = <1>;
             qcom,bcm-voter-names = "apps", "disp";
             qcom,bcm-voters = <&apps_bcm_voter>, <&disp_bcm_voter>;
      };
```

## Documentation/devicetree/bindings/interconnect/qcom,sdx75-rpmh.yaml
```yaml
# SPDX-License-Identifier: (GPL-2.0 OR BSD-2-Clause)
%YAML 1.2
---
$id: http://devicetree.org/schemas/interconnect/qcom,sdx75-rpmh.yaml#
$schema: http://devicetree.org/meta-schemas/core.yaml#

title: Qualcomm RPMh Network-On-Chip Interconnect on SDX75

maintainers:
  - Rohit Agarwal <quic_rohiagar@quicinc.com>

description:
  RPMh interconnect providers support system bandwidth requirements through
  RPMh hardware accelerators known as Bus Clock Manager (BCM). The provider is
  able to communicate with the BCM through the Resource State Coordinator (RSC)
  associated with each execution environment. Provider nodes must point to at
  least one RPMh device child node pertaining to their RSC and each provider
  can map to multiple RPMh resources.

properties:
  compatible:
    enum:
      - qcom,sdx75-clk-virt
      - qcom,sdx75-dc-noc
      - qcom,sdx75-gem-noc
      - qcom,sdx75-mc-virt
      - qcom,sdx75-pcie-anoc
      - qcom,sdx75-system-noc

  '#interconnect-cells': true

  reg:
    maxItems: 1

  clocks:
    maxItems: 1

required:
  - compatible

allOf:
  - $ref: qcom,rpmh-common.yaml#
  - if:
      properties:
        compatible:
          contains:
            enum:
              - qcom,sdx75-clk-virt
              - qcom,sdx75-mc-virt
    then:
      properties:
        reg: false
    else:
      required:
        - reg

  - if:
      properties:
        compatible:
          contains:
            enum:
              - qcom,sdx75-clk-virt
    then:
      properties:
        clocks:
          items:
            - description: RPMH CC QPIC Clock
      required:
        - clocks
    else:
      properties:
        clocks: false

unevaluatedProperties: false

examples:
  - |
    #include <dt-bindings/clock/qcom,rpmh.h>

    clk_virt: interconnect-0 {
        compatible = "qcom,sdx75-clk-virt";
        #interconnect-cells = <2>;
        qcom,bcm-voters = <&apps_bcm_voter>;
        clocks = <&rpmhcc RPMH_QPIC_CLK>;
    };

    system_noc: interconnect@1640000 {
        compatible = "qcom,sdx75-system-noc";
        reg = <0x1640000 0x4b400>;
        #interconnect-cells = <2>;
        qcom,bcm-voters = <&apps_bcm_voter>;
    };
```
