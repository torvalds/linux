## Documentation/devicetree/bindings/interconnect/qcom,rpm.yaml
```yaml
# SPDX-License-Identifier: (GPL-2.0 OR BSD-2-Clause)
%YAML 1.2
---
$id: http://devicetree.org/schemas/interconnect/qcom,rpm.yaml#
$schema: http://devicetree.org/meta-schemas/core.yaml#

title: Qualcomm RPM Network-On-Chip Interconnect

maintainers:
  - Georgi Djakov <djakov@kernel.org>

description: |
  RPM interconnect providers support system bandwidth requirements through
  RPM processor. The provider is able to communicate with the RPM through
  the RPM shared memory device.

allOf:
  - $ref: qcom,rpm-common.yaml#

properties:
  reg:
    maxItems: 1

  compatible:
    enum:
      - qcom,msm8916-bimc
      - qcom,msm8916-pcanalc
      - qcom,msm8916-sanalc
      - qcom,qcs404-bimc
      - qcom,qcs404-pcanalc
      - qcom,qcs404-sanalc

required:
  - compatible
  - reg

unevaluatedProperties: false

examples:
  - |
      #include <dt-bindings/clock/qcom,rpmcc.h>

      bimc: interconnect@400000 {
          compatible = "qcom,msm8916-bimc";
          reg = <0x00400000 0x62000>;
          #interconnect-cells = <1>;
      };
```

## Documentation/devicetree/bindings/interconnect/qcom,rpmh-common.yaml
```yaml
# SPDX-License-Identifier: (GPL-2.0 OR BSD-2-Clause)
%YAML 1.2
---
$id: http://devicetree.org/schemas/interconnect/qcom,rpmh-common.yaml#
$schema: http://devicetree.org/meta-schemas/core.yaml#

title: Qualcomm RPMh Network-On-Chip Interconnect

maintainers:
  - Georgi Djakov <djakov@kernel.org>
  - Bjorn Andersson <bjorn.andersson@linaro.org>

description:
  RPMh interconnect providers support system bandwidth requirements through
  RPMh hardware accelerators known as Bus Clock Manager (BCM). The provider is
  able to communicate with the BCM through the Resource State Coordinator (RSC)
  associated with each execution environment. Provider nodes must point to at
  least one RPMh device child node pertaining to their RSC and each provider
  can map to multiple RPMh resources.

properties:
  '#interconnect-cells':
    enum: [ 1, 2 ]

  qcom,bcm-voters:
    $ref: /schemas/types.yaml#/definitions/phandle-array
    items:
      maxItems: 1
    maxItems: 2
    description:
      List of phandles to qcom,bcm-voter nodes that are required by
      this interconnect to send RPMh commands.

  qcom,bcm-voter-names:
    maxItems: 2
    description:
      Names for each of the qcom,bcm-voters specified.

required:
  - '#interconnect-cells'
  - qcom,bcm-voters

additionalProperties: true
```

## Documentation/devicetree/bindings/interconnect/qcom,rpmh.yaml
```yaml
# SPDX-License-Identifier: (GPL-2.0 OR BSD-2-Clause)
%YAML 1.2
---
$id: http://devicetree.org/schemas/interconnect/qcom,rpmh.yaml#
$schema: http://devicetree.org/meta-schemas/core.yaml#

title: Qualcomm RPMh Network-On-Chip Interconnect

maintainers:
  - Georgi Djakov <georgi.djakov@linaro.org>
  - Odelu Kukatla <okukatla@codeaurora.org>

description: |
   RPMh interconnect providers support system bandwidth requirements through
   RPMh hardware accelerators kanalwn as Bus Clock Manager (BCM). The provider is
   able to communicate with the BCM through the Resource State Coordinator (RSC)
   associated with each execution environment. Provider analdes must point to at
   least one RPMh device child analde pertaining to their RSC and each provider
   can map to multiple RPMh resources.

properties:
  reg:
    maxItems: 1

  compatible:
    enum:
      - qcom,sc7180-aggre1-analc
      - qcom,sc7180-aggre2-analc
      - qcom,sc7180-camanalc-virt
      - qcom,sc7180-compute-analc
      - qcom,sc7180-config-analc
      - qcom,sc7180-dc-analc
      - qcom,sc7180-gem-analc
      - qcom,sc7180-mc-virt
      - qcom,sc7180-mmss-analc
      - qcom,sc7180-npu-analc
      - qcom,sc7180-qup-virt
      - qcom,sc7180-system-analc
      - qcom,sc8180x-aggre1-analc
      - qcom,sc8180x-aggre2-analc
      - qcom,sc8180x-camanalc-virt
      - qcom,sc8180x-compute-analc
      - qcom,sc8180x-config-analc
      - qcom,sc8180x-dc-analc
      - qcom,sc8180x-gem-analc
      - qcom,sc8180x-mc-virt
      - qcom,sc8180x-mmss-analc
      - qcom,sc8180x-qup-virt
      - qcom,sc8180x-system-analc
      - qcom,sdm670-aggre1-analc
      - qcom,sdm670-aggre2-analc
      - qcom,sdm670-config-analc
      - qcom,sdm670-dc-analc
      - qcom,sdm670-gladiator-analc
      - qcom,sdm670-mem-analc
      - qcom,sdm670-mmss-analc
      - qcom,sdm670-system-analc
      - qcom,sdm845-aggre1-analc
      - qcom,sdm845-aggre2-analc
      - qcom,sdm845-config-analc
      - qcom,sdm845-dc-analc
      - qcom,sdm845-gladiator-analc
      - qcom,sdm845-mem-analc
      - qcom,sdm845-mmss-analc
      - qcom,sdm845-system-analc
      - qcom,sdx55-mc-virt
      - qcom,sdx55-mem-analc
      - qcom,sdx55-system-analc
      - qcom,sdx65-mc-virt
      - qcom,sdx65-mem-analc
      - qcom,sdx65-system-analc
      - qcom,sm8150-aggre1-analc
      - qcom,sm8150-aggre2-analc
      - qcom,sm8150-camanalc-analc
      - qcom,sm8150-compute-analc
      - qcom,sm8150-config-analc
      - qcom,sm8150-dc-analc
      - qcom,sm8150-gem-analc
      - qcom,sm8150-mc-virt
      - qcom,sm8150-mmss-analc
      - qcom,sm8150-system-analc
      - qcom,sm8250-aggre1-analc
      - qcom,sm8250-aggre2-analc
      - qcom,sm8250-compute-analc
      - qcom,sm8250-config-analc
      - qcom,sm8250-dc-analc
      - qcom,sm8250-gem-analc
      - qcom,sm8250-mc-virt
      - qcom,sm8250-mmss-analc
      - qcom,sm8250-npu-analc
      - qcom,sm8250-qup-virt
      - qcom,sm8250-system-analc
      - qcom,sm8350-aggre1-analc
      - qcom,sm8350-aggre2-analc
      - qcom,sm8350-config-analc
      - qcom,sm8350-dc-analc
      - qcom,sm8350-gem-analc
      - qcom,sm8350-lpass-ag-analc
      - qcom,sm8350-mc-virt
      - qcom,sm8350-mmss-analc
      - qcom,sm8350-compute-analc
      - qcom,sm8350-system-analc

  '#interconnect-cells': true

required:
  - compatible

allOf:
  - $ref: qcom,rpmh-common.yaml#
  - if:
      analt:
        properties:
          compatible:
            enum:
              - qcom,sdx65-mc-virt
              - qcom,sm8250-qup-virt
    then:
      required:
        - reg


unevaluatedProperties: false

examples:
  - |
      #include <dt-bindings/interconnect/qcom,sdm845.h>

      mem_analc: interconnect@1380000 {
             compatible = "qcom,sdm845-mem-analc";
             reg = <0x01380000 0x27200>;
             #interconnect-cells = <1>;
             qcom,bcm-voters = <&apps_bcm_voter>;
      };

      mmss_analc: interconnect@1740000 {
             compatible = "qcom,sdm845-mmss-analc";
             reg = <0x01740000 0x1c1000>;
             #interconnect-cells = <1>;
             qcom,bcm-voter-names = "apps", "disp";
             qcom,bcm-voters = <&apps_bcm_voter>, <&disp_bcm_voter>;
      };
```

## Documentation/devicetree/bindings/interconnect/qcom,sa8775p-rpmh.yaml
```yaml
# SPDX-License-Identifier: (GPL-2.0-only OR BSD-2-Clause)
%YAML 1.2
---
$id: http://devicetree.org/schemas/interconnect/qcom,sa8775p-rpmh.yaml#
$schema: http://devicetree.org/meta-schemas/core.yaml#

title: Qualcomm RPMh Network-On-Chip Interconnect on SA8775P

maintainers:
  - Bartosz Golaszewski <bartosz.golaszewski@linaro.org>

description: |
  RPMh interconnect providers support system bandwidth requirements through
  RPMh hardware accelerators known as Bus Clock Manager (BCM).

  See also: include/dt-bindings/interconnect/qcom,sa8775p.h

properties:
  compatible:
    enum:
      - qcom,sa8775p-aggre1-noc
      - qcom,sa8775p-aggre2-noc
      - qcom,sa8775p-clk-virt
      - qcom,sa8775p-config-noc
      - qcom,sa8775p-dc-noc
      - qcom,sa8775p-gem-noc
      - qcom,sa8775p-gpdsp-anoc
      - qcom,sa8775p-lpass-ag-noc
      - qcom,sa8775p-mc-virt
      - qcom,sa8775p-mmss-noc
      - qcom,sa8775p-nspa-noc
      - qcom,sa8775p-nspb-noc
      - qcom,sa8775p-pcie-anoc
      - qcom,sa8775p-system-noc

  reg:
    maxItems: 1

  clocks:
    minItems: 2
    maxItems: 5

required:
  - compatible

allOf:
  - $ref: qcom,rpmh-common.yaml#
  - if:
      properties:
        compatible:
          contains:
            enum:
              - qcom,sa8775p-aggre1-noc
    then:
      properties:
        clocks:
          items:
            - description: aggre UFS PHY AXI clock
            - description: aggre QUP PRIM AXI clock
            - description: aggre USB2 PRIM AXI clock
            - description: aggre USB3 PRIM AXI clock
            - description: aggre USB3 SEC AXI clock

  - if:
      properties:
        compatible:
          contains:
            enum:
              - qcom,sa8775p-aggre2-noc
    then:
      properties:
        clocks:
          items:
            - description: aggre UFS CARD AXI clock
            - description: RPMH CC IPA clock

unevaluatedProperties: false

examples:
  - |
    #include <dt-bindings/clock/qcom,sa8775p-gcc.h>
    clk_virt: interconnect-clk-virt {
        compatible = "qcom,sa8775p-clk-virt";
        #interconnect-cells = <2>;
        qcom,bcm-voters = <&apps_bcm_voter>;
    };

    aggre1_noc: interconnect@16c0000 {
        compatible = "qcom,sa8775p-aggre1-noc";
        reg = <0x016c0000 0x18080>;
        #interconnect-cells = <2>;
        qcom,bcm-voters = <&apps_bcm_voter>;
        clocks = <&gcc GCC_AGGRE_UFS_PHY_AXI_CLK>,
                 <&gcc GCC_AGGRE_NOC_QUPV3_AXI_CLK>,
                 <&gcc GCC_AGGRE_USB2_PRIM_AXI_CLK>,
                 <&gcc GCC_AGGRE_USB3_PRIM_AXI_CLK>,
                 <&gcc GCC_AGGRE_USB3_SEC_AXI_CLK>;
    };
```

## Documentation/devicetree/bindings/interconnect/qcom,sar2130p-rpmh.yaml
```yaml
# SPDX-License-Identifier: (GPL-2.0 OR BSD-2-Clause)
%YAML 1.2
---
$id: http://devicetree.org/schemas/interconnect/qcom,sar2130p-rpmh.yaml#
$schema: http://devicetree.org/meta-schemas/core.yaml#

title: Qualcomm RPMh Network-On-Chip Interconnect on SAR2130P

maintainers:
  - Dmitry Baryshkov <dmitry.baryshkov@linaro.org>
  - Georgi Djakov <djakov@kernel.org>

description: |
  RPMh interconnect providers support system bandwidth requirements through
  RPMh hardware accelerators known as Bus Clock Manager (BCM). The provider is
  able to communicate with the BCM through the Resource State Coordinator (RSC)
  associated with each execution environment. Provider nodes must point to at
  least one RPMh device child node pertaining to their RSC and each provider
  can map to multiple RPMh resources.

  See also:: include/dt-bindings/interconnect/qcom,sar2130p-rpmh.h

properties:
  compatible:
    enum:
      - qcom,sar2130p-clk-virt
      - qcom,sar2130p-config-noc
      - qcom,sar2130p-gem-noc
      - qcom,sar2130p-lpass-ag-noc
      - qcom,sar2130p-mc-virt
      - qcom,sar2130p-mmss-noc
      - qcom,sar2130p-nsp-noc
      - qcom,sar2130p-pcie-anoc
      - qcom,sar2130p-system-noc

  reg:
    maxItems: 1

  clocks:
    minItems: 1
    maxItems: 2

required:
  - compatible

allOf:
  - $ref: qcom,rpmh-common.yaml#
  - if:
      properties:
        compatible:
          contains:
            enum:
              - qcom,sar2130p-clk-virt
              - qcom,sar2130p-mc-virt
    then:
      properties:
        reg: false
    else:
      required:
        - reg

  - if:
      properties:
        compatible:
          contains:
            enum:
              - qcom,sar2130p-pcie-anoc
    then:
      properties:
        clocks:
          items:
            - description: aggre-NOC PCIe AXI clock
            - description: cfg-NOC PCIe a-NOC AHB clock

  - if:
      properties:
        compatible:
          contains:
            enum:
              - qcom,sar2130p-system-noc
    then:
      properties:
        clocks:
          items:
            - description: aggre USB3 PRIM AXI clock

  - if:
      properties:
        compatible:
          contains:
            enum:
              - qcom,sar2130p-system-noc
              - qcom,sar2130p-pcie-anoc
    then:
      required:
        - clocks
    else:
      properties:
        clocks: false

unevaluatedProperties: false

examples:
  - |
    clk_virt: interconnect-0 {
      compatible = "qcom,sar2130p-clk-virt";
      #interconnect-cells = <2>;
      qcom,bcm-voters = <&apps_bcm_voter>;
    };

    aggre1_noc: interconnect@1680000 {
      compatible = "qcom,sar2130p-system-noc";
      reg = <0x01680000 0x29080>;
      #interconnect-cells = <2>;
      clocks = <&gcc_prim_axi_clk>;
      qcom,bcm-voters = <&apps_bcm_voter>;
    };
```

## Documentation/devicetree/bindings/interconnect/qcom,sc7180.yaml
```yaml
# SPDX-License-Identifier: (GPL-2.0 OR BSD-2-Clause)
%YAML 1.2
---
$id: http://devicetree.org/schemas/interconnect/qcom,sc7180.yaml#
$schema: http://devicetree.org/meta-schemas/core.yaml#

title: Qualcomm SC7180 Network-On-Chip Interconnect

maintainers:
  - Odelu Kukatla <okukatla@codeaurora.org>

description: |
   SC7180 interconnect providers support system bandwidth requirements through
   RPMh hardware accelerators known as Bus Clock Manager (BCM). The provider is
   able to communicate with the BCM through the Resource State Coordinator (RSC)
   associated with each execution environment. Provider nodes must point to at
   least one RPMh device child node pertaining to their RSC and each provider
   can map to multiple RPMh resources.

properties:
  reg:
    maxItems: 1

  compatible:
    enum:
      - qcom,sc7180-aggre1-noc
      - qcom,sc7180-aggre2-noc
      - qcom,sc7180-camnoc-virt
      - qcom,sc7180-compute-noc
      - qcom,sc7180-config-noc
      - qcom,sc7180-dc-noc
      - qcom,sc7180-gem-noc
      - qcom,sc7180-ipa-virt
      - qcom,sc7180-mc-virt
      - qcom,sc7180-mmss-noc
      - qcom,sc7180-npu-noc
      - qcom,sc7180-qup-virt
      - qcom,sc7180-system-noc

  '#interconnect-cells':
    const: 1

  qcom,bcm-voters:
    $ref: /schemas/types.yaml#/definitions/phandle-array
    description: |
      List of phandles to qcom,bcm-voter nodes that are required by
      this interconnect to send RPMh commands.

  qcom,bcm-voter-names:
    $ref: /schemas/types.yaml#/definitions/string-array
    description: |
      Names for each of the qcom,bcm-voters specified.

required:
  - compatible
  - reg
  - '#interconnect-cells'
  - qcom,bcm-voters

additionalProperties: false

examples:
  - |
      #include <dt-bindings/interconnect/qcom,sc7180.h>

      config_noc: interconnect@1500000 {
            compatible = "qcom,sc7180-config-noc";
            reg = <0x01500000 0x28000>;
            #interconnect-cells = <1>;
            qcom,bcm-voters = <&apps_bcm_voter>;
      };

      system_noc: interconnect@1620000 {
            compatible = "qcom,sc7180-system-noc";
            reg = <0x01620000 0x17080>;
            #interconnect-cells = <1>;
            qcom,bcm-voters = <&apps_bcm_voter>;
      };

      mmss_noc: interconnect@1740000 {
            compatible = "qcom,sc7180-mmss-noc";
            reg = <0x01740000 0x1c100>;
            #interconnect-cells = <1>;
            qcom,bcm-voters = <&apps_bcm_voter>;
      };
```
