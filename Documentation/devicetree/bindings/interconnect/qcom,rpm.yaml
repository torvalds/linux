## Documentation/devicetree/bindings/interconnect/qcom,sm8550-rpmh.yaml
```yaml
# SPDX-License-Identifier: (GPL-2.0 OR BSD-2-Clause)
%YAML 1.2
---
$id: http://devicetree.org/schemas/interconnect/qcom,sm8550-rpmh.yaml#
$schema: http://devicetree.org/meta-schemas/core.yaml#

title: Qualcomm RPMh Network-On-Chip Interconnect on SM8550

maintainers:
  - Abel Vesa <abel.vesa@linaro.org>
  - Neil Armstrong <neil.armstrong@linaro.org>

description: |
  RPMh interconnect providers support system bandwidth requirements through
  RPMh hardware accelerators known as Bus Clock Manager (BCM). The provider is
  able to communicate with the BCM through the Resource State Coordinator (RSC)
  associated with each execution environment. Provider nodes must point to at
  least one RPMh device child node pertaining to their RSC and each provider
  can map to multiple RPMh resources.

  See also: include/dt-bindings/interconnect/qcom,sm8550-rpmh.h

properties:
  compatible:
    enum:
      - qcom,sm8550-aggre1-noc
      - qcom,sm8550-aggre2-noc
      - qcom,sm8550-clk-virt
      - qcom,sm8550-cnoc-main
      - qcom,sm8550-config-noc
      - qcom,sm8550-gem-noc
      - qcom,sm8550-lpass-ag-noc
      - qcom,sm8550-lpass-lpiaon-noc
      - qcom,sm8550-lpass-lpicx-noc
      - qcom,sm8550-mc-virt
      - qcom,sm8550-mmss-noc
      - qcom,sm8550-nsp-noc
      - qcom,sm8550-pcie-anoc
      - qcom,sm8550-system-noc

  reg:
    maxItems: 1

  clocks:
    minItems: 1
    maxItems: 2

allOf:
  - $ref: qcom,rpmh-common.yaml#
  - if:
      properties:
        compatible:
          contains:
            enum:
              - qcom,sm8550-clk-virt
              - qcom,sm8550-mc-virt
    then:
      properties:
        reg: false
    else:
      required:
        - reg

  - if:
      properties:
        compatible:
          contains:
            enum:
              - qcom,sm8550-pcie-anoc
    then:
      properties:
        clocks:
          items:
            - description: aggre-NOC PCIe AXI clock
            - description: cfg-NOC PCIe a-NOC AHB clock

  - if:
      properties:
        compatible:
          contains:
            enum:
              - qcom,sm8550-aggre1-noc
    then:
      properties:
        clocks:
          items:
            - description: aggre UFS PHY AXI clock
            - description: aggre USB3 PRIM AXI clock

  - if:
      properties:
        compatible:
          contains:
            enum:
              - qcom,sm8550-aggre2-noc
    then:
      properties:
        clocks:
          items:
            - description: RPMH CC IPA clock

  - if:
      properties:
        compatible:
          contains:
            enum:
              - qcom,sm8550-aggre1-noc
              - qcom,sm8550-aggre2-noc
              - qcom,sm8550-pcie-anoc
    then:
      required:
        - clocks
    else:
      properties:
        clocks: false

required:
  - compatible

unevaluatedProperties: false

examples:
  - |
    #include <dt-bindings/clock/qcom,sm8550-gcc.h>

    clk_virt: interconnect-0 {
      compatible = "qcom,sm8550-clk-virt";
      #interconnect-cells = <2>;
      qcom,bcm-voters = <&apps_bcm_voter>;
    };

    aggre1_noc: interconnect@16e0000 {
      compatible = "qcom,sm8550-aggre1-noc";
      reg = <0x016e0000 0x14400>;
      #interconnect-cells = <2>;
      clocks = <&gcc GCC_AGGRE_UFS_PHY_AXI_CLK>,
               <&gcc GCC_AGGRE_USB3_PRIM_AXI_CLK>;
      qcom,bcm-voters = <&apps_bcm_voter>;
    };
```

## Documentation/devicetree/bindings/interconnect/qcom,sm8750-rpmh.yaml
```yaml
# SPDX-License-Identifier: (GPL-2.0 OR BSD-2-Clause)
%YAML 1.2
---
$id: http://devicetree.org/schemas/interconnect/qcom,sm8750-rpmh.yaml#
$schema: http://devicetree.org/meta-schemas/core.yaml#

title: Qualcomm RPMh Network-On-Chip Interconnect on SM8750

maintainers:
  - Abel Vesa <abel.vesa@linaro.org>
  - Neil Armstrong <neil.armstrong@linaro.org>

description: |
  RPMh interconnect providers support system bandwidth requirements through
  RPMh hardware accelerators known as Bus Clock Manager (BCM). The provider is
  able to communicate with the BCM through the Resource State Coordinator (RSC)
  associated with each execution environment. Provider nodes must point to at
  least one RPMh device child node pertaining to their RSC and each provider
  can map to multiple RPMh resources.

  See also:: include/dt-bindings/interconnect/qcom,sm8750-rpmh.h

properties:
  compatible:
    enum:
      - qcom,sm8750-aggre1-noc
      - qcom,sm8750-aggre2-noc
      - qcom,sm8750-clk-virt
      - qcom,sm8750-cnoc-main
      - qcom,sm8750-config-noc
      - qcom,sm8750-gem-noc
      - qcom,sm8750-lpass-ag-noc
      - qcom,sm8750-lpass-lpiaon-noc
      - qcom,sm8750-lpass-lpicx-noc
      - qcom,sm8750-mc-virt
      - qcom,sm8750-mmss-noc
      - qcom,sm8750-nsp-noc
      - qcom,sm8750-pcie-anoc
      - qcom,sm8750-system-noc

  reg:
    maxItems: 1

  clocks:
    minItems: 1
    maxItems: 2

required:
  - compatible

allOf:
  - $ref: qcom,rpmh-common.yaml#
  - if:
      properties:
        compatible:
          contains:
            enum:
              - qcom,sm8750-clk-virt
              - qcom,sm8750-mc-virt
    then:
      properties:
        reg: false
    else:
      required:
        - reg

  - if:
      properties:
        compatible:
          contains:
            enum:
              - qcom,sm8750-pcie-anoc
    then:
      properties:
        clocks:
          items:
            - description: aggre-NOC PCIe AXI clock
            - description: cfg-NOC PCIe a-NOC AHB clock

  - if:
      properties:
        compatible:
          contains:
            enum:
              - qcom,sm8750-aggre1-noc
    then:
      properties:
        clocks:
          items:
            - description: aggre UFS PHY AXI clock
            - description: aggre USB3 PRIM AXI clock

  - if:
      properties:
        compatible:
          contains:
            enum:
              - qcom,sm8750-aggre2-noc
    then:
      properties:
        clocks:
          items:
            - description: RPMH CC IPA clock

  - if:
      properties:
        compatible:
          contains:
            enum:
              - qcom,sm8750-aggre1-noc
              - qcom,sm8750-aggre2-noc
              - qcom,sm8750-pcie-anoc
    then:
      required:
        - clocks
    else:
      properties:
        clocks: false

unevaluatedProperties: false

examples:
  - |
    clk_virt: interconnect-0 {
      compatible = "qcom,sm8750-clk-virt";
      #interconnect-cells = <2>;
      qcom,bcm-voters = <&apps_bcm_voter>;
    };

    aggre1_noc: interconnect@16e0000 {
      compatible = "qcom,sm8750-aggre1-noc";
      reg = <0x016e0000 0x16400>;
      #interconnect-cells = <2>;
      clocks = <&gcc_phy_axi_clk>, <&gcc_prim_axi_clk>;
      qcom,bcm-voters = <&apps_bcm_voter>;
    };
```

## Documentation/devicetree/bindings/interconnect/qcom,x1e80100-rpmh.yaml
```yaml
# SPDX-License-Identifier: (GPL-2.0 OR BSD-2-Clause)
%YAML 1.2
---
$id: http://devicetree.org/schemas/interconnect/qcom,x1e80100-rpmh.yaml#
$schema: http://devicetree.org/meta-schemas/core.yaml#

title: Qualcomm RPMh Network-On-Chip Interconnect on X1E80100

maintainers:
  - Rajendra Nayak <quic_rjendra@quicinc.com>
  - Abel Vesa <abel.vesa@linaro.org>

description: |
  RPMh interconnect providers support system bandwidth requirements through
  RPMh hardware accelerators known as Bus Clock Manager (BCM). The provider is
  able to communicate with the BCM through the Resource State Coordinator (RSC)
  associated with each execution environment. Provider nodes must point to at
  least one RPMh device child node pertaining to their RSC and each provider
  can map to multiple RPMh resources.

  See also: include/dt-bindings/interconnect/qcom,x1e80100-rpmh.h

properties:
  compatible:
    enum:
      - qcom,x1e80100-aggre1-noc
      - qcom,x1e80100-aggre2-noc
      - qcom,x1e80100-clk-virt
      - qcom,x1e80100-cnoc-cfg
      - qcom,x1e80100-cnoc-main
      - qcom,x1e80100-gem-noc
      - qcom,x1e80100-lpass-ag-noc
      - qcom,x1e80100-lpass-lpiaon-noc
      - qcom,x1e80100-lpass-lpicx-noc
      - qcom,x1e80100-mc-virt
      - qcom,x1e80100-mmss-noc
      - qcom,x1e80100-nsp-noc
      - qcom,x1e80100-pcie-center-anoc
      - qcom,x1e80100-pcie-north-anoc
      - qcom,x1e80100-pcie-south-anoc
      - qcom,x1e80100-system-noc
      - qcom,x1e80100-usb-center-anoc
      - qcom,x1e80100-usb-north-anoc
      - qcom,x1e80100-usb-south-anoc

  reg:
    maxItems: 1

  clocks:
    minItems: 1
    maxItems: 6

required:
  - compatible

allOf:
  - $ref: qcom,rpmh-common.yaml#
  - if:
      properties:
        compatible:
          contains:
            enum:
              - qcom,x1e80100-clk-virt
              - qcom,x1e80100-mc-virt
    then:
      properties:
        reg: false
    else:
      required:
        - reg

  - if:
      properties:
        compatible:
          contains:
            enum:
              - qcom,x1e80100-aggre1-noc
    then:
      properties:
        clocks:
          items:
            - description: aggre UFS PHY AXI clock

  - if:
      properties:
        compatible:
          contains:
            enum:
              - qcom,x1e80100-usb-north-anoc
    then:
      properties:
        clocks:
          items:
            - description: aggre USB2 PRIM AXI clock
            - description: aggre USB3 MP AXI clock

  - if:
      properties:
        compatible:
          contains:
            enum:
              - qcom,x1e80100-usb-south-anoc
    then:
      properties:
        clocks:
          items:
            - description: aggre USB3 PRIM AXI clock
            - description: aggre USB3 SEC AXI clock
            - description: aggre USB3 TERT AXI clock
            - description: aggre USB4_0 AXI clock
            - description: aggre USB4_1 AXI clock
            - description: aggre USB4_2 AXI clock

  - if:
      properties:
        compatible:
          contains:
            enum:
              - qcom,x1e80100-aggre2-noc
              - qcom,x1e80100-clk-virt
              - qcom,x1e80100-cnoc-cfg
              - qcom,x1e80100-cnoc-main
              - qcom,x1e80100-gem-noc
              - qcom,x1e80100-lpass-ag-noc
              - qcom,x1e80100-lpass-lpiaon-noc
              - qcom,x1e80100-lpass-lpicx-noc
              - qcom,x1e80100-mc-virt
              - qcom,x1e80100-mmss-noc
              - qcom,x1e80100-nsp-noc
              - qcom,x1e80100-pcie-center-anoc
              - qcom,x1e80100-pcie-north-anoc
              - qcom,x1e80100-pcie-south-anoc
              - qcom,x1e80100-system-noc
              - qcom,x1e80100-usb-center-anoc
    then:
      properties:
        clocks: false

unevaluatedProperties: false

examples:
  - |
    clk_virt: interconnect-0 {
      compatible = "qcom,x1e80100-clk-virt";
      #interconnect-cells = <2>;
      qcom,bcm-voters = <&apps_bcm_voter>;
    };

    aggre1_noc: interconnect@16e0000 {
      compatible = "qcom,x1e80100-aggre1-noc";
      reg = <0x016e0000 0x14400>;
      #interconnect-cells = <2>;
      qcom,bcm-voters = <&apps_bcm_voter>;
      clocks = <&gcc_aggre_ufs_phy_axi_clk>;
    };
```
