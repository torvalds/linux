## Documentation/devicetree/bindings/interconnect/qcom,milos-rpmh.yaml
```yaml
# SPDX-License-Identifier: (GPL-2.0 OR BSD-2-Clause)
%YAML 1.2
---
$id: http://devicetree.org/schemas/interconnect/qcom,milos-rpmh.yaml#
$schema: http://devicetree.org/meta-schemas/core.yaml#

title: Qualcomm RPMh Network-On-Chip Interconnect on Milos SoC

maintainers:
  - Luca Weiss <luca.weiss@fairphone.com>

description: |
  RPMh interconnect providers support system bandwidth requirements through
  RPMh hardware accelerators known as Bus Clock Manager (BCM). The provider is
  able to communicate with the BCM through the Resource State Coordinator (RSC)
  associated with each execution environment. Provider nodes must point to at
  least one RPMh device child node pertaining to their RSC and each provider
  can map to multiple RPMh resources.

  See also: include/dt-bindings/interconnect/qcom,milos-rpmh.h

properties:
  compatible:
    enum:
      - qcom,milos-aggre1-noc
      - qcom,milos-aggre2-noc
      - qcom,milos-clk-virt
      - qcom,milos-cnoc-cfg
      - qcom,milos-cnoc-main
      - qcom,milos-gem-noc
      - qcom,milos-lpass-ag-noc
      - qcom,milos-mc-virt
      - qcom,milos-mmss-noc
      - qcom,milos-nsp-noc
      - qcom,milos-pcie-anoc
      - qcom,milos-system-noc

  reg:
    maxItems: 1

  clocks:
    minItems: 1
    maxItems: 2

required:
  - compatible

allOf:
  - $ref: qcom,rpmh-common.yaml#
  - if:
      properties:
        compatible:
          contains:
            enum:
              - qcom,milos-clk-virt
              - qcom,milos-mc-virt
    then:
      properties:
        reg: false
    else:
      required:
        - reg

  - if:
      properties:
        compatible:
          contains:
            enum:
              - qcom,milos-pcie-anoc
    then:
      properties:
        clocks:
          items:
            - description: aggre-NOC PCIe AXI clock
            - description: cfg-NOC PCIe a-NOC AHB clock

  - if:
      properties:
        compatible:
          contains:
            enum:
              - qcom,milos-aggre1-noc
    then:
      properties:
        clocks:
          items:
            - description: aggre USB3 PRIM AXI clock
            - description: aggre UFS PHY AXI clock

  - if:
      properties:
        compatible:
          contains:
            enum:
              - qcom,milos-aggre2-noc
    then:
      properties:
        clocks:
          items:
            - description: RPMH CC IPA clock

  - if:
      properties:
        compatible:
          contains:
            enum:
              - qcom,milos-aggre1-noc
              - qcom,milos-aggre2-noc
              - qcom,milos-pcie-anoc
    then:
      required:
        - clocks
    else:
      properties:
        clocks: false

unevaluatedProperties: false

examples:
  - |
    #include <dt-bindings/clock/qcom,milos-gcc.h>

    interconnect-0 {
        compatible = "qcom,milos-clk-virt";
        #interconnect-cells = <2>;
        qcom,bcm-voters = <&apps_bcm_voter>;
    };

    interconnect@16e0000 {
        compatible = "qcom,milos-aggre1-noc";
        reg = <0x016e0000 0x16400>;
        #interconnect-cells = <2>;
        clocks = <&gcc GCC_AGGRE_USB3_PRIM_AXI_CLK>,
                 <&gcc GCC_AGGRE_UFS_PHY_AXI_CLK>;
        qcom,bcm-voters = <&apps_bcm_voter>;
    };
```

## Documentation/devicetree/bindings/interconnect/qcom,msm8916.yaml
```yaml
# SPDX-License-Identifier: (GPL-2.0 OR BSD-2-Clause)
%YAML 1.2
---
$id: http://devicetree.org/schemas/interconnect/qcom,msm8916.yaml#
$schema: http://devicetree.org/meta-schemas/core.yaml#

title: Qualcomm MSM8916 Network-On-Chip interconnect

maintainers:
  - Georgi Djakov <georgi.djakov@linaro.org>

description: |
   The Qualcomm MSM8916 interconnect providers support adjusting the
   bandwidth requirements between the various NoC fabrics.

properties:
  compatible:
    enum:
      - qcom,msm8916-bimc
      - qcom,msm8916-pcnoc
      - qcom,msm8916-snoc

  reg:
    maxItems: 1

  '#interconnect-cells':
    const: 1

  clock-names:
    items:
      - const: bus
      - const: bus_a

  clocks:
    items:
      - description: Bus Clock
      - description: Bus A Clock

required:
  - compatible
  - reg
  - '#interconnect-cells'
  - clock-names
  - clocks

additionalProperties: false

examples:
  - |
      #include <dt-bindings/clock/qcom,rpmcc.h>

      bimc: interconnect@400000 {
              compatible = "qcom,msm8916-bimc";
              reg = <0x00400000 0x62000>;
              #interconnect-cells = <1>;
              clock-names = "bus", "bus_a";
              clocks = <&rpmcc RPM_SMD_BIMC_CLK>,
                       <&rpmcc RPM_SMD_BIMC_A_CLK>;
      };

      pcnoc: interconnect@500000 {
              compatible = "qcom,msm8916-pcnoc";
              reg = <0x00500000 0x11000>;
              #interconnect-cells = <1>;
              clock-names = "bus", "bus_a";
              clocks = <&rpmcc RPM_SMD_PCNOC_CLK>,
                       <&rpmcc RPM_SMD_PCNOC_A_CLK>;
      };

      snoc: interconnect@580000 {
              compatible = "qcom,msm8916-snoc";
              reg = <0x00580000 0x14000>;
              #interconnect-cells = <1>;
              clock-names = "bus", "bus_a";
              clocks = <&rpmcc RPM_SMD_SNOC_CLK>,
                       <&rpmcc RPM_SMD_SNOC_A_CLK>;
      };
```

## Documentation/devicetree/bindings/interconnect/qcom,msm8939.yaml
```yaml
# SPDX-License-Identifier: (GPL-2.0 OR BSD-2-Clause)
%YAML 1.2
---
$id: http://devicetree.org/schemas/interconnect/qcom,msm8939.yaml#
$schema: http://devicetree.org/meta-schemas/core.yaml#

title: Qualcomm MSM8937/MSM8939/MSM8976 Network-On-Chip interconnect

maintainers:
  - Konrad Dybcio <konradybcio@kernel.org>

description:
  The Qualcomm MSM8937/MSM8939/MSM8976 interconnect providers support
  adjusting the bandwidth requirements between the various NoC fabrics.

allOf:
  - $ref: qcom,rpm-common.yaml#

properties:
  compatible:
    enum:
      - qcom,msm8937-bimc
      - qcom,msm8937-pcnoc
      - qcom,msm8937-snoc
      - qcom,msm8939-bimc
      - qcom,msm8939-pcnoc
      - qcom,msm8939-snoc
      - qcom,msm8976-bimc
      - qcom,msm8976-pcnoc
      - qcom,msm8976-snoc

  reg:
    maxItems: 1

patternProperties:
  '^interconnect-[a-z0-9\-]+$':
    type: object
    $ref: qcom,rpm-common.yaml#
    description:
      The interconnect providers do not have a separate QoS register space,
      but share parent's space.

    allOf:
      - $ref: qcom,rpm-common.yaml#

    properties:
      compatible:
        enum:
          - qcom,msm8937-snoc-mm
          - qcom,msm8939-snoc-mm
          - qcom,msm8976-snoc-mm

    required:
      - compatible

    unevaluatedProperties: false

required:
  - compatible
  - reg

unevaluatedProperties: false

examples:
  - |
    #include <dt-bindings/clock/qcom,rpmcc.h>

    snoc: interconnect@580000 {
        compatible = "qcom,msm8939-snoc";
        reg = <0x00580000 0x14000>;
        #interconnect-cells = <1>;

          snoc_mm: interconnect-snoc {
              compatible = "qcom,msm8939-snoc-mm";
              #interconnect-cells = <1>;
          };
    };
```

## Documentation/devicetree/bindings/interconnect/qcom,msm8953.yaml
```yaml
# SPDX-License-Identifier: (GPL-2.0 OR BSD-2-Clause)
%YAML 1.2
---
$id: http://devicetree.org/schemas/interconnect/qcom,msm8953.yaml#
$schema: http://devicetree.org/meta-schemas/core.yaml#

title: Qualcomm MSM8953 Network-On-Chip interconnect

maintainers:
  - Barnabas Czeman <barnabas.czeman@mainlining.org>

description: |
  The Qualcomm MSM8953 interconnect providers support adjusting the
  bandwidth requirements between the various NoC fabrics.

  See also:
  - dt-bindings/interconnect/qcom,msm8953.h

properties:
  compatible:
    enum:
      - qcom,msm8953-bimc
      - qcom,msm8953-pcnoc
      - qcom,msm8953-snoc

  reg:
    maxItems: 1

  clocks:
    maxItems: 1

  clock-names:
    maxItems: 1

  '#interconnect-cells':
    const: 2

patternProperties:
  '^interconnect-[a-z0-9\-]+$':
    type: object
    $ref: qcom,rpm-common.yaml#
    unevaluatedProperties: false
    description:
      The interconnect providers do not have a separate QoS register space,
      but share parent's space.

    properties:
      compatible:
        const: qcom,msm8953-snoc-mm

    required:
      - compatible
      - '#interconnect-cells'

required:
  - compatible
  - reg
  - '#interconnect-cells'

allOf:
  - $ref: qcom,rpm-common.yaml#
  - if:
      properties:
        compatible:
          const: qcom,msm8953-pcnoc

    then:
      properties:
        clocks:
          items:
            - description: PCNOC USB3 AXI Clock.

        clock-names:
          const: pcnoc_usb3_axi

      required:
        - clocks
        - clock-names
    else:
      properties:
        clocks: false
        clock-names: false

additionalProperties: false

examples:
  - |
      #include <dt-bindings/clock/qcom,gcc-msm8953.h>

      snoc: interconnect@580000 {
          compatible = "qcom,msm8953-snoc";
          reg = <0x580000 0x16080>;

          #interconnect-cells = <2>;

          snoc_mm: interconnect-snoc {
              compatible = "qcom,msm8953-snoc-mm";

              #interconnect-cells = <2>;
          };
      };
```

## Documentation/devicetree/bindings/interconnect/qcom,msm8974.yaml
```yaml
# SPDX-License-Identifier: (GPL-2.0 OR BSD-2-Clause)
%YAML 1.2
---
$id: http://devicetree.org/schemas/interconnect/qcom,msm8974.yaml#
$schema: http://devicetree.org/meta-schemas/core.yaml#

title: Qualcomm MSM8974 Network-On-Chip Interconnect

maintainers:
  - Brian Masney <masneyb@onstation.org>

description: |
  The Qualcomm MSM8974 interconnect providers support setting system
  bandwidth requirements between various network-on-chip fabrics.

properties:
  reg:
    maxItems: 1

  compatible:
    enum:
      - qcom,msm8974-bimc
      - qcom,msm8974-cnoc
      - qcom,msm8974-mmssnoc
      - qcom,msm8974-ocmemnoc
      - qcom,msm8974-pnoc
      - qcom,msm8974-snoc

  '#interconnect-cells':
    const: 1

  clock-names:
    items:
      - const: bus
      - const: bus_a

  clocks:
    items:
      - description: Bus Clock
      - description: Bus A Clock

required:
  - compatible
  - reg
  - '#interconnect-cells'
  - clock-names
  - clocks

additionalProperties: false

examples:
  - |
      #include <dt-bindings/clock/qcom,rpmcc.h>

      bimc: interconnect@fc380000 {
              reg = <0xfc380000 0x6a000>;
              compatible = "qcom,msm8974-bimc";
              #interconnect-cells = <1>;
              clock-names = "bus", "bus_a";
              clocks = <&rpmcc RPM_SMD_BIMC_CLK>,
                       <&rpmcc RPM_SMD_BIMC_A_CLK>;
      };
```

## Documentation/devicetree/bindings/interconnect/qcom,msm8996.yaml
```yaml
# SPDX-License-Identifier: (GPL-2.0 OR BSD-2-Clause)
%YAML 1.2
---
$id: http://devicetree.org/schemas/interconnect/qcom,msm8996.yaml#
$schema: http://devicetree.org/meta-schemas/core.yaml#

title: Qualcomm MSM8996 Network-On-Chip interconnect

maintainers:
  - Konrad Dybcio <konradybcio@kernel.org>

description: |
  The Qualcomm MSM8996 interconnect providers support adjusting the
  bandwidth requirements between the various NoC fabrics.

properties:
  compatible:
    enum:
      - qcom,msm8996-a0noc
      - qcom,msm8996-a1noc
      - qcom,msm8996-a2noc
      - qcom,msm8996-bimc
      - qcom,msm8996-cnoc
      - qcom,msm8996-mnoc
      - qcom,msm8996-pnoc
      - qcom,msm8996-snoc

  reg:
    maxItems: 1

  clock-names:
    minItems: 1
    maxItems: 3

  clocks:
    minItems: 1
    maxItems: 3

  power-domains:
    maxItems: 1

required:
  - compatible
  - reg

unevaluatedProperties: false

allOf:
  - $ref: qcom,rpm-common.yaml#
  - if:
      properties:
        compatible:
          const: qcom,msm8996-a0noc

    then:
      properties:
        clocks:
          items:
            - description: Aggregate0 System NoC AXI Clock.
            - description: Aggregate0 Config NoC AHB Clock.
            - description: Aggregate0 NoC MPU Clock.

        clock-names:
          items:
            - const: aggre0_snoc_axi
            - const: aggre0_cnoc_ahb
            - const: aggre0_noc_mpu_cfg

      required:
        - power-domains

  - if:
      properties:
        compatible:
          const: qcom,msm8996-mnoc

    then:
      properties:
        clocks:
          items:
            - description: CPU-NoC High-performance Bus Clock.

        clock-names:
          const: iface

  - if:
      properties:
        compatible:
          const: qcom,msm8996-a2noc

    then:
      properties:
        clocks:
          items:
            - description: Aggregate2 NoC UFS AXI Clock
            - description: UFS AXI Clock

        clock-names:
          items:
            - const: aggre2_ufs_axi
            - const: ufs_axi

examples:
  - |
    #include <dt-bindings/clock/qcom,gcc-msm8996.h>
    #include <dt-bindings/clock/qcom,mmcc-msm8996.h>
    #include <dt-bindings/clock/qcom,rpmcc.h>

    bimc: interconnect@408000 {
        compatible = "qcom,msm8996-bimc";
        reg = <0x00408000 0x5a000>;
        #interconnect-cells = <1>;
    };

    a0noc: interconnect@543000 {
        compatible = "qcom,msm8996-a0noc";
        reg = <0x00543000 0x6000>;
        #interconnect-cells = <1>;
        clocks = <&gcc GCC_AGGRE0_SNOC_AXI_CLK>,
                 <&gcc GCC_AGGRE0_CNOC_AHB_CLK>,
                 <&gcc GCC_AGGRE0_NOC_MPU_CFG_AHB_CLK>;
        clock-names = "aggre0_snoc_axi",
                      "aggre0_cnoc_ahb",
                      "aggre0_noc_mpu_cfg";
        power-domains = <&gcc AGGRE0_NOC_GDSC>;
    };
```
