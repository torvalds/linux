## Documentation/devicetree/bindings/interconnect/qcom,glymur-rpmh.yaml
```yaml
# SPDX-License-Identifier: (GPL-2.0 OR BSD-2-Clause)
%YAML 1.2
---
$id: http://devicetree.org/schemas/interconnect/qcom,glymur-rpmh.yaml#
$schema: http://devicetree.org/meta-schemas/core.yaml#

title: Qualcomm RPMh Network-On-Chip Interconnect on GLYMUR

maintainers:
  - Raviteja Laggyshetty <raviteja.laggyshetty@oss.qualcomm.com>

description: |
  RPMh interconnect providers support system bandwidth requirements through
  RPMh hardware accelerators known as Bus Clock Manager (BCM). The provider is
  able to communicate with the BCM through the Resource State Coordinator (RSC)
  associated with each execution environment. Provider nodes must point to at
  least one RPMh device child node pertaining to their RSC and each provider
  can map to multiple RPMh resources.

  See also: include/dt-bindings/interconnect/qcom,glymur-rpmh.h

properties:
  compatible:
    enum:
      - qcom,glymur-aggre1-noc
      - qcom,glymur-aggre2-noc
      - qcom,glymur-aggre3-noc
      - qcom,glymur-aggre4-noc
      - qcom,glymur-clk-virt
      - qcom,glymur-cnoc-cfg
      - qcom,glymur-cnoc-main
      - qcom,glymur-hscnoc
      - qcom,glymur-lpass-ag-noc
      - qcom,glymur-lpass-lpiaon-noc
      - qcom,glymur-lpass-lpicx-noc
      - qcom,glymur-mc-virt
      - qcom,glymur-mmss-noc
      - qcom,glymur-nsinoc
      - qcom,glymur-nsp-noc
      - qcom,glymur-oobm-ss-noc
      - qcom,glymur-pcie-east-anoc
      - qcom,glymur-pcie-east-slv-noc
      - qcom,glymur-pcie-west-anoc
      - qcom,glymur-pcie-west-slv-noc
      - qcom,glymur-system-noc

  reg:
    maxItems: 1

  clocks:
    minItems: 1
    maxItems: 4

required:
  - compatible

allOf:
  - $ref: qcom,rpmh-common.yaml#
  - if:
      properties:
        compatible:
          contains:
            enum:
              - qcom,glymur-clk-virt
              - qcom,glymur-mc-virt
    then:
      properties:
        reg: false
    else:
      required:
        - reg

  - if:
      properties:
        compatible:
          contains:
            enum:
              - qcom,glymur-pcie-west-anoc
    then:
      properties:
        clocks:
          items:
            - description: aggre PCIE_3A WEST AXI clock
            - description: aggre PCIE_3B WEST AXI clock
            - description: aggre PCIE_4 WEST AXI clock
            - description: aggre PCIE_6 WEST AXI clock

  - if:
      properties:
        compatible:
          contains:
            enum:
              - qcom,glymur-pcie-east-anoc
    then:
      properties:
        clocks:
          items:
            - description: aggre PCIE_5 EAST AXI clock

  - if:
      properties:
        compatible:
          contains:
            enum:
              - qcom,glymur-aggre2-noc
    then:
      properties:
        clocks:
          items:
            - description: aggre USB3 TERT AXI clock
            - description: aggre USB4_2 AXI clock
            - description: aggre UFS PHY AXI clock

  - if:
      properties:
        compatible:
          contains:
            enum:
              - qcom,glymur-aggre4-noc
    then:
      properties:
        clocks:
          items:
            - description: aggre USB3 PRIM AXI clock
            - description: aggre USB3 SEC AXI clock
            - description: aggre USB4_0 AXI clock
            - description: aggre USB4_1 AXI clock

  - if:
      properties:
        compatible:
          contains:
            enum:
              - qcom,glymur-pcie-west-anoc
              - qcom,glymur-pcie-east-anoc
              - qcom,glymur-aggre2-noc
              - qcom,glymur-aggre4-noc
    then:
      required:
        - clocks
    else:
      properties:
        clocks: false

unevaluatedProperties: false

examples:
  - |
    #include <dt-bindings/clock/qcom,glymur-gcc.h>
    clk_virt: interconnect-0 {
      compatible = "qcom,glymur-clk-virt";
      #interconnect-cells = <2>;
      qcom,bcm-voters = <&apps_bcm_voter>;
    };

    aggre1_noc: interconnect@16e0000 {
      compatible = "qcom,glymur-aggre1-noc";
      reg = <0x016e0000 0x14400>;
      #interconnect-cells = <2>;
      qcom,bcm-voters = <&apps_bcm_voter>;
    };

    aggre4_noc: interconnect@1740000 {
      compatible = "qcom,glymur-aggre4-noc";
      reg = <0x01740000 0x14400>;
      #interconnect-cells = <2>;
      qcom,bcm-voters = <&apps_bcm_voter>;
      clocks = <&gcc GCC_AGGRE_USB3_PRIM_AXI_CLK>,
               <&gcc GCC_AGGRE_USB3_SEC_AXI_CLK>,
               <&gcc GCC_AGGRE_USB4_0_AXI_CLK>,
               <&gcc GCC_AGGRE_USB4_1_AXI_CLK>;
    };
```

## Documentation/devicetree/bindings/interconnect/qcom,hawi-rpmh.yaml
```yaml
# SPDX-License-Identifier: (GPL-2.0 OR BSD-2-Clause)
%YAML 1.2
---
$id: http://devicetree.org/schemas/interconnect/qcom,hawi-rpmh.yaml#
$schema: http://devicetree.org/meta-schemas/core.yaml#

title: Qualcomm RPMh Network-On-Chip Interconnect on Hawi

maintainers:
  - Vivek Aknurwar <vivek.aknurwar@oss.qualcomm.com>

description: |
  RPMh interconnect providers support system bandwidth requirements through
  RPMh hardware accelerators known as Bus Clock Manager (BCM). The provider is
  able to communicate with the BCM through the Resource State Coordinator (RSC)
  associated with each execution environment. Provider nodes must point to at
  least one RPMh device child node pertaining to their RSC and each provider
  can map to multiple RPMh resources.

  See also: include/dt-bindings/interconnect/qcom,hawi-rpmh.h

properties:
  compatible:
    enum:
      - qcom,hawi-aggre1-noc
      - qcom,hawi-clk-virt
      - qcom,hawi-cnoc-main
      - qcom,hawi-gem-noc
      - qcom,hawi-llclpi-noc
      - qcom,hawi-lpass-ag-noc
      - qcom,hawi-lpass-lpiaon-noc
      - qcom,hawi-lpass-lpicx-noc
      - qcom,hawi-mc-virt
      - qcom,hawi-mmss-noc
      - qcom,hawi-nsp-noc
      - qcom,hawi-pcie-anoc
      - qcom,hawi-stdst-cfg
      - qcom,hawi-stdst-main
      - qcom,hawi-system-noc

  reg:
    maxItems: 1

  clocks:
    minItems: 2
    maxItems: 3

required:
  - compatible

allOf:
  - $ref: qcom,rpmh-common.yaml#
  - if:
      properties:
        compatible:
          contains:
            enum:
              - qcom,hawi-clk-virt
              - qcom,hawi-mc-virt
    then:
      properties:
        reg: false
    else:
      required:
        - reg

  - if:
      properties:
        compatible:
          contains:
            enum:
              - qcom,hawi-pcie-anoc
    then:
      properties:
        clocks:
          items:
            - description: aggre-NOC PCIe AXI clock
            - description: cfg-NOC PCIe a-NOC AHB clock

  - if:
      properties:
        compatible:
          contains:
            enum:
              - qcom,hawi-aggre1-noc
    then:
      properties:
        clocks:
          items:
            - description: aggre UFS PHY AXI clock
            - description: aggre USB3 PRIM AXI clock
            - description: RPMH CC IPA clock

  - if:
      properties:
        compatible:
          contains:
            enum:
              - qcom,hawi-aggre1-noc
              - qcom,hawi-pcie-anoc
    then:
      required:
        - clocks
    else:
      properties:
        clocks: false

unevaluatedProperties: false

examples:
  - |
    soc {
      #address-cells = <2>;
      #size-cells = <2>;

      clk_virt: interconnect-0 {
        compatible = "qcom,hawi-clk-virt";
        #interconnect-cells = <2>;
        qcom,bcm-voters = <&apps_bcm_voter>;
      };

      aggre_noc: interconnect@f00000 {
        compatible = "qcom,hawi-aggre1-noc";
        reg = <0x0 0xf00000 0x0 0x54400>;
        #interconnect-cells = <2>;
        clocks = <&gcc_aggre_ufs_phy_axi_clk>,
                 <&gcc_aggre_usb3_prim_axi_clk>,
                 <&rpmhcc_ipa_clk>;
        qcom,bcm-voters = <&apps_bcm_voter>;
      };
    };
```

## Documentation/devicetree/bindings/interconnect/qcom,kaanapali-rpmh.yaml
```yaml
# SPDX-License-Identifier: (GPL-2.0 OR BSD-2-Clause)
%YAML 1.2
---
$id: http://devicetree.org/schemas/interconnect/qcom,kaanapali-rpmh.yaml#
$schema: http://devicetree.org/meta-schemas/core.yaml#

title: Qualcomm RPMh Network-On-Chip Interconnect on Kaanapali

maintainers:
  - Raviteja Laggyshetty <raviteja.laggyshetty@oss.qualcomm.com>

description: |
  RPMh interconnect providers support system bandwidth requirements through
  RPMh hardware accelerators known as Bus Clock Manager (BCM). The provider is
  able to communicate with the BCM through the Resource State Coordinator (RSC)
  associated with each execution environment. Provider nodes must point to at
  least one RPMh device child node pertaining to their RSC and each provider
  can map to multiple RPMh resources.

  See also: include/dt-bindings/interconnect/qcom,kaanapali-rpmh.h

properties:
  compatible:
    enum:
      - qcom,kaanapali-aggre-noc
      - qcom,kaanapali-clk-virt
      - qcom,kaanapali-cnoc-main
      - qcom,kaanapali-cnoc-cfg
      - qcom,kaanapali-gem-noc
      - qcom,kaanapali-lpass-ag-noc
      - qcom,kaanapali-lpass-lpiaon-noc
      - qcom,kaanapali-lpass-lpicx-noc
      - qcom,kaanapali-mc-virt
      - qcom,kaanapali-mmss-noc
      - qcom,kaanapali-nsp-noc
      - qcom,kaanapali-pcie-anoc
      - qcom,kaanapali-system-noc

  reg:
    maxItems: 1

  clocks:
    minItems: 2
    maxItems: 3

required:
  - compatible

allOf:
  - $ref: qcom,rpmh-common.yaml#
  - if:
      properties:
        compatible:
          contains:
            enum:
              - qcom,kaanapali-clk-virt
              - qcom,kaanapali-mc-virt
    then:
      properties:
        reg: false
    else:
      required:
        - reg

  - if:
      properties:
        compatible:
          contains:
            enum:
              - qcom,kaanapali-pcie-anoc
    then:
      properties:
        clocks:
          items:
            - description: aggre-NOC PCIe AXI clock
            - description: cfg-NOC PCIe a-NOC AHB clock

  - if:
      properties:
        compatible:
          contains:
            enum:
              - qcom,kaanapali-aggre-noc
    then:
      properties:
        clocks:
          items:
            - description: aggre UFS PHY AXI clock
            - description: aggre USB3 PRIM AXI clock
            - description: RPMH CC IPA clock

  - if:
      properties:
        compatible:
          contains:
            enum:
              - qcom,kaanapali-aggre-noc
              - qcom,kaanapali-pcie-anoc
    then:
      required:
        - clocks
    else:
      properties:
        clocks: false

unevaluatedProperties: false

examples:
  - |
    clk_virt: interconnect-0 {
      compatible = "qcom,kaanapali-clk-virt";
      #interconnect-cells = <2>;
      qcom,bcm-voters = <&apps_bcm_voter>;
    };

    aggre_noc: interconnect@16e0000 {
      compatible = "qcom,kaanapali-aggre-noc";
      reg = <0x016e0000 0x42400>;
      #interconnect-cells = <2>;
      clocks = <&gcc_aggre_ufs_phy_axi_clk>,
               <&gcc_aggre_usb3_prim_axi_clk>,
               <&rpmhcc_ipa_clk>;
      qcom,bcm-voters = <&apps_bcm_voter>;
    };
```

## Documentation/devicetree/bindings/interconnect/qcom,maili-rpmh.yaml
```yaml
# SPDX-License-Identifier: (GPL-2.0 OR BSD-2-Clause)
%YAML 1.2
---
$id: http://devicetree.org/schemas/interconnect/qcom,maili-rpmh.yaml#
$schema: http://devicetree.org/meta-schemas/core.yaml#

title: Qualcomm RPMh Network-On-Chip Interconnect on Maili SoC

maintainers:
  - Raviteja Laggyshetty <raviteja.laggyshetty@oss.qualcomm.com>

description: |
  RPMh interconnect providers support system bandwidth requirements through
  RPMh hardware accelerators known as Bus Clock Manager (BCM). The provider is
  able to communicate with the BCM through the Resource State Coordinator (RSC)
  associated with each execution environment. Provider nodes must point to at
  least one RPMh device child node pertaining to their RSC and each provider
  can map to multiple RPMh resources.

  See also: include/dt-bindings/interconnect/qcom,maili-rpmh.h

properties:
  compatible:
    enum:
      - qcom,maili-aggre-noc
      - qcom,maili-clk-virt
      - qcom,maili-cnoc-main
      - qcom,maili-gem-noc
      - qcom,maili-llclpi-noc
      - qcom,maili-lpass-ag-noc
      - qcom,maili-lpass-lpiaon-noc
      - qcom,maili-lpass-lpicx-noc
      - qcom,maili-mc-virt
      - qcom,maili-mmss-noc
      - qcom,maili-nsp-noc
      - qcom,maili-pcie-anoc
      - qcom,maili-stdst-cfg
      - qcom,maili-stdst-main
      - qcom,maili-system-noc

  reg:
    maxItems: 1

  clocks:
    minItems: 2
    maxItems: 3

required:
  - compatible

allOf:
  - $ref: qcom,rpmh-common.yaml#
  - if:
      properties:
        compatible:
          contains:
            enum:
              - qcom,maili-clk-virt
              - qcom,maili-mc-virt
    then:
      properties:
        reg: false
    else:
      required:
        - reg

  - if:
      properties:
        compatible:
          contains:
            enum:
              - qcom,maili-aggre-noc
    then:
      properties:
        clocks:
          items:
            - description: aggre UFS PHY AXI clock
            - description: aggre USB3 PRIM AXI clock
            - description: RPMH CC IPA clock

  - if:
      properties:
        compatible:
          contains:
            enum:
              - qcom,maili-pcie-anoc
    then:
      properties:
        clocks:
          items:
            - description: aggre-NOC PCIe AXI clock
            - description: cfg-NOC PCIe a-NOC AHB clock

  - if:
      properties:
        compatible:
          contains:
            enum:
              - qcom,maili-aggre-noc
              - qcom,maili-pcie-anoc
    then:
      required:
        - clocks
    else:
      properties:
        clocks: false

unevaluatedProperties: false

examples:
  - |
    gem_noc: interconnect@31100000 {
      compatible = "qcom,maili-gem-noc";
      reg = <0x31100000 0x160200>;
      #interconnect-cells = <2>;
      qcom,bcm-voters = <&apps_bcm_voter>;
    };

    aggre_noc: interconnect@f00000 {
      compatible = "qcom,maili-aggre-noc";
      reg = <0x00f00000 0x56200>;
      #interconnect-cells = <2>;
      clocks = <&gcc_phy_axi_clk>,
               <&gcc_prim_axi_clk>,
               <&rpmhcc_ipa_clk>;
      qcom,bcm-voters = <&apps_bcm_voter>;
    };
```
