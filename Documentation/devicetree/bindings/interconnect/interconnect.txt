## Documentation/devicetree/bindings/interconnect/qcom,msm8998-bwmon.yaml
```yaml
# SPDX-License-Identifier: GPL-2.0-only OR BSD-2-Clause
%YAML 1.2
---
$id: http://devicetree.org/schemas/interconnect/qcom,msm8998-bwmon.yaml#
$schema: http://devicetree.org/meta-schemas/core.yaml#

title: Qualcomm Interconnect Bandwidth Monitor

maintainers:
  - Krzysztof Kozlowski <krzysztof.kozlowski@linaro.org>

description: |
  Bandwidth Monitor measures current throughput on buses between various NoC
  fabrics and provides information when it crosses configured thresholds.

  Certain SoCs might have more than one Bandwidth Monitors, for example on SDM845::
   - Measuring the bandwidth between CPUs and Last Level Cache Controller -
     called just BWMON,
   - Measuring the bandwidth between Last Level Cache Controller and memory
     (DDR) - called LLCC BWMON.

properties:
  compatible:
    oneOf:
      - const: qcom,msm8998-bwmon       # BWMON v4
      - items:
          - enum:
              - qcom,qcm2290-cpu-bwmon
              - qcom,qcs615-cpu-bwmon
              - qcom,qcs8300-cpu-bwmon
              - qcom,sa8775p-cpu-bwmon
              - qcom,sc7180-cpu-bwmon
              - qcom,sc7280-cpu-bwmon
              - qcom,sc8280xp-cpu-bwmon
              - qcom,sdm845-cpu-bwmon
              - qcom,sm6115-cpu-bwmon
              - qcom,sm6350-llcc-bwmon
              - qcom,sm8250-cpu-bwmon
              - qcom,sm8550-cpu-bwmon
              - qcom,sm8650-cpu-bwmon
              - qcom,sm8750-cpu-bwmon
              - qcom,x1e80100-cpu-bwmon
          - const: qcom,sdm845-bwmon    # BWMON v4, unified register space
      - items:
          - enum:
              - qcom,qcs615-llcc-bwmon
              - qcom,qcs8300-llcc-bwmon
              - qcom,sa8775p-llcc-bwmon
              - qcom,sc7180-llcc-bwmon
              - qcom,sc8280xp-llcc-bwmon
              - qcom,sm6350-cpu-bwmon
              - qcom,sm8250-llcc-bwmon
              - qcom,sm8550-llcc-bwmon
              - qcom,sm8650-llcc-bwmon
              - qcom,x1e80100-llcc-bwmon
          - const: qcom,sc7280-llcc-bwmon
      - const: qcom,sc7280-llcc-bwmon   # BWMON v5
      - const: qcom,sdm845-llcc-bwmon   # BWMON v5

  interconnects:
    maxItems: 1

  interrupts:
    maxItems: 1

  operating-points-v2: true
  opp-table:
    type: object

  reg:
    # BWMON v5 uses one register address space, v1-v4 use one or two.
    minItems: 1
    maxItems: 2

  reg-names:
    minItems: 1
    maxItems: 2

required:
  - compatible
  - interconnects
  - interrupts
  - operating-points-v2
  - reg

additionalProperties: false

allOf:
  - if:
      properties:
        compatible:
          const: qcom,msm8998-bwmon
    then:
      properties:
        reg:
          minItems: 2

        reg-names:
          items:
            - const: monitor
            - const: global

    else:
      properties:
        reg:
          maxItems: 1

        reg-names:
          maxItems: 1

examples:
  - |
    #include <dt-bindings/interconnect/qcom,sdm845.h>
    #include <dt-bindings/interrupt-controller/arm-gic.h>

    pmu@1436400 {
        compatible = "qcom,sdm845-cpu-bwmon", "qcom,sdm845-bwmon";
        reg = <0x01436400 0x600>;
        interrupts = <GIC_SPI 581 IRQ_TYPE_LEVEL_HIGH>;
        interconnects = <&gladiator_noc MASTER_APPSS_PROC 3 &mem_noc SLAVE_LLCC 3>;

        operating-points-v2 = <&cpu_bwmon_opp_table>;

        cpu_bwmon_opp_table: opp-table {
            compatible = "operating-points-v2";
            opp-0 {
                opp-peak-kBps = <4800000>;
            };
            opp-1 {
                opp-peak-kBps = <9216000>;
            };
            opp-2 {
                opp-peak-kBps = <15052800>;
            };
            opp-3 {
                opp-peak-kBps = <20889600>;
            };
            opp-4 {
                opp-peak-kBps = <25497600>;
            };
        };
    };
```

## Documentation/devicetree/bindings/interconnect/qcom,nord-rpmh.yaml
```yaml
# SPDX-License-Identifier: (GPL-2.0 OR BSD-2-Clause)
%YAML 1.2
---
$id: http://devicetree.org/schemas/interconnect/qcom,nord-rpmh.yaml#
$schema: http://devicetree.org/meta-schemas/core.yaml#

title: Qualcomm RPMh Network-On-Chip Interconnect on Nord

maintainers:
  - Odelu Kukatla <odelu.kukatla@oss.qualcomm.com>

description: |
  RPMh interconnect providers support system bandwidth requirements through
  RPMh hardware accelerators known as Bus Clock Manager (BCM). The provider is
  able to communicate with the BCM through the Resource State Coordinator (RSC)
  associated with each execution environment. Provider nodes must point to at
  least one RPMh device child node pertaining to their RSC and each provider
  can map to multiple RPMh resources.

  See also: include/dt-bindings/interconnect/qcom,nord-rpmh.h

properties:
  compatible:
    enum:
      - qcom,nord-aggre1-noc
      - qcom,nord-aggre1-noc-tile
      - qcom,nord-aggre2-noc
      - qcom,nord-aggre2-noc-tile
      - qcom,nord-clk-virt
      - qcom,nord-cnoc-cfg
      - qcom,nord-cnoc-main
      - qcom,nord-hpass-ag-noc
      - qcom,nord-hscnoc
      - qcom,nord-mc-virt
      - qcom,nord-mmss-noc
      - qcom,nord-nsp-data-noc-0
      - qcom,nord-nsp-data-noc-1
      - qcom,nord-nsp-data-noc-2
      - qcom,nord-nsp-data-noc-3
      - qcom,nord-pcie-cfg
      - qcom,nord-pcie-data-inbound
      - qcom,nord-pcie-data-outbound
      - qcom,nord-system-noc

  reg:
    maxItems: 1

  clocks:
    minItems: 1
    maxItems: 4

required:
  - compatible

allOf:
  - $ref: qcom,rpmh-common.yaml#
  - if:
      properties:
        compatible:
          contains:
            enum:
              - qcom,nord-clk-virt
              - qcom,nord-mc-virt
    then:
      properties:
        reg: false
    else:
      required:
        - reg

  - if:
      properties:
        compatible:
          contains:
            enum:
              - qcom,nord-aggre1-noc-tile
    then:
      properties:
        clocks:
          items:
            - description: aggre UFS PHY AXI clock
            - description: aggre USB2 AXI clock
            - description: aggre USB3 PRIM AXI clock
            - description: aggre USB3 SEC AXI clock

  - if:
      properties:
        compatible:
          contains:
            enum:
              - qcom,nord-aggre2-noc
    then:
      properties:
        clocks:
          items:
            - description: RPMH CC IPA clock

  - if:
      properties:
        compatible:
          contains:
            enum:
              - qcom,nord-aggre1-noc-tile
              - qcom,nord-aggre2-noc
    then:
      required:
        - clocks
    else:
      properties:
        clocks: false

unevaluatedProperties: false

examples:
  - |
    clk_virt: interconnect-clk-virt {
      compatible = "qcom,nord-clk-virt";
      #interconnect-cells = <2>;
      qcom,bcm-voters = <&apps_bcm_voter>;
    };

    aggre1_noc_tile: interconnect@1720000 {
      compatible = "qcom,nord-aggre1-noc-tile";
      reg = <0x01720000 0x23400>;
      #interconnect-cells = <2>;
      qcom,bcm-voters = <&apps_bcm_voter>;
      clocks = <&ne_gcc_aggre_noc_ufs_phy_axi_clk>,
               <&ne_gcc_aggre_noc_usb2_axi_clk>,
               <&ne_gcc_aggre_noc_usb3_prim_axi_clk>,
               <&ne_gcc_aggre_noc_usb3_sec_axi_clk>;
    };
```

## Documentation/devicetree/bindings/interconnect/qcom,osm-l3.yaml
```yaml
# SPDX-License-Identifier: (GPL-2.0-only OR BSD-2-Clause)
%YAML 1.2
---
$id: http://devicetree.org/schemas/interconnect/qcom,osm-l3.yaml#
$schema: http://devicetree.org/meta-schemas/core.yaml#

title: Qualcomm Operating State Manager (OSM) L3 Interconnect Provider

maintainers:
  - Sibi Sankar <quic_sibis@quicinc.com>

description:
  L3 cache bandwidth requirements on Qualcomm SoCs is serviced by the OSM.
  The OSM L3 interconnect provider aggregates the L3 bandwidth requests
  from CPU/GPU and relays it to the OSM.

properties:
  compatible:
    oneOf:
      - items:
          - enum:
              - qcom,sc7180-osm-l3
              - qcom,sc8180x-osm-l3
              - qcom,sdm670-osm-l3
              - qcom,sdm845-osm-l3
              - qcom,sm6350-osm-l3
              - qcom,sm8150-osm-l3
          - const: qcom,osm-l3
      - items:
          - enum:
              - qcom,sa8775p-epss-l3
              - qcom,sc7280-epss-l3
              - qcom,sc8280xp-epss-l3
              - qcom,sm6375-cpucp-l3
              - qcom,sm8250-epss-l3
              - qcom,sm8350-epss-l3
              - qcom,sm8650-epss-l3
          - const: qcom,epss-l3

  reg:
    maxItems: 1

  clocks:
    items:
      - description: xo clock
      - description: alternate clock

  clock-names:
    items:
      - const: xo
      - const: alternate

  '#interconnect-cells':
    const: 1

required:
  - compatible
  - reg
  - clocks
  - clock-names
  - '#interconnect-cells'

additionalProperties: false

examples:
  - |

    #define GPLL0               165
    #define RPMH_CXO_CLK        0

    osm_l3: interconnect@17d41000 {
      compatible = "qcom,sdm845-osm-l3", "qcom,osm-l3";
      reg = <0x17d41000 0x1400>;

      clocks = <&rpmhcc RPMH_CXO_CLK>, <&gcc GPLL0>;
      clock-names = "xo", "alternate";

      #interconnect-cells = <1>;
    };
```

## Documentation/devicetree/bindings/interconnect/qcom,qcm2290.yaml
```yaml
# SPDX-License-Identifier: (GPL-2.0 OR BSD-2-Clause)
%YAML 1.2
---
$id: http://devicetree.org/schemas/interconnect/qcom,qcm2290.yaml#
$schema: http://devicetree.org/meta-schemas/core.yaml#

title: Qualcomm QCM2290 Network-On-Chip interconnect

maintainers:
  - Shawn Guo <shawn.guo@linaro.org>

description: |
  The Qualcomm QCM2290 interconnect providers support adjusting the
  bandwidth requirements between the various NoC fabrics.

allOf:
  - $ref: qcom,rpm-common.yaml#

properties:
  reg:
    maxItems: 1

  compatible:
    enum:
      - qcom,qcm2290-bimc
      - qcom,qcm2290-cnoc
      - qcom,qcm2290-snoc

# Child node's properties
patternProperties:
  '^interconnect-[a-z0-9]+$':
    type: object
    description:
      The interconnect providers do not have a separate QoS register space,
      but share parent's space.

    allOf:
      - $ref: qcom,rpm-common.yaml#

    properties:
      compatible:
        enum:
          - qcom,qcm2290-qup-virt
          - qcom,qcm2290-mmrt-virt
          - qcom,qcm2290-mmnrt-virt

    required:
      - compatible

    unevaluatedProperties: false

required:
  - compatible
  - reg

unevaluatedProperties: false

examples:
  - |
    #include <dt-bindings/clock/qcom,rpmcc.h>

    snoc: interconnect@1880000 {
        compatible = "qcom,qcm2290-snoc";
        reg = <0x01880000 0x60200>;
        #interconnect-cells = <1>;

        qup_virt: interconnect-qup {
            compatible = "qcom,qcm2290-qup-virt";
            #interconnect-cells = <1>;
        };

        mmnrt_virt: interconnect-mmnrt {
            compatible = "qcom,qcm2290-mmnrt-virt";
            #interconnect-cells = <1>;
        };

        mmrt_virt: interconnect-mmrt {
            compatible = "qcom,qcm2290-mmrt-virt";
            #interconnect-cells = <1>;
        };
    };

    cnoc: interconnect@1900000 {
        compatible = "qcom,qcm2290-cnoc";
        reg = <0x01900000 0x8200>;
        #interconnect-cells = <1>;
    };

    bimc: interconnect@4480000 {
        compatible = "qcom,qcm2290-bimc";
        reg = <0x04480000 0x80000>;
        #interconnect-cells = <1>;
    };
```

## Documentation/devicetree/bindings/interconnect/qcom,qcs404.txt
```
Qualcomm QCS404 Network-On-Chip interconnect driver binding
-----------------------------------------------------------

Required properties :
- compatible : shall contain only one of the following:
			"qcom,qcs404-bimc"
			"qcom,qcs404-pcnoc"
			"qcom,qcs404-snoc"
- #interconnect-cells : should contain 1

reg : specifies the physical base address and size of registers
clocks : list of phandles and specifiers to all interconnect bus clocks
clock-names : clock names should include both "bus" and "bus_a"

Example:

soc {
	...
	bimc: interconnect@400000 {
		reg = <0x00400000 0x80000>;
		compatible = "qcom,qcs404-bimc";
		#interconnect-cells = <1>;
		clock-names = "bus", "bus_a";
		clocks = <&rpmcc RPM_SMD_BIMC_CLK>,
			<&rpmcc RPM_SMD_BIMC_A_CLK>;
	};

	pnoc: interconnect@500000 {
		reg = <0x00500000 0x15080>;
		compatible = "qcom,qcs404-pcnoc";
		#interconnect-cells = <1>;
		clock-names = "bus", "bus_a";
		clocks = <&rpmcc RPM_SMD_PNOC_CLK>,
			<&rpmcc RPM_SMD_PNOC_A_CLK>;
	};

	snoc: interconnect@580000 {
		reg = <0x00580000 0x23080>;
		compatible = "qcom,qcs404-snoc";
		#interconnect-cells = <1>;
		clock-names = "bus", "bus_a";
		clocks = <&rpmcc RPM_SMD_SNOC_CLK>,
			<&rpmcc RPM_SMD_SNOC_A_CLK>;
	};
};
```

## Documentation/devicetree/bindings/interconnect/qcom,qcs404.yaml
```yaml
# SPDX-License-Identifier: (GPL-2.0 OR BSD-2-Clause)
%YAML 1.2
---
$id: http://devicetree.org/schemas/interconnect/qcom,qcs404.yaml#
$schema: http://devicetree.org/meta-schemas/core.yaml#

title: Qualcomm QCS404 Network-On-Chip interconnect

maintainers:
  - Georgi Djakov <georgi.djakov@linaro.org>

description: |
  The Qualcomm QCS404 interconnect providers support adjusting the
  bandwidth requirements between the various NoC fabrics.

properties:
  reg:
    maxItems: 1

  compatible:
    enum:
      - qcom,qcs404-bimc
      - qcom,qcs404-pcnoc
      - qcom,qcs404-snoc

  '#interconnect-cells':
    const: 1

  clock-names:
    items:
      - const: bus
      - const: bus_a

  clocks:
    items:
      - description: Bus Clock
      - description: Bus A Clock

required:
  - compatible
  - reg
  - '#interconnect-cells'
  - clock-names
  - clocks

additionalProperties: false

examples:
  - |
      #include <dt-bindings/clock/qcom,rpmcc.h>

      bimc: interconnect@400000 {
              reg = <0x00400000 0x80000>;
              compatible = "qcom,qcs404-bimc";
              #interconnect-cells = <1>;
              clock-names = "bus", "bus_a";
              clocks = <&rpmcc RPM_SMD_BIMC_CLK>,
                       <&rpmcc RPM_SMD_BIMC_A_CLK>;
      };

      pnoc: interconnect@500000 {
             reg = <0x00500000 0x15080>;
             compatible = "qcom,qcs404-pcnoc";
             #interconnect-cells = <1>;
             clock-names = "bus", "bus_a";
             clocks = <&rpmcc RPM_SMD_PNOC_CLK>,
                      <&rpmcc RPM_SMD_PNOC_A_CLK>;
      };

      snoc: interconnect@580000 {
            reg = <0x00580000 0x23080>;
            compatible = "qcom,qcs404-snoc";
            #interconnect-cells = <1>;
            clock-names = "bus", "bus_a";
            clocks = <&rpmcc RPM_SMD_SNOC_CLK>,
                     <&rpmcc RPM_SMD_SNOC_A_CLK>;
      };
```
