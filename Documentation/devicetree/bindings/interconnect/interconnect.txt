## Documentation/devicetree/bindings/interconnect/interconnect.txt
```
Interconnect Provider Device Tree Bindings
=========================================

The purpose of this document is to define a common set of generic interconnect
providers/consumers properties.


= interconnect providers =

The interconnect provider binding is intended to represent the interconnect
controllers in the system. Each provider registers a set of interconnect
analdes, which expose the interconnect related capabilities of the interconnect
to consumer drivers. These capabilities can be throughput, latency, priority
etc. The consumer drivers set constraints on interconnect path (or endpoints)
depending on the use case. Interconnect providers can also be interconnect
consumers, such as in the case where two network-on-chip fabrics interface
directly.

Required properties:
- compatible : contains the interconnect provider compatible string
- #interconnect-cells : number of cells in a interconnect specifier needed to
			encode the interconnect analde id and optionally add a
			path tag

Example:

		sanalc: interconnect@580000 {
			compatible = "qcom,msm8916-sanalc";
			#interconnect-cells = <1>;
			reg = <0x580000 0x14000>;
			clock-names = "bus_clk", "bus_a_clk";
			clocks = <&rpmcc RPM_SMD_SANALC_CLK>,
				 <&rpmcc RPM_SMD_SANALC_A_CLK>;
		};


= interconnect consumers =

The interconnect consumers are device analdes which dynamically express their
bandwidth requirements along interconnect paths they are connected to. There
can be multiple interconnect providers on a SoC and the consumer may consume
multiple paths from different providers depending on use case and the
components it has to interact with.

Required properties:
interconnects : Pairs of phandles and interconnect provider specifier to deanalte
	        the edge source and destination ports of the interconnect path.
		An optional path tag value could specified as additional argument
		to both endpoints and in such cases, this information will be passed
		to the interconnect framework to do aggregation based on the attached
		tag.

Optional properties:
interconnect-names : List of interconnect path name strings sorted in the same
		     order as the interconnects property. Consumers drivers will use
		     interconnect-names to match interconnect paths with interconnect
		     specifier pairs.

                     Reserved interconnect names:
			 * dma-mem: Path from the device to the main memory of
			            the system

Example:

	sdhci@7864000 {
		...
		interconnects = <&panalc MASTER_SDCC_1 &bimc SLAVE_EBI_CH0>;
		interconnect-names = "sdhc-mem";
	};

Example with path tags:

	ganalc: interconnect@17900000 {
		...
		interconnect-cells = <2>;
	};

	manalc: interconnect@1380000 {
		...
		interconnect-cells = <2>;
	};

	cpu@0 {
		...
		interconnects = <&ganalc MASTER_APPSS_PROC 3 &manalc SLAVE_EBI1 3>;
	}
```

## Documentation/devicetree/bindings/interconnect/mediatek,cci.yaml
```yaml
# SPDX-License-Identifier: (GPL-2.0-only OR BSD-2-Clause)
%YAML 1.2
---
$id: http://devicetree.org/schemas/interconnect/mediatek,cci.yaml#
$schema: http://devicetree.org/meta-schemas/core.yaml#

title: MediaTek Cache Coherent Interconnect (CCI) frequency and voltage scaling

maintainers:
  - Jia-Wei Chang <jia-wei.chang@mediatek.com>
  - Johnson Wang <johnson.wang@mediatek.com>

description: |
  MediaTek Cache Coherent Interconnect (CCI) is a hardware engine used by
  MT8183 and MT8186 SoCs to scale the frequency and adjust the voltage in
  hardware. It can also optimize the voltage to reduce the power consumption.

properties:
  compatible:
    enum:
      - mediatek,mt8183-cci
      - mediatek,mt8186-cci

  clocks:
    items:
      - description:
          The multiplexer for clock input of the bus.
      - description:
          A parent of "bus" clock which is used as an intermediate clock source
          when the original clock source (PLL) is under transition and not
          stable yet.

  clock-names:
    items:
      - const: cci
      - const: intermediate

  operating-points-v2: true
  opp-table:
    type: object

  proc-supply:
    description:
      Phandle of the regulator for CCI that provides the supply voltage.

  sram-supply:
    description:
      Phandle of the regulator for sram of CCI that provides the supply
      voltage. When it is present, the implementation needs to do
      "voltage tracking" to step by step scale up/down Vproc and Vsram to fit
      SoC specific needs. When absent, the voltage scaling flow is handled by
      hardware, hence no software "voltage tracking" is needed.

required:
  - compatible
  - clocks
  - clock-names
  - operating-points-v2
  - proc-supply

additionalProperties: false

examples:
  - |
    #include <dt-bindings/clock/mt8183-clk.h>
    cci: cci {
        compatible = "mediatek,mt8183-cci";
        clocks = <&mcucfg CLK_MCU_BUS_SEL>,
                 <&topckgen CLK_TOP_ARMPLL_DIV_PLL1>;
        clock-names = "cci", "intermediate";
        operating-points-v2 = <&cci_opp>;
        proc-supply = <&mt6358_vproc12_reg>;
    };

    cci_opp: opp-table-cci {
        compatible = "operating-points-v2";
        opp-shared;
        opp2_00: opp-273000000 {
            opp-hz = /bits/ 64 <273000000>;
            opp-microvolt = <650000>;
        };
        opp2_01: opp-338000000 {
            opp-hz = /bits/ 64 <338000000>;
            opp-microvolt = <687500>;
        };
        opp2_02: opp-403000000 {
            opp-hz = /bits/ 64 <403000000>;
            opp-microvolt = <718750>;
        };
        opp2_03: opp-463000000 {
            opp-hz = /bits/ 64 <463000000>;
            opp-microvolt = <756250>;
        };
        opp2_04: opp-546000000 {
            opp-hz = /bits/ 64 <546000000>;
            opp-microvolt = <800000>;
        };
        opp2_05: opp-624000000 {
            opp-hz = /bits/ 64 <624000000>;
            opp-microvolt = <818750>;
        };
        opp2_06: opp-689000000 {
            opp-hz = /bits/ 64 <689000000>;
            opp-microvolt = <850000>;
        };
        opp2_07: opp-767000000 {
            opp-hz = /bits/ 64 <767000000>;
            opp-microvolt = <868750>;
        };
        opp2_08: opp-845000000 {
            opp-hz = /bits/ 64 <845000000>;
            opp-microvolt = <893750>;
        };
        opp2_09: opp-871000000 {
            opp-hz = /bits/ 64 <871000000>;
            opp-microvolt = <906250>;
        };
        opp2_10: opp-923000000 {
            opp-hz = /bits/ 64 <923000000>;
            opp-microvolt = <931250>;
        };
        opp2_11: opp-962000000 {
            opp-hz = /bits/ 64 <962000000>;
            opp-microvolt = <943750>;
        };
        opp2_12: opp-1027000000 {
            opp-hz = /bits/ 64 <1027000000>;
            opp-microvolt = <975000>;
        };
        opp2_13: opp-1092000000 {
            opp-hz = /bits/ 64 <1092000000>;
            opp-microvolt = <1000000>;
        };
        opp2_14: opp-1144000000 {
            opp-hz = /bits/ 64 <1144000000>;
            opp-microvolt = <1025000>;
        };
        opp2_15: opp-1196000000 {
            opp-hz = /bits/ 64 <1196000000>;
            opp-microvolt = <1050000>;
        };
    };
```

## Documentation/devicetree/bindings/interconnect/mediatek,mt8183-emi.yaml
```yaml
# SPDX-License-Identifier: GPL-2.0-only OR BSD-2-Clause
%YAML 1.2
---
$id: http://devicetree.org/schemas/interconnect/mediatek,mt8183-emi.yaml#
$schema: http://devicetree.org/meta-schemas/core.yaml#

title: MediaTek External Memory Interface (EMI) Interconnect

maintainers:
  - AngeloGioacchino Del Regno <angelogioacchino.delregno@collabora.com>

description: |
  EMI interconnect providers support system bandwidth requirements through
  Dynamic Voltage Frequency Scaling Resource Collector (DVFSRC) hardware.
  The provider is able to communicate with the DVFSRC through Secure Monitor
  Call (SMC).

             ICC provider         ICC Nodes
                              ----          ----
             _________       |CPU |   |--- |VPU |
    _____   |         |-----  ----    |     ----
   |     |->|  DRAM   |       ----    |     ----
   |DRAM |->|scheduler|----- |GPU |   |--- |DISP|
   |     |->|  (EMI)  |       ----    |     ----
   |_____|->|_________|---.   -----   |     ----
               /|\         `-|MMSYS|--|--- |VDEC|
                |             -----   |     ----
                |                     |     ----
                | change DRAM freq    |--- |VENC|
             --------                 |     ----
    SMC --> | DVFSRC |                |     ----
             --------                 |--- |IMG |
                                      |     ----
                                      |     ----
                                      |--- |CAM |
                                            ----

properties:
  compatible:
    enum:
      - mediatek,mt8183-emi
      - mediatek,mt8195-emi

  '#interconnect-cells':
    const: 1

required:
  - compatible
  - '#interconnect-cells'

unevaluatedProperties: false
```

## Documentation/devicetree/bindings/interconnect/qcom,bcm-voter.yaml
```yaml
# SPDX-License-Identifier: (GPL-2.0 OR BSD-2-Clause)
%YAML 1.2
---
$id: http://devicetree.org/schemas/interconnect/qcom,bcm-voter.yaml#
$schema: http://devicetree.org/meta-schemas/core.yaml#

title: Qualcomm BCM-Voter Interconnect

maintainers:
  - Georgi Djakov <georgi.djakov@linaro.org>

description: |
  The Bus Clock Manager (BCM) is a dedicated hardware accelerator that manages
  shared system resources by aggregating requests from multiple Resource State
  Coordinators (RSC). Interconnect providers are able to vote for aggregated
  thresholds values from consumers by communicating through their respective
  RSCs.

properties:
  compatible:
    enum:
      - qcom,bcm-voter

  qcom,tcs-wait:
    description: |
      Optional mask of which TCSs (Triggered Command Sets) wait for completion
      upon triggering. If not specified, then the AMC and WAKE sets wait for
      completion. The mask bits are available in the QCOM_ICC_TAG_* defines.

      The AMC TCS is triggered immediately when icc_set_bw() is called. The
      WAKE/SLEEP TCSs are triggered when the RSC transitions between active and
      sleep modes.

      In most cases, it's necessary to wait in both the AMC and WAKE sets to
      ensure resources are available before use. If a specific RSC and its use
      cases can ensure sufficient delay by other means, then this can be
      overridden to reduce latencies.

    $ref: /schemas/types.yaml#/definitions/uint32

required:
  - compatible

additionalProperties: false

examples:
  # Example 1: apps bcm_voter on SDM845 SoC should be defined inside &apps_rsc node
  # as defined in Documentation/devicetree/bindings/soc/qcom/qcom,rpmh-rsc.yaml
  - |

    apps_bcm_voter: bcm-voter {
        compatible = "qcom,bcm-voter";
    };

  # Example 2: disp bcm_voter on SDM845 should be defined inside &disp_rsc node
  # as defined in Documentation/devicetree/bindings/soc/qcom/qcom,rpmh-rsc.yaml
  - |

    #include <dt-bindings/interconnect/qcom,icc.h>

    disp_bcm_voter: bcm-voter {
        compatible = "qcom,bcm-voter";
        qcom,tcs-wait = <QCOM_ICC_TAG_AMC>;
    };
...
```

## Documentation/devicetree/bindings/interconnect/qcom,eliza-rpmh.yaml
```yaml
# SPDX-License-Identifier: GPL-2.0-only OR BSD-2-Clause
%YAML 1.2
---
$id: http://devicetree.org/schemas/interconnect/qcom,eliza-rpmh.yaml#
$schema: http://devicetree.org/meta-schemas/core.yaml#

title: Qualcomm RPMh Network-On-Chip Interconnect on Eliza SoC

maintainers:
  - Odelu Kukatla <odelu.kukatla@oss.qualcomm.com>

description: |
  RPMh interconnect providers support system bandwidth requirements through
  RPMh hardware accelerators known as Bus Clock Manager (BCM). The provider is
  able to communicate with the BCM through the Resource State Coordinator (RSC)
  associated with each execution environment. Provider nodes must point to at
  least one RPMh device child node pertaining to their RSC and each provider
  can map to multiple RPMh resources.

  See also: include/dt-bindings/interconnect/qcom,eliza-rpmh.h

properties:
  compatible:
    enum:
      - qcom,eliza-aggre1-noc
      - qcom,eliza-aggre2-noc
      - qcom,eliza-clk-virt
      - qcom,eliza-cnoc-cfg
      - qcom,eliza-cnoc-main
      - qcom,eliza-gem-noc
      - qcom,eliza-lpass-ag-noc
      - qcom,eliza-lpass-lpiaon-noc
      - qcom,eliza-lpass-lpicx-noc
      - qcom,eliza-mc-virt
      - qcom,eliza-mmss-noc
      - qcom,eliza-nsp-noc
      - qcom,eliza-pcie-anoc
      - qcom,eliza-system-noc

  reg:
    maxItems: 1

  clocks:
    minItems: 1
    maxItems: 2

required:
  - compatible

allOf:
  - $ref: qcom,rpmh-common.yaml#
  - if:
      properties:
        compatible:
          contains:
            enum:
              - qcom,eliza-clk-virt
              - qcom,eliza-mc-virt
    then:
      properties:
        reg: false
    else:
      required:
        - reg

  - if:
      properties:
        compatible:
          contains:
            enum:
              - qcom,eliza-aggre1-noc
    then:
      properties:
        clocks:
          items:
            - description: aggre UFS PHY AXI clock
            - description: aggre USB3 PRIM AXI clock

  - if:
      properties:
        compatible:
          contains:
            enum:
              - qcom,eliza-aggre2-noc
    then:
      properties:
        clocks:
          items:
            - description: RPMH CC IPA clock

  - if:
      properties:
        compatible:
          contains:
            enum:
              - qcom,eliza-pcie-anoc
    then:
      properties:
        clocks:
          items:
            - description: aggre-NOC PCIe AXI clock
            - description: cfg-NOC PCIe a-NOC AHB clock

  - if:
      properties:
        compatible:
          contains:
            enum:
              - qcom,eliza-aggre1-noc
              - qcom,eliza-aggre2-noc
              - qcom,eliza-pcie-anoc
    then:
      required:
        - clocks
    else:
      properties:
        clocks: false

unevaluatedProperties: false

examples:
  - |
    gem_noc: interconnect@24100000 {
        compatible = "qcom,eliza-gem-noc";
        reg = <0x24100000 0x163080>;
        #interconnect-cells = <2>;
        qcom,bcm-voters = <&apps_bcm_voter>;
    };

    mc_virt: interconnect-2 {
        compatible = "qcom,eliza-mc-virt";
        #interconnect-cells = <2>;
        qcom,bcm-voters = <&apps_bcm_voter>;
    };

    aggre1_noc: interconnect@16e0000 {
        compatible = "qcom,eliza-aggre1-noc";
        reg = <0x16e0000 0x16400>;
        #interconnect-cells = <2>;
        clocks = <&gcc_phy_axi_clk>, <&gcc_prim_axi_clk>;
        qcom,bcm-voters = <&apps_bcm_voter>;
    };
```
