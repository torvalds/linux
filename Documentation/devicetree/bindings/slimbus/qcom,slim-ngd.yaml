## Documentation/devicetree/bindings/slimbus/qcom,slim-ngd.yaml
```yaml
# SPDX-License-Identifier: GPL-2.0 OR BSD-2-Clause
%YAML 1.2
---
$id: http://devicetree.org/schemas/slimbus/qcom,slim-ngd.yaml#
$schema: http://devicetree.org/meta-schemas/core.yaml#

title: Qualcomm SoC SLIMBus Non Generic Device (NGD) Controller

maintainers:
  - Krzysztof Kozlowski <krzysztof.kozlowski@linaro.org>
  - Srinivas Kandagatla <srinivas.kandagatla@linaro.org>

description:
  SLIMBus NGD controller is a light-weight driver responsible for communicating
  with SLIMBus slaves directly over the bus using messaging interface and
  communicating with master component residing on ADSP for bandwidth and
  data-channel management

properties:
  compatible:
    enum:
      - qcom,slim-ngd-v1.5.0        # for MSM8996
      - qcom,slim-ngd-v2.1.0        # for SDM845

  reg:
    maxItems: 1

  "#address-cells":
    const: 1

  "#size-cells":
    const: 0

  dmas:
    maxItems: 2

  dma-names:
    items:
      - const: rx
      - const: tx

  interrupts:
    maxItems: 1

  iommus:
    maxItems: 1

patternProperties:
  "^slim@[0-9a-f]+$":
    type: object
    $ref: slimbus.yaml#
    description:
      Each subnode represents an instance of NGD

    properties:
      reg:
        maxItems: 1

    unevaluatedProperties: false

required:
  - compatible
  - reg
  - "#address-cells"
  - "#size-cells"
  - dmas
  - dma-names
  - interrupts

additionalProperties: false

examples:
  - |
    #include <dt-bindings/gpio/gpio.h>
    #include <dt-bindings/interrupt-controller/arm-gic.h>

    slim-ngd@171c0000 {
        compatible = "qcom,slim-ngd-v2.1.0";
        reg = <0x171c0000 0x2c000>;
        interrupts = <GIC_SPI 163 IRQ_TYPE_LEVEL_HIGH>;

        dmas = <&slimbam 3>, <&slimbam 4>;
        dma-names = "rx", "tx";
        iommus = <&apps_smmu 0x1806 0x0>;
        #address-cells = <1>;
        #size-cells = <0>;

        slim@1 {
            reg = <1>;
            #address-cells = <2>;
            #size-cells = <0>;

            codec@1,0 {
                compatible = "slim217,250";
                reg = <1 0>;
                slim-ifc-dev = <&wcd9340_ifd>;

                #sound-dai-cells = <1>;

                interrupts-extended = <&tlmm 54 IRQ_TYPE_LEVEL_HIGH>;
                interrupt-controller;
                #interrupt-cells = <1>;

                #clock-cells = <0>;
                clock-frequency = <9600000>;
                clock-output-names = "mclk";
                qcom,micbias1-microvolt = <1800000>;
                qcom,micbias2-microvolt = <1800000>;
                qcom,micbias3-microvolt = <1800000>;
                qcom,micbias4-microvolt = <1800000>;

                #address-cells = <1>;
                #size-cells = <1>;

                reset-gpios = <&tlmm 64 GPIO_ACTIVE_HIGH>;

                /* Rest of the WCD9340 codec */
            };
        };
    };
```

## Documentation/devicetree/bindings/slimbus/qcom,slim.yaml
```yaml
# SPDX-License-Identifier: GPL-2.0 OR BSD-2-Clause
%YAML 1.2
---
$id: http://devicetree.org/schemas/slimbus/qcom,slim.yaml#
$schema: http://devicetree.org/meta-schemas/core.yaml#

title: Qualcomm SoC SLIMbus controller

maintainers:
  - Krzysztof Kozlowski <krzysztof.kozlowski@linaro.org>
  - Srinivas Kandagatla <srinivas.kandagatla@linaro.org>

description:
  SLIMbus controller used when applications processor controls SLIMbus master
  component.

allOf:
  - $ref: slimbus.yaml#

properties:
  compatible:
    items:
      - enum:
          - qcom,apq8064-slim
      - const: qcom,slim

  reg:
    items:
      - description: Physical address of controller register blocks
      - description: SLEW RATE register

  reg-names:
    items:
      - const: ctrl
      - const: slew

  clocks:
    items:
      - description: Interface clock for this controller
      - description: Interrupt for controller core's BAM

  clock-names:
    items:
      - const: iface
      - const: core

  interrupts:
    maxItems: 1

required:
  - compatible
  - reg
  - reg-names
  - clocks
  - clock-names
  - interrupts

unevaluatedProperties: false

examples:
  - |
    #include <dt-bindings/clock/qcom,gcc-msm8960.h>
    #include <dt-bindings/clock/qcom,lcc-msm8960.h>
    #include <dt-bindings/interrupt-controller/arm-gic.h>

    soc {
        #address-cells = <1>;
        #size-cells = <1>;
        ranges;

        slim@28080000 {
            compatible = "qcom,apq8064-slim", "qcom,slim";
            reg = <0x28080000 0x2000>, <0x80207c 4>;
            reg-names = "ctrl", "slew";
            interrupts = <GIC_SPI 33 IRQ_TYPE_LEVEL_HIGH>;
            clocks = <&lcc SLIMBUS_SRC>, <&lcc AUDIO_SLIMBUS_CLK>;
            clock-names = "iface", "core";
            #address-cells = <2>;
            #size-cells = <0>;

            audio-codec@1,0 {
                compatible = "slim217,60";
                reg = <1 0>;
            };
        };
    };
```

## Documentation/devicetree/bindings/slimbus/slim-ngd-qcom-ctrl.txt
```
Qualcomm SLIMBus Non Generic Device (NGD) Controller binding

SLIMBus NGD controller is a light-weight driver responsible for communicating
with SLIMBus slaves directly over the bus using messaging interface and
communicating with master component residing on ADSP for bandwidth and
data-channel management

Please refer to slimbus/bus.txt for details of the common SLIMBus bindings.

- compatible:
	Usage: required
	Value type: <stringlist>
	Definition: must be "qcom,slim-ngd-v<MAJOR>.<MINOR>.<STEP>"
	must be one of the following.
	"qcom,slim-ngd-v1.5.0" for MSM8996
	"qcom,slim-ngd-v2.1.0" for SDM845

- reg:
	Usage: required
	Value type: <prop-encoded-array>
	Definition: must specify the base address and size of the controller
		    register space.
- dmas
	Usage: required
	Value type: <array of phandles>
	Definition: List of rx and tx dma channels

- dma-names
	Usage: required
	Value type: <stringlist>
	Definition: must be "rx" and "tx".

- interrupts:
	Usage: required
	Value type: <prop-encoded-array>
	Definition: must list controller IRQ.

#address-cells
	Usage: required
	Value type: <u32>
	Definition: Should be 1, reflecting the instance id of ngd.

#size-cells
	Usage: required
	Value type: <u32>
	Definition: Should be 0

= NGD Devices
Each subnode represents an instance of NGD, must contain the following
properties:

- reg:
	Usage: required
	Value type: <u32>
	Definition: Should be instance id of ngd.

#address-cells
	Usage: required
	Refer to slimbus/bus.txt for details of the common SLIMBus bindings.

#size-cells
	Usage: required
	Refer to slimbus/bus.txt for details of the common SLIMBus bindings.

= EXAMPLE

slim@91c0000 {
	compatible = "qcom,slim-ngd-v1.5.0";
	reg = <0x91c0000 0x2c000>;
	interrupts = <0 163 0>;
	dmas =	<&slimbam 3>, <&slimbam 4>;
	dma-names = "rx", "tx";
	#address-cells = <1>;
	#size-cells = <0>;
	ngd@1 {
		reg = <1>;
		#address-cells = <1>;
		#size-cells = <1>;
		codec@1 {
			compatible = "slim217,1a0";
			reg  = <1 0>;
		};
	};
};
```

## Documentation/devicetree/bindings/slimbus/slim-qcom-ctrl.txt
```
Qualcomm SLIMbus controller
This controller is used if applications processor driver controls SLIMbus
master component.

Required properties:

 - #address-cells - refer to Documentation/devicetree/bindings/slimbus/bus.txt
 - #size-cells	- refer to Documentation/devicetree/bindings/slimbus/bus.txt

 - reg : Offset and length of the register region(s) for the device
 - reg-names : Register region name(s) referenced in reg above
	 Required register resource entries are:
	 "ctrl": Physical address of controller register blocks
 	 "slew": required for "qcom,apq8064-slim" SOC.
 - compatible : should be "qcom,<SOC-NAME>-slim" for SOC specific compatible
 		followed by "qcom,slim" for fallback.
 - interrupts : Interrupt number used by this controller
 - clocks : Interface and core clocks used by this SLIMbus controller
 - clock-names : Required clock-name entries are:
	"iface" : Interface clock for this controller
	"core" : Interrupt for controller core's BAM

Example:

	slim@28080000 {
		compatible = "qcom,apq8064-slim", "qcom,slim";
		reg = <0x28080000 0x2000>, <0x80207C 4>;
		reg-names = "ctrl", "slew";
		interrupts = <0 33 0>;
		clocks = <&lcc SLIMBUS_SRC>, <&lcc AUDIO_SLIMBUS_CLK>;
		clock-names = "iface", "core";
		#address-cells = <2>;
		#size-cell = <0>;

		wcd9310: audio-codec@1,0{
			compatible = "slim217,60";
			reg = <1 0>;
		};
	};
```

## Documentation/devicetree/bindings/slimbus/slimbus.yaml
```yaml
# SPDX-License-Identifier: GPL-2.0 OR BSD-2-Clause
%YAML 1.2
---
$id: http://devicetree.org/schemas/slimbus/slimbus.yaml#
$schema: http://devicetree.org/meta-schemas/core.yaml#

title: SLIM (Serial Low Power Interchip Media) bus

maintainers:
  - Srinivas Kandagatla <srinivas.kandagatla@linaro.org>

description:
  SLIMbus is a 2-wire bus, and is used to communicate with peripheral
  components like audio-codec.

properties:
  $nodename:
    pattern: "^slim(@.*|-([0-9]|[1-9][0-9]+))?$"

  "#address-cells":
    const: 2

  "#size-cells":
    const: 0

patternProperties:
  "^.*@[0-9a-f]+,[0-9a-f]+$":
    type: object
    description: |
      Every SLIMbus controller node can contain zero or more child nodes
      representing slave devices on the bus. Every SLIMbus slave device is
      uniquely determined by the enumeration address containing 4 fields::
      Manufacturer ID, Product code, Device index, and Instance value for the
      device.

      If child node is not present and it is instantiated after device
      discovery (slave device reporting itself present).

      In some cases it may be necessary to describe non-probeable device
      details such as non-standard ways of powering up a device. In such cases,
      child nodes for those devices will be present as slaves of the SLIMbus
      controller.

    properties:
      compatible:
        pattern: "^slim[0-9a-f]+,[0-9a-f]+$"

      reg:
        maxItems: 1
        description: |
          Pair of (device index, instande ID), where::
           - Device index, which uniquely identifies multiple devices within a
             single component.
           - Instance ID, can be used for the cases where multiple devices of
             the same type or class are attached to the bus.

    required:
      - compatible
      - reg

    additionalProperties: true

required:
  - "#address-cells"
  - "#size-cells"

additionalProperties: true

examples:
  - |
    #include <dt-bindings/clock/qcom,gcc-msm8960.h>
    #include <dt-bindings/clock/qcom,lcc-msm8960.h>
    #include <dt-bindings/interrupt-controller/arm-gic.h>

    soc {
        #address-cells = <1>;
        #size-cells = <1>;
        ranges;

        slim@28080000 {
            compatible = "qcom,apq8064-slim", "qcom,slim";
            reg = <0x28080000 0x2000>, <0x80207c 4>;
            reg-names = "ctrl", "slew";
            interrupts = <GIC_SPI 33 IRQ_TYPE_LEVEL_HIGH>;
            clocks = <&lcc SLIMBUS_SRC>, <&lcc AUDIO_SLIMBUS_CLK>;
            clock-names = "iface", "core";
            #address-cells = <2>;
            #size-cells = <0>;

            audio-codec@1,0 {
                compatible = "slim217,60";
                reg = <1 0>;
            };
        };
    };
```

## Documentation/devicetree/bindings/soc/altera/altr,sys-mgr.yaml
```yaml
# SPDX-License-Identifier: (GPL-2.0-only OR BSD-2-Clause)
%YAML 1.2
---
$id: http://devicetree.org/schemas/soc/altera/altr,sys-mgr.yaml#
$schema: http://devicetree.org/meta-schemas/core.yaml#

title: Altera SOCFPGA System Manager

maintainers:
  - Dinh Nguyen <dinguyen@kernel.org>

properties:
  compatible:
    oneOf:
      - description: Cyclone5/Arria5/Arria10
        const: altr,sys-mgr
      - description: Stratix10 SoC
        items:
          - const: altr,sys-mgr-s10
          - const: altr,sys-mgr

  reg:
    maxItems: 1

  cpu1-start-addr:
    $ref: /schemas/types.yaml#/definitions/uint32
    description: CPU1 start address in hex

required:
  - compatible
  - reg

allOf:
  - if:
      properties:
        compatible:
          contains:
            const: altr,sys-mgr-s10
    then:
      properties:
        cpu1-start-addr: false

additionalProperties: false

examples:
  - |
    sysmgr@ffd08000 {
      compatible = "altr,sys-mgr";
      reg = <0xffd08000 0x1000>;
      cpu1-start-addr = <0xffd080c4>;
    };
```

## Documentation/devicetree/bindings/soc/amlogic/amlogic,canvas.txt
```
Amlogic Canvas
================================

A canvas is a collection of metadata that describes a pixel buffer.
Those metadata include: width, height, phyaddr, wrapping and block mode.
Starting with GXBB the endianness can also be described.

Many IPs within Amlogic SoCs rely on canvas indexes to read/write pixel data
rather than use the phy addresses directly. For instance, this is the case for
the video decoders and the display.

Amlogic SoCs have 256 canvas.

Device Tree Bindings:
---------------------

Video Lookup Table
--------------------------

Required properties:
- compatible: has to be one of:
		- "amlogic,meson8-canvas", "amlogic,canvas" on Meson8
		- "amlogic,meson8b-canvas", "amlogic,canvas" on Meson8b
		- "amlogic,meson8m2-canvas", "amlogic,canvas" on Meson8m2
		- "amlogic,canvas" on GXBB and newer
- reg: Base physical address and size of the canvas registers.

Example:

canvas: video-lut@48 {
	compatible = "amlogic,canvas";
	reg = <0x0 0x48 0x0 0x14>;
};
```

## Documentation/devicetree/bindings/soc/amlogic/amlogic,canvas.yaml
```yaml
# SPDX-License-Identifier: (GPL-2.0 OR BSD-2-Clause)
# Copyright 2019 BayLibre, SAS
%YAML 1.2
---
$id: "http://devicetree.org/schemas/soc/amlogic/amlogic,canvas.yaml#"
$schema: "http://devicetree.org/meta-schemas/core.yaml#"

title: Amlogic Canvas Video Lookup Table

maintainers:
  - Neil Armstrong <narmstrong@baylibre.com>
  - Maxime Jourdan <mjourdan@baylibre.com>

description: |
  A canvas is a collection of metadata that describes a pixel buffer.
  Those metadata include: width, height, phyaddr, wrapping and block mode.
  Starting with GXBB the endianness can also be described.

  Many IPs within Amlogic SoCs rely on canvas indexes to read/write pixel data
  rather than use the phy addresses directly. For instance, this is the case for
  the video decoders and the display.

  Amlogic SoCs have 256 canvas.

properties:
  compatible:
    oneOf:
      - items:
          - enum:
              - amlogic,meson8-canvas
              - amlogic,meson8b-canvas
              - amlogic,meson8m2-canvas
          - const: amlogic,canvas
      - const: amlogic,canvas # GXBB and newer SoCs

  reg:
    maxItems: 1

required:
  - compatible
  - reg

additionalProperties: false

examples:
  - |
    canvas: video-lut@48 {
        compatible = "amlogic,canvas";
        reg = <0x48 0x14>;
    };
```

## Documentation/devicetree/bindings/soc/amlogic/amlogic,meson-gx-clk-measure.yaml
```yaml
# SPDX-License-Identifier: (GPL-2.0-only OR BSD-2-Clause)
%YAML 1.2
---
$id: http://devicetree.org/schemas/soc/amlogic/amlogic,meson-gx-clk-measure.yaml#
$schema: http://devicetree.org/meta-schemas/core.yaml#

title: Amlogic Internal Clock Measurer

description:
  The Amlogic SoCs contains an IP to measure the internal clocks.
  The precision is multiple of MHz, useful to debug the clock states.

maintainers:
  - Neil Armstrong <neil.armstrong@linaro.org>

properties:
  compatible:
    enum:
      - amlogic,meson-gx-clk-measure
      - amlogic,meson8-clk-measure
      - amlogic,meson8b-clk-measure
      - amlogic,meson-axg-clk-measure
      - amlogic,meson-g12a-clk-measure
      - amlogic,meson-sm1-clk-measure

  reg:
    maxItems: 1

required:
  - compatible
  - reg

unevaluatedProperties: false

examples:
  - |
    clock-measure@8758 {
        compatible = "amlogic,meson-gx-clk-measure";
        reg = <0x8758 0x10>;
    };
```
