## Documentation/devicetree/bindings/soc/amlogic/amlogic,meson-gx-hhi-sysctrl.yaml
```yaml
# SPDX-License-Identifier: (GPL-2.0-only OR BSD-2-Clause)
%YAML 1.2
---
$id: http://devicetree.org/schemas/soc/amlogic/amlogic,meson-gx-hhi-sysctrl.yaml#
$schema: http://devicetree.org/meta-schemas/core.yaml#

title: Amlogic Meson System Control registers

maintainers:
  - Neil Armstrong <neil.armstrong@linaro.org>

properties:
  compatible:
    items:
      - enum:
          - amlogic,meson-gx-hhi-sysctrl
          - amlogic,meson-gx-ao-sysctrl
          - amlogic,meson-axg-hhi-sysctrl
          - amlogic,meson-axg-ao-sysctrl
      - const: simple-mfd
      - const: syscon

  reg:
    maxItems: 1

  clock-controller:
    type: object

  power-controller:
    $ref: /schemas/power/amlogic,meson-ee-pwrc.yaml

  pinctrl:
    type: object

  phy:
    type: object

allOf:
  - if:
      properties:
        compatible:
          enum:
            - amlogic,meson-gx-hhi-sysctrl
            - amlogic,meson-axg-hhi-sysctrl
    then:
      properties:
        clock-controller:
          $ref: /schemas/clock/amlogic,gxbb-clkc.yaml#

      required:
        - power-controller

  - if:
      properties:
        compatible:
          enum:
            - amlogic,meson-gx-ao-sysctrl
            - amlogic,meson-axg-ao-sysctrl
    then:
      properties:
        clock-controller:
          $ref: /schemas/clock/amlogic,gxbb-aoclkc.yaml#

        power-controller: false
        phy: false

  - if:
      properties:
        compatible:
          enum:
            - amlogic,meson-gx-hhi-sysctrl
    then:
      properties:
        phy: false

  - if:
      properties:
        compatible:
          enum:
            - amlogic,meson-axg-hhi-sysctrl
    then:
      properties:
        phy:
          oneOf:
            - $ref: /schemas/phy/amlogic,g12a-mipi-dphy-analog.yaml
            - $ref: /schemas/phy/amlogic,meson-axg-mipi-pcie-analog.yaml

required:
  - compatible
  - reg
  - clock-controller

additionalProperties: false

examples:
  - |
    bus@c883c000 {
        compatible = "simple-bus";
        reg = <0xc883c000 0x2000>;
        #address-cells = <1>;
        #size-cells = <1>;
        ranges = <0x0 0xc883c000 0x2000>;

        sysctrl: system-controller@0 {
            compatible = "amlogic,meson-gx-hhi-sysctrl", "simple-mfd", "syscon";
            reg = <0 0x400>;

            clock-controller {
                compatible = "amlogic,gxbb-clkc";
                #clock-cells = <1>;
                clocks = <&xtal>;
                clock-names = "xtal";
            };

            power-controller {
                compatible = "amlogic,meson-gxbb-pwrc";
                #power-domain-cells = <1>;
                amlogic,ao-sysctrl = <&sysctrl_AO>;

                resets = <&reset_viu>,
                         <&reset_venc>,
                         <&reset_vcbus>,
                         <&reset_bt656>,
                         <&reset_dvin>,
                         <&reset_rdma>,
                         <&reset_venci>,
                         <&reset_vencp>,
                         <&reset_vdac>,
                         <&reset_vdi6>,
                         <&reset_vencl>,
                         <&reset_vid_lock>;
                reset-names = "viu", "venc", "vcbus", "bt656", "dvin",
                              "rdma", "venci", "vencp", "vdac", "vdi6",
                              "vencl", "vid_lock";
                clocks = <&clk_vpu>, <&clk_vapb>;
                clock-names = "vpu", "vapb";
            };
        };
    };

    bus@c8100000 {
        compatible = "simple-bus";
        reg = <0xc8100000 0x100000>;
        #address-cells = <1>;
        #size-cells = <1>;
        ranges = <0x0 0xc8100000 0x100000>;

        sysctrl_AO: system-controller@0 {
            compatible = "amlogic,meson-gx-ao-sysctrl", "simple-mfd", "syscon";
            reg = <0 0x100>;

            clock-controller {
                compatible = "amlogic,meson-gxbb-aoclkc", "amlogic,meson-gx-aoclkc";
                #clock-cells = <1>;
                #reset-cells = <1>;
                clocks = <&xtal>, <&clk81>;
                clock-names = "xtal", "mpeg-clk";
            };
        };
    };

  - |
    system-controller@ff63c000 {
        compatible = "amlogic,meson-axg-hhi-sysctrl", "simple-mfd", "syscon";
        reg = <0xff63c000 0x400>;

        clock-controller {
            compatible = "amlogic,axg-clkc";
            #clock-cells = <1>;
            clocks = <&xtal>;
            clock-names = "xtal";
        };

        power-controller {
           compatible = "amlogic,meson-axg-pwrc";
           #power-domain-cells = <1>;
           amlogic,ao-sysctrl = <&sysctrl_AO>;

           resets = <&reset_viu>,
                    <&reset_venc>,
                    <&reset_vcbus>,
                    <&reset_vencl>,
                    <&reset_vid_lock>;
           reset-names = "viu", "venc", "vcbus", "vencl", "vid_lock";
           clocks = <&clk_vpu>, <&clk_vapb>;
           clock-names = "vpu", "vapb";
        };

        phy {
           compatible = "amlogic,axg-mipi-pcie-analog-phy";
           #phy-cells = <0>;
        };
    };
```

## Documentation/devicetree/bindings/soc/amlogic/clk-measure.txt
```
Amlogic Internal Clock Measurer
===============================

The Amlogic SoCs contains an IP to measure the internal clocks.
The precision is multiple of MHz, useful to debug the clock states.

Required properties:
- compatible: Shall contain one of the following :
			"amlogic,meson-gx-clk-measure" for GX SoCs
			"amlogic,meson8-clk-measure" for Meson8 SoCs
			"amlogic,meson8b-clk-measure" for Meson8b SoCs
- reg: base address and size of the Clock Measurer register space.

Example:
	clock-measure@8758 {
		compatible = "amlogic,meson-gx-clk-measure";
		reg = <0x0 0x8758 0x0 0x10>;
	};
```

## Documentation/devicetree/bindings/soc/apple/apple,t6000-pmgr-misc.yaml
```yaml
# SPDX-License-Identifier: (GPL-2.0-only OR BSD-2-Clause)
%YAML 1.2
---
$id: http://devicetree.org/schemas/soc/apple/apple,t6000-pmgr-misc.yaml#
$schema: http://devicetree.org/meta-schemas/core.yaml#

title: Apple SoC PMGR Misc Power States

maintainers:
  - Sasha Finkelstein <k@chaosmail.tech>

description: |
  Certain Apple SoCs include additional PMGR power states that are controlled
  via a different "misc" control block. This includes the fabric and memory
  controller states.

properties:
  compatible:
    enum:
      - apple,t6000-pmgr-misc
      - apple,t6020-pmgr-misc

  reg:
    maxItems: 2

  reg-names:
    items:
      - const: fabric-ps
      - const: dcs-ps

required:
  - compatible
  - reg
  - reg-names

additionalProperties: false

examples:
  - |
    power-management@8e20c000 {
        compatible = "apple,t6000-pmgr-misc";
        reg = <0x8e20c000 0x400>,
              <0x8e20c800 0x400>;
        reg-names = "fabric-ps", "dcs-ps";
    };
```

## Documentation/devicetree/bindings/soc/aspeed/espi.yaml
```yaml
# SPDX-License-Identifier: (GPL-2.0-only OR BSD-2-Clause)
# # Copyright (c) 2021 Aspeed Technology Inc.
%YAML 1.2
---
$id: "http://devicetree.org/schemas/soc/aspeed/espi.yaml#"
$schema: "http://devicetree.org/meta-schemas/core.yaml#"

title: Aspeed eSPI Controller

maintainers:
  - Chia-Wei Wang <chiawei_wang@aspeedtech.com>
  - Ryan Chen <ryan_chen@aspeedtech.com>

description:
  Aspeed eSPI controller implements a slave side eSPI endpoint device
  supporting the four eSPI channels, namely peripheral, virtual wire,
  out-of-band, and flash.

properties:
  compatible:
    items:
      - enum:
          - aspeed,ast2500-espi
          - aspeed,ast2600-espi
      - const: simple-mfd
      - const: syscon

  reg:
    maxItems: 1

  "#address-cells":
    const: 1

  "#size-cells":
    const: 1

  ranges: true

patternProperties:
  "^espi-ctrl@[0-9a-f]+$":
    type: object

    description: Control of the four basic eSPI channels

    properties:
      compatible:
        items:
          - enum:
              - aspeed,ast2500-espi-ctrl
              - aspeed,ast2600-espi-ctrl

      interrupts:
        maxItems: 1

      clocks:
        maxItems: 1

      perif,memcyc-enable:
        type: boolean
        description: Enable memory cycle over eSPI peripheral channel

      perif,memcyc-src-addr:
        $ref: /schemas/types.yaml#/definitions/uint32
        description: The Host side address to be decoded into the memory cycle over eSPI peripheral channel

      perif,memcyc-size:
        $ref: /schemas/types.yaml#/definitions/uint32
        description: The size of the memory region allocated for the memory cycle over eSPI peripheral channel
        minimum: 65536

      perif,dma-mode:
        type: boolean
        description: Enable DMA support for eSPI peripheral channel

      oob,dma-mode:
        type: boolean
        description: Enable DMA support for eSPI out-of-band channel

      oob,dma-tx-desc-num:
        $ref: /schemas/types.yaml#/definitions/uint32
        minimum: 2
        maximum: 1023
        description: The number of TX descriptors available for eSPI OOB DMA engine

      oob,dma-rx-desc-num:
        $ref: /schemas/types.yaml#/definitions/uint32
        minimum: 2
        maximum: 1023
        description: The number of RX descriptors available for eSPI OOB DMA engine

      flash,dma-mode:
        type: boolean
        description: Enable DMA support for eSPI flash channel

      flash,safs-mode:
        $ref: /schemas/types.yaml#/definitions/uint32
        enum: [ 0, 1, 2 ]
        default: 0
        description: Slave-Attached-Sharing-Flash mode, 0->Mix, 1->SW, 2->HW

    dependencies:
      perif,memcyc-src-addr: [ "perif,memcyc-enable" ]
      perif,memcyc-size: [ "perif,memcyc-enable" ]
      oob,dma-tx-desc-num: [ "oob,dma-mode" ]
      oob,dma-rx-desc-num: [ "oob,dma-mode" ]

    required:
      - compatible
      - interrupts
      - clocks

  "^espi-mmbi@[0-9a-f]+$":
    type: object

    description: Control of the PCH-BMC data exchange over eSPI peripheral memory cycle

    properties:
      compatible:
        const: aspeed,ast2600-espi-mmbi

      interrupts:
        maxItems: 1

    required:
      - compatible
      - interrupts

required:
  - compatible
  - reg
  - "#address-cells"
  - "#size-cells"
  - ranges

additionalProperties: false

examples:
  - |
    #include <dt-bindings/interrupt-controller/arm-gic.h>
    #include <dt-bindings/clock/ast2600-clock.h>

    espi: espi@1e6ee000 {
        compatible = "aspeed,ast2600-espi", "simple-mfd", "syscon";
        reg = <0x1e6ee000 0x1000>;

        #address-cells = <1>;
        #size-cells = <1>;
        ranges = <0x0 0x1e6ee000 0x1000>;

        espi_ctrl: espi-ctrl@0 {
            compatible = "aspeed,ast2600-espi-ctrl";
            reg = <0x0 0x800>;
            interrupts = <GIC_SPI 42 IRQ_TYPE_LEVEL_HIGH>;
            clocks = <&syscon ASPEED_CLK_GATE_ESPICLK>;
        };

        espi_mmbi: espi-mmbi@800 {
            compatible = "aspeed,ast2600-espi-mmbi";
            reg = <0x800 0x50>;
            interrupts = <GIC_SPI 108 IRQ_TYPE_LEVEL_HIGH>;
        };
    };
```

## Documentation/devicetree/bindings/soc/aspeed/uart-routing.yaml
```yaml
# SPDX-License-Identifier: (GPL-2.0-only OR BSD-2-Clause)
# # Copyright (c) 2018 Google LLC
# # Copyright (c) 2021 Aspeed Technology Inc.
%YAML 1.2
---
$id: "http://devicetree.org/schemas/soc/aspeed/uart-routing.yaml#"
$schema: "http://devicetree.org/meta-schemas/core.yaml#"

title: Aspeed UART Routing Controller

maintainers:
  - Oskar Senft <osk@google.com>
  - Chia-Wei Wang <chiawei_wang@aspeedtech.com>

description:
  The Aspeed UART routing control allow to dynamically route the inputs for
  the built-in UARTS and physical serial I/O ports.

  This allows, for example, to connect the output of UART to another UART.
  This can be used to enable Host <-> BMC communication via UARTs, e.g. to
  allow access to the Host's serial console.

  This driver is for the BMC side. The sysfs files allow the BMC userspace
  which owns the system configuration policy, to configure how UARTs and
  physical serial I/O ports are routed.

properties:
  compatible:
    items:
      - enum:
          - aspeed,ast2400-uart-routing
          - aspeed,ast2500-uart-routing
          - aspeed,ast2600-uart-routing
  reg:
    maxItems: 1

required:
  - compatible

additionalProperties: false

examples:
  - |
    lpc: lpc@1e789000 {
        compatible = "aspeed,ast2600-lpc-v2", "simple-mfd", "syscon";
        reg = <0x1e789000 0x1000>;

        #address-cells = <1>;
        #size-cells = <1>;
        ranges = <0x0 0x1e789000 0x1000>;

        uart_routing: uart-routing@98 {
            compatible = "aspeed,ast2600-uart-routing";
            reg = <0x98 0x8>;
        };
    };
```

## Documentation/devicetree/bindings/soc/aspeed/xdma.yaml
```yaml
# SPDX-License-Identifier: (GPL-2.0-only OR BSD-2-Clause)
%YAML 1.2
---
$id: http://devicetree.org/schemas/soc/aspeed/xdma.yaml#
$schema: http://devicetree.org/meta-schemas/core.yaml#

title: Aspeed AST25XX and AST26XX XDMA Engine

maintainers:
  - Eddie James <eajames@linux.ibm.com>

description: |
  This binding describes the XDMA Engine embedded in the AST2500 and AST2600
  SOCs. The XDMA engine can perform automatic DMA operations over PCI between
  the SOC (acting as a BMC) and a host processor.

properties:
  compatible:
    enum:
      - aspeed,ast2500-xdma
      - aspeed,ast2600-xdma

  reg:
    maxItems: 1

  clocks:
    maxItems: 1

  resets:
    minItems: 1
    maxItems: 2

  reset-names:
    items:
      - const: device
      - const: root-complex

  interrupts:
    items:
      - description: global interrupt for the XDMA engine
      - description: PCI-E reset or PERST interrupt

  aspeed,scu:
    description: a reference to the System Control Unit node of the Aspeed SOC.
    allOf:
      - $ref: /schemas/types.yaml#/definitions/phandle

  aspeed,pcie-device:
    description: describes which PCI-E device the XDMA engine should use
    allOf:
      - $ref: /schemas/types.yaml#/definitions/string
      - enum: [ bmc, vga ]

required:
  - compatible
  - reg
  - clocks
  - resets
  - interrupts-extended
  - aspeed,scu
  - memory-region

if:
  properties:
    compatible:
      contains:
        const: aspeed,ast2600-xdma
then:
  required:
    - reset-names

additionalProperties: false

examples:
  - |
    #include <dt-bindings/clock/ast2600-clock.h>
    #include <dt-bindings/interrupt-controller/arm-gic.h>
    #include <dt-bindings/interrupt-controller/aspeed-scu-ic.h>
    syscon: syscon@1e6e2000 {
        reg = <0x1e6e2000 0x1000>;
        ranges = <0 0x1e6e2000 0x1000>;
        #address-cells = <1>;
        #size-cells = <1>;
        #clock-cells = <1>;
        #reset-cells = <1>;
        scu_ic0: interrupt-controller@560 {
            reg = <0x560 0x4>;
            interrupt-controller;
            #interrupt-cells = <1>;
        };
    };
    xdma@1e6e7000 {
        compatible = "aspeed,ast2600-xdma";
        reg = <0x1e6e7000 0x100>;
        clocks = <&syscon ASPEED_CLK_GATE_BCLK>;
        resets = <&syscon ASPEED_RESET_DEV_XDMA>, <&syscon ASPEED_RESET_RC_XDMA>;
        reset-names = "device", "root-complex";
        interrupts-extended = <&gic GIC_SPI 6 IRQ_TYPE_LEVEL_HIGH>,
                              <&scu_ic0 ASPEED_AST2600_SCU_IC0_PCIE_PERST_LO_TO_HI>;
        aspeed,scu = <&syscon>;
        aspeed,pcie-device = "bmc";
        memory-region = <&vga_memory>;
    };
```
