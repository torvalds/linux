## Documentation/devicetree/bindings/soc/bcm/brcm,bcm23550-cdc.yaml
```yaml
# SPDX-License-Identifier: GPL-2.0-only OR BSD-2-Clause
%YAML 1.2
---
$id: http://devicetree.org/schemas/soc/bcm/brcm,bcm23550-cdc.yaml#
$schema: http://devicetree.org/meta-schemas/core.yaml#

title: Broadcom BCM23550 Cluster Dormant Control

description:
  The Cluster Dormant Control block keeps the CPU in idle state. A command
  needs to be sent to this block to bring the CPU into running state.

maintainers:
  - Florian Fainelli <f.fainelli@gmail.com>

properties:
  compatible:
    const: brcm,bcm23550-cdc

  reg:
    maxItems: 1

required:
  - compatible
  - reg

additionalProperties: false

examples:
  - |
    cdc@3fe0e000 {
        compatible = "brcm,bcm23550-cdc";
        reg = <0x3fe0e000 0x78>;
    };
...
```

## Documentation/devicetree/bindings/soc/bcm/brcm,bcm2711-avs-monitor.yaml
```yaml
# SPDX-License-Identifier: GPL-2.0-only OR BSD-2-Clause
%YAML 1.2
---
$id: http://devicetree.org/schemas/soc/bcm/brcm,bcm2711-avs-monitor.yaml#
$schema: http://devicetree.org/meta-schemas/core.yaml#

title: Broadcom AVS Monitor

maintainers:
  - Stefan Wahren <wahrenst@gmx.net>

properties:
  compatible:
    items:
      - const: brcm,bcm2711-avs-monitor
      - const: syscon
      - const: simple-mfd

  reg:
    maxItems: 1

  thermal:
    $ref: /schemas/thermal/brcm,avs-ro-thermal.yaml
    description: Broadcom AVS ring oscillator thermal

required:
  - compatible
  - reg
  - thermal

additionalProperties: false

examples:
  - |
    avs-monitor@7d5d2000 {
        compatible = "brcm,bcm2711-avs-monitor", "syscon", "simple-mfd";
        reg = <0x7d5d2000 0xf00>;

        thermal: thermal {
            compatible = "brcm,bcm2711-thermal";
            #thermal-sensor-cells = <0>;
        };
    };
...
```

## Documentation/devicetree/bindings/soc/bcm/brcm,bcm2835-pm.txt
```
BCM2835 PM (Power domains, watchdog)

The PM block controls power domains and some reset lines, and includes
a watchdog timer.  This binding supersedes the brcm,bcm2835-pm-wdt
binding which covered some of PM's register range and functionality.

Required properties:

- compatible:		Should be "brcm,bcm2835-pm"
- reg:			Specifies base physical address and size of the two
			  register ranges ("PM" and "ASYNC_BRIDGE" in that
			  order)
- clocks:		a) v3d: The V3D clock from CPRMAN
			b) peri_image: The PERI_IMAGE clock from CPRMAN
			c) h264: The H264 clock from CPRMAN
			d) isp: The ISP clock from CPRMAN
- #reset-cells: 	Should be 1.  This property follows the reset controller
			  bindings[1].
- #power-domain-cells:	Should be 1.  This property follows the power domain
			  bindings[2].

Optional properties:

- timeout-sec:		Contains the watchdog timeout in seconds
- system-power-controller: Whether the watchdog is controlling the
    system power.  This node follows the power controller bindings[3].

[1] Documentation/devicetree/bindings/reset/reset.txt
[2] Documentation/devicetree/bindings/power/power-domain.yaml
[3] Documentation/devicetree/bindings/power/power-controller.txt

Example:

pm {
	compatible = "brcm,bcm2835-pm", "brcm,bcm2835-pm-wdt";
	#power-domain-cells = <1>;
	#reset-cells = <1>;
	reg = <0x7e100000 0x114>,
	      <0x7e00a000 0x24>;
	clocks = <&clocks BCM2835_CLOCK_V3D>,
		 <&clocks BCM2835_CLOCK_PERI_IMAGE>,
		 <&clocks BCM2835_CLOCK_H264>,
		 <&clocks BCM2835_CLOCK_ISP>;
	clock-names = "v3d", "peri_image", "h264", "isp";
	system-power-controller;
};
```

## Documentation/devicetree/bindings/soc/bcm/brcm,bcm2835-pm.yaml
```yaml
# SPDX-License-Identifier: GPL-2.0-only OR BSD-2-Clause
%YAML 1.2
---
$id: http://devicetree.org/schemas/soc/bcm/brcm,bcm2835-pm.yaml#
$schema: http://devicetree.org/meta-schemas/core.yaml#

title: BCM2835 PM (Power domains, watchdog)

description: |
  The PM block controls power domains and some reset lines, and includes a
  watchdog timer.

maintainers:
  - Nicolas Saenz Julienne <nsaenz@kernel.org>

allOf:
  - $ref: /schemas/watchdog/watchdog.yaml#

properties:
  compatible:
    items:
      - enum:
          - brcm,bcm2835-pm
          - brcm,bcm2711-pm
      - const: brcm,bcm2835-pm-wdt

  reg:
    minItems: 2
    maxItems: 3

  reg-names:
    minItems: 2
    items:
      - const: pm
      - const: asb
      - const: rpivid_asb

  "#power-domain-cells":
    const: 1

  "#reset-cells":
    const: 1

  clocks:
    minItems: 4
    maxItems: 4

  clock-names:
    items:
      - const: v3d
      - const: peri_image
      - const: h264
      - const: isp

  system-power-controller:
    type: boolean

  timeout-sec: true

required:
  - compatible
  - reg
  - "#power-domain-cells"
  - "#reset-cells"
  - clocks

additionalProperties: false

examples:
  - |
    #include <dt-bindings/clock/bcm2835.h>

    watchdog@7e100000 {
        compatible = "brcm,bcm2835-pm", "brcm,bcm2835-pm-wdt";
        #power-domain-cells = <1>;
        #reset-cells = <1>;
        reg = <0x7e100000 0x114>,
              <0x7e00a000 0x24>;
        reg-names = "pm", "asb";
        clocks = <&clocks BCM2835_CLOCK_V3D>,
               <&clocks BCM2835_CLOCK_PERI_IMAGE>,
               <&clocks BCM2835_CLOCK_H264>,
               <&clocks BCM2835_CLOCK_ISP>;
        clock-names = "v3d", "peri_image", "h264", "isp";
        system-power-controller;
    };
```

## Documentation/devicetree/bindings/soc/bcm/brcm,bcm2835-vchiq.txt
```
Broadcom VCHIQ firmware services

Required properties:

- compatible:	Should be "brcm,bcm2835-vchiq" on BCM2835, otherwise
		"brcm,bcm2836-vchiq".
- reg:		Physical base address and length of the doorbell register pair
- interrupts:	The interrupt number
		  See bindings/interrupt-controller/brcm,bcm2835-armctrl-ic.txt

Example:

mailbox@7e00b840 {
	compatible = "brcm,bcm2835-vchiq";
	reg = <0x7e00b840 0xf>;
	interrupts = <0 2>;
};
```

## Documentation/devicetree/bindings/soc/bcm/brcm,bcm2835-vchiq.yaml
```yaml
# SPDX-License-Identifier: (GPL-2.0-only OR BSD-2-Clause)
%YAML 1.2
---
$id: http://devicetree.org/schemas/soc/bcm/brcm,bcm2835-vchiq.yaml#
$schema: http://devicetree.org/meta-schemas/core.yaml#

title: Broadcom VCHIQ firmware services

maintainers:
  - Nicolas Saenz Julienne <nsaenz@kernel.org>

description:
  The VCHIQ communication channel can be provided by BCM283x and Capri SoCs,
  to communicate with the VPU-side OS services.

properties:
  compatible:
    oneOf:
      - description: BCM2835 based boards
        items:
          - enum:
              - brcm,bcm2835-vchiq

      - description: BCM2836/BCM2837 based boards
        items:
          - enum:
              - brcm,bcm2836-vchiq
          - const: brcm,bcm2835-vchiq

  reg:
    description: Physical base address and length of the doorbell register pair
    minItems: 1

  interrupts:
    description: Interrupt number of the doorbell interrupt
    minItems: 1

required:
  - compatible
  - reg
  - interrupts

additionalProperties: false

examples:
  - |
    mailbox@7e00b840 {
      compatible = "brcm,bcm2835-vchiq";
      reg = <0x7e00b840 0xf>;
      interrupts = <0 2>;
    };

...
```

## Documentation/devicetree/bindings/soc/bcm/raspberrypi,bcm2835-power.txt
```
Raspberry Pi power domain driver

Required properties:

- compatible:		Should be "raspberrypi,bcm2835-power".
- firmware:		Reference to the RPi firmware device node.
- #power-domain-cells:	Should be <1>, we providing multiple power domains.

The valid defines for power domain are:

 RPI_POWER_DOMAIN_I2C0
 RPI_POWER_DOMAIN_I2C1
 RPI_POWER_DOMAIN_I2C2
 RPI_POWER_DOMAIN_VIDEO_SCALER
 RPI_POWER_DOMAIN_VPU1
 RPI_POWER_DOMAIN_HDMI
 RPI_POWER_DOMAIN_USB
 RPI_POWER_DOMAIN_VEC
 RPI_POWER_DOMAIN_JPEG
 RPI_POWER_DOMAIN_H264
 RPI_POWER_DOMAIN_V3D
 RPI_POWER_DOMAIN_ISP
 RPI_POWER_DOMAIN_UNICAM0
 RPI_POWER_DOMAIN_UNICAM1
 RPI_POWER_DOMAIN_CCP2RX
 RPI_POWER_DOMAIN_CSI2
 RPI_POWER_DOMAIN_CPI
 RPI_POWER_DOMAIN_DSI0
 RPI_POWER_DOMAIN_DSI1
 RPI_POWER_DOMAIN_TRANSPOSER
 RPI_POWER_DOMAIN_CCP2TX
 RPI_POWER_DOMAIN_CDP
 RPI_POWER_DOMAIN_ARM

Example:

power: power {
	compatible = "raspberrypi,bcm2835-power";
	firmware = <&firmware>;
	#power-domain-cells = <1>;
};

Example for using power domain:

&usb {
       power-domains = <&power RPI_POWER_DOMAIN_USB>;
};
```

## Documentation/devicetree/bindings/soc/cirrus/cirrus,ep9301-syscon.yaml
```yaml
# SPDX-License-Identifier: GPL-2.0-only OR BSD-2-Clause
%YAML 1.2
---
$id: http://devicetree.org/schemas/soc/cirrus/cirrus,ep9301-syscon.yaml#
$schema: http://devicetree.org/meta-schemas/core.yaml#

title: Cirrus Logic EP93xx Platforms System Controller

maintainers:
  - Alexander Sverdlin <alexander.sverdlin@gmail.com>
  - Nikita Shubin <nikita.shubin@maquefel.me>

description: |
  Central resources are controlled by a set of software-locked registers,
  which can be used to prevent accidental accesses. Syscon generates
  the various bus and peripheral clocks and controls the system startup
  configuration.

  The System Controller (Syscon) provides:
  - Clock control
  - Power management
  - System configuration management

  Syscon registers are common for all EP93xx SoC's, through some actual peripheral
  may be missing depending on actual SoC model.

properties:
  compatible:
    oneOf:
      - items:
          - enum:
              - cirrus,ep9302-syscon
              - cirrus,ep9307-syscon
              - cirrus,ep9312-syscon
              - cirrus,ep9315-syscon
          - const: cirrus,ep9301-syscon
          - const: syscon
      - items:
          - const: cirrus,ep9301-syscon
          - const: syscon

  reg:
    maxItems: 1

  "#clock-cells":
    const: 1

  clocks:
    items:
      - description: reference clock

patternProperties:
  '^pins-':
    type: object
    description: pin node
    $ref: /schemas/pinctrl/pinmux-node.yaml

    properties:
      function:
        enum: [ spi, ac97, i2s, pwm, keypad, pata, lcd, gpio ]

      groups:
        enum: [ ssp, ac97, i2s_on_ssp, i2s_on_ac97, pwm1, gpio1agrp,
                gpio2agrp, gpio3agrp, gpio4agrp, gpio6agrp, gpio7agrp,
                rasteronsdram0grp, rasteronsdram3grp, keypadgrp, idegrp ]

    required:
      - function
      - groups

    unevaluatedProperties: false

required:
  - compatible
  - reg
  - "#clock-cells"
  - clocks

additionalProperties: false

examples:
  - |
    syscon@80930000 {
      compatible = "cirrus,ep9301-syscon", "syscon";
      reg = <0x80930000 0x1000>;

      #clock-cells = <1>;
      clocks = <&xtali>;

      spi_default_pins: pins-spi {
        function = "spi";
        groups = "ssp";
      };
    };
```

## Documentation/devicetree/bindings/soc/cix/cix,sky1-system-control.yaml
```yaml
# SPDX-License-Identifier: GPL-2.0-only OR BSD-2-Clause
%YAML 1.2
---
$id: http://devicetree.org/schemas/soc/cix/cix,sky1-system-control.yaml#
$schema: http://devicetree.org/meta-schemas/core.yaml#

title: Cix Sky1 SoC system control register region

maintainers:
  - Gary Yang <gary.yang@cixtech.com>

description:
  An wide assortment of registers of the system controller on Sky1 SoC,
  including resets, usb, wakeup sources and so on.

properties:
  compatible:
    items:
      - enum:
          - cix,sky1-system-control
          - cix,sky1-s5-system-control
      - const: syscon

  reg:
    maxItems: 1

  '#reset-cells':
    const: 1

required:
  - compatible
  - reg

additionalProperties: false

examples:
  - |
    syscon@4160000 {
      compatible = "cix,sky1-system-control", "syscon";
      reg = <0x4160000 0x100>;
      #reset-cells = <1>;
    };
```

## Documentation/devicetree/bindings/soc/dove/pmu.txt
```
Device Tree bindings for Marvell PMU

Required properties:
 - compatible: value should be "marvell,dove-pmu".
    May also include "simple-bus" if there are child devices, in which
    case the ranges node is required.
 - reg: two base addresses and sizes of the PM controller and PMU.
 - interrupts: single interrupt number for the PMU interrupt
 - interrupt-controller: must be specified as the PMU itself is an
    interrupt controller.
 - #interrupt-cells: must be 1.
 - #reset-cells: must be 1.
 - domains: sub-node containing domain descriptions

Optional properties:
 - ranges: defines the address mapping for child devices, as per the
   standard property of this name.  Required when compatible includes
   "simple-bus".

Power domain descriptions are listed as child nodes of the "domains"
sub-node.  Each domain has the following properties:

Required properties:
 - #power-domain-cells: must be 0.

Optional properties:
 - marvell,pmu_pwr_mask: specifies the mask value for PMU power register
 - marvell,pmu_iso_mask: specifies the mask value for PMU isolation register
 - resets: points to the reset manager (PMU node) and reset index.

Example:

	pmu: power-management@d0000 {
		compatible = "marvell,dove-pmu";
		reg = <0xd0000 0x8000>, <0xd8000 0x8000>;
		interrupts = <33>;
		interrupt-controller;
		#interrupt-cells = <1>;
		#reset-cells = <1>;

		domains {
			vpu_domain: vpu-domain {
				#power-domain-cells = <0>;
				marvell,pmu_pwr_mask = <0x00000008>;
				marvell,pmu_iso_mask = <0x00000001>;
				resets = <&pmu 16>;
			};

			gpu_domain: gpu-domain {
				#power-domain-cells = <0>;
				marvell,pmu_pwr_mask = <0x00000004>;
				marvell,pmu_iso_mask = <0x00000002>;
				resets = <&pmu 18>;
			};
		};
	};
```
