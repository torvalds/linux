## Documentation/devicetree/bindings/fpga/lattice,ice40-fpga-mgr.yaml
```yaml
# SPDX-License-Identifier: (GPL-2.0-only OR BSD-2-Clause)
%YAML 1.2
---
$id: http://devicetree.org/schemas/fpga/lattice,ice40-fpga-mgr.yaml#
$schema: http://devicetree.org/meta-schemas/core.yaml#

title: Lattice iCE40 FPGA Manager

maintainers:
  - Joel Holdsworth <joel@airwebreathe.org.uk>

properties:
  compatible:
    const: lattice,ice40-fpga-mgr

  reg:
    maxItems: 1

  spi-max-frequency:
    minimum: 1000000
    maximum: 25000000

  cdone-gpios:
    maxItems: 1
    description: GPIO input connected to CDONE pin

  reset-gpios:
    maxItems: 1
    description:
      Active-low GPIO output connected to CRESET_B pin. Note that unless the
      GPIO is held low during startup, the FPGA will enter Master SPI mode and
      drive SCK with a clock signal potentially jamming other devices on the bus
      until the firmware is loaded.

required:
  - compatible
  - reg
  - spi-max-frequency
  - cdone-gpios
  - reset-gpios

additionalProperties: false

examples:
  - |
    #include <dt-bindings/gpio/gpio.h>

    spi {
        #address-cells = <1>;
        #size-cells = <0>;

        fpga@0 {
            compatible = "lattice,ice40-fpga-mgr";
            reg = <0>;
            spi-max-frequency = <1000000>;
            cdone-gpios = <&gpio 24 GPIO_ACTIVE_HIGH>;
            reset-gpios = <&gpio 22 GPIO_ACTIVE_LOW>;
        };
    };
```

## Documentation/devicetree/bindings/fpga/lattice,sysconfig.yaml
```yaml
# SPDX-License-Identifier: (GPL-2.0-only OR BSD-2-Clause)
%YAML 1.2
---
$id: http://devicetree.org/schemas/fpga/lattice,sysconfig.yaml#
$schema: http://devicetree.org/meta-schemas/core.yaml#

title: Lattice Slave SPI sysCONFIG FPGA manager

maintainers:
  - Vladimir Georgiev <v.georgiev@metrotek.ru>

description: |
  Lattice sysCONFIG port, which is used for FPGA configuration, among others,
  have Slave Serial Peripheral Interface. Only full reconfiguration is
  supported.

  Programming of ECP5 is done by writing uncompressed bitstream image in .bit
  format into FPGA's SRAM configuration memory.

properties:
  compatible:
    enum:
      - lattice,sysconfig-ecp5

  reg:
    maxItems: 1

  program-gpios:
    description:
      A GPIO line connected to PROGRAMN (active low) pin of the device.
      Initiates configuration sequence.
    maxItems: 1

  init-gpios:
    description:
      A GPIO line connected to INITN (active low) pin of the device.
      Indicates that the FPGA is ready to be configured.
    maxItems: 1

  done-gpios:
    description:
      A GPIO line connected to DONE (active high) pin of the device.
      Indicates that the configuration sequence is complete.
    maxItems: 1

required:
  - compatible
  - reg

allOf:
  - $ref: /schemas/spi/spi-peripheral-props.yaml

  - if:
      properties:
        compatible:
          contains:
            const: lattice,sysconfig-ecp5
    then:
      properties:
        spi-max-frequency:
          maximum: 60000000

unevaluatedProperties: false

examples:
  - |
    #include <dt-bindings/gpio/gpio.h>

    spi {
        #address-cells = <1>;
        #size-cells = <0>;

        fpga-mgr@0 {
            compatible = "lattice,sysconfig-ecp5";
            reg = <0>;
            spi-max-frequency = <20000000>;
            program-gpios = <&gpio3 4 GPIO_ACTIVE_LOW>;
            init-gpios = <&gpio3 3 GPIO_ACTIVE_LOW>;
            done-gpios = <&gpio3 2 GPIO_ACTIVE_HIGH>;
        };
    };
```

## Documentation/devicetree/bindings/fpga/lattice-ice40-fpga-mgr.txt
```
Lattice iCE40 FPGA Manager

Required properties:
- compatible:		Should contain "lattice,ice40-fpga-mgr"
- reg:			SPI chip select
- spi-max-frequency:	Maximum SPI frequency (>=1000000, <=25000000)
- cdone-gpios:		GPIO input connected to CDONE pin
- reset-gpios:		Active-low GPIO output connected to CRESET_B pin. Note
			that unless the GPIO is held low during startup, the
			FPGA will enter Master SPI mode and drive SCK with a
			clock signal potentially jamming other devices on the
			bus until the firmware is loaded.

Example:
	fpga: fpga@0 {
		compatible = "lattice,ice40-fpga-mgr";
		reg = <0>;
		spi-max-frequency = <1000000>;
		cdone-gpios = <&gpio 24 GPIO_ACTIVE_HIGH>;
		reset-gpios = <&gpio 22 GPIO_ACTIVE_LOW>;
	};
```

## Documentation/devicetree/bindings/fpga/lattice-machxo2-spi.txt
```
Lattice MachXO2 Slave SPI FPGA Manager

Lattice MachXO2 FPGAs support a method of loading the bitstream over
'slave SPI' interface.

See 'MachXO2ProgrammingandConfigurationUsageGuide.pdf' on www.latticesemi.com

Required properties:
- compatible: should contain "lattice,machxo2-slave-spi"
- reg: spi chip select of the FPGA

Example for full FPGA configuration:

	fpga-region0 {
		compatible = "fpga-region";
		fpga-mgr = <&fpga_mgr_spi>;
		#address-cells = <0x1>;
		#size-cells = <0x1>;
	};

	spi1: spi@2000 {
        ...

		fpga_mgr_spi: fpga-mgr@0 {
			compatible = "lattice,machxo2-slave-spi";
			spi-max-frequency = <8000000>;
			reg = <0>;
		};
	};
```

## Documentation/devicetree/bindings/fpga/microchip,mpf-spi-fpga-mgr.yaml
```yaml
# SPDX-License-Identifier: (GPL-2.0-only OR BSD-2-Clause)
%YAML 1.2
---
$id: http://devicetree.org/schemas/fpga/microchip,mpf-spi-fpga-mgr.yaml#
$schema: http://devicetree.org/meta-schemas/core.yaml#

title: Microchip Polarfire FPGA manager.

maintainers:
  - Ivan Bornyakov <i.bornyakov@metrotek.ru>

description:
  Device Tree Bindings for Microchip Polarfire FPGA Manager using slave SPI to
  load the bitstream in .dat format.

properties:
  compatible:
    enum:
      - microchip,mpf-spi-fpga-mgr

  reg:
    description: SPI chip select
    maxItems: 1

  spi-max-frequency: true

required:
  - compatible
  - reg

additionalProperties: false

examples:
  - |
    spi {
            #address-cells = <1>;
            #size-cells = <0>;

            fpga_mgr@0 {
                    compatible = "microchip,mpf-spi-fpga-mgr";
                    spi-max-frequency = <20000000>;
                    reg = <0>;
            };
    };
```

## Documentation/devicetree/bindings/fpga/technologic,ts7300-fpga.yaml
```yaml
# SPDX-License-Identifier: (GPL-2.0-only OR BSD-2-Clause)
%YAML 1.2
---
$id: http://devicetree.org/schemas/fpga/technologic,ts7300-fpga.yaml#
$schema: http://devicetree.org/meta-schemas/core.yaml#

title: Technologic Systems TS-7300 FPGA Manager

maintainers:
  - Florian Fainelli <f.fainelli@gmail.com>

description:
  FPGA manager for the Altera Cyclone II FPGA on Technologic Systems
  TS-7300 board. The FPGA is programmed via the memory-mapped interface
  implemented in the CPLD.

properties:
  compatible:
    const: technologic,ts7300-fpga

  reg:
    maxItems: 1

required:
  - compatible
  - reg

additionalProperties: false

examples:
  - |
    fpga-mgr@13c00000 {
        compatible = "technologic,ts7300-fpga";
        reg = <0x13c00000 0x2>;
    };
...
```

## Documentation/devicetree/bindings/fpga/xilinx-pr-decoupler.txt
```
Xilinx LogiCORE Partial Reconfig Decoupler Softcore

The Xilinx LogiCORE Partial Reconfig Decoupler manages one or more
decouplers / fpga bridges.
The controller can decouple/disable the bridges which prevents signal
changes from passing through the bridge.  The controller can also
couple / enable the bridges which allows traffic to pass through the
bridge normally.

Xilinx LogiCORE Dynamic Function eXchange(DFX) AXI shutdown manager
Softcore is compatible with the Xilinx LogiCORE pr-decoupler.

The Dynamic Function eXchange AXI shutdown manager prevents AXI traffic
from passing through the bridge. The controller safely handles AXI4MM
and AXI4-Lite interfaces on a Reconfigurable Partition when it is
undergoing dynamic reconfiguration, preventing the system deadlock
that can occur if AXI transactions are interrupted by DFX

The Driver supports only MMIO handling. A PR region can have multiple
PR Decouplers which can be handled independently or chained via decouple/
decouple_status signals.

Required properties:
- compatible		: Should contain "xlnx,pr-decoupler-1.00" followed by
                          "xlnx,pr-decoupler" or
                          "xlnx,dfx-axi-shutdown-manager-1.00" followed by
                          "xlnx,dfx-axi-shutdown-manager"
- regs			: base address and size for decoupler module
- clocks		: input clock to IP
- clock-names		: should contain "aclk"

See Documentation/devicetree/bindings/fpga/fpga-region.txt and
Documentation/devicetree/bindings/fpga/fpga-bridge.txt for generic bindings.

Example:
Partial Reconfig Decoupler:
	fpga-bridge@100000450 {
		compatible = "xlnx,pr-decoupler-1.00",
			     "xlnx-pr-decoupler";
		regs = <0x10000045 0x10>;
		clocks = <&clkc 15>;
		clock-names = "aclk";
		bridge-enable = <0>;
	};

Dynamic Function eXchange AXI shutdown manager:
	fpga-bridge@100000450 {
		compatible = "xlnx,dfx-axi-shutdown-manager-1.00",
			     "xlnx,dfx-axi-shutdown-manager";
		regs = <0x10000045 0x10>;
		clocks = <&clkc 15>;
		clock-names = "aclk";
		bridge-enable = <0>;
	};
```

## Documentation/devicetree/bindings/fpga/xilinx-slave-serial.txt
```
Xilinx Slave Serial SPI FPGA Manager

Xilinx Spartan-6 and 7 Series FPGAs support a method of loading the
bitstream over what is referred to as "slave serial" interface.
The slave serial link is not technically SPI, and might require extra
circuits in order to play nicely with other SPI slaves on the same bus.

See:
- https://www.xilinx.com/support/documentation/user_guides/ug380.pdf
- https://www.xilinx.com/support/documentation/user_guides/ug470_7Series_Config.pdf
- https://www.xilinx.com/support/documentation/application_notes/xapp583-fpga-configuration.pdf

Required properties:
- compatible: should contain "xlnx,fpga-slave-serial"
- reg: spi chip select of the FPGA
- prog_b-gpios: config pin (referred to as PROGRAM_B in the manual)
- done-gpios: config status pin (referred to as DONE in the manual)

Optional properties:
- init-b-gpios: initialization status and configuration error pin
                (referred to as INIT_B in the manual)

Example for full FPGA configuration:

	fpga-region0 {
		compatible = "fpga-region";
		fpga-mgr = <&fpga_mgr_spi>;
		#address-cells = <0x1>;
		#size-cells = <0x1>;
	};

	spi1: spi@10680 {
		compatible = "marvell,armada-xp-spi", "marvell,orion-spi";
		pinctrl-0 = <&spi0_pins>;
		pinctrl-names = "default";
		#address-cells = <1>;
		#size-cells = <0>;
		cell-index = <1>;
		interrupts = <92>;
		clocks = <&coreclk 0>;

		fpga_mgr_spi: fpga-mgr@0 {
			compatible = "xlnx,fpga-slave-serial";
			spi-max-frequency = <60000000>;
			spi-cpha;
			reg = <0>;
			prog_b-gpios = <&gpio0 29 GPIO_ACTIVE_LOW>;
			init-b-gpios = <&gpio0 28 GPIO_ACTIVE_LOW>;
			done-gpios = <&gpio0 9 GPIO_ACTIVE_HIGH>;
		};
	};
```

## Documentation/devicetree/bindings/fpga/xilinx-zynq-fpga-mgr.txt
```
Xilinx Zynq FPGA Manager

Required properties:
- compatible:		should contain "xlnx,zynq-devcfg-1.0"
- reg:			base address and size for memory mapped io
- interrupts:		interrupt for the FPGA manager device
- clocks:		phandle for clocks required operation
- clock-names:		name for the clock, should be "ref_clk"
- syscon:		phandle for access to SLCR registers

Example:
	devcfg: devcfg@f8007000 {
		compatible = "xlnx,zynq-devcfg-1.0";
		reg = <0xf8007000 0x100>;
		interrupts = <0 8 4>;
		clocks = <&clkc 12>;
		clock-names = "ref_clk";
		syscon = <&slcr>;
	};
```

## Documentation/devicetree/bindings/fpga/xilinx-zynq-fpga-mgr.yaml
```yaml
# SPDX-License-Identifier: (GPL-2.0 OR BSD-2-Clause)
%YAML 1.2
---
$id: http://devicetree.org/schemas/fpga/xilinx-zynq-fpga-mgr.yaml#
$schema: http://devicetree.org/meta-schemas/core.yaml#

title: Xilinx Zynq FPGA Manager

maintainers:
  - Michal Simek <michal.simek@amd.com>

properties:
  compatible:
    const: xlnx,zynq-devcfg-1.0

  reg:
    maxItems: 1

  interrupts:
    maxItems: 1

  clocks:
    maxItems: 1

  clock-names:
    items:
      - const: ref_clk

  syscon:
    $ref: /schemas/types.yaml#/definitions/phandle
    description:
      Phandle to syscon block which provide access to SLCR registers

required:
  - compatible
  - reg
  - clocks
  - clock-names
  - syscon

additionalProperties: false

examples:
  - |
    devcfg: devcfg@f8007000 {
      compatible = "xlnx,zynq-devcfg-1.0";
      reg = <0xf8007000 0x100>;
      interrupts = <0 8 4>;
      clocks = <&clkc 12>;
      clock-names = "ref_clk";
      syscon = <&slcr>;
    };
```

## Documentation/devicetree/bindings/fpga/xlnx,fpga-selectmap.yaml
```yaml
# SPDX-License-Identifier: (GPL-2.0-only OR BSD-2-Clause)
%YAML 1.2
---
$id: http://devicetree.org/schemas/fpga/xlnx,fpga-selectmap.yaml#
$schema: http://devicetree.org/meta-schemas/core.yaml#

title: Xilinx SelectMAP FPGA interface

maintainers:
  - Charles Perry <charles.perry@savoirfairelinux.com>

description: |
  Xilinx 7 Series FPGAs support a method of loading the bitstream over a
  parallel port named the SelectMAP interface in the documentation. Only
  the x8 mode is supported where data is loaded at one byte per rising edge of
  the clock, with the MSB of each byte presented to the D0 pin.

  Datasheets:
    https://www.xilinx.com/support/documentation/user_guides/ug470_7Series_Config.pdf

allOf:
  - $ref: /schemas/memory-controllers/mc-peripheral-props.yaml#

properties:
  compatible:
    enum:
      - xlnx,fpga-xc7s-selectmap
      - xlnx,fpga-xc7a-selectmap
      - xlnx,fpga-xc7k-selectmap
      - xlnx,fpga-xc7v-selectmap

  reg:
    description:
      At least 1 byte of memory mapped IO
    maxItems: 1

  prog-gpios:
    description:
      config pin (referred to as PROGRAM_B in the manual)
    maxItems: 1

  done-gpios:
    description:
      config status pin (referred to as DONE in the manual)
    maxItems: 1

  init-gpios:
    description:
      initialization status and configuration error pin
      (referred to as INIT_B in the manual)
    maxItems: 1

  csi-gpios:
    description:
      chip select pin (referred to as CSI_B in the manual)
      Optional gpio for if the bus controller does not provide a chip select.
    maxItems: 1

  rdwr-gpios:
    description:
      read/write select pin (referred to as RDWR_B in the manual)
      Optional gpio for if the bus controller does not provide this pin.
    maxItems: 1

required:
  - compatible
  - reg
  - prog-gpios
  - done-gpios
  - init-gpios

unevaluatedProperties: false

examples:
  - |
    #include <dt-bindings/gpio/gpio.h>
    fpga-mgr@8000000 {
      compatible = "xlnx,fpga-xc7s-selectmap";
      reg = <0x8000000 0x4>;
      prog-gpios = <&gpio5 5 GPIO_ACTIVE_LOW>;
      init-gpios = <&gpio5 8 GPIO_ACTIVE_LOW>;
      done-gpios = <&gpio2 30 GPIO_ACTIVE_HIGH>;
      csi-gpios = <&gpio3 19 GPIO_ACTIVE_LOW>;
      rdwr-gpios = <&gpio3 10 GPIO_ACTIVE_LOW>;
    };
...
```
