## Documentation/devicetree/bindings/fpga/xlnx,fpga-slave-serial.yaml
```yaml
# SPDX-License-Identifier: (GPL-2.0-only OR BSD-2-Clause)
%YAML 1.2
---
$id: http://devicetree.org/schemas/fpga/xlnx,fpga-slave-serial.yaml#
$schema: http://devicetree.org/meta-schemas/core.yaml#

title: Xilinx Slave Serial SPI FPGA

maintainers:
  - Nava kishore Manne <nava.kishore.manne@amd.com>

description: |
  Xilinx Spartan-6 and 7 Series FPGAs support a method of loading the bitstream
  over what is referred to as slave serial interface.The slave serial link is
  not technically SPI, and might require extra circuits in order to play nicely
  with other SPI slaves on the same bus.

  Datasheets:
    https://www.xilinx.com/support/documentation/user_guides/ug380.pdf
    https://www.xilinx.com/support/documentation/user_guides/ug470_7Series_Config.pdf
    https://www.xilinx.com/support/documentation/application_notes/xapp583-fpga-configuration.pdf

allOf:
  - $ref: /schemas/spi/spi-peripheral-props.yaml#

properties:
  compatible:
    enum:
      - xlnx,fpga-slave-serial

  spi-cpha: true

  spi-max-frequency:
    maximum: 60000000

  reg:
    maxItems: 1

  prog_b-gpios:
    description:
      config pin (referred to as PROGRAM_B in the manual)
    maxItems: 1

  done-gpios:
    description:
      config status pin (referred to as DONE in the manual)
    maxItems: 1

  init-b-gpios:
    description:
      initialization status and configuration error pin
      (referred to as INIT_B in the manual)
    maxItems: 1

required:
  - compatible
  - reg
  - prog_b-gpios
  - done-gpios
  - init-b-gpios

additionalProperties: false

examples:
  - |
    #include <dt-bindings/gpio/gpio.h>
    spi {
      #address-cells = <1>;
      #size-cells = <0>;
      fpga_mgr_spi: fpga-mgr@0 {
        compatible = "xlnx,fpga-slave-serial";
        spi-max-frequency = <60000000>;
        spi-cpha;
        reg = <0>;
        prog_b-gpios = <&gpio0 29 GPIO_ACTIVE_LOW>;
        init-b-gpios = <&gpio0 28 GPIO_ACTIVE_LOW>;
        done-gpios = <&gpio0 9 GPIO_ACTIVE_HIGH>;
      };
    };
...
```

## Documentation/devicetree/bindings/fpga/xlnx,pr-decoupler.yaml
```yaml
# SPDX-License-Identifier: (GPL-2.0-only OR BSD-2-Clause)
%YAML 1.2
---
$id: http://devicetree.org/schemas/fpga/xlnx,pr-decoupler.yaml#
$schema: http://devicetree.org/meta-schemas/core.yaml#

title: Xilinx LogiCORE Partial Reconfig Decoupler/AXI shutdown manager Softcore

maintainers:
  - Nava kishore Manne <nava.kishore.manne@amd.com>

allOf:
  - $ref: fpga-bridge.yaml#

description: |
  The Xilinx LogiCORE Partial Reconfig(PR) Decoupler manages one or more
  decouplers/fpga bridges. The controller can decouple/disable the bridges
  which prevents signal changes from passing through the bridge. The controller
  can also couple / enable the bridges which allows traffic to pass through the
  bridge normally.
  Xilinx LogiCORE Dynamic Function eXchange(DFX) AXI shutdown manager Softcore
  is compatible with the Xilinx LogiCORE pr-decoupler. The Dynamic Function
  eXchange AXI shutdown manager prevents AXI traffic from passing through the
  bridge. The controller safely handles AXI4MM and AXI4-Lite interfaces on a
  Reconfigurable Partition when it is undergoing dynamic reconfiguration,
  preventing the system deadlock that can occur if AXI transactions are
  interrupted by DFX.
  Please refer to fpga-region.txt and fpga-bridge.txt in this directory for
  common binding part and usage.

properties:
  compatible:
    oneOf:
      - items:
          - const: xlnx,pr-decoupler-1.00
          - const: xlnx,pr-decoupler
      - items:
          - const: xlnx,dfx-axi-shutdown-manager-1.00
          - const: xlnx,dfx-axi-shutdown-manager

  reg:
    maxItems: 1

  clocks:
    maxItems: 1

  clock-names:
    items:
      - const: aclk

required:
  - compatible
  - reg
  - clocks
  - clock-names

unevaluatedProperties: false

examples:
  - |
    fpga-bridge@100000450 {
      compatible = "xlnx,pr-decoupler-1.00", "xlnx,pr-decoupler";
      reg = <0x10000045 0x10>;
      clocks = <&clkc 15>;
      clock-names = "aclk";
    };
...
```

## Documentation/devicetree/bindings/fpga/xlnx,versal-fpga.yaml
```yaml
# SPDX-License-Identifier: (GPL-2.0-only OR BSD-2-Clause)
%YAML 1.2
---
$id: http://devicetree.org/schemas/fpga/xlnx,versal-fpga.yaml#
$schema: http://devicetree.org/meta-schemas/core.yaml#

title: Xilinx Versal FPGA driver.

maintainers:
  - Nava kishore Manne <nava.kishore.manne@amd.com>

description: |
  Device Tree Versal FPGA bindings for the Versal SoC, controlled
  using firmware interface.

properties:
  compatible:
    items:
      - enum:
          - xlnx,versal-fpga

required:
  - compatible

additionalProperties: false

examples:
  - |
    versal_fpga: versal_fpga {
         compatible = "xlnx,versal-fpga";
    };

...
```

## Documentation/devicetree/bindings/fpga/xlnx,zynqmp-pcap-fpga.txt
```
Devicetree bindings for Zynq Ultrascale MPSoC FPGA Manager.
The ZynqMP SoC uses the PCAP (Processor configuration Port) to configure the
Programmable Logic (PL). The configuration uses  the firmware interface.

Required properties:
- compatible: should contain "xlnx,zynqmp-pcap-fpga"

Example for full FPGA configuration:

	fpga-region0 {
		compatible = "fpga-region";
		fpga-mgr = <&zynqmp_pcap>;
		#address-cells = <0x1>;
		#size-cells = <0x1>;
	};

	firmware {
		zynqmp_firmware: zynqmp-firmware {
			compatible = "xlnx,zynqmp-firmware";
			method = "smc";
			zynqmp_pcap: pcap {
				compatible = "xlnx,zynqmp-pcap-fpga";
			};
		};
	};
```

## Documentation/devicetree/bindings/fpga/xlnx,zynqmp-pcap-fpga.yaml
```yaml
# SPDX-License-Identifier: (GPL-2.0 OR BSD-2-Clause)
%YAML 1.2
---
$id: http://devicetree.org/schemas/fpga/xlnx,zynqmp-pcap-fpga.yaml#
$schema: http://devicetree.org/meta-schemas/core.yaml#

title: Xilinx Zynq Ultrascale MPSoC FPGA Manager

maintainers:
  - Nava kishore Manne <navam@xilinx.com>

description: |
  Device Tree Bindings for Zynq Ultrascale MPSoC FPGA Manager.
  The ZynqMP SoC uses the PCAP (Processor Configuration Port) to
  configure the Programmable Logic (PL). The configuration uses the
  firmware interface.

properties:
  compatible:
    const: xlnx,zynqmp-pcap-fpga

required:
  - compatible

additionalProperties: false

examples:
  - |
    firmware {
      zynqmp_firmware: zynqmp-firmware {
        zynqmp_pcap: pcap {
          compatible = "xlnx,zynqmp-pcap-fpga";
        };
      };
    };
...
```

## Documentation/devicetree/bindings/fsi/aspeed,ast2400-cf-fsi-master.yaml
```yaml
# SPDX-License-Identifier: (GPL-2.0-only OR BSD-2-Clause)
%YAML 1.2
---
$id: http://devicetree.org/schemas/fsi/aspeed,ast2400-cf-fsi-master.yaml#
$schema: http://devicetree.org/meta-schemas/core.yaml#

title: ASpeed ColdFire offloaded GPIO-based FSI master

maintainers:
  - Eddie James <eajames@linux.ibm.com>

allOf:
  - $ref: /schemas/fsi/fsi-controller.yaml#

properties:
  compatible:
    enum:
      - aspeed,ast2400-cf-fsi-master
      - aspeed,ast2500-cf-fsi-master

  clock-gpios:
    maxItems: 1
    description: GPIO for FSI clock

  data-gpios:
    maxItems: 1
    description: GPIO for FSI data signal

  enable-gpios:
    maxItems: 1
    description: GPIO for enable signal

  trans-gpios:
    maxItems: 1
    description: GPIO for voltage translator enable

  mux-gpios:
    maxItems: 1
    description:
      GPIO for pin multiplexing with other functions (eg, external FSI masters)

  memory-region:
    maxItems: 1
    description:
      Reference to the reserved memory for the ColdFire. Must be 2M aligned on
      AST2400 and 1M aligned on AST2500.

  aspeed,cvic:
    description: Reference to the CVIC node.
    $ref: /schemas/types.yaml#/definitions/phandle

  aspeed,sram:
    description: Reference to the SRAM node.
    $ref: /schemas/types.yaml#/definitions/phandle

required:
  - compatible
  - clock-gpios
  - data-gpios
  - enable-gpios
  - trans-gpios
  - mux-gpios
  - memory-region
  - aspeed,cvic
  - aspeed,sram

unevaluatedProperties: false

examples:
  - |
    fsi-master {
      compatible = "aspeed,ast2500-cf-fsi-master";
      clock-gpios = <&gpio 0>;
      data-gpios = <&gpio 1>;
      enable-gpios = <&gpio 2>;
      trans-gpios = <&gpio 3>;
      mux-gpios = <&gpio 4>;
      memory-region = <&coldfire_memory>;
      aspeed,cvic = <&cvic>;
      aspeed,sram = <&sram>;
    };
```

## Documentation/devicetree/bindings/fsi/aspeed,ast2600-fsi-master.yaml
```yaml
# SPDX-License-Identifier: (GPL-2.0-only OR BSD-2-Clause)
%YAML 1.2
---
$id: http://devicetree.org/schemas/fsi/aspeed,ast2600-fsi-master.yaml#
$schema: http://devicetree.org/meta-schemas/core.yaml#

title: Aspeed FSI master

maintainers:
  - Eddie James <eajames@linux.ibm.com>

description:
  The AST2600 and later contain two identical FSI masters. They share a
  clock and have a separate interrupt line and output pins.

properties:
  compatible:
    enum:
      - aspeed,ast2600-fsi-master
      - aspeed,ast2700-fsi-master

  clocks:
    maxItems: 1

  cfam-reset-gpios:
    maxItems: 1
    description:
      Output GPIO pin for CFAM reset

  fsi-routing-gpios:
    maxItems: 1
    description:
      Output GPIO pin for setting the FSI mux (internal or cabled)

  fsi-mux-gpios:
    maxItems: 1
    description:
      Input GPIO pin for detecting the desired FSI mux state

  interrupts:
    maxItems: 1

if:
  properties:
    compatible:
      contains:
        enum:
          - aspeed,ast2600-fsi-master
then:
  properties:
    reg:
      maxItems: 1
else:
  properties:
    reg:
      minItems: 1
      items:
        - description: OPB control registers
        - description: FSI controller registers
        - description: FSI link address space
    reg-names:
      items:
        - const: opb
        - const: ctrl
        - const: fsi

required:
  - compatible
  - reg
  - clocks
  - interrupts

allOf:
  - $ref: fsi-controller.yaml#

unevaluatedProperties: false

examples:
  - |
    #include <dt-bindings/clock/ast2600-clock.h>
    #include <dt-bindings/gpio/aspeed-gpio.h>
    #include <dt-bindings/interrupt-controller/arm-gic.h>
    fsi-master@1e79b000 {
        compatible = "aspeed,ast2600-fsi-master";
        reg = <0x1e79b000 0x94>;
        #address-cells = <2>;
        #size-cells = <0>;
        interrupts = <GIC_SPI 100 IRQ_TYPE_LEVEL_HIGH>;
        pinctrl-names = "default";
        pinctrl-0 = <&pinctrl_fsi1_default>;
        clocks = <&syscon ASPEED_CLK_GATE_FSICLK>;
        fsi-routing-gpios = <&gpio0 ASPEED_GPIO(Q, 7) GPIO_ACTIVE_HIGH>;
        fsi-mux-gpios = <&gpio0 ASPEED_GPIO(B, 0) GPIO_ACTIVE_HIGH>;
        cfam-reset-gpios = <&gpio0 ASPEED_GPIO(Q, 0) GPIO_ACTIVE_LOW>;

        cfam@0,0 {
            reg = <0 0>;
            #address-cells = <1>;
            #size-cells = <1>;
            chip-id = <0>;
        };
    };
  - |
    bus {
        #address-cells = <2>;
        #size-cells = <2>;

        fsi-master@21800000 {
            compatible = "aspeed,ast2700-fsi-master";
            reg = <0x0 0x21800000 0x0 0x100>,
                  <0x0 0x21000000 0x0 0x1000>,
                  <0x0 0x20000000 0x0 0x1000000>;
            reg-names = "opb", "ctrl", "fsi";
            #interrupt-cells = <1>;
            interrupt-controller;
            interrupts-extended = <&intc 6>;
            pinctrl-names = "default";
            pinctrl-0 = <&pinctrl_fsi0_default>;
            clocks = <&syscon 40>;
        };
    };
```

## Documentation/devicetree/bindings/fsi/fsi-controller.yaml
```yaml
# SPDX-License-Identifier: (GPL-2.0-only OR BSD-2-Clause)
%YAML 1.2
---
$id: http://devicetree.org/schemas/fsi/fsi-controller.yaml#
$schema: http://devicetree.org/meta-schemas/core.yaml#

title: FSI Controller Common Properties

maintainers:
  - Eddie James <eajames@linux.ibm.com>

description:
  FSI (FRU (Field Replaceable Unit) Service Interface) is a two wire bus. The
  FSI bus is connected to a CFAM (Common FRU Access Macro) which contains
  various engines such as I2C controllers, SPI controllers, etc.

properties:
  "#address-cells":
    const: 2

  "#size-cells":
    const: 0

  '#interrupt-cells':
    const: 1

  bus-frequency:
    minimum: 1
    maximum: 200000000

  interrupt-controller: true

  no-scan-on-init:
    $ref: /schemas/types.yaml#/definitions/flag
    description:
      The FSI controller cannot scan the bus during initialization.

patternProperties:
  "cfam@[0-9a-f],[0-9a-f]":
    type: object
    properties:
      chip-id:
        $ref: /schemas/types.yaml#/definitions/uint32
        description:
          Processor index, a global unique chip ID which is used to identify
          the physical location of the chip in a system specific way.

      bus-frequency:
        minimum: 1
        maximum: 100000000

      reg:
        maxItems: 1

      "#address-cells":
        const: 1

      "#size-cells":
        const: 1

    required:
      - reg

    additionalProperties: true

additionalProperties: true
```

## Documentation/devicetree/bindings/fsi/fsi-master-aspeed.txt
```
Device-tree bindings for AST2600 FSI master
-------------------------------------------

The AST2600 contains two identical FSI masters. They share a clock and have a
separate interrupt line and output pins.

Required properties:
 - compatible: "aspeed,ast2600-fsi-master"
 - reg: base address and length
 - clocks: phandle and clock number
 - interrupts: platform dependent interrupt description
 - pinctrl-0: phandle to pinctrl node
 - pinctrl-names: pinctrl state

Optional properties:
 - cfam-reset-gpios: GPIO for CFAM reset

 - fsi-routing-gpios: GPIO for setting the FSI mux (internal or cabled)
 - fsi-mux-gpios: GPIO for detecting the desired FSI mux state


Examples:

    fsi-master {
        compatible = "aspeed,ast2600-fsi-master", "fsi-master";
        reg = <0x1e79b000 0x94>;
	interrupts = <GIC_SPI 100 IRQ_TYPE_LEVEL_HIGH>;
	pinctrl-names = "default";
	pinctrl-0 = <&pinctrl_fsi1_default>;
	clocks = <&syscon ASPEED_CLK_GATE_FSICLK>;

	fsi-routing-gpios = <&gpio0 ASPEED_GPIO(Q, 7) GPIO_ACTIVE_HIGH>;
	fsi-mux-gpios = <&gpio0 ASPEED_GPIO(B, 0) GPIO_ACTIVE_HIGH>;

	cfam-reset-gpios = <&gpio0 ASPEED_GPIO(Q, 0) GPIO_ACTIVE_LOW>;
    };
```
