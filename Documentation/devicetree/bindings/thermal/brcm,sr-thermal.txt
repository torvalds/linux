## Documentation/devicetree/bindings/thermal/brcm,sr-thermal.txt
```
* Broadcom Stingray Thermal

This binding describes thermal sensors that is part of Stingray SoCs.

Required properties:
- compatible : Must be "brcm,sr-thermal"
- reg : Memory where tmon data will be available.
- brcm,tmon-mask: A one cell bit mask of valid TMON sources.
                  Each bit represents single TMON source.
- #thermal-sensor-cells : Thermal sensor phandler
- polling-delay: Max number of milliseconds to wait between polls.
- thermal-sensors: A list of thermal sensor phandles and specifier.
                   specifier value is tmon ID and it should be
                   in correspond with brcm,tmon-mask.
- temperature: trip temperature threshold in millicelsius.

Example:
	tmons {
		compatible = "simple-bus";
		#address-cells = <1>;
		#size-cells = <1>;
		ranges = <0x0 0x0 0x8f100000 0x100>;

		tmon: tmon@0 {
			compatible = "brcm,sr-thermal";
			reg = <0x0 0x40>;
			brcm,tmon-mask = <0x3f>;
			#thermal-sensor-cells = <1>;
		};
	};

	thermal-zones {
		ihost0_thermal: ihost0-thermal {
			polling-delay-passive = <0>;
			polling-delay = <1000>;
			thermal-sensors = <&tmon 0>;
			trips {
				cpu-crit {
					temperature = <105000>;
					hysteresis = <0>;
					type = "critical";
				};
			};
		};
		ihost1_thermal: ihost1-thermal {
			polling-delay-passive = <0>;
			polling-delay = <1000>;
			thermal-sensors = <&tmon 1>;
			trips {
				cpu-crit {
					temperature = <105000>;
					hysteresis = <0>;
					type = "critical";
				};
			};
		};
		ihost2_thermal: ihost2-thermal {
			polling-delay-passive = <0>;
			polling-delay = <1000>;
			thermal-sensors = <&tmon 2>;
			trips {
				cpu-crit {
					temperature = <105000>;
					hysteresis = <0>;
					type = "critical";
				};
			};
		};
		ihost3_thermal: ihost3-thermal {
			polling-delay-passive = <0>;
			polling-delay = <1000>;
			thermal-sensors = <&tmon 3>;
			trips {
				cpu-crit {
					temperature = <105000>;
					hysteresis = <0>;
					type = "critical";
				};
			};
		};
		crmu_thermal: crmu-thermal {
			polling-delay-passive = <0>;
			polling-delay = <1000>;
			thermal-sensors = <&tmon 4>;
			trips {
				cpu-crit {
					temperature = <105000>;
					hysteresis = <0>;
					type = "critical";
				};
			};
		};
		nitro_thermal: nitro-thermal {
			polling-delay-passive = <0>;
			polling-delay = <1000>;
			thermal-sensors = <&tmon 5>;
			trips {
				cpu-crit {
					temperature = <105000>;
					hysteresis = <0>;
					type = "critical";
				};
			};
		};
	};
```

## Documentation/devicetree/bindings/thermal/brcm,sr-thermal.yaml
```yaml
# SPDX-License-Identifier: (GPL-2.0-only OR BSD-2-Clause)
%YAML 1.2
---
$id: http://devicetree.org/schemas/thermal/brcm,sr-thermal.yaml#
$schema: http://devicetree.org/meta-schemas/core.yaml#

title: Broadcom Stingray Thermal Sensors

maintainers:
  - Ray Jui <rjui@broadcom.com>
  - Scott Branden <sbranden@broadcom.com>

allOf:
  - $ref: thermal-sensor.yaml#

properties:
  compatible:
    const: brcm,sr-thermal

  reg:
    maxItems: 1

  brcm,tmon-mask:
    description:
      A one-cell bit mask of valid TMON sources. Each bit represents a single
      TMON source.
    $ref: /schemas/types.yaml#/definitions/uint32

  '#thermal-sensor-cells':
    const: 1

required:
  - compatible
  - reg
  - brcm,tmon-mask

additionalProperties: false

examples:
  - |
    tmon: thermal-sensor@0 {
        compatible = "brcm,sr-thermal";
        reg = <0x0 0x40>;
        brcm,tmon-mask = <0x3f>;
        #thermal-sensor-cells = <1>;
    };

    thermal-zones {
      ihost0_thermal: ihost0-thermal {
        polling-delay-passive = <0>;
        polling-delay = <1000>;
        thermal-sensors = <&tmon 0>;
        trips {
          cpu-crit {
            temperature = <105000>;
            hysteresis = <0>;
            type = "critical";
          };
        };
      };
      ihost1_thermal: ihost1-thermal {
        polling-delay-passive = <0>;
        polling-delay = <1000>;
        thermal-sensors = <&tmon 1>;
        trips {
          cpu-crit {
            temperature = <105000>;
            hysteresis = <0>;
            type = "critical";
          };
        };
      };
      ihost2_thermal: ihost2-thermal {
        polling-delay-passive = <0>;
        polling-delay = <1000>;
        thermal-sensors = <&tmon 2>;
        trips {
          cpu-crit {
            temperature = <105000>;
            hysteresis = <0>;
            type = "critical";
          };
        };
      };
      ihost3_thermal: ihost3-thermal {
        polling-delay-passive = <0>;
        polling-delay = <1000>;
        thermal-sensors = <&tmon 3>;
        trips {
          cpu-crit {
            temperature = <105000>;
            hysteresis = <0>;
            type = "critical";
          };
        };
      };
      crmu_thermal: crmu-thermal {
        polling-delay-passive = <0>;
        polling-delay = <1000>;
        thermal-sensors = <&tmon 4>;
        trips {
          cpu-crit {
            temperature = <105000>;
            hysteresis = <0>;
            type = "critical";
          };
        };
      };
      nitro_thermal: nitro-thermal {
        polling-delay-passive = <0>;
        polling-delay = <1000>;
        thermal-sensors = <&tmon 5>;
        trips {
          cpu-crit {
            temperature = <105000>;
            hysteresis = <0>;
            type = "critical";
          };
        };
      };
    };
```

## Documentation/devicetree/bindings/thermal/da9062-thermal.txt
```
* Dialog DA9062/61 TJUNC Thermal Module

This module is part of the DA9061/DA9062. For more details about entire
DA9062 and DA9061 chips see Documentation/devicetree/bindings/mfd/da9062.txt

Junction temperature thermal module uses an interrupt signal to identify
high THERMAL_TRIP_HOT temperatures for the PMIC device.

Required properties:

- compatible: should be one of the following valid compatible string lines:
        "dlg,da9061-thermal", "dlg,da9062-thermal"
        "dlg,da9062-thermal"

Optional properties:

- polling-delay-passive : Specify the polling period, measured in
    milliseconds, between thermal zone device update checks.

Example: DA9062

	pmic0: da9062@58 {
		thermal {
			compatible = "dlg,da9062-thermal";
			polling-delay-passive = <3000>;
		};
	};

Example: DA9061 using a fall-back compatible for the DA9062 onkey driver

	pmic0: da9061@58 {
		thermal {
			compatible = "dlg,da9061-thermal", "dlg,da9062-thermal";
			polling-delay-passive = <3000>;
		};
	};
```

## Documentation/devicetree/bindings/thermal/db8500-thermal.txt
```
* ST-Ericsson DB8500 Thermal

** Thermal node properties:

- compatible : "stericsson,db8500-thermal";
- reg : address range of the thermal sensor registers;
- interrupts : interrupts generated from PRCMU;
- interrupt-names : "IRQ_HOTMON_LOW" and "IRQ_HOTMON_HIGH";
- num-trips : number of total trip points, this is required, set it 0 if none,
  if greater than 0, the following properties must be defined;
- tripN-temp : temperature of trip point N, should be in ascending order;
- tripN-type : type of trip point N, should be one of "active" "passive" "hot"
  "critical";
- tripN-cdev-num : number of the cooling devices which can be bound to trip
  point N, this is required if trip point N is defined, set it 0 if none,
  otherwise the following cooling device names must be defined;
- tripN-cdev-nameM : name of the No. M cooling device of trip point N;

Usually the num-trips and tripN-*** are separated in board related dts files.

Example:
thermal@801573c0 {
	compatible = "stericsson,db8500-thermal";
	reg = <0x801573c0 0x40>;
	interrupts = <21 0x4>, <22 0x4>;
	interrupt-names = "IRQ_HOTMON_LOW", "IRQ_HOTMON_HIGH";

	num-trips = <3>;

	trip0-temp = <75000>;
	trip0-type = "active";
	trip0-cdev-num = <1>;
	trip0-cdev-name0 = "thermal-cpufreq-0";

	trip1-temp = <80000>;
	trip1-type = "active";
	trip1-cdev-num = <2>;
	trip1-cdev-name0 = "thermal-cpufreq-0";
	trip1-cdev-name1 = "thermal-fan";

	trip2-temp = <85000>;
	trip2-type = "critical";
	trip2-cdev-num = <0>;
}
```

## Documentation/devicetree/bindings/thermal/dlg,da9062-thermal.yaml
```yaml
# SPDX-License-Identifier: (GPL-2.0-only OR BSD-2-Clause)
%YAML 1.2
---
$id: http://devicetree.org/schemas/thermal/dlg,da9062-thermal.yaml#
$schema: http://devicetree.org/meta-schemas/core.yaml#

title: Dialog DA9062/61 TJUNC Thermal Module

maintainers:
  - Biju Das <biju.das.jz@bp.renesas.com>

description: |
  This module is part of the DA9061/DA9062. For more details about entire
  DA906{1,2} chips see Documentation/devicetree/bindings/mfd/dlg,da9063.yaml

  Junction temperature thermal module uses an interrupt signal to identify
  high THERMAL_TRIP_HOT temperatures for the PMIC device.

properties:
  compatible:
    oneOf:
      - const: dlg,da9062-thermal
      - items:
          - const: dlg,da9061-thermal
          - const: dlg,da9062-thermal

  polling-delay-passive:
    description:
      Specify the polling period, measured in milliseconds, between
      thermal zone device update checks.

required:
  - compatible

additionalProperties: false
```

## Documentation/devicetree/bindings/thermal/dove-thermal.txt
```
* Dove Thermal

This driver is for Dove SoCs which contain a thermal sensor.

Required properties:
- compatible : "marvell,dove-thermal"
- reg : Address range of the thermal registers

The reg properties should contain two ranges. The first is for the
three Thermal Manager registers, while the second range contains the
Thermal Diode Control Registers.

Example:

	thermal@10078 {
		compatible = "marvell,dove-thermal";
		reg = <0xd001c 0x0c>, <0xd005c 0x08>;
	};
```

## Documentation/devicetree/bindings/thermal/exynos-thermal.txt
```
* Exynos Thermal Management Unit (TMU)

** Required properties:

- compatible : One of the following:
	       "samsung,exynos3250-tmu"
	       "samsung,exynos4412-tmu"
	       "samsung,exynos4210-tmu"
	       "samsung,exynos5250-tmu"
	       "samsung,exynos5260-tmu"
	       "samsung,exynos5420-tmu" for TMU channel 0, 1 on Exynos5420
	       "samsung,exynos5420-tmu-ext-triminfo" for TMU channels 2, 3 and 4
			Exynos5420 (Must pass triminfo base and triminfo clock)
               "samsung,exynos5433-tmu"
	       "samsung,exynos7-tmu"
- reg : Address range of the thermal registers. For soc's which has multiple
	instances of TMU and some registers are shared across all TMU's like
	interrupt related then 2 set of register has to supplied. First set
	belongs	to register set of TMU instance and second set belongs to
	registers shared with the TMU instance.

  NOTE: On Exynos5420, the TRIMINFO register is misplaced for TMU
	channels 2, 3 and 4
	Use "samsung,exynos5420-tmu-ext-triminfo" in cases, there is a misplaced
	register, also provide clock to access that base.

	TRIMINFO at 0x1006c000 contains data for TMU channel 3
	TRIMINFO at 0x100a0000 contains data for TMU channel 4
	TRIMINFO at 0x10068000 contains data for TMU channel 2

- interrupts : Should contain interrupt for thermal system
- clocks : The main clocks for TMU device
	-- 1. operational clock for TMU channel
	-- 2. optional clock to access the shared registers of TMU channel
	-- 3. optional special clock for functional operation
- clock-names : Thermal system clock name
	-- "tmu_apbif" operational clock for current TMU channel
	-- "tmu_triminfo_apbif" clock to access the shared triminfo register
		for current TMU channel
	-- "tmu_sclk" clock for functional operation of the current TMU
		channel

The Exynos TMU supports generating interrupts when reaching given
temperature thresholds. Number of supported thermal trip points depends
on the SoC (only first trip points defined in DT will be configured):
 - most of SoC: 4
 - samsung,exynos5433-tmu: 8
 - samsung,exynos7-tmu: 8

** Optional properties:

- vtmu-supply: This entry is optional and provides the regulator node supplying
		voltage to TMU. If needed this entry can be placed inside
		board/platform specific dts file.

Example 1):

	tmu@100c0000 {
		compatible = "samsung,exynos4412-tmu";
		interrupt-parent = <&combiner>;
		reg = <0x100C0000 0x100>;
		interrupts = <2 4>;
		clocks = <&clock 383>;
		clock-names = "tmu_apbif";
		vtmu-supply = <&tmu_regulator_node>;
		#thermal-sensor-cells = <0>;
	};

Example 2): (In case of Exynos5420 "with misplaced TRIMINFO register")
	tmu_cpu2: tmu@10068000 {
		compatible = "samsung,exynos5420-tmu-ext-triminfo";
		reg = <0x10068000 0x100>, <0x1006c000 0x4>;
		interrupts = <0 184 0>;
		clocks = <&clock 318>, <&clock 318>;
		clock-names = "tmu_apbif", "tmu_triminfo_apbif";
		#thermal-sensor-cells = <0>;
	};

	tmu_cpu3: tmu@1006c000 {
		compatible = "samsung,exynos5420-tmu-ext-triminfo";
		reg = <0x1006c000 0x100>, <0x100a0000 0x4>;
		interrupts = <0 185 0>;
		clocks = <&clock 318>, <&clock 319>;
		clock-names = "tmu_apbif", "tmu_triminfo_apbif";
		#thermal-sensor-cells = <0>;
	};

	tmu_gpu: tmu@100a0000 {
		compatible = "samsung,exynos5420-tmu-ext-triminfo";
		reg = <0x100a0000 0x100>, <0x10068000 0x4>;
		interrupts = <0 215 0>;
		clocks = <&clock 319>, <&clock 318>;
		clock-names = "tmu_apbif", "tmu_triminfo_apbif";
		#thermal-sensor-cells = <0>;
	};

Note: For multi-instance tmu each instance should have an alias correctly
numbered in "aliases" node.

Example:

aliases {
	tmuctrl0 = &tmuctrl_0;
	tmuctrl1 = &tmuctrl_1;
	tmuctrl2 = &tmuctrl_2;
};
```

## Documentation/devicetree/bindings/thermal/fsl,imx91-tmu.yaml
```yaml
# SPDX-License-Identifier: (GPL-2.0-only OR BSD-2-Clause)
%YAML 1.2
---
$id: http://devicetree.org/schemas/thermal/fsl,imx91-tmu.yaml#
$schema: http://devicetree.org/meta-schemas/core.yaml#

title: NXP i.MX91 Thermal

maintainers:
  - Pengfei Li <pengfei.li_1@nxp.com>

description:
  i.MX91 features a new temperature sensor. It includes programmable
  temperature threshold comparators for both normal and privileged
  accesses and allows a programmable measurement frequency for the
  Periodic One-Shot Measurement mode. Additionally, it provides
  status registers for indicating the end of measurement and threshold
  violation events.

properties:
  compatible:
    items:
      - const: fsl,imx91-tmu

  reg:
    maxItems: 1

  clocks:
    maxItems: 1

  interrupts:
    items:
      - description: Comparator 1 irq
      - description: Comparator 2 irq
      - description: Data ready irq

  interrupt-names:
    items:
      - const: thr1
      - const: thr2
      - const: ready

  nvmem-cells:
    items:
      - description: Phandle to the trim control 1 provided by ocotp
      - description: Phandle to the trim control 2 provided by ocotp

  nvmem-cell-names:
    items:
      - const: trim1
      - const: trim2

  "#thermal-sensor-cells":
    const: 0

required:
  - compatible
  - reg
  - clocks
  - interrupts
  - interrupt-names

allOf:
  - $ref: thermal-sensor.yaml

unevaluatedProperties: false

examples:
  - |
    #include <dt-bindings/interrupt-controller/arm-gic.h>
    #include <dt-bindings/clock/imx93-clock.h>

    thermal-sensor@44482000 {
        compatible = "fsl,imx91-tmu";
        reg = <0x44482000 0x1000>;
        #thermal-sensor-cells = <0>;
        clocks = <&clk IMX93_CLK_TMC_GATE>;
        interrupt-parent = <&gic>;
        interrupts = <GIC_SPI 83 IRQ_TYPE_LEVEL_HIGH>,
                     <GIC_SPI 84 IRQ_TYPE_LEVEL_HIGH>,
                     <GIC_SPI 85 IRQ_TYPE_LEVEL_HIGH>;
        interrupt-names = "thr1", "thr2", "ready";
        nvmem-cells = <&tmu_trim1>, <&tmu_trim2>;
        nvmem-cell-names = "trim1", "trim2";
    };

...
```
