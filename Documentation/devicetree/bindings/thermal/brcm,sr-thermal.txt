## Documentation/devicetree/bindings/thermal/fsl,scu-thermal.yaml
```yaml
# SPDX-License-Identifier: (GPL-2.0-only OR BSD-2-Clause)
%YAML 1.2
---
$id: http://devicetree.org/schemas/thermal/fsl,scu-thermal.yaml#
$schema: http://devicetree.org/meta-schemas/core.yaml#

title: i.MX SCU Client Device Node - Thermal Based on SCU Message Protocol

maintainers:
  - Dong Aisheng <aisheng.dong@nxp.com>

description: i.MX SCU Client Device Node
  Client nodes are maintained as children of the relevant IMX-SCU device node.

allOf:
  - $ref: thermal-sensor.yaml#

properties:
  compatible:
    items:
      - enum:
          - fsl,imx8dxl-sc-thermal
          - fsl,imx8qxp-sc-thermal
      - const: fsl,imx-sc-thermal

  '#thermal-sensor-cells':
    const: 1

required:
  - compatible
  - '#thermal-sensor-cells'

additionalProperties: false

examples:
  - |
    thermal-sensor {
        compatible = "fsl,imx8qxp-sc-thermal", "fsl,imx-sc-thermal";
        #thermal-sensor-cells = <1>;
    };
```

## Documentation/devicetree/bindings/thermal/generic-adc-thermal.yaml
```yaml
# SPDX-License-Identifier: GPL-2.0-only OR BSD-2-Clause
%YAML 1.2
---
$id: http://devicetree.org/schemas/thermal/generic-adc-thermal.yaml#
$schema: http://devicetree.org/meta-schemas/core.yaml#

title: General Purpose Analog To Digital Converter (ADC) based thermal sensor

maintainers:
  - Laxman Dewangan <ldewangan@nvidia.com>

description:
  On some of platforms, thermal sensor like thermistors are connected to
  one of ADC channel and sensor resistance is read via voltage across the
  sensor resistor. The voltage read across the sensor is mapped to
  temperature using voltage-temperature lookup table.

properties:
  compatible:
    const: generic-adc-thermal

  '#thermal-sensor-cells':
    const: 0

  io-channels:
    maxItems: 1

  io-channel-names:
    const: sensor-channel

  temperature-lookup-table:
    description: |
      Lookup table to map the relation between ADC value and temperature.
      When ADC is read, the value is looked up on the table to get the
      equivalent temperature.

      If not specified, driver assumes the ADC channel gives milliCelsius
      directly.
    $ref: /schemas/types.yaml#/definitions/int32-matrix
    items:
      items:
        - description: Temperature in milliCelsius
        - description: ADC read value

required:
  - compatible
  - '#thermal-sensor-cells'
  - io-channels
  - io-channel-names

additionalProperties: false

examples:
  - |
    #include <dt-bindings/thermal/thermal.h>

    thermal-sensor {
        compatible = "generic-adc-thermal";
        #thermal-sensor-cells = <0>;
        io-channels = <&ads1015 1>;
        io-channel-names = "sensor-channel";
        temperature-lookup-table = <
              (-40000) 2578
              (-39000) 2577
              (-38000) 2576
              (-37000) 2575
              (-36000) 2574
              (-35000) 2573
              (-34000) 2572
              (-33000) 2571
              (-32000) 2569
              (-31000) 2568
              (-30000) 2567
              /* skip */
              118000 254
              119000 247
              120000 240
              121000 233
              122000 226
              123000 220
              124000 214
              125000 208>;
    };
...
```

## Documentation/devicetree/bindings/thermal/hisilicon,tsensor.yaml
```yaml
# SPDX-License-Identifier: GPL-2.0-only OR BSD-2-Clause
%YAML 1.2
---
$id: http://devicetree.org/schemas/thermal/hisilicon,tsensor.yaml#
$schema: http://devicetree.org/meta-schemas/core.yaml#

title: Temperature Sensor on HiSilicon SoCs

maintainers:
  - Abdulrasaq Lawani <abdulrasaqolawani@gmail.com>

allOf:
  - $ref: thermal-sensor.yaml

properties:
  compatible:
    enum:
      - hisilicon,tsensor
      - hisilicon,hi3660-tsensor

  reg:
    maxItems: 1

  clocks:
    maxItems: 1

  clock-names:
    items:
      - const: thermal_clk

  interrupts:
    maxItems: 1

  '#thermal-sensor-cells':
    const: 1

required:
  - compatible
  - reg
  - interrupts
  - '#thermal-sensor-cells'

unevaluatedProperties: false

examples:
  - |
    #include <dt-bindings/clock/hi6220-clock.h>
    #include <dt-bindings/interrupt-controller/arm-gic.h>

    temperature-sensor@f7030700 {
        compatible = "hisilicon,tsensor";
        reg = <0xf7030700 0x1000>;
        interrupts = <GIC_SPI 7 IRQ_TYPE_LEVEL_HIGH>;
        clocks = <&sys_ctrl HI6220_TSENSOR_CLK>;
        clock-names = "thermal_clk";
        #thermal-sensor-cells = <1>;
    };
```

## Documentation/devicetree/bindings/thermal/hisilicon-thermal.txt
```
* Temperature Sensor on hisilicon SoCs

** Required properties :

- compatible: "hisilicon,tsensor".
- reg: physical base address of thermal sensor and length of memory mapped
  region.
- interrupt: The interrupt number to the cpu. Defines the interrupt used
  by /SOCTHERM/tsensor.
- clock-names: Input clock name, should be 'thermal_clk'.
- clocks: phandles for clock specified in "clock-names" property.
- #thermal-sensor-cells: Should be 1. See ./thermal.txt for a description.

Example :

for Hi6220:
	tsensor: tsensor@0,f7030700 {
		compatible = "hisilicon,tsensor";
		reg = <0x0 0xf7030700 0x0 0x1000>;
		interrupts = <0 7 0x4>;
		clocks = <&sys_ctrl HI6220_TSENSOR_CLK>;
		clock-names = "thermal_clk";
		#thermal-sensor-cells = <1>;
	}

for Hi3660:
	tsensor: tsensor@fff30000 {
		compatible = "hisilicon,hi3660-tsensor";
		reg = <0x0 0xfff30000 0x0 0x1000>;
		interrupts = <GIC_SPI 145 IRQ_TYPE_LEVEL_HIGH>;
		#thermal-sensor-cells = <1>;
	};
```

## Documentation/devicetree/bindings/thermal/imx-thermal.txt
```
* Temperature Monitor (TEMPMON) on Freescale i.MX SoCs

Required properties:
- compatible : "fsl,imx6q-tempmon" for i.MX6Q, "fsl,imx6sx-tempmon" for i.MX6SX.
  i.MX6SX has two more IRQs than i.MX6Q, one is IRQ_LOW and the other is IRQ_PANIC,
  when temperature is below than low threshold, IRQ_LOW will be triggered, when temperature
  is higher than panic threshold, system will auto reboot by SRC module.
- fsl,tempmon : phandle pointer to system controller that contains TEMPMON
  control registers, e.g. ANATOP on imx6q.
- nvmem-cells: A phandle to the calibration cells provided by ocotp.
- nvmem-cell-names: Should be "calib", "temp_grade".

Deprecated properties:
- fsl,tempmon-data : phandle pointer to fuse controller that contains TEMPMON
  calibration data, e.g. OCOTP on imx6q.  The details about calibration data
  can be found in SoC Reference Manual.

Direct access to OCOTP via fsl,tempmon-data is incorrect on some newer chips
because it does not handle OCOTP clock requirements.

Optional properties:
- clocks : thermal sensor's clock source.

Example:
ocotp: ocotp@21bc000 {
	#address-cells = <1>;
	#size-cells = <1>;
	compatible = "fsl,imx6sx-ocotp", "syscon";
	reg = <0x021bc000 0x4000>;
	clocks = <&clks IMX6SX_CLK_OCOTP>;

	tempmon_calib: calib@38 {
		reg = <0x38 4>;
	};

	tempmon_temp_grade: temp-grade@20 {
		reg = <0x20 4>;
	};
};

tempmon: tempmon {
	compatible = "fsl,imx6sx-tempmon", "fsl,imx6q-tempmon";
	interrupts = <GIC_SPI 49 IRQ_TYPE_LEVEL_HIGH>;
	fsl,tempmon = <&anatop>;
	nvmem-cells = <&tempmon_calib>, <&tempmon_temp_grade>;
	nvmem-cell-names = "calib", "temp_grade";
	clocks = <&clks IMX6SX_CLK_PLL3_USB_OTG>;
};

Legacy method (Deprecated):
tempmon {
	compatible = "fsl,imx6q-tempmon";
	fsl,tempmon = <&anatop>;
	fsl,tempmon-data = <&ocotp>;
	clocks = <&clks 172>;
};
```

## Documentation/devicetree/bindings/thermal/imx-thermal.yaml
```yaml
# SPDX-License-Identifier: (GPL-2.0-only OR BSD-2-Clause)
%YAML 1.2
---
$id: http://devicetree.org/schemas/thermal/imx-thermal.yaml#
$schema: http://devicetree.org/meta-schemas/core.yaml#

title: NXP i.MX Thermal

maintainers:
  - Shawn Guo <shawnguo@kernel.org>
  - Anson Huang <Anson.Huang@nxp.com>

properties:
  compatible:
    enum:
      - fsl,imx6q-tempmon
      - fsl,imx6sx-tempmon
      - fsl,imx7d-tempmon

  interrupts:
    description: |
      The interrupt output of the controller, i.MX6Q has IRQ_HIGH which
      will be triggered when temperature is higher than high threshold,
      i.MX6SX and i.MX7S/D have two more IRQs than i.MX6Q, one is IRQ_LOW
      and the other is IRQ_PANIC, when temperature is lower than low
      threshold, IRQ_LOW will be triggered, when temperature is higher
      than panic threshold, IRQ_PANIC will be triggered, and system can
      be configured to auto reboot by SRC module for IRQ_PANIC. IRQ_HIGH,
      IRQ_LOW and IRQ_PANIC share same interrupt output of controller.
    maxItems: 1

  nvmem-cells:
    items:
      - description: Phandle to the calibration data provided by ocotp
      - description: Phandle to the temperature grade provided by ocotp

  nvmem-cell-names:
    items:
      - const: calib
      - const: temp_grade

  fsl,tempmon:
    $ref: '/schemas/types.yaml#/definitions/phandle'
    description: Phandle to anatop system controller node.

  fsl,tempmon-data:
    $ref: '/schemas/types.yaml#/definitions/phandle'
    description: |
      Deprecated property, phandle pointer to fuse controller that contains
      TEMPMON calibration data, e.g. OCOTP on imx6q. The details about
      calibration data can be found in SoC Reference Manual.
    deprecated: true

  clocks:
    maxItems: 1

required:
  - compatible
  - interrupts
  - fsl,tempmon
  - nvmem-cells
  - nvmem-cell-names

additionalProperties: false

examples:
  - |
    #include <dt-bindings/clock/imx6sx-clock.h>
    #include <dt-bindings/interrupt-controller/arm-gic.h>

    efuse@21bc000 {
         #address-cells = <1>;
         #size-cells = <1>;
         compatible = "fsl,imx6sx-ocotp", "syscon";
         reg = <0x021bc000 0x4000>;
         clocks = <&clks IMX6SX_CLK_OCOTP>;

         tempmon_calib: calib@38 {
             reg = <0x38 4>;
         };

         tempmon_temp_grade: temp-grade@20 {
             reg = <0x20 4>;
         };
    };

    anatop@20c8000 {
        compatible = "fsl,imx6q-anatop", "syscon", "simple-mfd";
        reg = <0x020c8000 0x1000>;
        interrupts = <0 49 IRQ_TYPE_LEVEL_HIGH>,
                     <0 54 IRQ_TYPE_LEVEL_HIGH>,
                     <0 127 IRQ_TYPE_LEVEL_HIGH>;

        tempmon {
             compatible = "fsl,imx6sx-tempmon";
             interrupts = <GIC_SPI 49 IRQ_TYPE_LEVEL_HIGH>;
             fsl,tempmon = <&anatop>;
             nvmem-cells = <&tempmon_calib>, <&tempmon_temp_grade>;
             nvmem-cell-names = "calib", "temp_grade";
             clocks = <&clks IMX6SX_CLK_PLL3_USB_OTG>;
        };
    };
```

## Documentation/devicetree/bindings/thermal/imx8mm-thermal.txt
```
* Thermal Monitoring Unit (TMU) on Freescale i.MX8MM SoC

Required properties:
- compatible : Must be "fsl,imx8mm-tmu" or "fsl,imx8mp-tmu".
- reg : Address range of TMU registers.
- clocks : TMU's clock source.
- #thermal-sensor-cells : Should be 0 or 1. See ./thermal.txt for a description.

Example:
tmu: tmu@30260000 {
	compatible = "fsl,imx8mm-tmu";
	reg = <0x30260000 0x10000>;
	clocks = <&clk IMX8MM_CLK_TMU_ROOT>;
	#thermal-sensor-cells = <0>;
};
```

## Documentation/devicetree/bindings/thermal/imx8mm-thermal.yaml
```yaml
# SPDX-License-Identifier: GPL-2.0
%YAML 1.2
---
$id: http://devicetree.org/schemas/thermal/imx8mm-thermal.yaml#
$schema: http://devicetree.org/meta-schemas/core.yaml#

title: NXP i.MX8M Mini Thermal

maintainers:
  - Shawn Guo <shawnguo@kernel.org>
  - Sascha Hauer <s.hauer@pengutronix.de>
  - Fabio Estevam <festevam@gmail.com>

description: |
  i.MX8MM has TMU IP to allow temperature measurement, there are
  currently two distinct major versions of the IP that is supported
  by a single driver. The IP versions are named v1 and v2, v1 is
  for i.MX8MM which has ONLY 1 sensor, v2 is for i.MX8MP which has
  2 sensors.

$ref: thermal-sensor.yaml#

properties:
  compatible:
    oneOf:
      - enum:
          - fsl,imx8mm-tmu
          - fsl,imx8mp-tmu
      - items:
          - const: fsl,imx8mn-tmu
          - const: fsl,imx8mm-tmu

  reg:
    maxItems: 1

  clocks:
    maxItems: 1

  nvmem-cells:
    maxItems: 1
    description: Phandle to the calibration data provided by ocotp

  nvmem-cell-names:
    const: calib

  "#thermal-sensor-cells":
    description: |
      Number of cells required to uniquely identify the thermal
      sensors, 0 for ONLY one sensor and 1 for multiple sensors.
    enum:
      - 0
      - 1

required:
  - compatible
  - reg
  - clocks

unevaluatedProperties: false

examples:
  - |
    #include <dt-bindings/clock/imx8mm-clock.h>

    thermal-sensor@30260000 {
        compatible = "fsl,imx8mm-tmu";
        reg = <0x30260000 0x10000>;
        clocks = <&clk IMX8MM_CLK_TMU_ROOT>;
        #thermal-sensor-cells = <0>;
    };

...
```

## Documentation/devicetree/bindings/thermal/kirkwood-thermal.txt
```
* Kirkwood Thermal

This version is for Kirkwood 88F8262 & 88F6283 SoCs. Other kirkwoods
don't contain a thermal sensor.

Required properties:
- compatible : "marvell,kirkwood-thermal"
- reg : Address range of the thermal registers

Example:

	thermal@10078 {
		compatible = "marvell,kirkwood-thermal";
		reg = <0x10078 0x4>;
	};
```

## Documentation/devicetree/bindings/thermal/loongson,ls2k-thermal.yaml
```yaml
# SPDX-License-Identifier: (GPL-2.0-only OR BSD-2-Clause)
%YAML 1.2
---
$id: http://devicetree.org/schemas/thermal/loongson,ls2k-thermal.yaml#
$schema: http://devicetree.org/meta-schemas/core.yaml#

title: Thermal sensors on Loongson-2 SoCs

maintainers:
  - zhanghongchen <zhanghongchen@loongson.cn>
  - Yinbo Zhu <zhuyinbo@loongson.cn>

properties:
  compatible:
    oneOf:
      - enum:
          - loongson,ls2k1000-thermal
      - items:
          - enum:
              - loongson,ls2k2000-thermal
          - const: loongson,ls2k1000-thermal

  reg:
    maxItems: 1

  interrupts:
    maxItems: 1

required:
  - compatible
  - reg
  - interrupts

additionalProperties: false

examples:
  - |
    #include <dt-bindings/interrupt-controller/irq.h>
    thermal: thermal-sensor@1fe01500 {
        compatible = "loongson,ls2k1000-thermal";
        reg = <0x1fe01500 0x30>;
        interrupt-parent = <&liointc0>;
        interrupts = <7 IRQ_TYPE_LEVEL_LOW>;
    };
```

## Documentation/devicetree/bindings/thermal/marvell,armada-ap806-thermal.yaml
```yaml
# SPDX-License-Identifier: (GPL-2.0-only OR BSD-2-Clause)
%YAML 1.2
---
$id: http://devicetree.org/schemas/thermal/marvell,armada-ap806-thermal.yaml#
$schema: http://devicetree.org/meta-schemas/core.yaml#

title: Marvell Armada AP80x/CP110 thermal management

maintainers:
  - Miquel Raynal <miquel.raynal@bootlin.com>

properties:
  compatible:
    enum:
      - marvell,armada-ap806-thermal
      - marvell,armada-ap807-thermal
      - marvell,armada-cp110-thermal

  reg:
    maxItems: 1

  interrupts:
    description:
      Overheat interrupt. The interrupt is connected thru a System Error
      Interrupt (SEI) controller.
    maxItems: 1

  '#thermal-sensor-cells':
    description: Cell represents the channel ID. There is one sensor per
      channel. O refers to the thermal IP internal channel.
    const: 1

required:
  - compatible
  - reg

additionalProperties: false

examples:
  - |
    thermal-sensor@80 {
        compatible = "marvell,armada-ap806-thermal";
        reg = <0x80 0x10>;
        interrupts = <18>;
        #thermal-sensor-cells = <1>;
    };
```
