## Documentation/devicetree/bindings/thermal/marvell,armada370-thermal.yaml
```yaml
# SPDX-License-Identifier: (GPL-2.0-only OR BSD-2-Clause)
%YAML 1.2
---
$id: http://devicetree.org/schemas/thermal/marvell,armada370-thermal.yaml#
$schema: http://devicetree.org/meta-schemas/core.yaml#

title: Marvell Armada 3xx/XP thermal management

maintainers:
  - Miquel Raynal <miquel.raynal@bootlin.com>

properties:
  compatible:
    enum:
      - marvell,armada370-thermal
      - marvell,armada375-thermal
      - marvell,armada380-thermal
      - marvell,armadaxp-thermal

  reg:
    items:
      - description: status register (4B)
      - description: control register (8B)

required:
  - compatible
  - reg

additionalProperties: false

examples:
  - |
    thermal@d0018300 {
        compatible = "marvell,armada370-thermal";
        reg = <0xd0018300 0x4>,
              <0xd0018304 0x8>;
    };
```

## Documentation/devicetree/bindings/thermal/max77620_thermal.txt
```
Thermal driver for MAX77620 Power management IC from Maxim Semiconductor.

Maxim Semiconductor MAX77620 supports alarm interrupts when its
die temperature crosses 120C and 140C. These threshold temperatures
are not configurable. Device does not provide the real temperature
of die other than just indicating whether temperature is above or
below threshold level.

Required properties:
-------------------
#thermal-sensor-cells:	For more details, please refer to
			<devicetree/bindings/thermal/thermal-sensor.yaml>
			The value must be 0.

For more details, please refer generic thermal DT binding document
<devicetree/bindings/thermal/thermal*.yaml>.

Please refer <devicetree/bindings/mfd/max77620.txt> for mfd DT binding
document for the MAX77620.

Example:
--------
#include <dt-bindings/mfd/max77620.h>
#include <dt-bindings/thermal/thermal.h>
...

i2c@7000d000 {
	spmic: max77620@3c {
		compatible = "maxim,max77620";
		:::::
		#thermal-sensor-cells = <0>;
		:::
	};
};

cool_dev: cool-dev {
	compatible = "cooling-dev";
	#cooling-cells = <2>;
};

thermal-zones {
	PMIC-Die {
		polling-delay = <0>;
		polling-delay-passive = <0>;
		thermal-sensors = <&spmic>;

		trips {
			pmic_die_warn_temp_thresh: hot-die {
				temperature = <120000>;
				type = "hot";
				hysteresis = <0>;
			};

			pmic_die_cirt_temp_thresh: cirtical-die {
				temperature = <140000>;
				type = "critical";
				hysteresis = <0>;
			};
		};

		cooling-maps {
			map0 {
				trip = <&pmic_die_warn_temp_thresh>;
				cooling-device = <&cool_dev THERMAL_NO_LIMIT
						  THERMAL_NO_LIMIT>;
				contribution = <100>;
			};
		};
	};
};
```

## Documentation/devicetree/bindings/thermal/mediatek,lvts-thermal.yaml
```yaml
# SPDX-License-Identifier: (GPL-2.0-only OR BSD-2-Clause)
%YAML 1.2
---
$id: http://devicetree.org/schemas/thermal/mediatek,lvts-thermal.yaml#
$schema: http://devicetree.org/meta-schemas/core.yaml#

title: MediaTek SoC Low Voltage Thermal Sensor (LVTS)

maintainers:
  - Balsam CHIHI <bchihi@baylibre.com>

description: |
  LVTS is a thermal management architecture composed of three subsystems,
  a Sensing device - Thermal Sensing Micro Circuit Unit (TSMCU),
  a Converter - Low Voltage Thermal Sensor converter (LVTS), and
  a Digital controller (LVTS_CTRL).

properties:
  compatible:
    enum:
      - mediatek,mt7988-lvts-ap
      - mediatek,mt8186-lvts
      - mediatek,mt8188-lvts-ap
      - mediatek,mt8188-lvts-mcu
      - mediatek,mt8192-lvts-ap
      - mediatek,mt8192-lvts-mcu
      - mediatek,mt8195-lvts-ap
      - mediatek,mt8195-lvts-mcu

  reg:
    maxItems: 1

  interrupts:
    maxItems: 1

  clocks:
    maxItems: 1

  resets:
    maxItems: 1
    description: LVTS reset for clearing temporary data on AP/MCU.

  nvmem-cells:
    minItems: 1
    items:
      - description: Calibration eFuse data 1 for LVTS
      - description: Calibration eFuse data 2 for LVTS

  nvmem-cell-names:
    minItems: 1
    items:
      - const: lvts-calib-data-1
      - const: lvts-calib-data-2

  "#thermal-sensor-cells":
    const: 1

allOf:
  - $ref: thermal-sensor.yaml#

  - if:
      properties:
        compatible:
          contains:
            enum:
              - mediatek,mt8188-lvts-ap
              - mediatek,mt8188-lvts-mcu
              - mediatek,mt8192-lvts-ap
              - mediatek,mt8192-lvts-mcu
    then:
      properties:
        nvmem-cells:
          maxItems: 1

        nvmem-cell-names:
          maxItems: 1

  - if:
      properties:
        compatible:
          contains:
            enum:
              - mediatek,mt8186-lvts
              - mediatek,mt8195-lvts-ap
              - mediatek,mt8195-lvts-mcu
    then:
      properties:
        nvmem-cells:
          minItems: 2

        nvmem-cell-names:
          minItems: 2

required:
  - compatible
  - reg
  - interrupts
  - clocks
  - resets
  - nvmem-cells
  - nvmem-cell-names

additionalProperties: false

examples:
  - |
    #include <dt-bindings/interrupt-controller/arm-gic.h>
    #include <dt-bindings/clock/mt8195-clk.h>
    #include <dt-bindings/reset/mt8195-resets.h>
    #include <dt-bindings/thermal/mediatek,lvts-thermal.h>

    soc {
      #address-cells = <2>;
      #size-cells = <2>;

      lvts_mcu: thermal-sensor@11278000 {
        compatible = "mediatek,mt8195-lvts-mcu";
        reg = <0 0x11278000 0 0x1000>;
        interrupts = <GIC_SPI 170 IRQ_TYPE_LEVEL_HIGH 0>;
        clocks = <&infracfg_ao CLK_INFRA_AO_THERM>;
        resets = <&infracfg_ao MT8195_INFRA_RST4_THERM_CTRL_MCU_SWRST>;
        nvmem-cells = <&lvts_efuse_data1 &lvts_efuse_data2>;
        nvmem-cell-names = "lvts-calib-data-1", "lvts-calib-data-2";
        #thermal-sensor-cells = <1>;
      };
    };

    thermal_zones: thermal-zones {
      cpu0-thermal {
        polling-delay = <1000>;
        polling-delay-passive = <250>;
        thermal-sensors = <&lvts_mcu MT8195_MCU_LITTLE_CPU0>;

        trips {
          cpu0_alert: trip-alert {
            temperature = <85000>;
            hysteresis = <2000>;
            type = "passive";
          };

          cpu0_crit: trip-crit {
            temperature = <100000>;
            hysteresis = <2000>;
            type = "critical";
          };
        };
      };
    };
```

## Documentation/devicetree/bindings/thermal/mediatek,thermal.yaml
```yaml
# SPDX-License-Identifier: GPL-2.0-only OR BSD-2-Clause
%YAML 1.2
---
$id: http://devicetree.org/schemas/thermal/mediatek,thermal.yaml#
$schema: http://devicetree.org/meta-schemas/core.yaml#

title: Mediatek thermal controller for on-SoC temperatures

maintainers:
  - Sascha Hauer <s.hauer@pengutronix.de>

description:
  This device does not have its own ADC, instead it directly controls the AUXADC
  via AHB bus accesses. For this reason it needs phandles to the AUXADC. Also it
  controls a mux in the apmixedsys register space via AHB bus accesses, so a
  phandle to the APMIXEDSYS is also needed.

allOf:
  - $ref: thermal-sensor.yaml#

properties:
  compatible:
    oneOf:
      - enum:
          - mediatek,mt2701-thermal
          - mediatek,mt2712-thermal
          - mediatek,mt7622-thermal
          - mediatek,mt7986-thermal
          - mediatek,mt8173-thermal
          - mediatek,mt8183-thermal
          - mediatek,mt8365-thermal
      - items:
          - enum:
              - mediatek,mt8516-thermal
          - const: mediatek,mt2701-thermal
      - items:
          - enum:
              - mediatek,mt7981-thermal
          - const: mediatek,mt7986-thermal

  reg:
    maxItems: 1

  interrupts:
    maxItems: 1

  clocks:
    items:
      - description: Main clock needed for register access
      - description: The AUXADC clock

  clock-names:
    items:
      - const: therm
      - const: auxadc

  mediatek,auxadc:
    $ref: /schemas/types.yaml#/definitions/phandle
    description: A phandle to the AUXADC which the thermal controller uses

  mediatek,apmixedsys:
    $ref: /schemas/types.yaml#/definitions/phandle
    description: A phandle to the APMIXEDSYS controller

  resets:
    description: Reset controller controlling the thermal controller

  nvmem-cells:
    items:
      - description:
          NVMEM cell with EEPROMA phandle to the calibration data provided by an
          NVMEM device. If unspecified default values shall be used.

  nvmem-cell-names:
    items:
      - const: calibration-data

required:
  - reg
  - interrupts
  - clocks
  - clock-names
  - mediatek,auxadc
  - mediatek,apmixedsys

unevaluatedProperties: false

examples:
  - |
    #include <dt-bindings/interrupt-controller/irq.h>
    #include <dt-bindings/clock/mt8173-clk.h>
    #include <dt-bindings/reset/mt8173-resets.h>

    thermal@1100b000 {
        compatible = "mediatek,mt8173-thermal";
        reg = <0x1100b000 0x1000>;
        interrupts = <0 70 IRQ_TYPE_LEVEL_LOW>;
        clocks = <&pericfg CLK_PERI_THERM>, <&pericfg CLK_PERI_AUXADC>;
        clock-names = "therm", "auxadc";
        resets = <&pericfg MT8173_PERI_THERM_SW_RST>;
        mediatek,auxadc = <&auxadc>;
        mediatek,apmixedsys = <&apmixedsys>;
        nvmem-cells = <&thermal_calibration_data>;
        nvmem-cell-names = "calibration-data";
        #thermal-sensor-cells = <1>;
    };
```

## Documentation/devicetree/bindings/thermal/mediatek-thermal.txt
```
* Mediatek Thermal

This describes the device tree binding for the Mediatek thermal controller
which measures the on-SoC temperatures. This device does not have its own ADC,
instead it directly controls the AUXADC via AHB bus accesses. For this reason
this device needs phandles to the AUXADC. Also it controls a mux in the
apmixedsys register space via AHB bus accesses, so a phandle to the APMIXEDSYS
is also needed.

Required properties:
- compatible:
  - "mediatek,mt8173-thermal" : For MT8173 family of SoCs
  - "mediatek,mt2701-thermal" : For MT2701 family of SoCs
  - "mediatek,mt2712-thermal" : For MT2712 family of SoCs
- reg: Address range of the thermal controller
- interrupts: IRQ for the thermal controller
- clocks, clock-names: Clocks needed for the thermal controller. required
                       clocks are:
		       "therm":	 Main clock needed for register access
		       "auxadc": The AUXADC clock
- resets: Reference to the reset controller controlling the thermal controller.
- mediatek,auxadc: A phandle to the AUXADC which the thermal controller uses
- mediatek,apmixedsys: A phandle to the APMIXEDSYS controller.
- #thermal-sensor-cells : Should be 0. See ./thermal.txt for a description.

Optional properties:
- nvmem-cells: A phandle to the calibration data provided by a nvmem device. If
               unspecified default values shall be used.
- nvmem-cell-names: Should be "calibration-data"

Example:

	thermal: thermal@1100b000 {
		#thermal-sensor-cells = <1>;
		compatible = "mediatek,mt8173-thermal";
		reg = <0 0x1100b000 0 0x1000>;
		interrupts = <0 70 IRQ_TYPE_LEVEL_LOW>;
		clocks = <&pericfg CLK_PERI_THERM>, <&pericfg CLK_PERI_AUXADC>;
		clock-names = "therm", "auxadc";
		resets = <&pericfg MT8173_PERI_THERM_SW_RST>;
		reset-names = "therm";
		mediatek,auxadc = <&auxadc>;
		mediatek,apmixedsys = <&apmixedsys>;
		nvmem-cells = <&thermal_calibration_data>;
		nvmem-cell-names = "calibration-data";
	};
```
