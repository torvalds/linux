## Documentation/devicetree/bindings/thermal/nvidia,tegra30-tsensor.yaml
```yaml
# SPDX-License-Identifier: (GPL-2.0-only OR BSD-2-Clause)
%YAML 1.2
---
$id: http://devicetree.org/schemas/thermal/nvidia,tegra30-tsensor.yaml#
$schema: http://devicetree.org/meta-schemas/core.yaml#

title: NVIDIA Tegra30 Thermal Sensor

maintainers:
  - Dmitry Osipenko <digetx@gmail.com>
  - Jon Hunter <jonathanh@nvidia.com>
  - Thierry Reding <thierry.reding@gmail.com>

description: |
  TSENSOR provides thermal and voltage sensors which monitor temperature
  and voltage of the chip. Sensors are placed across the die to gauge the
  temperature of the whole chip. The TSENSOR module:

    Generates an interrupt to SW to lower temperature via DVFS on reaching
    a certain thermal/voltage threshold.

    Generates a signal to the CAR to reduce CPU frequency by half on reaching
    a certain thermal/voltage threshold.

    Generates a signal to the PMC when the temperature reaches dangerously high
    levels to reset the chip and sets a flag in the PMC.

  TSENSOR has two channels which monitor two different spots of the SoC.

properties:
  compatible:
    const: nvidia,tegra30-tsensor

  reg:
    maxItems: 1

  clocks:
    maxItems: 1

  resets:
    maxItems: 1

  interrupts:
    maxItems: 1

  "#thermal-sensor-cells":
    const: 1

  assigned-clock-parents: true
  assigned-clock-rates: true
  assigned-clocks: true

required:
  - compatible
  - reg
  - clocks
  - resets
  - interrupts
  - "#thermal-sensor-cells"

additionalProperties: false

examples:
  - |
    thermal-sensor@70014000 {
      compatible = "nvidia,tegra30-tsensor";
      reg = <0x70014000 0x500>;
      interrupts = <0 102 4>;
      clocks = <&clk 100>;
      resets = <&rst 100>;

      #thermal-sensor-cells = <1>;
    };
```

## Documentation/devicetree/bindings/thermal/qcom,spmi-temp-alarm.yaml
```yaml
# SPDX-License-Identifier: GPL-2.0-only OR BSD-2-Clause
%YAML 1.2
---
$id: http://devicetree.org/schemas/thermal/qcom,spmi-temp-alarm.yaml#
$schema: http://devicetree.org/meta-schemas/core.yaml#

title: Qualcomm QPNP PMIC Temperature Alarm

maintainers:
  - Bjorn Andersson <bjorn.andersson@linaro.org>

description:
  QPNP temperature alarm peripherals are found inside of Qualcomm PMIC chips
  that utilize the Qualcomm SPMI implementation. These peripherals provide an
  interrupt signal and status register to identify high PMIC die temperature.

allOf:
  - $ref: thermal-sensor.yaml#

properties:
  compatible:
    const: qcom,spmi-temp-alarm

  reg:
    maxItems: 1

  interrupts:
    maxItems: 1

  io-channels:
    items:
      - description: ADC channel, which reports chip die temperature

  io-channel-names:
    items:
      - const: thermal

  '#thermal-sensor-cells':
    const: 0

required:
  - compatible
  - reg
  - interrupts
  - '#thermal-sensor-cells'

additionalProperties: false

examples:
  - |
    #include <dt-bindings/interrupt-controller/arm-gic.h>

    pmic {
        #address-cells = <1>;
        #size-cells = <0>;

        pm8350_temp_alarm: temperature-sensor@a00 {
            compatible = "qcom,spmi-temp-alarm";
            reg = <0xa00>;
            interrupts = <0x1 0xa 0x0 IRQ_TYPE_EDGE_BOTH>;
            #thermal-sensor-cells = <0>;
        };
    };

    thermal-zones {
        pm8350_thermal: pm8350c-thermal {
            polling-delay-passive = <100>;
            polling-delay = <0>;
            thermal-sensors = <&pm8350_temp_alarm>;

            trips {
                pm8350_trip0: trip0 {
                    temperature = <95000>;
                    hysteresis = <0>;
                    type = "passive";
                };

                pm8350_crit: pm8350c-crit {
                    temperature = <115000>;
                    hysteresis = <0>;
                    type = "critical";
                };
            };
        };
    };
```

## Documentation/devicetree/bindings/thermal/qcom-lmh.yaml
```yaml
# SPDX-License-Identifier: (GPL-2.0-only OR BSD-2-Clause)
# Copyright 2021 Linaro Ltd.
%YAML 1.2
---
$id: http://devicetree.org/schemas/thermal/qcom-lmh.yaml#
$schema: http://devicetree.org/meta-schemas/core.yaml#

title: Qualcomm Limits Management Hardware(LMh)

maintainers:
  - Thara Gopinath <thara.gopinath@gmail.com>

description:
  Limits Management Hardware(LMh) is a hardware infrastructure on some
  Qualcomm SoCs that can enforce temperature and current limits as
  programmed by software for certain IPs like CPU.

properties:
  compatible:
    oneOf:
      - enum:
          - qcom,sc8180x-lmh
          - qcom,sdm845-lmh
          - qcom,sm8150-lmh
      - items:
          - const: qcom,qcm2290-lmh
          - const: qcom,sm8150-lmh

  reg:
    items:
      - description: core registers

  interrupts:
    maxItems: 1

  '#interrupt-cells':
    const: 1

  interrupt-controller: true

  cpus:
    description:
      phandle of the first cpu in the LMh cluster
    maxItems: 1

  qcom,lmh-temp-arm-millicelsius:
    description:
      An integer expressing temperature threshold at which the LMh thermal
      FSM is engaged.

  qcom,lmh-temp-low-millicelsius:
    description:
      An integer expressing temperature threshold at which the state machine
      will attempt to remove frequency throttling.

  qcom,lmh-temp-high-millicelsius:
    description:
      An integer expressing temperature threshold at which the state machine
      will attempt to throttle the frequency.

required:
  - compatible
  - reg
  - interrupts
  - '#interrupt-cells'
  - interrupt-controller
  - cpus
  - qcom,lmh-temp-arm-millicelsius
  - qcom,lmh-temp-low-millicelsius
  - qcom,lmh-temp-high-millicelsius

additionalProperties: false

examples:
  - |
    #include <dt-bindings/interrupt-controller/arm-gic.h>

    lmh@17d70800 {
      compatible = "qcom,sdm845-lmh";
      reg = <0x17d70800 0x400>;
      interrupts = <GIC_SPI 33 IRQ_TYPE_LEVEL_HIGH>;
      cpus = <&CPU4>;
      qcom,lmh-temp-arm-millicelsius = <65000>;
      qcom,lmh-temp-low-millicelsius = <94500>;
      qcom,lmh-temp-high-millicelsius = <95000>;
      interrupt-controller;
      #interrupt-cells = <1>;
    };
```

## Documentation/devicetree/bindings/thermal/qcom-spmi-adc-tm5.yaml
```yaml
# SPDX-License-Identifier: (GPL-2.0 OR BSD-2-Clause)
%YAML 1.2
---
$id: http://devicetree.org/schemas/thermal/qcom-spmi-adc-tm5.yaml#
$schema: http://devicetree.org/meta-schemas/core.yaml#

title: Qualcomm's SPMI PMIC ADC Thermal Monitoring
maintainers:
  - Dmitry Baryshkov <dmitry.baryshkov@linaro.org>

$ref: thermal-sensor.yaml#

properties:
  compatible:
    enum:
      - qcom,spmi-adc-tm5
      - qcom,spmi-adc-tm5-gen2
      - qcom,adc-tm7 # Incomplete / subject to change

  reg:
    maxItems: 1

  interrupts:
    maxItems: 1

  "#thermal-sensor-cells":
    const: 1

  "#address-cells":
    const: 1

  "#size-cells":
    const: 0

  qcom,avg-samples:
    $ref: /schemas/types.yaml#/definitions/uint32
    description: Number of samples to be used for measurement.
            Not applicable for Gen2 ADC_TM peripheral.
    enum:
      - 1
      - 2
      - 4
      - 8
      - 16
    default: 1

  qcom,decimation:
    $ref: /schemas/types.yaml#/definitions/uint32
    description: This parameter is used to decrease ADC sampling rate.
            Quicker measurements can be made by reducing decimation ratio.
            Not applicable for Gen2 ADC_TM peripheral.
    enum:
      - 250
      - 420
      - 840
    default: 840

patternProperties:
  "^([-a-z0-9]*)@[0-7]$":
    type: object
    description:
      Represent one thermal sensor.

    properties:
      reg:
        description: Specify the sensor channel. There are 8 channels in PMIC5's ADC TM
        minimum: 0
        maximum: 7

      io-channels:
        description:
          From common IIO binding. Used to pipe PMIC ADC channel to thermal monitor

      qcom,ratiometric:
        $ref: /schemas/types.yaml#/definitions/flag
        description:
          Channel calibration type.
          If this property is specified VADC will use the VDD reference
          (1.875V) and GND for channel calibration. If property is not found,
          channel will be calibrated with 0V and 1.25V reference channels,
          also known as absolute calibration.

      qcom,hw-settle-time-us:
        description: Time between AMUX getting configured and the ADC starting conversion.
        enum: [15, 100, 200, 300, 400, 500, 600, 700, 1000, 2000, 4000, 8000, 16000, 32000, 64000, 128000]

      qcom,pre-scaling:
        $ref: /schemas/types.yaml#/definitions/uint32-array
        description: Used for scaling the channel input signal before the
          signal is fed to VADC. The configuration for this node is to know the
          pre-determined ratio and use it for post scaling. It is a pair of
          integers, denoting the numerator and denominator of the fraction by
          which input signal is multiplied. For example, <1 3> indicates the
          signal is scaled down to 1/3 of its value before ADC measurement.  If
          property is not found default value depending on chip will be used.
        items:
          - const: 1
          - enum: [ 1, 3, 4, 6, 20, 8, 10 ]

      qcom,avg-samples:
        $ref: /schemas/types.yaml#/definitions/uint32
        description: Number of samples to be used for measurement.
          This property in child node is applicable only for Gen2 ADC_TM peripheral.
        enum:
          - 1
          - 2
          - 4
          - 8
          - 16
        default: 1

      qcom,decimation:
        $ref: /schemas/types.yaml#/definitions/uint32
        description: This parameter is used to decrease ADC sampling rate.
          Quicker measurements can be made by reducing decimation ratio.
          This property in child node is applicable only for Gen2 ADC_TM peripheral.
        enum:
          - 85
          - 340
          - 1360
        default: 1360

    required:
      - reg
      - io-channels

    additionalProperties:
      false

allOf:
  - if:
      properties:
        compatible:
          contains:
            const: qcom,spmi-adc-tm5

    then:
      patternProperties:
        "^([-a-z0-9]*)@[0-7]$":
          properties:
            qcom,decimation: false
            qcom,avg-samples: false

  - if:
      properties:
        compatible:
          contains:
            const: qcom,spmi-adc-tm5-gen2

    then:
      properties:
        qcom,avg-samples: false
        qcom,decimation: false

required:
  - compatible
  - reg
  - interrupts
  - "#address-cells"
  - "#size-cells"

unevaluatedProperties: false

examples:
  - |
    #include <dt-bindings/iio/qcom,spmi-vadc.h>
    #include <dt-bindings/interrupt-controller/irq.h>

    pmic {
        #address-cells = <1>;
        #size-cells = <0>;

        pm8150b_adc: adc@3100 {
            compatible = "qcom,spmi-adc5";
            reg = <0x3100>;
            #address-cells = <1>;
            #size-cells = <0>;
            #io-channel-cells = <1>;

            /* Other properties are omitted */
            channel@4f {
                reg = <ADC5_AMUX_THM3_100K_PU>;
                qcom,ratiometric;
                qcom,hw-settle-time = <200>;
                label = "conn_therm";
            };
        };

        adc-tm@3500 {
            compatible = "qcom,spmi-adc-tm5";
            reg = <0x3500>;
            interrupts = <0x2 0x35 0x0 IRQ_TYPE_EDGE_RISING>;
            #thermal-sensor-cells = <1>;
            #address-cells = <1>;
            #size-cells = <0>;

            conn-therm@0 {
                reg = <0>;
                io-channels = <&pm8150b_adc ADC5_AMUX_THM3_100K_PU>;
                qcom,ratiometric;
                qcom,hw-settle-time-us = <200>;
            };
        };
    };

  - |
    #include <dt-bindings/iio/qcom,spmi-adc7-pmk8350.h>
    #include <dt-bindings/iio/qcom,spmi-adc7-pm8350.h>
    #include <dt-bindings/interrupt-controller/irq.h>

    pmic {
        #address-cells = <1>;
        #size-cells = <0>;

        pmk8350_vadc: adc@3100 {
            compatible = "qcom,spmi-adc7";
            reg = <0x3100>;
            #address-cells = <1>;
            #size-cells = <0>;
            #io-channel-cells = <1>;

            /* Other properties are omitted */
            channel@44 {
                reg = <PMK8350_ADC7_AMUX_THM1_100K_PU>;
                qcom,ratiometric;
                qcom,hw-settle-time = <200>;
                label = "xo_therm";
            };

            channel@147 {
                reg = <PM8350_ADC7_AMUX_THM4_100K_PU(1)>;
                qcom,ratiometric;
                qcom,hw-settle-time = <200>;
                label = "conn_therm";
            };
        };

        adc-tm@3400 {
            compatible = "qcom,spmi-adc-tm5-gen2";
            reg = <0x3400>;
            interrupts = <0x0 0x34 0x0 IRQ_TYPE_EDGE_RISING>;
            #thermal-sensor-cells = <1>;
            #address-cells = <1>;
            #size-cells = <0>;

            pmk8350-xo-therm@0 {
                reg = <0>;
                io-channels = <&pmk8350_vadc PMK8350_ADC7_AMUX_THM1_100K_PU>;
                qcom,decimation = <340>;
                qcom,ratiometric;
                qcom,hw-settle-time-us = <200>;
            };

            conn-therm@1 {
                reg = <1>;
                io-channels = <&pmk8350_vadc PM8350_ADC7_AMUX_THM4_100K_PU(1)>;
                qcom,avg-samples = <2>;
                qcom,ratiometric;
                qcom,hw-settle-time-us = <200>;
            };
        };
    };
...
```

## Documentation/devicetree/bindings/thermal/qcom-spmi-temp-alarm.txt
```
Qualcomm QPNP PMIC Temperature Alarm

QPNP temperature alarm peripherals are found inside of Qualcomm PMIC chips
that utilize the Qualcomm SPMI implementation. These peripherals provide an
interrupt signal and status register to identify high PMIC die temperature.

Required properties:
- compatible:      Should contain "qcom,spmi-temp-alarm".
- reg:             Specifies the SPMI address.
- interrupts:      PMIC temperature alarm interrupt.
- #thermal-sensor-cells: Should be 0. See thermal.txt for a description.

Optional properties:
- io-channels:     Should contain IIO channel specifier for the ADC channel,
                   which report chip die temperature.
- io-channel-names: Should contain "thermal".

Example:

	pm8941_temp: thermal-alarm@2400 {
		compatible = "qcom,spmi-temp-alarm";
		reg = <0x2400>;
		interrupts = <0 0x24 0 IRQ_TYPE_EDGE_RISING>;
		#thermal-sensor-cells = <0>;

		io-channels = <&pm8941_vadc VADC_DIE_TEMP>;
		io-channel-names = "thermal";
	};

	thermal-zones {
		pm8941 {
			polling-delay-passive = <250>;
			polling-delay = <1000>;

			thermal-sensors = <&pm8941_temp>;

			trips {
				stage1 {
					temperature = <105000>;
					hysteresis = <2000>;
					type = "passive";
				};
				stage2 {
					temperature = <125000>;
					hysteresis = <2000>;
					type = "critical";
				};
			};
		};
	};
```
