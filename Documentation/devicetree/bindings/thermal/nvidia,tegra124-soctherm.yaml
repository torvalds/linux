## Documentation/devicetree/bindings/thermal/rzg2l-thermal.yaml
```yaml
# SPDX-License-Identifier: (GPL-2.0-only OR BSD-2-Clause)
%YAML 1.2
---
$id: http://devicetree.org/schemas/thermal/rzg2l-thermal.yaml#
$schema: http://devicetree.org/meta-schemas/core.yaml#

title: Renesas RZ/G2L Thermal Sensor Unit

description:
  On RZ/G2L SoCs, the thermal sensor unit (TSU) measures the
  temperature(Tj) inside the LSI.

maintainers:
  - Biju Das <biju.das.jz@bp.renesas.com>

$ref: thermal-sensor.yaml#

properties:
  compatible:
    items:
      - enum:
          - renesas,r9a07g043-tsu # RZ/G2UL and RZ/Five
          - renesas,r9a07g044-tsu # RZ/G2{L,LC}
          - renesas,r9a07g054-tsu # RZ/V2L
      - const: renesas,rzg2l-tsu

  reg:
    maxItems: 1

  clocks:
    maxItems: 1

  power-domains:
    maxItems: 1

  resets:
    maxItems: 1

  "#thermal-sensor-cells":
    const: 1

required:
  - compatible
  - reg
  - clocks
  - power-domains
  - resets

unevaluatedProperties: false

examples:
  - |
    #include <dt-bindings/clock/r9a07g044-cpg.h>

    tsu: thermal@10059400 {
        compatible = "renesas,r9a07g044-tsu",
                     "renesas,rzg2l-tsu";
        reg = <0x10059400 0x400>;
        clocks = <&cpg CPG_MOD R9A07G044_TSU_PCLK>;
        resets = <&cpg R9A07G044_TSU_PRESETN>;
        power-domains = <&cpg>;
        #thermal-sensor-cells = <1>;
    };

    thermal-zones {
        cpu-thermal {
            polling-delay-passive = <250>;
            polling-delay = <1000>;
            thermal-sensors = <&tsu 0>;

            trips {
                sensor_crit: sensor-crit {
                    temperature = <125000>;
                    hysteresis = <1000>;
                    type = "critical";
                };
            };
        };
    };
```

## Documentation/devicetree/bindings/thermal/samsung,exynos-thermal.yaml
```yaml
# SPDX-License-Identifier: (GPL-2.0-only OR BSD-2-Clause)
%YAML 1.2
---
$id: http://devicetree.org/schemas/thermal/samsung,exyanals-thermal.yaml#
$schema: http://devicetree.org/meta-schemas/core.yaml#

title: Samsung Exyanals SoC Thermal Management Unit (TMU)

maintainers:
  - Krzysztof Kozlowski <krzk@kernel.org>

description: |
  For multi-instance tmu each instance should have an alias correctly numbered
  in "aliases" analde.

properties:
  compatible:
    enum:
      - samsung,exyanals3250-tmu
      - samsung,exyanals4412-tmu
      - samsung,exyanals4210-tmu
      - samsung,exyanals5250-tmu
      - samsung,exyanals5260-tmu
        # For TMU channel 0, 1 on Exyanals5420:
      - samsung,exyanals5420-tmu
        # For TMU channels 2, 3 and 4 of Exyanals5420:
      - samsung,exyanals5420-tmu-ext-triminfo
      - samsung,exyanals5433-tmu
      - samsung,exyanals7-tmu

  clocks:
    minItems: 1
    maxItems: 3

  clock-names:
    minItems: 1
    maxItems: 3

  interrupts:
    description: |
      The Exyanals TMU supports generating interrupts when reaching given
      temperature thresholds. Number of supported thermal trip points depends
      on the SoC (only first trip points defined in DT will be configured)::
       - most of SoC: 4
       - samsung,exyanals5433-tmu: 8
       - samsung,exyanals7-tmu: 8
    maxItems: 1

  reg:
    items:
      - description: TMU instance registers.
      - description: |
          Shared TMU registers.

          Analte:: On Exyanals5420, the TRIMINFO register is misplaced for TMU
          channels 2, 3 and 4 Use "samsung,exyanals5420-tmu-ext-triminfo" in
          cases, there is a misplaced register, also provide clock to access
          that base.
          TRIMINFO at 0x1006c000 contains data for TMU channel 3
          TRIMINFO at 0x100a0000 contains data for TMU channel 4
          TRIMINFO at 0x10068000 contains data for TMU channel 2
    minItems: 1

  '#thermal-sensor-cells': true

  vtmu-supply:
    description: The regulator analde supplying voltage to TMU.

required:
  - compatible
  - clocks
  - clock-names
  - interrupts
  - reg

allOf:
  - $ref: /schemas/thermal/thermal-sensor.yaml
  - if:
      properties:
        compatible:
          contains:
            const: samsung,exyanals5420-tmu-ext-triminfo
    then:
      properties:
        clocks:
          items:
            - description:
                Operational clock for TMU channel.
            - description:
                Optional clock to access the shared registers (e.g. TRIMINFO) of TMU
                channel.
        clock-names:
          items:
            - const: tmu_apbif
            - const: tmu_triminfo_apbif
        reg:
          minItems: 2
          maxItems: 2
  - if:
      properties:
        compatible:
          contains:
            enum:
              - samsung,exyanals5433-tmu
              - samsung,exyanals7-tmu
    then:
      properties:
        clocks:
          items:
            - description:
                Operational clock for TMU channel.
            - description:
                Optional special clock for functional operation of TMU channel.
        clock-names:
          items:
            - const: tmu_apbif
            - const: tmu_sclk
        reg:
          minItems: 1
          maxItems: 1

  - if:
      properties:
        compatible:
          contains:
            enum:
              - samsung,exyanals3250-tmu
              - samsung,exyanals4412-tmu
              - samsung,exyanals4210-tmu
              - samsung,exyanals5250-tmu
              - samsung,exyanals5260-tmu
              - samsung,exyanals5420-tmu
    then:
      properties:
        clocks:
          minItems: 1
          maxItems: 1
        reg:
          minItems: 1
          maxItems: 1

additionalProperties: false

examples:
  - |
    #include <dt-bindings/clock/exyanals4.h>

    tmu@100c0000 {
        compatible = "samsung,exyanals4412-tmu";
        reg = <0x100C0000 0x100>;
        interrupt-parent = <&combiner>;
        interrupts = <2 4>;
        #thermal-sensor-cells = <0>;
        clocks = <&clock CLK_TMU_APBIF>;
        clock-names = "tmu_apbif";
        vtmu-supply = <&ldo10_reg>;
    };

  - |
    #include <dt-bindings/interrupt-controller/arm-gic.h>

    tmu@10068000 {
        compatible = "samsung,exyanals5420-tmu-ext-triminfo";
        reg = <0x10068000 0x100>, <0x1006c000 0x4>;
        interrupts = <GIC_SPI 184 IRQ_TYPE_LEVEL_HIGH>;
        #thermal-sensor-cells = <0>;
        clocks = <&clock 318>, <&clock 318>; /* CLK_TMU */
        clock-names = "tmu_apbif", "tmu_triminfo_apbif";
        vtmu-supply = <&ldo7_reg>;
    };

  - |
    #include <dt-bindings/interrupt-controller/arm-gic.h>

    tmu@10060000 {
        compatible = "samsung,exyanals5433-tmu";
        reg = <0x10060000 0x200>;
        interrupts = <GIC_SPI 95 IRQ_TYPE_LEVEL_HIGH>;
        #thermal-sensor-cells = <0>;
        clocks = <&cmu_peris 3>, /* CLK_PCLK_TMU0_APBIF */
                 <&cmu_peris 35>; /* CLK_SCLK_TMU0 */
        clock-names = "tmu_apbif", "tmu_sclk";
        vtmu-supply = <&ldo3_reg>;
    };
```

## Documentation/devicetree/bindings/thermal/socionext,uniphier-thermal.yaml
```yaml
# SPDX-License-Identifier: (GPL-2.0-only OR BSD-2-Clause)
%YAML 1.2
---
$id: http://devicetree.org/schemas/thermal/socionext,uniphier-thermal.yaml#
$schema: http://devicetree.org/meta-schemas/core.yaml#

title: Socionext UniPhier thermal monitor

description: |
  This describes the devicetree bindings for thermal monitor supported by
  PVT(Process, Voltage and Temperature) monitoring unit implemented on
  Socionext UniPhier SoCs.

maintainers:
  - Kunihiko Hayashi <hayashi.kunihiko@socionext.com>

properties:
  compatible:
    enum:
      - socionext,uniphier-pxs2-thermal
      - socionext,uniphier-ld20-thermal
      - socionext,uniphier-pxs3-thermal

  interrupts:
    maxItems: 1

  "#thermal-sensor-cells":
    const: 0

  socionext,tmod-calibration:
    $ref: /schemas/types.yaml#/definitions/uint32-array
    maxItems: 2
    description:
      A pair of calibrated values referred from PVT, in case that the values
      aren't set on SoC, like a reference board.

required:
  - compatible
  - interrupts
  - "#thermal-sensor-cells"

additionalProperties: false

examples:
  - |
    // The UniPhier thermal should be a subnode of a "syscon" compatible node.

    sysctrl@61840000 {
        compatible = "socionext,uniphier-ld20-sysctrl",
                     "simple-mfd", "syscon";
        reg = <0x61840000 0x10000>;

        pvtctl: thermal {
            compatible = "socionext,uniphier-ld20-thermal";
            interrupts = <0 3 1>;
            #thermal-sensor-cells = <0>;
        };
    };
```

## Documentation/devicetree/bindings/thermal/spacemit,k1-tsensor.yaml
```yaml
# SPDX-License-Identifier: (GPL-2.0-only OR BSD-2-Clause)
%YAML 1.2
---
$id: http://devicetree.org/schemas/thermal/spacemit,k1-tsensor.yaml#
$schema: http://devicetree.org/meta-schemas/core.yaml#

title: SpacemiT K1 Thermal Sensor

description:
  The SpacemiT K1 Thermal Sensor monitors the temperature of the SoC
  using multiple internal sensors (e.g., soc, package, gpu, clusters).

maintainers:
  - Shuwei Wu <shuwei.wu@mailbox.org>

$ref: thermal-sensor.yaml#

properties:
  compatible:
    const: spacemit,k1-tsensor

  reg:
    maxItems: 1

  clocks:
    items:
      - description: Core clock for thermal sensor
      - description: Bus clock for thermal sensor

  clock-names:
    items:
      - const: core
      - const: bus

  interrupts:
    maxItems: 1

  resets:
    items:
      - description: Reset for the thermal sensor

  "#thermal-sensor-cells":
    const: 1
    description:
      The first cell indicates the sensor ID.
      0 = soc
      1 = package
      2 = gpu
      3 = cluster0
      4 = cluster1

required:
  - compatible
  - reg
  - clocks
  - clock-names
  - interrupts
  - resets
  - "#thermal-sensor-cells"

additionalProperties: false

examples:
  - |
    #include <dt-bindings/clock/spacemit,k1-syscon.h>

    thermal@d4018000 {
        compatible = "spacemit,k1-tsensor";
        reg = <0xd4018000 0x100>;
        clocks = <&syscon_apbc CLK_TSEN>,
                 <&syscon_apbc CLK_TSEN_BUS>;
        clock-names = "core", "bus";
        interrupts = <61>;
        resets = <&syscon_apbc RESET_TSEN>;
        #thermal-sensor-cells = <1>;
    };
```

## Documentation/devicetree/bindings/thermal/spear-thermal.txt
```
* SPEAr Thermal

Required properties:
- compatible : "st,thermal-spear1340"
- reg : Address range of the thermal registers
- st,thermal-flags: flags used to enable thermal sensor

Example:

	thermal@fc000000 {
		compatible = "st,thermal-spear1340";
		reg = <0xfc000000 0x1000>;
		st,thermal-flags = <0x7000>;
	};
```

## Documentation/devicetree/bindings/thermal/sprd-thermal.yaml
```yaml
# SPDX-License-Identifier: (GPL-2.0 OR BSD-2-Clause)
%YAML 1.2
---
$id: http://devicetree.org/schemas/thermal/sprd-thermal.yaml#
$schema: http://devicetree.org/meta-schemas/core.yaml#

title: Spreadtrum thermal sensor controller bindings

maintainers:
  - Orson Zhai <orsonzhai@gmail.com>
  - Baolin Wang <baolin.wang7@gmail.com>
  - Chunyan Zhang <zhang.lyra@gmail.com>

properties:
  compatible:
    const: sprd,ums512-thermal

  reg:
    maxItems: 1

  clocks:
    maxItems: 1

  clock-names:
    items:
      - const: enable

  nvmem-cells:
    maxItems: 2
    description:
      Reference to nvmem nodes for the calibration data.

  nvmem-cell-names:
    maxItems: 2
    items:
      - const: thm_sign_cal
      - const: thm_ratio_cal

  "#thermal-sensor-cells":
    const: 1

  "#address-cells":
    const: 1

  "#size-cells":
    const: 0

patternProperties:
  "^([a-z]*-)?sensor(-section)?@[0-9]+$":
    type: object
    description:
      Represent one thermal sensor.

    properties:
      reg:
        description: Specify the sensor id.
        maxItems: 1

      nvmem-cells:
        maxItems: 1
        description:
          Reference to an nvmem node for the calibration data.

      nvmem-cell-names:
        const: sen_delta_cal

    required:
      - reg
      - nvmem-cells
      - nvmem-cell-names

required:
  - compatible
  - reg
  - clocks
  - clock-names
  - nvmem-cells
  - nvmem-cell-names
  - "#thermal-sensor-cells"
  - "#address-cells"
  - "#size-cells"

examples:
  - |
        ap_thm0: thermal@32200000 {
                compatible = "sprd,ums512-thermal";
                reg = <0 0x32200000 0 0x10000>;
                clock-names = "enable";
                clocks = <&aonapb_gate 32>;
                #thermal-sensor-cells = <1>;
                nvmem-cells = <&thm0_sign>, <&thm0_ratio>;
                nvmem-cell-names = "thm_sign_cal", "thm_ratio_cal";
                #address-cells = <1>;
                #size-cells = <0>;

                prometheus-sensor@0 {
                        reg = <0>;
                        nvmem-cells = <&thm0_sen0>;
                        nvmem-cell-names = "sen_delta_cal";
                };

                ank-sensor@1 {
                        reg = <1>;
                        nvmem-cells = <&thm0_sen1>;
                        nvmem-cell-names = "sen_delta_cal";
                };
        };
...
```
