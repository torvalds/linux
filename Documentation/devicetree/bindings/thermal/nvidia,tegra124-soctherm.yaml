## Documentation/devicetree/bindings/thermal/qoriq-thermal.yaml
```yaml
# SPDX-License-Identifier: (GPL-2.0-only OR BSD-2-Clause)
%YAML 1.2
---
$id: http://devicetree.org/schemas/thermal/qoriq-thermal.yaml#
$schema: http://devicetree.org/meta-schemas/core.yaml#

title: Thermal Monitoring Unit (TMU) on Freescale QorIQ SoCs

maintainers:
  - Anson Huang <Anson.Huang@nxp.com>

properties:
  compatible:
    description: |
      The version of the device is determined by the TMU IP Block Revision
      Register (IPBRR0) at offset 0x0BF8.
      Table of correspondences between IPBRR0 values and example chips:
            Value           Device
            ----------      -----
            0x01900102      T1040
    enum:
      - fsl,qoriq-tmu
      - fsl,imx8mq-tmu

  reg:
    maxItems: 1

  interrupts:
    maxItems: 1

  fsl,tmu-range:
    $ref: '/schemas/types.yaml#/definitions/uint32-array'
    description: |
      The values to be programmed into TTRnCR, as specified by the SoC
      reference manual. The first cell is TTR0CR, the second is TTR1CR, etc.
    maxItems: 4

  fsl,tmu-calibration:
    $ref: '/schemas/types.yaml#/definitions/uint32-matrix'
    description: |
      A list of cell pairs containing temperature calibration data, as
      specified by the SoC reference manual. The first cell of each pair
      is the value to be written to TTCFGR, and the second is the value
      to be written to TSCFGR.
    items:
      items:
        - description: value for TTCFGR
        - description: value for TSCFGR
    minItems: 1
    maxItems: 64

  little-endian:
    description: |
      boolean, if present, the TMU registers are little endian. If absent,
      the default is big endian.
    type: boolean

  clocks:
    maxItems: 1

  "#thermal-sensor-cells":
    const: 1

required:
  - compatible
  - reg
  - interrupts
  - fsl,tmu-range
  - fsl,tmu-calibration
  - '#thermal-sensor-cells'

additionalProperties: false

examples:
  - |
    tmu@f0000 {
        compatible = "fsl,qoriq-tmu";
        reg = <0xf0000 0x1000>;
        interrupts = <18 2 0 0>;
        fsl,tmu-range = <0x000a0000 0x00090026 0x0008004a 0x0001006a>;
        fsl,tmu-calibration = <0x00000000 0x00000025>,
                              <0x00000001 0x00000028>,
                              <0x00000002 0x0000002d>,
                              <0x00000003 0x00000031>,
                              <0x00000004 0x00000036>,
                              <0x00000005 0x0000003a>,
                              <0x00000006 0x00000040>,
                              <0x00000007 0x00000044>,
                              <0x00000008 0x0000004a>,
                              <0x00000009 0x0000004f>,
                              <0x0000000a 0x00000054>,
                              <0x00010000 0x0000000d>,
                              <0x00010001 0x00000013>,
                              <0x00010002 0x00000019>,
                              <0x00010003 0x0000001f>,
                              <0x00010004 0x00000025>,
                              <0x00010005 0x0000002d>,
                              <0x00010006 0x00000033>,
                              <0x00010007 0x00000043>,
                              <0x00010008 0x0000004b>,
                              <0x00010009 0x00000053>,
                              <0x00020000 0x00000010>,
                              <0x00020001 0x00000017>,
                              <0x00020002 0x0000001f>,
                              <0x00020003 0x00000029>,
                              <0x00020004 0x00000031>,
                              <0x00020005 0x0000003c>,
                              <0x00020006 0x00000042>,
                              <0x00020007 0x0000004d>,
                              <0x00020008 0x00000056>,
                              <0x00030000 0x00000012>,
                              <0x00030001 0x0000001d>;
        #thermal-sensor-cells = <1>;
    };
```

## Documentation/devicetree/bindings/thermal/rcar-gen3-thermal.txt
```
* DT bindings for Renesas R-Car Gen3 Thermal Sensor driver

On R-Car Gen3 SoCs, the thermal sensor controllers (TSC) control the thermal
sensors (THS) which are the analog circuits for measuring temperature (Tj)
inside the LSI.

Required properties:
- compatible		: "renesas,<soctype>-thermal",
			  Examples with soctypes are:
			    - "renesas,r8a774a1-thermal" (RZ/G2M)
			    - "renesas,r8a7795-thermal" (R-Car H3)
			    - "renesas,r8a7796-thermal" (R-Car M3-W)
			    - "renesas,r8a77965-thermal" (R-Car M3-N)
			    - "renesas,r8a77980-thermal" (R-Car V3H)
- reg			: Address ranges of the thermal registers. Each sensor
			  needs one address range. Sorting must be done in
			  increasing order according to datasheet, i.e.
			  TSC1, TSC2, ...
- clocks		: Must contain a reference to the functional clock.
- #thermal-sensor-cells : must be <1>.

Optional properties:

- interrupts		: interrupts routed to the TSC (must be 3).
- power-domain		: Must contain a reference to the power domain. This
			  property is mandatory if the thermal sensor instance
			  is part of a controllable power domain.

Example:

	tsc: thermal@e6198000 {
		compatible = "renesas,r8a7795-thermal";
		reg = <0 0xe6198000 0 0x100>,
		      <0 0xe61a0000 0 0x100>,
		      <0 0xe61a8000 0 0x100>;
		interrupts = <GIC_SPI 67 IRQ_TYPE_LEVEL_HIGH>,
			     <GIC_SPI 68 IRQ_TYPE_LEVEL_HIGH>,
			     <GIC_SPI 69 IRQ_TYPE_LEVEL_HIGH>;
		clocks = <&cpg CPG_MOD 522>;
		power-domains = <&sysc R8A7795_PD_ALWAYS_ON>;
		#thermal-sensor-cells = <1>;
	};

	thermal-zones {
		sensor_thermal1: sensor-thermal1 {
			polling-delay-passive = <250>;
			polling-delay = <1000>;
			thermal-sensors = <&tsc 0>;

			trips {
				sensor1_crit: sensor1-crit {
					temperature = <90000>;
					hysteresis = <2000>;
					type = "critical";
				};
			};
		};
	};
```

## Documentation/devicetree/bindings/thermal/rcar-gen3-thermal.yaml
```yaml
# SPDX-License-Identifier: GPL-2.0-only
# Copyright (C) 2020 Renesas Electronics Corp.
%YAML 1.2
---
$id: http://devicetree.org/schemas/thermal/rcar-gen3-thermal.yaml#
$schema: http://devicetree.org/meta-schemas/core.yaml#

title: Renesas R-Car Gen3 Thermal Sensor

description:
  On R-Car Gen3 SoCs, the thermal sensor controllers (TSC) control the thermal
  sensors (THS) which are the analog circuits for measuring temperature (Tj)
  inside the LSI.

maintainers:
  - Niklas Söderlund <niklas.soderlund@ragnatech.se>

properties:
  compatible:
    enum:
      - renesas,r8a774a1-thermal # RZ/G2M
      - renesas,r8a774b1-thermal # RZ/G2N
      - renesas,r8a774e1-thermal # RZ/G2H
      - renesas,r8a7795-thermal  # R-Car H3
      - renesas,r8a7796-thermal  # R-Car M3-W
      - renesas,r8a77961-thermal # R-Car M3-W+
      - renesas,r8a77965-thermal # R-Car M3-N
      - renesas,r8a77980-thermal # R-Car V3H
      - renesas,r8a779a0-thermal # R-Car V3U

  reg: true

  interrupts:
    items:
      - description: TEMP1 interrupt
      - description: TEMP2 interrupt
      - description: TEMP3 interrupt

  clocks:
    maxItems: 1

  power-domains:
    maxItems: 1

  resets:
    maxItems: 1

  "#thermal-sensor-cells":
    const: 1

required:
  - compatible
  - reg
  - clocks
  - power-domains
  - resets
  - "#thermal-sensor-cells"

if:
  not:
    properties:
      compatible:
        contains:
          enum:
            - renesas,r8a779a0-thermal
then:
  properties:
    reg:
      minItems: 2
      items:
        - description: TSC1 registers
        - description: TSC2 registers
        - description: TSC3 registers
  required:
    - interrupts
else:
  properties:
    reg:
      items:
        - description: TSC0 registers
        - description: TSC1 registers
        - description: TSC2 registers
        - description: TSC3 registers
        - description: TSC4 registers

additionalProperties: false

examples:
  - |
    #include <dt-bindings/clock/r8a7795-cpg-mssr.h>
    #include <dt-bindings/interrupt-controller/arm-gic.h>
    #include <dt-bindings/power/r8a7795-sysc.h>

    tsc: thermal@e6198000 {
            compatible = "renesas,r8a7795-thermal";
            reg = <0xe6198000 0x100>,
                  <0xe61a0000 0x100>,
                  <0xe61a8000 0x100>;
            interrupts = <GIC_SPI 67 IRQ_TYPE_LEVEL_HIGH>,
                         <GIC_SPI 68 IRQ_TYPE_LEVEL_HIGH>,
                         <GIC_SPI 69 IRQ_TYPE_LEVEL_HIGH>;
            clocks = <&cpg CPG_MOD 522>;
            power-domains = <&sysc R8A7795_PD_ALWAYS_ON>;
            resets = <&cpg 522>;
            #thermal-sensor-cells = <1>;
    };

    thermal-zones {
            sensor_thermal: sensor-thermal {
                    polling-delay-passive = <250>;
                    polling-delay = <1000>;
                    thermal-sensors = <&tsc 0>;

                    trips {
                            sensor1_crit: sensor1-crit {
                                    temperature = <90000>;
                                    hysteresis = <2000>;
                                    type = "critical";
                            };
                    };
            };
    };
  - |
    #include <dt-bindings/clock/r8a779a0-cpg-mssr.h>
    #include <dt-bindings/interrupt-controller/arm-gic.h>
    #include <dt-bindings/power/r8a779a0-sysc.h>

    tsc_r8a779a0: thermal@e6190000 {
            compatible = "renesas,r8a779a0-thermal";
            reg = <0xe6190000 0x200>,
                  <0xe6198000 0x200>,
                  <0xe61a0000 0x200>,
                  <0xe61a8000 0x200>,
                  <0xe61b0000 0x200>;
            clocks = <&cpg CPG_MOD 919>;
            power-domains = <&sysc R8A779A0_PD_ALWAYS_ON>;
            resets = <&cpg 919>;
            #thermal-sensor-cells = <1>;
    };
```

## Documentation/devicetree/bindings/thermal/rcar-thermal.txt
```
* Renesas R-Car Thermal

Required properties:
- compatible		: "renesas,thermal-<soctype>",
			   "renesas,rcar-gen2-thermal" (with thermal-zone) or
			   "renesas,rcar-thermal" (without thermal-zone) as
                           fallback except R-Car D3.
			  Examples with soctypes are:
			    - "renesas,thermal-r8a73a4" (R-Mobile APE6)
			    - "renesas,thermal-r8a7743" (RZ/G1M)
			    - "renesas,thermal-r8a7779" (R-Car H1)
			    - "renesas,thermal-r8a7790" (R-Car H2)
			    - "renesas,thermal-r8a7791" (R-Car M2-W)
			    - "renesas,thermal-r8a7792" (R-Car V2H)
			    - "renesas,thermal-r8a7793" (R-Car M2-N)
			    - "renesas,thermal-r8a77995" (R-Car D3)
- reg			: Address range of the thermal registers.
			  The 1st reg will be recognized as common register
			  if it has "interrupts".

Option properties:

- interrupts		: If present should contain 3 interrupts for
                          R-Car D3 or 1 interrupt otherwise.

Example (non interrupt support):

thermal@ffc48000 {
	compatible = "renesas,thermal-r8a7779", "renesas,rcar-thermal";
	reg = <0xffc48000 0x38>;
};

Example (interrupt support):

thermal@e61f0000 {
	compatible = "renesas,thermal-r8a73a4", "renesas,rcar-thermal";
	reg = <0xe61f0000 0x14
		0xe61f0100 0x38
		0xe61f0200 0x38
		0xe61f0300 0x38>;
	interrupts = <0 69 IRQ_TYPE_LEVEL_HIGH>;
};

Example (with thermal-zone):

thermal-zones {
	cpu_thermal: cpu-thermal {
		polling-delay-passive	= <1000>;
		polling-delay		= <5000>;

		thermal-sensors = <&thermal>;

		trips {
			cpu-crit {
				temperature	= <115000>;
				hysteresis	= <0>;
				type		= "critical";
			};
		};
		cooling-maps {
		};
	};
};

thermal: thermal@e61f0000 {
	compatible =	"renesas,thermal-r8a7790",
			"renesas,rcar-gen2-thermal",
			"renesas,rcar-thermal";
	reg = <0 0xe61f0000 0 0x14>, <0 0xe61f0100 0 0x38>;
	interrupts = <0 69 IRQ_TYPE_LEVEL_HIGH>;
	clocks = <&mstp5_clks R8A7790_CLK_THERMAL>;
	power-domains = <&cpg_clocks>;
	#thermal-sensor-cells = <0>;
};
```
