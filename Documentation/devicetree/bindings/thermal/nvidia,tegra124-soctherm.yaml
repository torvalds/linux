## Documentation/devicetree/bindings/thermal/rcar-thermal.yaml
```yaml
# SPDX-License-Identifier: GPL-2.0-only
# Copyright (C) 2020 Renesas Electronics Corp.
%YAML 1.2
---
$id: http://devicetree.org/schemas/thermal/rcar-thermal.yaml#
$schema: http://devicetree.org/meta-schemas/core.yaml#

title: Renesas R-Car Thermal

maintainers:
  - Niklas Söderlund <niklas.soderlund@ragnatech.se>

properties:
  compatible:
    oneOf:
      - items:
          - enum:
              - renesas,thermal-r8a73a4 # R-Mobile APE6
              - renesas,thermal-r8a7779 # R-Car H1
          - const: renesas,rcar-thermal # Generic without thermal-zone
      - items:
          - enum:
              - renesas,thermal-r8a7742 # RZ/G1H
              - renesas,thermal-r8a7743 # RZ/G1M
              - renesas,thermal-r8a7744 # RZ/G1N
          - const: renesas,rcar-gen2-thermal # Generic thermal-zone
      - items:
          - enum:
              - renesas,thermal-r8a7790 # R-Car H2
              - renesas,thermal-r8a7791 # R-Car M2-W
              - renesas,thermal-r8a7792 # R-Car V2H
              - renesas,thermal-r8a7793 # R-Car M2-N
          - const: renesas,rcar-gen2-thermal # Generic thermal-zone
          - const: renesas,rcar-thermal # Generic without thermal-zone
      - items:
          - enum:
              - renesas,thermal-r8a774c0 # RZ/G2E
              - renesas,thermal-r8a77970 # R-Car V3M
              - renesas,thermal-r8a77990 # R-Car E3
              - renesas,thermal-r8a77995 # R-Car D3
  reg:
    description:
      Address ranges of the thermal registers. If more then one range is given
      the first one must be the common registers followed by each sensor
      according to the datasheet.
    minItems: 1
    maxItems: 4

  interrupts:
    minItems: 1
    maxItems: 3

  clocks:
    maxItems: 1

  power-domains:
    maxItems: 1

  resets:
    maxItems: 1

  "#thermal-sensor-cells":
    const: 0

required:
  - compatible
  - reg

allOf:
  - if:
      not:
        properties:
          compatible:
            contains:
              enum:
                - renesas,thermal-r8a73a4 # R-Mobile APE6
                - renesas,thermal-r8a7779 # R-Car H1
    then:
      required:
        - resets
        - '#thermal-sensor-cells'

  - if:
      not:
        properties:
          compatible:
            contains:
              const: renesas,thermal-r8a7779 # R-Car H1
    then:
      required:
        - interrupts
        - clocks
        - power-domains

additionalProperties: false

examples:
  # Example (non interrupt support)
  - |
    thermal@ffc48000 {
        compatible = "renesas,thermal-r8a7779", "renesas,rcar-thermal";
        reg = <0xffc48000 0x38>;
    };

  # Example (interrupt support)
  - |
    #include <dt-bindings/clock/r8a73a4-clock.h>
    #include <dt-bindings/interrupt-controller/arm-gic.h>
    #include <dt-bindings/interrupt-controller/irq.h>

    thermal@e61f0000 {
        compatible = "renesas,thermal-r8a73a4", "renesas,rcar-thermal";
        reg = <0xe61f0000 0x14>, <0xe61f0100 0x38>,
              <0xe61f0200 0x38>, <0xe61f0300 0x38>;
        interrupts = <GIC_SPI 69 IRQ_TYPE_LEVEL_HIGH>;
        clocks = <&mstp5_clks R8A73A4_CLK_THERMAL>;
        power-domains = <&pd_c5>;
    };

  # Example (with thermal-zone)
  - |
    #include <dt-bindings/clock/r8a7790-cpg-mssr.h>
    #include <dt-bindings/interrupt-controller/arm-gic.h>
    #include <dt-bindings/power/r8a7790-sysc.h>

    thermal: thermal@e61f0000 {
        compatible = "renesas,thermal-r8a7790",
                     "renesas,rcar-gen2-thermal",
                     "renesas,rcar-thermal";
        reg = <0xe61f0000 0x10>, <0xe61f0100 0x38>;
        interrupts = <GIC_SPI 69 IRQ_TYPE_LEVEL_HIGH>;
        clocks = <&cpg CPG_MOD 522>;
        power-domains = <&sysc R8A7790_PD_ALWAYS_ON>;
        resets = <&cpg 522>;
        #thermal-sensor-cells = <0>;
    };

    thermal-zones {
        cpu_thermal: cpu-thermal {
            polling-delay-passive = <1000>;
            polling-delay = <5000>;

            thermal-sensors = <&thermal>;

            trips {
                cpu-crit {
                    temperature = <115000>;
                    hysteresis = <0>;
                    type = "critical";
                };
            };
            cooling-maps {
            };
        };
    };
```

## Documentation/devicetree/bindings/thermal/renesas,r9a08g045-tsu.yaml
```yaml
# SPDX-License-Identifier: (GPL-2.0-only OR BSD-2-Clause)
%YAML 1.2
---
$id: http://devicetree.org/schemas/thermal/renesas,r9a08g045-tsu.yaml#
$schema: http://devicetree.org/meta-schemas/core.yaml#

title: Renesas RZ/G3S Thermal Sensor Unit

description:
  The thermal sensor unit (TSU) measures the temperature(Tj) inside
  the LSI.

maintainers:
  - Claudiu Beznea <claudiu.beznea.uj@bp.renesas.com>

$ref: thermal-sensor.yaml#

properties:
  compatible:
    const: renesas,r9a08g045-tsu

  reg:
    maxItems: 1

  clocks:
    items:
      - description: TSU module clock

  power-domains:
    maxItems: 1

  resets:
    items:
      - description: TSU module reset

  io-channels:
    items:
      - description: ADC channel which reports the TSU temperature

  io-channel-names:
    items:
      - const: tsu

  "#thermal-sensor-cells":
    const: 0

required:
  - compatible
  - reg
  - clocks
  - power-domains
  - resets
  - io-channels
  - io-channel-names
  - '#thermal-sensor-cells'

additionalProperties: false

examples:
  - |
    #include <dt-bindings/clock/r9a08g045-cpg.h>

    tsu: thermal@10059000 {
        compatible = "renesas,r9a08g045-tsu";
        reg = <0x10059000 0x1000>;
        clocks = <&cpg CPG_MOD R9A08G045_TSU_PCLK>;
        resets = <&cpg R9A08G045_TSU_PRESETN>;
        power-domains = <&cpg>;
        #thermal-sensor-cells = <0>;
        io-channels = <&adc 8>;
        io-channel-names = "tsu";
    };

    thermal-zones {
        cpu-thermal {
            polling-delay-passive = <250>;
            polling-delay = <1000>;
            thermal-sensors = <&tsu>;

            trips {
                sensor_crit: sensor-crit {
                    temperature = <125000>;
                    hysteresis = <1000>;
                    type = "critical";
                };
                target: trip-point {
                    temperature = <100000>;
                    hysteresis = <1000>;
                    type = "passive";
                };
            };
        };
    };
```

## Documentation/devicetree/bindings/thermal/renesas,r9a09g047-tsu.yaml
```yaml
# SPDX-License-Identifier: (GPL-2.0-only OR BSD-2-Clause)
%YAML 1.2
---
$id: http://devicetree.org/schemas/thermal/renesas,r9a09g047-tsu.yaml#
$schema: http://devicetree.org/meta-schemas/core.yaml#

title: Renesas RZ/G3E Temperature Sensor Unit (TSU)

maintainers:
  - John Madieu <john.madieu.xa@bp.renesas.com>

description:
  The Temperature Sensor Unit (TSU) is an integrated thermal sensor that
  monitors the chip temperature on the Renesas RZ/G3E SoC. The TSU provides
  real-time temperature measurements for thermal management.

properties:
  compatible:
    const: renesas,r9a09g047-tsu

  reg:
    maxItems: 1

  clocks:
    maxItems: 1

  resets:
    maxItems: 1

  power-domains:
    maxItems: 1

  interrupts:
    items:
      - description: Conversion complete interrupt signal (pulse)
      - description: Comparison result interrupt signal (level)

  interrupt-names:
    items:
      - const: adi
      - const: adcmpi

  "#thermal-sensor-cells":
    const: 0

  renesas,tsu-trim:
    $ref: /schemas/types.yaml#/definitions/phandle-array
    items:
      - items:
          - description: phandle to system controller
          - description: offset of trim registers
    description:
      Phandle and offset to the system controller containing the TSU
      calibration trim values. The offset points to the first trim register
      (OTPTSU1TRMVAL0), with the second trim register (OTPTSU1TRMVAL1) located
      at offset + 4.

required:
  - compatible
  - reg
  - clocks
  - resets
  - power-domains
  - interrupts
  - interrupt-names
  - "#thermal-sensor-cells"
  - renesas,tsu-trim

additionalProperties: false

examples:
  - |
    #include <dt-bindings/clock/renesas,r9a09g047-cpg.h>
    #include <dt-bindings/interrupt-controller/arm-gic.h>

    thermal-sensor@14002000 {
        compatible = "renesas,r9a09g047-tsu";
        reg = <0x14002000 0x1000>;
        clocks = <&cpg CPG_MOD 0x10a>;
        resets = <&cpg 0xf8>;
        power-domains = <&cpg>;
        interrupts = <GIC_SPI 250 IRQ_TYPE_EDGE_RISING>,
                     <GIC_SPI 251 IRQ_TYPE_LEVEL_HIGH>;
        interrupt-names = "adi", "adcmpi";
        #thermal-sensor-cells = <0>;
        renesas,tsu-trim = <&sys 0x330>;
    };
```

## Documentation/devicetree/bindings/thermal/rockchip-thermal.txt
```
* Temperature Sensor ADC (TSADC) on rockchip SoCs

Required properties:
- compatible : should be "rockchip,<name>-tsadc"
   "rockchip,px30-tsadc":   found on PX30 SoCs
   "rockchip,rv1108-tsadc": found on RV1108 SoCs
   "rockchip,rv1126-tsadc": found on RV1126 SoCs
   "rockchip,rk1808-tsadc": found on RK1808 SoCs
   "rockchip,rk3228-tsadc": found on RK3228 SoCs
   "rockchip,rk3288-tsadc": found on RK3288 SoCs
   "rockchip,rk3328-tsadc": found on RK3328 SoCs
   "rockchip,rk3368-tsadc": found on RK3368 SoCs
   "rockchip,rk3399-tsadc": found on RK3399 SoCs
   "rockchip,rk3568-tsadc": found on RK3568 SoCs
   "rockchip,rk3588-tsadc": found on RK3588 SoCs
- reg : physical base address of the controller and length of memory mapped
	region.
- interrupts : The interrupt number to the cpu. The interrupt specifier format
	       depends on the interrupt controller.
- clocks : Must contain an entry for each entry in clock-names.
- clock-names : Shall be "tsadc" for the converter-clock, and "apb_pclk" for
		the peripheral clock.
- resets : Must contain an entry for each entry in reset-names.
	   See ../reset/reset.txt for details.
- reset-names : Must include the name "tsadc-apb".
- pinctrl-names : The pin control state names;
- pinctrl-0 : The "gpio" pinctrl state, it will be set if tsadc via reset
	      CRU when tshut.
- pinctrl-1 : The "otpout" pinctrl state, it will be set if tsadc via set
	      otpout_gpio when tshut.
- #thermal-sensor-cells : Should be 1. See Documentation/devicetree/bindings/thermal/thermal-sensor.yaml for a description.

Optional properties:
- rockchip,hw-tshut-temp : The hardware-controlled shutdown temperature value.
- rockchip,hw-tshut-mode : The hardware-controlled shutdown mode 0:CRU 1:GPIO.
- rockchip,hw-tshut-polarity : The hardware-controlled active polarity 0:LOW
			       1:HIGH.
- rockchip,grf : The phandle of the syscon node for the general register file.

Exiample:
tsadc: tsadc@ff280000 {
	compatible = "rockchip,rk3288-tsadc";
	reg = <0xff280000 0x100>;
	interrupts = <GIC_SPI 37 IRQ_TYPE_LEVEL_HIGH>;
	clocks = <&cru SCLK_TSADC>, <&cru PCLK_TSADC>;
	clock-names = "tsadc", "apb_pclk";
	resets = <&cru SRST_TSADC>;
	reset-names = "tsadc-apb";
	pinctrl-names = "gpio", "otpout";
	pinctrl-0 = <&otp_pin>;
	pinctrl-1 = <&otp_out>;
	#thermal-sensor-cells = <1>;
	rockchip,hw-tshut-temp = <95000>;
	rockchip,hw-tshut-mode = <0>;
	rockchip,hw-tshut-polarity = <0>;
};

Example: referring to thermal sensors:
thermal-zones {
	cpu_thermal: cpu_thermal {
		polling-delay-passive = <1000>; /* milliseconds */
		polling-delay = <5000>; /* milliseconds */

		/* sensor	ID */
		thermal-sensors = <&tsadc	1>;

		trips {
			cpu_alert0: cpu_alert {
				temperature = <70000>; /* millicelsius */
				hysteresis = <2000>; /* millicelsius */
				type = "passive";
			};
			cpu_crit: cpu_crit {
				temperature = <90000>; /* millicelsius */
				hysteresis = <2000>; /* millicelsius */
				type = "critical";
			};
		};

		cooling-maps {
			map0 {
				trip = <&cpu_alert0>;
				cooling-device =
				    <&cpu0 THERMAL_NO_LIMIT THERMAL_NO_LIMIT>;
			};
		};
	};
};
```

## Documentation/devicetree/bindings/thermal/rockchip-thermal.yaml
```yaml
# SPDX-License-Identifier: GPL-2.0-only
%YAML 1.2
---
$id: http://devicetree.org/schemas/thermal/rockchip-thermal.yaml#
$schema: http://devicetree.org/meta-schemas/core.yaml#

title: Temperature Sensor ADC (TSADC) on Rockchip SoCs

maintainers:
  - Heiko Stuebner <heiko@sntech.de>

$ref: thermal-sensor.yaml#

properties:
  compatible:
    enum:
      - rockchip,px30-tsadc
      - rockchip,rk3228-tsadc
      - rockchip,rk3288-tsadc
      - rockchip,rk3328-tsadc
      - rockchip,rk3368-tsadc
      - rockchip,rk3399-tsadc
      - rockchip,rk3568-tsadc
      - rockchip,rk3576-tsadc
      - rockchip,rk3588-tsadc
      - rockchip,rv1108-tsadc

  reg:
    maxItems: 1

  interrupts:
    maxItems: 1

  clocks:
    minItems: 2
    maxItems: 2

  clock-names:
    items:
      - const: tsadc
      - const: apb_pclk

  nvmem-cells:
    items:
      - description: cell handle to where the trim's base temperature is stored
      - description:
          cell handle to where the trim's tenths of Celsius base value is stored

  nvmem-cell-names:
    items:
      - const: trim_base
      - const: trim_base_frac

  resets:
    minItems: 1
    maxItems: 3

  reset-names:
    minItems: 1
    items:
      - const: tsadc-apb
      - const: tsadc
      - const: tsadc-phy

  "#address-cells":
    const: 1

  "#size-cells":
    const: 0

  "#thermal-sensor-cells":
    const: 1

  rockchip,grf:
    description: The phandle of the syscon node for the general register file.
    $ref: /schemas/types.yaml#/definitions/phandle

  rockchip,hw-tshut-temp:
    description: The hardware-controlled shutdown temperature value.
    $ref: /schemas/types.yaml#/definitions/uint32

  rockchip,hw-tshut-mode:
    description: The hardware-controlled shutdown mode 0:CRU 1:GPIO.
    $ref: /schemas/types.yaml#/definitions/uint32
    enum: [0, 1]

  rockchip,hw-tshut-polarity:
    description: The hardware-controlled active polarity 0:LOW 1:HIGH.
    $ref: /schemas/types.yaml#/definitions/uint32
    enum: [0, 1]

patternProperties:
  "@[0-9a-f]+$":
    type: object
    properties:
      reg:
        maxItems: 1
        description: sensor ID, a.k.a. channel number

      nvmem-cells:
        items:
          - description: handle of cell containing calibration data

      nvmem-cell-names:
        items:
          - const: trim

    required:
      - reg

    unevaluatedProperties: false

required:
  - compatible
  - reg
  - interrupts
  - clocks
  - clock-names
  - resets

allOf:
  - if:
      properties:
        compatible:
          contains:
            enum:
              - rockchip,px30-tsadc
              - rockchip,rk3366-tsadc
              - rockchip,rk3399-tsadc
              - rockchip,rk3568-tsadc
    then:
      required:
        - rockchip,grf
    else:
      properties:
        rockchip,grf: false
  - if:
      not:
        properties:
          compatible:
            contains:
              const: rockchip,rk3568-tsadc
    then:
      properties:
        nvmem-cells: false
        nvmem-cell-names: false
  - if:
      not:
        properties:
          compatible:
            contains:
              enum:
                - rockchip,rk3568-tsadc
                - rockchip,rk3576-tsadc
    then:
      patternProperties:
        "@[0-9a-f]+$": false

unevaluatedProperties: false

examples:
  - |
    #include <dt-bindings/interrupt-controller/arm-gic.h>
    #include <dt-bindings/clock/rk3288-cru.h>

    tsadc: tsadc@ff280000 {
        compatible = "rockchip,rk3288-tsadc";
        reg = <0xff280000 0x100>;
        interrupts = <GIC_SPI 37 IRQ_TYPE_LEVEL_HIGH>;
        clocks = <&cru SCLK_TSADC>, <&cru PCLK_TSADC>;
        clock-names = "tsadc", "apb_pclk";
        resets = <&cru SRST_TSADC>;
        reset-names = "tsadc-apb";
        #thermal-sensor-cells = <1>;
        rockchip,hw-tshut-temp = <95000>;
        rockchip,hw-tshut-mode = <0>;
        rockchip,hw-tshut-polarity = <0>;
    };
```
