## Documentation/devicetree/bindings/thermal/ti,am654-thermal.yaml
```yaml
# SPDX-License-Identifier: (GPL-2.0-only OR BSD-2-Clause)
%YAML 1.2
---
$id: http://devicetree.org/schemas/thermal/ti,am654-thermal.yaml#
$schema: http://devicetree.org/meta-schemas/core.yaml#

title: Texas Instruments AM654 VTM (DTS) binding

maintainers:
  - Keerthy <j-keerthy@ti.com>

properties:
  compatible:
    const: ti,am654-vtm

  reg:
    maxItems: 1

  power-domains:
    maxItems: 1

  "#thermal-sensor-cells":
    const: 1

required:
  - compatible
  - reg
  - power-domains
  - "#thermal-sensor-cells"

additionalProperties: false

examples:
  - |
    #include <dt-bindings/soc/ti,sci_pm_domain.h>
    vtm: thermal@42050000 {
        compatible = "ti,am654-vtm";
        reg = <0x42050000 0x25c>;
        power-domains = <&k3_pds 80 TI_SCI_PD_EXCLUSIVE>;
        #thermal-sensor-cells = <1>;
    };

    mpu0_thermal: mpu0_thermal {
        polling-delay-passive = <250>; /* milliseconds */
        polling-delay = <500>; /* milliseconds */
        thermal-sensors = <&vtm0 0>;

        trips {
                mpu0_crit: mpu0_crit {
                        temperature = <125000>; /* milliCelsius */
                        hysteresis = <2000>; /* milliCelsius */
                        type = "critical";
                };
        };
    };
...
```

## Documentation/devicetree/bindings/thermal/ti,j72xx-thermal.yaml
```yaml
# SPDX-License-Identifier: (GPL-2.0-only OR BSD-2-Clause)
%YAML 1.2
---
$id: http://devicetree.org/schemas/thermal/ti,j72xx-thermal.yaml#
$schema: http://devicetree.org/meta-schemas/core.yaml#

title: Texas Instruments J72XX VTM (DTS) binding

maintainers:
  - Keerthy <j-keerthy@ti.com>

properties:
  compatible:
    enum:
      - ti,j721e-vtm
      - ti,j7200-vtm

  reg:
    items:
      - description: VTM cfg1 register space
      - description: VTM cfg2 register space
      - description: VTM efuse register space

  power-domains:
    maxItems: 1

  "#thermal-sensor-cells":
    const: 1

required:
  - compatible
  - reg
  - power-domains
  - "#thermal-sensor-cells"

additionalProperties: false

examples:
  - |
    #include <dt-bindings/soc/ti,sci_pm_domain.h>
    wkup_vtm0: thermal-sensor@42040000 {
        compatible = "ti,j721e-vtm";
        reg = <0x42040000 0x350>,
              <0x42050000 0x350>,
              <0x43000300 0x10>;
        power-domains = <&k3_pds 154 TI_SCI_PD_EXCLUSIVE>;
        #thermal-sensor-cells = <1>;
    };

    mpu_thermal: mpu-thermal {
        polling-delay-passive = <250>; /* milliseconds */
        polling-delay = <500>; /* milliseconds */
        thermal-sensors = <&wkup_vtm0 0>;

        trips {
            mpu_crit: mpu-crit {
                temperature = <125000>; /* milliCelsius */
                hysteresis = <2000>; /* milliCelsius */
                type = "critical";
            };
        };
    };
...
```

## Documentation/devicetree/bindings/thermal/ti_soc_thermal.txt
```
* Texas Instrument OMAP SCM bandgap bindings

In the System Control Module, OMAP supplies a voltage reference
and a temperature sensor feature that are gathered in the band
gap voltage and temperature sensor (VBGAPTS) module. The band
gap provides current and voltage reference for its internal
circuits and other analog IP blocks. The analog-to-digital
converter (ADC) produces an output value that is proportional
to the silicon temperature.

Required properties:
- compatible : Should be:
  - "ti,omap4430-bandgap" : for OMAP4430 bandgap
  - "ti,omap4460-bandgap" : for OMAP4460 bandgap
  - "ti,omap4470-bandgap" : for OMAP4470 bandgap
  - "ti,omap5430-bandgap" : for OMAP5430 bandgap
- interrupts : this entry should indicate which interrupt line
the talert signal is routed to;
Specific:
- ti,tshut-gpio : this entry should be used to inform which GPIO
line the tshut signal is routed to;
- regs : this entry must also be specified and it is specific
to each bandgap version, because the mapping may change from
soc to soc, apart of depending on available features.

Example:
OMAP4430:
bandgap {
	reg = <0x4a002260 0x4 0x4a00232C 0x4>;
	compatible = "ti,omap4430-bandgap";
};

OMAP4460:
bandgap {
	reg = <0x4a002260 0x4
		0x4a00232C 0x4
		0x4a002378 0x18>;
	compatible = "ti,omap4460-bandgap";
	interrupts = <0 126 4>; /* talert */
	ti,tshut-gpio = <86>;
};

OMAP4470:
bandgap {
	reg = <0x4a002260 0x4
		0x4a00232C 0x4
		0x4a002378 0x18>;
	compatible = "ti,omap4470-bandgap";
	interrupts = <0 126 4>; /* talert */
	ti,tshut-gpio = <86>;
};

OMAP5430:
bandgap {
	reg = <0x4a0021e0 0xc
		0x4a00232c 0xc
		0x4a002380 0x2c
		0x4a0023C0 0x3c>;
	compatible = "ti,omap5430-bandgap";
	interrupts = <0 126 4>; /* talert */
};
```

## Documentation/devicetree/bindings/thermal/uniphier-thermal.txt
```
* UniPhier Thermal bindings

This describes the devicetree bindings for thermal monitor supported by
PVT(Process, Voltage and Temperature) monitoring unit implemented on Socionext
UniPhier SoCs.

Required properties:
- compatible :
  - "socionext,uniphier-pxs2-thermal" : For UniPhier PXs2 SoC
  - "socionext,uniphier-ld20-thermal" : For UniPhier LD20 SoC
- interrupts : IRQ for the temperature alarm
- #thermal-sensor-cells : Should be 0. See ./thermal.txt for details.

Optional properties:
- socionext,tmod-calibration: A pair of calibrated values referred from PVT,
                              in case that the values aren't set on SoC,
                              like a reference board.

Example:

	sysctrl@61840000 {
		compatible = "socionext,uniphier-ld20-sysctrl",
			     "simple-mfd", "syscon";
		reg = <0x61840000 0x10000>;
		...
		pvtctl: pvtctl {
			compatible = "socionext,uniphier-ld20-thermal";
			interrupts = <0 3 1>;
			#thermal-sensor-cells = <0>;
		};
		...
	};

	thermal-zones {
		cpu_thermal {
			polling-delay-passive = <250>;	/* 250ms */
			polling-delay = <1000>;		/* 1000ms */
			thermal-sensors = <&pvtctl>;

			trips {
				cpu_crit: cpu_crit {
					temperature = <110000>;	/* 110C */
					hysteresis = <2000>;
					type = "critical";
				};
				cpu_alert: cpu_alert {
					temperature = <100000>;	/* 100C */
					hysteresis = <2000>;
					type = "passive";
				};
			};

			cooling-maps {
				map0 {
					trip = <&cpu_alert>;
					cooling-device = <&cpu0 (-1) (-1)>;
				};
				map1 {
					trip = <&cpu_alert>;
					cooling-device = <&cpu2 (-1) (-1)>;
				};
			};
		};
	};
```

## Documentation/devicetree/bindings/thermal/zx2967-thermal.txt
```
* ZTE zx2967 family Thermal

Required Properties:
- compatible: should be one of the following.
    * zte,zx296718-thermal
- reg: physical base address of the controller and length of memory mapped
    region.
- clocks : Pairs of phandle and specifier referencing the controller's clocks.
- clock-names: "topcrm" for the topcrm clock.
	       "apb" for the apb clock.
- #thermal-sensor-cells: must be 0.

Please note: slope coefficient defined in thermal-zones section need to be
multiplied by 1000.

Example for tempsensor:

	tempsensor: tempsensor@148a000 {
		compatible = "zte,zx296718-thermal";
		reg = <0x0148a000 0x20>;
		clocks = <&topcrm TEMPSENSOR_GATE>, <&audiocrm AUDIO_TS_PCLK>;
		clock-names = "topcrm", "apb";
		#thermal-sensor-cells = <0>;
	};

Example for cooling device:

	cooling_dev: cooling_dev {
		cluster0_cooling_dev: cluster0-cooling-dev {
			#cooling-cells = <2>;
			cpumask = <0xf>;
			capacitance = <1500>;
		};

	cluster1_cooling_dev: cluster1-cooling-dev {
			#cooling-cells = <2>;
			cpumask = <0x30>;
			capacitance = <2000>;
		};
	};

Example for thermal zones:

	thermal-zones {
		zx296718_thermal: zx296718_thermal {
			polling-delay-passive = <500>;
			polling-delay = <1000>;
			sustainable-power = <6500>;

			thermal-sensors = <&tempsensor 0>;
			/*
			 * slope need to be multiplied by 1000.
			 */
			coefficients = <1951 (-922)>;

			trips {
				trip0: switch_on_temperature {
					temperature = <90000>;
					hysteresis = <2000>;
					type = "passive";
				};

				trip1: desired_temperature {
					temperature = <100000>;
					hysteresis = <2000>;
					type = "passive";
				};

				crit: critical_temperature {
					temperature = <110000>;
					hysteresis = <2000>;
					type = "critical";
				};
			};

			cooling-maps {
				map0 {
					trip = <&trip0>;
					cooling-device = <&gpu 2 5>;
				};

				map1 {
					trip = <&trip0>;
					cooling-device = <&cluster0_cooling_dev 1 2>;
				};

				map2 {
					trip = <&trip1>;
					cooling-device = <&cluster0_cooling_dev 1 2>;
				};

				map3 {
					trip = <&crit>;
					cooling-device = <&cluster0_cooling_dev 1 2>;
				};

				map4 {
					trip = <&trip0>;
					cooling-device = <&cluster1_cooling_dev 1 2>;
					contribution = <9000>;
				};

				map5 {
					trip = <&trip1>;
					cooling-device = <&cluster1_cooling_dev 1 2>;
					contribution = <4096>;
				};

				map6 {
					trip = <&crit>;
					cooling-device = <&cluster1_cooling_dev 1 2>;
					contribution = <4096>;
				};
			};
		};
	};
```

## Documentation/devicetree/bindings/timer/actions,owl-timer.txt
```
Actions Semi Owl Timer

Required properties:
- compatible      :  "actions,s500-timer" for S500
                     "actions,s900-timer" for S900
- reg             :  Offset and length of the register set for the device.
- interrupts      :  Should contain the interrupts.
- interrupt-names :  Valid names are: "2hz0", "2hz1",
                                      "timer0", "timer1", "timer2", "timer3"
                     See ../resource-names.txt

Example:

		timer@b0168000 {
			compatible = "actions,s500-timer";
			reg = <0xb0168000 0x100>;
			interrupts = <GIC_SPI 10 IRQ_TYPE_LEVEL_HIGH>,
			             <GIC_SPI 11 IRQ_TYPE_LEVEL_HIGH>;
			interrupt-names = "timer0", "timer1";
		};
```

## Documentation/devicetree/bindings/timer/actions,owl-timer.yaml
```yaml
# SPDX-License-Identifier: GPL-2.0-only OR BSD-2-Clause
%YAML 1.2
---
$id: http://devicetree.org/schemas/timer/actions,owl-timer.yaml#
$schema: http://devicetree.org/meta-schemas/core.yaml#

title: Actions Semi Owl timer

maintainers:
  - Andreas Färber <afaerber@suse.de>

description:
  Actions Semi Owl SoCs provide 32bit and 2Hz timers.
  The 32bit timers support dynamic irq, as well as one-shot mode.

properties:
  compatible:
    enum:
      - actions,s500-timer
      - actions,s700-timer
      - actions,s900-timer

  clocks:
    maxItems: 1

  interrupts:
    minItems: 1
    maxItems: 6

  interrupt-names:
    minItems: 1
    maxItems: 6
    items:
      enum:
        - 2hz0
        - 2hz1
        - timer0
        - timer1
        - timer2
        - timer3

  reg:
    maxItems: 1

required:
  - compatible
  - clocks
  - interrupts
  - interrupt-names
  - reg

allOf:
  - if:
      properties:
        compatible:
          contains:
            enum:
              - actions,s500-timer
    then:
      properties:
        interrupts:
          minItems: 4
          maxItems: 4
        interrupt-names:
          items:
            - const: 2hz0
            - const: 2hz1
            - const: timer0
            - const: timer1

  - if:
      properties:
        compatible:
          contains:
            enum:
              - actions,s700-timer
              - actions,s900-timer
    then:
      properties:
        interrupts:
          minItems: 1
          maxItems: 1
        interrupt-names:
          items:
            - const: timer1

additionalProperties: false

examples:
  - |
    #include <dt-bindings/interrupt-controller/arm-gic.h>
    #include <dt-bindings/interrupt-controller/irq.h>
    soc {
      #address-cells = <1>;
      #size-cells = <1>;
      timer@b0168000 {
        compatible = "actions,s500-timer";
        reg = <0xb0168000 0x100>;
        clocks = <&hosc>;
        interrupts = <GIC_SPI 8 IRQ_TYPE_LEVEL_HIGH>,
                     <GIC_SPI 9 IRQ_TYPE_LEVEL_HIGH>,
                     <GIC_SPI 10 IRQ_TYPE_LEVEL_HIGH>,
                     <GIC_SPI 11 IRQ_TYPE_LEVEL_HIGH>;
        interrupt-names = "2hz0", "2hz1", "timer0", "timer1";
      };
    };
...
```

## Documentation/devicetree/bindings/timer/allwinner,sun4i-a10-timer.yaml
```yaml
# SPDX-License-Identifier: GPL-2.0
%YAML 1.2
---
$id: http://devicetree.org/schemas/timer/allwinner,sun4i-a10-timer.yaml#
$schema: http://devicetree.org/meta-schemas/core.yaml#

title: Allwinner A10 Timer Device Tree Bindings

maintainers:
  - Chen-Yu Tsai <wens@csie.org>
  - Maxime Ripard <mripard@kernel.org>

properties:
  compatible:
    enum:
      - allwinner,sun4i-a10-timer
      - allwinner,sun8i-a23-timer
      - allwinner,sun8i-v3s-timer
      - allwinner,suniv-f1c100s-timer

  reg:
    maxItems: 1

  interrupts:
    description:
      List of timers interrupts

  clocks:
    maxItems: 1

allOf:
  - if:
      properties:
        compatible:
          items:
            const: allwinner,sun4i-a10-timer

    then:
      properties:
        interrupts:
          minItems: 6
          maxItems: 6

  - if:
      properties:
        compatible:
          items:
            const: allwinner,sun8i-a23-timer

    then:
      properties:
        interrupts:
          minItems: 2
          maxItems: 2

  - if:
      properties:
        compatible:
          items:
            const: allwinner,sun8i-v3s-timer

    then:
      properties:
        interrupts:
          minItems: 3
          maxItems: 3

  - if:
      properties:
        compatible:
          items:
            const: allwinner,suniv-f1c100s-timer

    then:
      properties:
        interrupts:
          minItems: 3
          maxItems: 3

required:
  - compatible
  - reg
  - interrupts
  - clocks

additionalProperties: false

examples:
  - |
    timer@1c20c00 {
        compatible = "allwinner,sun4i-a10-timer";
        reg = <0x01c20c00 0x400>;
        interrupts = <22>,
                     <23>,
                     <24>,
                     <25>,
                     <67>,
                     <68>;
        clocks = <&osc>;
    };

...
```

## Documentation/devicetree/bindings/timer/allwinner,sun4i-timer.txt
```
Allwinner A1X SoCs Timer Controller

Required properties:

- compatible : should be "allwinner,sun4i-a10-timer"
- reg : Specifies base physical address and size of the registers.
- interrupts : The interrupt of the first timer
- clocks: phandle to the source clock (usually a 24 MHz fixed clock)

Example:

timer {
	compatible = "allwinner,sun4i-a10-timer";
	reg = <0x01c20c00 0x400>;
	interrupts = <22>;
	clocks = <&osc>;
};
```

## Documentation/devicetree/bindings/timer/allwinner,sun5i-a13-hstimer.txt
```
Allwinner SoCs High Speed Timer Controller

Required properties:

- compatible :	should be "allwinner,sun5i-a13-hstimer" or
		"allwinner,sun7i-a20-hstimer"
- reg : Specifies base physical address and size of the registers.
- interrupts :	The interrupts of these timers (2 for the sun5i IP, 4 for the sun7i
		one)
- clocks: phandle to the source clock (usually the AHB clock)

Optional properties:
- resets: phandle to a reset controller asserting the timer

Example:

timer@01c60000 {
	compatible = "allwinner,sun7i-a20-hstimer";
	reg = <0x01c60000 0x1000>;
	interrupts = <0 51 1>,
		     <0 52 1>,
		     <0 53 1>,
		     <0 54 1>;
	clocks = <&ahb1_gates 19>;
	resets = <&ahb1rst 19>;
};
```
