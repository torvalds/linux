## Documentation/devicetree/bindings/timer/allwinner,sun5i-a13-hstimer.yaml
```yaml
# SPDX-License-Identifier: GPL-2.0
%YAML 1.2
---
$id: http://devicetree.org/schemas/timer/allwinner,sun5i-a13-hstimer.yaml#
$schema: http://devicetree.org/meta-schemas/core.yaml#

title: Allwinner A13 High-Speed Timer

maintainers:
  - Chen-Yu Tsai <wens@csie.org>
  - Maxime Ripard <mripard@kernel.org>

properties:
  compatible:
    oneOf:
      - const: allwinner,sun5i-a13-hstimer
      - const: allwinner,sun7i-a20-hstimer
      - items:
          - const: allwinner,sun6i-a31-hstimer
          - const: allwinner,sun7i-a20-hstimer

  reg:
    maxItems: 1

  interrupts:
    minItems: 2
    items:
      - description: Timer 0 Interrupt
      - description: Timer 1 Interrupt
      - description: Timer 2 Interrupt
      - description: Timer 3 Interrupt

  clocks:
    maxItems: 1

  resets:
    maxItems: 1

required:
  - compatible
  - reg
  - interrupts
  - clocks

if:
  properties:
    compatible:
      const: allwinner,sun5i-a13-hstimer

then:
  properties:
    interrupts:
      minItems: 2
      maxItems: 2

else:
  properties:
    interrupts:
      minItems: 4
      maxItems: 4

additionalProperties: false

examples:
  - |
    timer@1c60000 {
        compatible = "allwinner,sun7i-a20-hstimer";
        reg = <0x01c60000 0x1000>;
        interrupts = <0 51 1>,
                     <0 52 1>,
                     <0 53 1>,
                     <0 54 1>;
        clocks = <&ahb1_gates 19>;
        resets = <&ahb1rst 19>;
    };

...
```

## Documentation/devicetree/bindings/timer/altr,timer-1.0.yaml
```yaml
# SPDX-License-Identifier: (GPL-2.0-only OR BSD-2-Clause)
%YAML 1.2
---
$id: http://devicetree.org/schemas/altr,timer-1.0.yaml#
$schema: http://devicetree.org/meta-schemas/core.yaml#

title: Altera Timer

maintainers:
  - Dinh Nguyen <dinguyen@kernel.org>

properties:
  compatible:
    const: altr,timer-1.0

  reg:
    maxItems: 1

  interrupts:
    maxItems: 1

  clock-frequency:
    description: Frequency of the clock that drives the counter, in Hz.

required:
  - compatible
  - reg
  - interrupts

additionalProperties: false

examples:
  - |
    timer@400000 {
        compatible = "altr,timer-1.0";
        reg = <0x00400000 0x00000020>;
        interrupts = <11>;
        clock-frequency = <125000000>;
    };
```
