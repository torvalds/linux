## Documentation/devicetree/bindings/thermal/st,stih407-thermal.yaml
```yaml
# SPDX-License-Identifier: (GPL-2.0-only OR BSD-2-Clause)
%YAML 1.2
---
$id: http://devicetree.org/schemas/thermal/st,stih407-thermal.yaml#
$schema: http://devicetree.org/meta-schemas/core.yaml#

title: STMicroelectronics STi digital thermal sensor (DTS)

maintainers:
  - Patrice Chotard <patrice.chotard@foss.st.com>
  - Lee Jones <lee@kernel.org>

allOf:
  - $ref: thermal-sensor.yaml

properties:
  compatible:
    const: st,stih407-thermal

  reg:
    maxItems: 1

  clocks:
    maxItems: 1

  clock-names:
    items:
      - const: thermal

  interrupts:
    description:
      For thermal sensors for which no interrupt has been defined, a polling
      delay of 1000ms will be used to read the temperature from device.
    maxItems: 1

  '#thermal-sensor-cells':
    const: 0

required:
  - compatible
  - reg
  - clocks
  - clock-names

unevaluatedProperties: false

examples:
  - |
    #include <dt-bindings/interrupt-controller/arm-gic.h>
    temperature-sensor@91a0000 {
        compatible = "st,stih407-thermal";
        reg = <0x91a0000 0x28>;
        clock-names = "thermal";
        clocks = <&CLK_SYSIN>;
        interrupts = <GIC_SPI 205 IRQ_TYPE_EDGE_RISING>;
        #thermal-sensor-cells = <0>;
    };
...
```

## Documentation/devicetree/bindings/thermal/st,stm32-thermal.yaml
```yaml
# SPDX-License-Identifier: (GPL-2.0-only OR BSD-2-Clause)
%YAML 1.2
---
$id: http://devicetree.org/schemas/thermal/st,stm32-thermal.yaml#
$schema: http://devicetree.org/meta-schemas/core.yaml#

title: STMicroelectronics STM32 digital thermal sensor (DTS)

maintainers:
  - Pascal Paillet <p.paillet@foss.st.com>

properties:
  compatible:
    const: st,stm32-thermal

  reg:
    maxItems: 1

  interrupts:
    maxItems: 1

  clocks:
    maxItems: 1

  clock-names:
    items:
      - const: pclk

  "#thermal-sensor-cells":
    const: 0

required:
  - "#thermal-sensor-cells"
  - compatible
  - reg
  - interrupts
  - clocks
  - clock-names

additionalProperties: false

examples:
  - |
    #include <dt-bindings/interrupt-controller/arm-gic.h>
    #include <dt-bindings/clock/stm32mp1-clks.h>
    dts: thermal@50028000 {
        compatible = "st,stm32-thermal";
        reg = <0x50028000 0x100>;
        clocks = <&rcc TMPSENS>;
        clock-names = "pclk";
        #thermal-sensor-cells = <0>;
        interrupts = <GIC_SPI 147 IRQ_TYPE_LEVEL_HIGH>;
    };

    thermal-zones {
        cpu_thermal: cpu-thermal {
            polling-delay-passive = <0>;
            polling-delay = <0>;

            thermal-sensors = <&dts>;
            trips {
                cpu_alert1: cpu-alert1 {
                    temperature = <85000>;
                    hysteresis = <0>;
                    type = "passive";
                };

                cpu_crit: cpu-crit {
                    temperature = <120000>;
                    hysteresis = <0>;
                    type = "critical";
                };
            };

            cooling-maps {
            };
        };
    };
...
```

## Documentation/devicetree/bindings/thermal/st,thermal-spear1340.yaml
```yaml
# SPDX-License-Identifier: (GPL-2.0-only OR BSD-2-Clause)
%YAML 1.2
---
$id: http://devicetree.org/schemas/thermal/st,thermal-spear1340.yaml#
$schema: http://devicetree.org/meta-schemas/core.yaml#

title: SPEAr Thermal Sensor

maintainers:
  - Viresh Kumar <vireshk@kernel.org>

properties:
  compatible:
    const: st,thermal-spear1340

  reg:
    maxItems: 1

  st,thermal-flags:
    description: flags used to enable thermal sensor
    $ref: /schemas/types.yaml#/definitions/uint32

required:
  - compatible
  - reg
  - st,thermal-flags

additionalProperties: false

examples:
  - |
    thermal@fc000000 {
      compatible = "st,thermal-spear1340";
      reg = <0xfc000000 0x1000>;
      st,thermal-flags = <0x7000>;
    };
```

## Documentation/devicetree/bindings/thermal/st-thermal.txt
```
Binding for Thermal Sensor driver for STMicroelectronics STi series of SoCs.

Required parameters:
-------------------

compatible : 	Should be "st,stih407-thermal"

clock-names : 	Should be "thermal".
		  See: Documentation/devicetree/bindings/resource-names.txt
clocks : 	Phandle of the clock used by the thermal sensor.
		  See: Documentation/devicetree/bindings/clock/clock-bindings.txt

Optional parameters:
-------------------

reg : 		For non-sysconf based sensors, this should be the physical base
		address and length of the sensor's registers.
interrupts :	Standard way to define interrupt number.
		  NB: For thermal sensor's for which no interrupt has been
		  defined, a polling delay of 1000ms will be used to read the
		  temperature from device.

Example:

	temp0@91a0000 {
		compatible = "st,stih407-thermal";
		reg = <0x91a0000 0x28>;
		clock-names = "thermal";
		clocks = <&CLK_SYSIN>;
		interrupts = <GIC_SPI 205 IRQ_TYPE_EDGE_RISING>;
		st,passive_cooling_temp = <110>;
	};
```

## Documentation/devicetree/bindings/thermal/stm32-thermal.txt
```
Binding for Thermal Sensor for STMicroelectronics STM32 series of SoCs.

On STM32 SoCs, the Digital Temperature Sensor (DTS) is in charge of managing an
analog block which delivers a frequency depending on the internal SoC's
temperature. By using a reference frequency, DTS is able to provide a sample
number which can be translated into a temperature by the user.

DTS provides interrupt notification mechanism by threshold. This mechanism
offers two temperature trip points: passive and critical. The first is intended
for passive cooling notification while the second is used for over-temperature
reset.

Required parameters:
-------------------

compatible: 	Should be "st,stm32-thermal"
reg: 		This should be the physical base address and length of the
		sensor's registers.
clocks: 	Phandle of the clock used by the thermal sensor.
		  See: Documentation/devicetree/bindings/clock/clock-bindings.txt
clock-names: 	Should be "pclk" for register access clock and reference clock.
		  See: Documentation/devicetree/bindings/resource-names.txt
#thermal-sensor-cells: Should be 0. See ./thermal.txt for a description.
interrupts:	Standard way to define interrupt number.

Example:

	thermal-zones {
		cpu_thermal: cpu-thermal {
			polling-delay-passive = <0>;
			polling-delay = <0>;

			thermal-sensors = <&thermal>;

			trips {
				cpu_alert1: cpu-alert1 {
					temperature = <85000>;
					hysteresis = <0>;
					type = "passive";
				};

				cpu-crit: cpu-crit {
					temperature = <120000>;
					hysteresis = <0>;
					type = "critical";
				};
			};

			cooling-maps {
			};
		};
	};

	thermal: thermal@50028000 {
		compatible = "st,stm32-thermal";
		reg = <0x50028000 0x100>;
		clocks = <&rcc TMPSENS>;
		clock-names = "pclk";
		#thermal-sensor-cells = <0>;
		interrupts = <GIC_SPI 147 IRQ_TYPE_LEVEL_HIGH>;
	};
```

## Documentation/devicetree/bindings/thermal/tango-thermal.txt
```
* Tango Thermal

The SMP8758 SoC includes 3 instances of this temperature sensor
(in the CPU, video decoder, and PCIe controller).

Required properties:
- #thermal-sensor-cells: Should be 0 (see thermal.txt)
- compatible: "sigma,smp8758-thermal"
- reg: Address range of the thermal registers

Example:

	cpu_temp: thermal@920100 {
		#thermal-sensor-cells = <0>;
		compatible = "sigma,smp8758-thermal";
		reg = <0x920100 12>;
	};
```

## Documentation/devicetree/bindings/thermal/tegra-soctherm.txt
```
Tegra124 SOCTHERM thermal management system

The SOCTHERM IP block contains thermal sensors, support for polled
or interrupt-based thermal monitoring, CPU and GPU throttling based
on temperature trip points, and handling external overcurrent
notifications. It is also used to manage emergency shutdown in an
overheating situation.

Required properties :
- compatible : For Tegra124, must contain "nvidia,tegra124-soctherm".
  For Tegra132, must contain "nvidia,tegra132-soctherm".
  For Tegra210, must contain "nvidia,tegra210-soctherm".
- reg : Should contain 1 entry:
  - SOCTHERM register set
- interrupts : Defines the interrupt used by SOCTHERM
- clocks : Must contain an entry for each entry in clock-names.
  See ../clocks/clock-bindings.txt for details.
- clock-names : Must include the following entries:
  - tsensor
  - soctherm
- resets : Must contain an entry for each entry in reset-names.
  See ../reset/reset.txt for details.
- reset-names : Must include the following entries:
  - soctherm
- #thermal-sensor-cells : Should be 1. See ./thermal.txt for a description
    of this property. See <dt-bindings/thermal/tegra124-soctherm.h> for a
    list of valid values when referring to thermal sensors.


Example :

	soctherm@700e2000 {
		compatible = "nvidia,tegra124-soctherm";
		reg = <0x0 0x700e2000 0x0 0x1000>;
		interrupts = <GIC_SPI 48 IRQ_TYPE_LEVEL_HIGH>;
		clocks = <&tegra_car TEGRA124_CLK_TSENSOR>,
			<&tegra_car TEGRA124_CLK_SOC_THERM>;
		clock-names = "tsensor", "soctherm";
		resets = <&tegra_car 78>;
		reset-names = "soctherm";

		#thermal-sensor-cells = <1>;
	};

Example: referring to thermal sensors :

       thermal-zones {
                cpu {
                        polling-delay-passive = <1000>;
                        polling-delay = <1000>;

                        thermal-sensors =
                                <&soctherm TEGRA124_SOCTHERM_SENSOR_CPU>;
                };
	};
```

## Documentation/devicetree/bindings/thermal/thermal-cooling-devices.yaml
```yaml
# SPDX-License-Identifier: (GPL-2.0)
# Copyright 2020 Linaro Ltd.
%YAML 1.2
---
$id: http://devicetree.org/schemas/thermal/thermal-cooling-devices.yaml#
$schema: http://devicetree.org/meta-schemas/core.yaml#

title: Thermal cooling device binding

maintainers:
  - Amit Kucheria <amitk@kernel.org>

description: |
  Thermal management is achieved in devicetree by describing the sensor hardware
  and the software abstraction of cooling devices and thermal zones required to
  take appropriate action to mitigate thermal overload.

  The following node types are used to completely describe a thermal management
  system in devicetree:
   - thermal-sensor: device that measures temperature, has SoC-specific bindings
   - cooling-device: device used to dissipate heat either passively or actively
   - thermal-zones: a container of the following node types used to describe all
     thermal data for the platform

  This binding describes the cooling devices.

  There are essentially two ways to provide control on power dissipation:
    - Passive cooling: by means of regulating device performance. A typical
      passive cooling mechanism is a CPU that has dynamic voltage and frequency
      scaling (DVFS), and uses lower frequencies as cooling states.
    - Active cooling: by means of activating devices in order to remove the
      dissipated heat, e.g. regulating fan speeds.

  Any cooling device has a range of cooling states (i.e. different levels of
  heat dissipation). They also have a way to determine the state of cooling in
  which the device is. For example, a fan's cooling states correspond to the
  different fan speeds possible. Cooling states are referred to by single
  unsigned integers, where larger numbers mean greater heat dissipation. The
  precise set of cooling states associated with a device should be defined in
  a particular device's binding.

select: true

properties:
  "#cooling-cells":
    description:
        Must be 2, in order to specify minimum and maximum cooling state used in
        the cooling-maps reference. The first cell is the minimum cooling state
        and the second cell is the maximum cooling state requested.
    const: 2

examples:
  - |
    #include <dt-bindings/interrupt-controller/arm-gic.h>
    #include <dt-bindings/thermal/thermal.h>

    // Example 1: Cpufreq cooling device on CPU0
    cpus {
            #address-cells = <2>;
            #size-cells = <0>;

            CPU0: cpu@0 {
                    device_type = "cpu";
                    compatible = "qcom,kryo385";
                    reg = <0x0 0x0>;
                    enable-method = "psci";
                    cpu-idle-states = <&LITTLE_CPU_SLEEP_0
                                       &LITTLE_CPU_SLEEP_1
                                       &CLUSTER_SLEEP_0>;
                    capacity-dmips-mhz = <607>;
                    dynamic-power-coefficient = <100>;
                    qcom,freq-domain = <&cpufreq_hw 0>;
                    #cooling-cells = <2>;
                    next-level-cache = <&L2_0>;
                    L2_0: l2-cache {
                            compatible = "cache";
                            next-level-cache = <&L3_0>;
                            L3_0: l3-cache {
                                    compatible = "cache";
                            };
                    };
          };

          /* ... */

    };

    /* ... */

    thermal-zones {
            cpu0-thermal {
                    polling-delay-passive = <250>;
                    polling-delay = <1000>;

                    thermal-sensors = <&tsens0 1>;

                    trips {
                            cpu0_alert0: trip-point0 {
                                    temperature = <90000>;
                                    hysteresis = <2000>;
                                    type = "passive";
                            };
                    };

                    cooling-maps {
                            map0 {
                                    trip = <&cpu0_alert0>;
                                    /* Corresponds to 1000MHz in OPP table */
                                    cooling-device = <&CPU0 5 5>;
                            };
                    };
            };

            /* ... */
    };
...
```
