## Documentation/devicetree/bindings/mmc/usdhi6rol0.txt
```
* Renesas usdhi6rol0 SD/SDIO host controller

Required properties:

- compatible:	must be
		"renesas,usdhi6rol0"
- interrupts:	3 interrupts, named "card detect", "data" and "SDIO" must be
		specified
- clocks:	a clock binding for the IMCLK input

Optional properties:

- vmmc-supply:	a phandle of a regulator, supplying Vcc to the card
- vqmmc-supply:	a phandle of a regulator, supplying VccQ to the card
- pinctrl-names: Can contain a "default" entry and a "state_uhs"
                 entry. The state_uhs entry is used together with the default
                 entry when the board requires distinct settings for UHS speeds.

- pinctrl-N: One property for each name listed in pinctrl-names, see
             ../pinctrl/pinctrl-bindings.txt.

Additionally any standard mmc bindings from mmc.txt can be used.

Example:

sd0: sd@ab000000 {
	compatible = "renesas,usdhi6rol0";
	reg = <0xab000000 0x200>;
	interrupts = <0 23 0x4
		      0 24 0x4
		      0 25 0x4>;
	interrupt-names = "card detect", "data", "SDIO";
	bus-width = <4>;
	max-frequency = <50000000>;
	cap-power-off-card;
	clocks = <&imclk>;
	vmmc-supply = <&vcc_sd0>;
	vqmmc-supply = <&vccq_sd0>;
};
```

## Documentation/devicetree/bindings/mmc/vt8500-sdmmc.txt
```
* Wondermedia WM8505/WM8650 SD/MMC Host Controller

This file documents differences between the core properties described
by mmc.txt and the properties used by the wmt-sdmmc driver.

Required properties:
- compatible: Should be "wm,wm8505-sdhc".
- interrupts: Two interrupts are required - regular irq and dma irq.

Optional properties:
- sdon-inverted: SD_ON bit is inverted on the controller

Examples:

sdhc@d800a000 {
	compatible = "wm,wm8505-sdhc";
	reg = <0xd800a000 0x1000>;
	interrupts = <20 21>;
	clocks = <&sdhc>;
	bus-width = <4>;
	sdon-inverted;
};
```

## Documentation/devicetree/bindings/mmc/wm,wm8505-sdhc.yaml
```yaml
# SPDX-License-Identifier: GPL-2.0-only OR BSD-2-Clause
%YAML 1.2
---
$id: http://devicetree.org/schemas/mmc/wm,wm8505-sdhc.yaml#
$schema: http://devicetree.org/meta-schemas/core.yaml#

title: WonderMedia SoC SDHCI Controller

maintainers:
  - Alexey Charkov <alchark@gmail.com>

allOf:
  - $ref: mmc-controller.yaml#

properties:
  compatible:
    oneOf:
      - const: wm,wm8505-sdhc
      - items:
          - const: wm,wm8650-sdhc
          - const: wm,wm8505-sdhc
      - items:
          - const: wm,wm8750-sdhc
          - const: wm,wm8505-sdhc
      - items:
          - const: wm,wm8850-sdhc
          - const: wm,wm8505-sdhc

  reg:
    maxItems: 1

  clocks:
    maxItems: 1

  interrupts:
    items:
      - description: SDMMC controller interrupt
      - description: SDMMC controller DMA interrupt

  sdon-inverted:
    type: boolean
    description: All chips before (not including) WM8505 rev. A2 treated their
      "clock stop" bit (register offset 0x08 a.k.a. SDMMC_BUSMODE, bit 0x10)
      as "set 1 to disable SD clock", while all the later versions treated it
      as "set 0 to disable SD clock". Set this property for later versions of
      wm,wm8505-sdhc. On wm,wm8650-sdhc and later this property is implied and
      does not need to be set explicitly

required:
  - compatible
  - reg
  - interrupts
  - clocks

unevaluatedProperties: false

examples:
  - |
    mmc@d800a000 {
        compatible = "wm,wm8505-sdhc";
        reg = <0xd800a000 0x1000>;
        interrupts = <20>, <21>;
        clocks = <&sdhc>;
        bus-width = <4>;
        sdon-inverted;
    };
```

## Documentation/devicetree/bindings/mmc/zx-dw-mshc.txt
```
* ZTE specific extensions to the Synopsys Designware Mobile Storage
  Host Controller

The Synopsys designware mobile storage host controller is used to interface
a SoC with storage medium such as eMMC or SD/MMC cards. This file documents
differences between the core Synopsys dw mshc controller properties described
by synopsys-dw-mshc.txt and the properties used by the ZTE specific
extensions to the Synopsys Designware Mobile Storage Host Controller.

Required Properties:

* compatible: should be
	- "zte,zx296718-dw-mshc": for ZX SoCs

Example:

	mmc1: mmc@1110000 {
		compatible = "zte,zx296718-dw-mshc";
		reg = <0x01110000 0x1000>;
		interrupts = <GIC_SPI 15 IRQ_TYPE_LEVEL_HIGH>;
		fifo-depth = <32>;
		data-addr = <0x200>;
		fifo-watermark-aligned;
		bus-width = <4>;
		clock-frequency = <50000000>;
		clocks = <&topcrm SD0_AHB>, <&topcrm SD0_WCLK>;
		clock-names = "biu", "ciu";
		num-slots = <1>;
		max-frequency = <50000000>;
		cap-sdio-irq;
		cap-sd-highspeed;
		status = "disabled";
	};
```

## Documentation/devicetree/bindings/mtd/allwinner,sun4i-a10-nand.yaml
```yaml
# SPDX-License-Identifier: GPL-2.0
%YAML 1.2
---
$id: http://devicetree.org/schemas/mtd/allwinner,sun4i-a10-nand.yaml#
$schema: http://devicetree.org/meta-schemas/core.yaml#

title: Allwinner A10 NAND Controller

maintainers:
  - Chen-Yu Tsai <wens@csie.org>
  - Maxime Ripard <mripard@kernel.org>

properties:
  compatible:
    enum:
      - allwinner,sun4i-a10-nand
      - allwinner,sun8i-a23-nand-controller
      - allwinner,sun50i-h616-nand-controller

  reg:
    maxItems: 1

  interrupts:
    maxItems: 1

  clocks:
    minItems: 2
    items:
      - description: Bus Clock
      - description: Module Clock
      - description: ECC Clock
      - description: MBus Clock

  clock-names:
    minItems: 2
    items:
      - const: ahb
      - const: mod
      - const: ecc
      - const: mbus

  resets:
    maxItems: 1

  reset-names:
    const: ahb

  dmas:
    maxItems: 1

  dma-names:
    const: rxtx

patternProperties:
  "^nand@[a-f0-9]$":
    type: object
    $ref: raw-nand-chip.yaml
    properties:
      reg:
        minimum: 0
        maximum: 7

      nand-ecc-algo:
        const: bch

      nand-ecc-step-size:
        enum: [ 512, 1024 ]

      nand-ecc-strength:
        maximum: 80

      allwinner,rb:
        description:
          Contains the native Ready/Busy IDs.
        $ref: /schemas/types.yaml#/definitions/uint32-array
        minItems: 1
        maxItems: 2
        items:
          minimum: 0
          maximum: 1

    unevaluatedProperties: false

required:
  - compatible
  - reg
  - interrupts
  - clocks
  - clock-names

unevaluatedProperties: false

allOf:
  - $ref: nand-controller.yaml

  - if:
      properties:
        compatible:
          contains:
            enum:
              - allwinner,sun4i-a10-nand
              - allwinner,sun8i-a23-nand-controller
    then:
      properties:
        clocks:
          maxItems: 2
        clock-names:
          maxItems: 2

  - if:
      properties:
        compatible:
          contains:
            enum:
              - allwinner,sun50i-h616-nand-controller
    then:
      properties:
        clocks:
          minItems: 4
        clock-names:
          minItems: 4

examples:
  - |
    #include <dt-bindings/interrupt-controller/arm-gic.h>
    #include <dt-bindings/clock/sun6i-rtc.h>
    #include <dt-bindings/clock/sun8i-a23-a33-ccu.h>
    #include <dt-bindings/reset/sun8i-a23-a33-ccu.h>

    nand-controller@1c03000 {
        compatible = "allwinner,sun8i-a23-nand-controller";
        reg = <0x01c03000 0x1000>;
        interrupts = <GIC_SPI 70 IRQ_TYPE_LEVEL_HIGH>;
        clocks = <&ccu CLK_BUS_NAND>, <&ccu CLK_NAND>;
        clock-names = "ahb", "mod";
        resets = <&ccu RST_BUS_NAND>;
        reset-names = "ahb";
        dmas = <&dma 5>;
        dma-names = "rxtx";
        pinctrl-names = "default";
        pinctrl-0 = <&nand_pins &nand_cs0_pin &nand_rb0_pin>;
        #address-cells = <1>;
        #size-cells = <0>;
    };

...
```

## Documentation/devicetree/bindings/mtd/amlogic,meson-nand.txt
```
Amlogic NAND Flash Controller (NFC) for GXBB/GXL/AXG family SoCs

This file documents the properties in addition to those available in
the MTD NAND bindings.

Required properties:
- compatible : contains one of:
  - "amlogic,meson-gxl-nfc"
  - "amlogic,meson-axg-nfc"

- reg        : Offset and length of the register set

- reg-names  : "nfc" is the register set for NFC controller and "emmc"
		is the register set for MCI controller.

- clocks     :
	A list of phandle + clock-specifier pairs for the clocks listed
	in clock-names.

- clock-names: Should contain the following:
	"core" - NFC module gate clock
	"device" - parent clock for internal NFC

Optional children nodes:
Children nodes represent the available nand chips.

Other properties:
see Documentation/devicetree/bindings/mtd/nand-controller.yaml for generic bindings.

Example demonstrate on AXG SoC:

	nand-controller@7800 {
		compatible = "amlogic,meson-axg-nfc";
		reg = <0x0 0x7800 0x0 0x100>,
		      <0x0 0x7000 0x0 0x800>;
		reg-names = "nfc", "emmc";
		#address-cells = <1>;
		#size-cells = <0>;
		interrupts = <GIC_SPI 34 IRQ_TYPE_EDGE_RISING>;

		clocks = <&clkc CLKID_SD_EMMC_C>,
			 <&clkc CLKID_FCLK_DIV2>;
		clock-names = "core", "device";

		pinctrl-names = "default";
		pinctrl-0 = <&nand_pins>;

		nand@0 {
			reg = <0>;
			#address-cells = <1>;
			#size-cells = <1>;

			nand-on-flash-bbt;
		};
	};
```

## Documentation/devicetree/bindings/mtd/amlogic,meson-nand.yaml
```yaml
# SPDX-License-Identifier: (GPL-2.0-only OR BSD-2-Clause)
%YAML 1.2
---
$id: http://devicetree.org/schemas/mtd/amlogic,meson-nand.yaml#
$schema: http://devicetree.org/meta-schemas/core.yaml#

title: Amlogic NAND Flash Controller (NFC) for GXBB/GXL/AXG family SoCs

allOf:
  - $ref: nand-controller.yaml

maintainers:
  - liang.yang@amlogic.com

properties:
  compatible:
    enum:
      - amlogic,meson-gxl-nfc
      - amlogic,meson-axg-nfc

  reg:
    maxItems: 2

  reg-names:
    items:
      - const: nfc
      - const: emmc

  interrupts:
    maxItems: 1

  clocks:
    minItems: 2

  clock-names:
    items:
      - const: core
      - const: device

patternProperties:
  "^nand@[0-7]$":
    type: object
    $ref: raw-nand-chip.yaml
    properties:
      reg:
        minimum: 0
        maximum: 1

      nand-ecc-mode:
        const: hw

      nand-ecc-step-size:
        enum: [512, 1024]

      nand-ecc-strength:
        enum: [8, 16, 24, 30, 40, 50, 60]
        description: |
          The ECC configurations that can be supported are as follows.
            meson-gxl-nfc 8, 16, 24, 30, 40, 50, 60
            meson-axg-nfc 8

      nand-rb:
        maxItems: 1
        items:
          maximum: 0

      amlogic,boot-pages:
        $ref: /schemas/types.yaml#/definitions/uint32
        description:
          Number of pages starting from offset 0, where a special ECC
          configuration must be used because it is accessed by the ROM
          code. This ECC configuration uses 384 bytes data blocks.
          Also scrambling mode is enabled for such pages.

      amlogic,boot-page-step:
        $ref: /schemas/types.yaml#/definitions/uint32
        description:
          Interval between pages, accessed by the ROM code. For example
          we have 8 pages [0, 7]. Pages 0,2,4,6 are accessed by the
          ROM code, so this field will be 2 (e.g. every 2nd page). Rest
          of pages - 1,3,5,7 are read/written without this mode.

    unevaluatedProperties: false

    dependencies:
      nand-ecc-strength: [nand-ecc-step-size]
      nand-ecc-step-size: [nand-ecc-strength]
      amlogic,boot-pages: [nand-is-boot-medium, "amlogic,boot-page-step"]
      amlogic,boot-page-step: [nand-is-boot-medium, "amlogic,boot-pages"]


required:
  - compatible
  - reg
  - interrupts
  - clocks
  - clock-names

unevaluatedProperties: false

examples:
  - |
    #include <dt-bindings/clock/axg-clkc.h>
    #include <dt-bindings/interrupt-controller/arm-gic.h>
    nand-controller@ffe07800 {
      compatible = "amlogic,meson-axg-nfc";
      reg = <0xffe07800 0x100>, <0xffe07000 0x800>;
      reg-names = "nfc", "emmc";
      interrupts = <GIC_SPI 34 IRQ_TYPE_EDGE_RISING>;
      clocks = <&clkc CLKID_SD_EMMC_C>,  <&clkc CLKID_FCLK_DIV2>;
      clock-names = "core", "device";

      pinctrl-0 = <&nand_pins>;
      pinctrl-names = "default";

      #address-cells = <1>;
      #size-cells = <0>;

      nand@0 {
        reg = <0>;
        nand-rb = <0>;
      };
    };

...
```

## Documentation/devicetree/bindings/mtd/arasan,nand-controller.yaml
```yaml
# SPDX-License-Identifier: (GPL-2.0-only OR BSD-2-Clause)
%YAML 1.2
---
$id: http://devicetree.org/schemas/mtd/arasan,nand-controller.yaml#
$schema: http://devicetree.org/meta-schemas/core.yaml#

title: Arasan NAND Flash Controller with ONFI 3.1 support device tree bindings

allOf:
  - $ref: "nand-controller.yaml"

maintainers:
  - Naga Sureshkumar Relli <naga.sureshkumar.relli@xilinx.com>

properties:
  compatible:
    items:
      - enum:
          - xlnx,zynqmp-nand-controller
      - const: arasan,nfc-v3p10

  reg:
    maxItems: 1

  clocks:
    items:
      - description: Controller clock
      - description: NAND bus clock

  clock-names:
    items:
      - const: controller
      - const: bus

  interrupts:
    maxItems: 1

  "#address-cells": true
  "#size-cells": true

required:
  - compatible
  - reg
  - clocks
  - clock-names
  - interrupts

additionalProperties: true

examples:
  - |
    nfc: nand-controller@ff100000 {
        compatible = "xlnx,zynqmp-nand-controller", "arasan,nfc-v3p10";
        reg = <0xff100000 0x1000>;
        clock-names = "controller", "bus";
        clocks = <&clk200>, <&clk100>;
        interrupt-parent = <&gic>;
        interrupts = <0 14 4>;
        #address-cells = <1>;
        #size-cells = <0>;
    };
```

## Documentation/devicetree/bindings/mtd/arm,pl353-nand-r2p1.yaml
```yaml
# SPDX-License-Identifier: (GPL-2.0-only OR BSD-2-Clause)
%YAML 1.2
---
$id: http://devicetree.org/schemas/mtd/arm,pl353-nand-r2p1.yaml#
$schema: http://devicetree.org/meta-schemas/core.yaml#

title: PL353 NAND Controller

allOf:
  - $ref: "nand-controller.yaml"

maintainers:
  - Miquel Raynal <miquel.raynal@bootlin.com>
  - Naga Sureshkumar Relli <naga.sureshkumar.relli@xilinx.com>

properties:
  compatible:
    items:
      - const: arm,pl353-nand-r2p1

  reg:
    items:
      - items:
          - description: CS with regard to the parent ranges property
          - description: Offset of the memory region requested by the device
          - description: Length of the memory region requested by the device

required:
  - compatible
  - reg

unevaluatedProperties: false

examples:
  - |
    smcc: memory-controller@e000e000 {
        compatible = "arm,pl353-smc-r2p1", "arm,primecell";
        reg = <0xe000e000 0x0001000>;
        clock-names = "memclk", "apb_pclk";
        clocks = <&clkc 11>, <&clkc 44>;
        ranges = <0x0 0x0 0xe1000000 0x1000000 /* Nand CS region */
                  0x1 0x0 0xe2000000 0x2000000 /* SRAM/NOR CS0 region */
                  0x2 0x0 0xe4000000 0x2000000>; /* SRAM/NOR CS1 region */
        #address-cells = <2>;
        #size-cells = <1>;

        nfc0: nand-controller@0,0 {
            compatible = "arm,pl353-nand-r2p1";
            reg = <0 0 0x1000000>;
            #address-cells = <1>;
            #size-cells = <0>;
        };
    };
```

## Documentation/devicetree/bindings/mtd/arm-versatile.txt
```
Flash device on ARM Versatile board

These flash chips are found in the ARM reference designs like Integrator,
Versatile, RealView, Versatile Express etc.

They are regular CFI compatible (Intel or AMD extended) flash chips with
some special write protect/VPP bits that can be controlled by the machine's
system controller.

Required properties:
- compatible : must be "arm,versatile-flash", "cfi-flash";
- reg : memory address for the flash chip
- bank-width : width in bytes of flash interface.

For the rest of the properties, see mtd-physmap.txt.

The device tree may optionally contain sub-nodes describing partitions of the
address space. See partition.txt for more detail.

Example:

flash@34000000 {
	compatible = "arm,versatile-flash", "cfi-flash";
	reg = <0x34000000 0x4000000>;
	bank-width = <4>;
};
```
