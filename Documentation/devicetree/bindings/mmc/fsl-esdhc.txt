## Documentation/devicetree/bindings/mmc/hisilicon,hi3798cv200-dw-mshc.yaml
```yaml
# SPDX-License-Identifier: GPL-2.0-only OR BSD-2-Clause
%YAML 1.2
---
$id: http://devicetree.org/schemas/mmc/hisilicon,hi3798cv200-dw-mshc.yaml#
$schema: http://devicetree.org/meta-schemas/core.yaml#

title: Hisilicon HiSTB SoCs specific extensions to the Synopsys DWMMC controller

maintainers:
  - Yang Xiwen <forbidden405@outlook.com>

properties:
  compatible:
    enum:
      - hisilicon,hi3798cv200-dw-mshc
      - hisilicon,hi3798mv200-dw-mshc

  reg:
    maxItems: 1

  interrupts:
    maxItems: 1

  clocks:
    items:
      - description: bus interface unit clock
      - description: card interface unit clock
      - description: card input sample phase clock
      - description: controller output drive phase clock

  clock-names:
    items:
      - const: ciu
      - const: biu
      - const: ciu-sample
      - const: ciu-drive

  hisilicon,sap-dll-reg:
    $ref: /schemas/types.yaml#/definitions/phandle-array
    description: |
      DWMMC core on Hi3798MV2x SoCs has a delay-locked-loop(DLL) attached to card data input path.
      It is integrated into CRG core on the SoC and has to be controlled during tuning.
    items:
      - description: A phandle pointed to the CRG syscon node
      - description: Sample DLL register offset in CRG address space

required:
  - compatible
  - reg
  - interrupts
  - clocks
  - clock-names

allOf:
  - $ref: synopsys-dw-mshc-common.yaml#

  - if:
      properties:
        compatible:
          contains:
            const: hisilicon,hi3798mv200-dw-mshc
    then:
      required:
        - hisilicon,sap-dll-reg
    else:
      properties:
        hisilicon,sap-dll-reg: false

unevaluatedProperties: false

examples:
  - |
    #include <dt-bindings/clock/histb-clock.h>
    #include <dt-bindings/interrupt-controller/arm-gic.h>

    mmc@9830000 {
        compatible = "hisilicon,hi3798cv200-dw-mshc";
        reg = <0x9830000 0x10000>;
        interrupts = <GIC_SPI 35 IRQ_TYPE_LEVEL_HIGH>;
        clocks = <&crg HISTB_MMC_CIU_CLK>,
                 <&crg HISTB_MMC_BIU_CLK>,
                 <&crg HISTB_MMC_SAMPLE_CLK>,
                 <&crg HISTB_MMC_DRV_CLK>;
        clock-names = "ciu", "biu", "ciu-sample", "ciu-drive";
        resets = <&crg 0xa0 4>;
        reset-names = "reset";
        pinctrl-names = "default";
        pinctrl-0 = <&emmc_pins_1 &emmc_pins_2
                     &emmc_pins_3 &emmc_pins_4>;
        fifo-depth = <256>;
        clock-frequency = <200000000>;
        cap-mmc-highspeed;
        mmc-ddr-1_8v;
        mmc-hs200-1_8v;
        non-removable;
        bus-width = <8>;
    };
```

## Documentation/devicetree/bindings/mmc/img-dw-mshc.txt
```
* Imagination specific extensions to the Synopsys Designware Mobile Storage
  Host Controller

The Synopsys designware mobile storage host controller is used to interface
a SoC with storage medium such as eMMC or SD/MMC cards. This file documents
differences between the core Synopsys dw mshc controller properties described
by synopsys-dw-mshc.txt and the properties used by the Imagination specific
extensions to the Synopsys Designware Mobile Storage Host Controller.

Required Properties:

* compatible: should be
	- "img,pistachio-dw-mshc": for Pistachio SoCs

Example:

	mmc@18142000 {
		compatible = "img,pistachio-dw-mshc";
		reg = <0x18142000 0x400>;
		interrupts = <GIC_SHARED 39 IRQ_TYPE_LEVEL_HIGH>;

		clocks = <&system_clk>, <&sdhost_clk>;
		clock-names = "biu", "ciu";

		fifo-depth = <0x20>;
		bus-width = <4>;
		disable-wp;
	};
```

## Documentation/devicetree/bindings/mmc/ingenic,mmc.yaml
```yaml
# SPDX-License-Identifier: (GPL-2.0-only OR BSD-2-Clause)
%YAML 1.2
---
$id: http://devicetree.org/schemas/mmc/ingenic,mmc.yaml#
$schema: http://devicetree.org/meta-schemas/core.yaml#

title: Ingenic SoCs MMC Controller

maintainers:
  - Paul Cercueil <paul@crapouillou.net>

allOf:
  - $ref: mmc-controller.yaml#

properties:
  compatible:
    oneOf:
      - enum:
          - ingenic,jz4740-mmc
          - ingenic,jz4725b-mmc
          - ingenic,jz4760-mmc
          - ingenic,jz4775-mmc
          - ingenic,jz4780-mmc
          - ingenic,x1000-mmc
      - items:
          - const: ingenic,jz4770-mmc
          - const: ingenic,jz4760-mmc

  reg:
    maxItems: 1

  interrupts:
    maxItems: 1

  clocks:
    maxItems: 1

  clock-names:
    const: mmc

  dmas:
    minItems: 1
    maxItems: 2

  dma-names:
    oneOf:
      - items:
          - const: rx
          - const: tx
      - const: tx-rx

required:
  - compatible
  - reg
  - interrupts
  - clocks
  - clock-names
  - dmas
  - dma-names

unevaluatedProperties: false

examples:
  - |
    #include <dt-bindings/clock/ingenic,jz4780-cgu.h>
    #include <dt-bindings/dma/jz4780-dma.h>
    mmc0: mmc@13450000 {
      compatible = "ingenic,jz4780-mmc";
      reg = <0x13450000 0x1000>;

      interrupt-parent = <&intc>;
      interrupts = <37>;

      clocks = <&cgu JZ4780_CLK_MSC0>;
      clock-names = "mmc";

      cap-sd-highspeed;
      cap-mmc-highspeed;
      cap-sdio-irq;
      dmas = <&dma JZ4780_DMA_MSC0_RX 0xffffffff>,
             <&dma JZ4780_DMA_MSC0_TX 0xffffffff>;
      dma-names = "rx", "tx";
    };
  - |
    #include <dt-bindings/clock/ingenic,jz4780-cgu.h>
    #include <dt-bindings/dma/jz4780-dma.h>
    /*
     * Alternative version of the example above,
     * but using one single DMA channel for both
     * TX and RX.
     */
    mmc1: mmc@13460000 {
      compatible = "ingenic,jz4780-mmc";
      reg = <0x13460000 0x1000>;

      interrupt-parent = <&intc>;
      interrupts = <36>;

      clocks = <&cgu JZ4780_CLK_MSC1>;
      clock-names = "mmc";

      cap-sd-highspeed;
      cap-mmc-highspeed;
      cap-sdio-irq;
      dmas = <&dma JZ4780_DMA_MSC1_TX JZ4780_DMA_MSC1_RX 0xffffffff>;
      dma-names = "tx-rx";
    };
```

## Documentation/devicetree/bindings/mmc/jz4740.txt
```
* Ingenic XBurst MMC controllers

This file documents the device tree properties used for the MMC controller in
Ingenic JZ4740/JZ4760/JZ4780/X1000 SoCs. These are in addition to the core MMC
properties described in mmc.txt.

Required properties:
- compatible: Should be one of the following:
  - "ingenic,jz4740-mmc" for the JZ4740
  - "ingenic,jz4725b-mmc" for the JZ4725B
  - "ingenic,jz4760-mmc" for the JZ4760
  - "ingenic,jz4780-mmc" for the JZ4780
  - "ingenic,x1000-mmc" for the X1000
- reg: Should contain the MMC controller registers location and length.
- interrupts: Should contain the interrupt specifier of the MMC controller.
- clocks: Clock for the MMC controller.

Optional properties:
- dmas: List of DMA specifiers with the controller specific format
        as described in the generic DMA client binding. A tx and rx
        specifier is required.
- dma-names: RX and TX  DMA request names.
        Should be "rx" and "tx", in that order.

For additional details on DMA client bindings see ../dma/dma.txt.

Example:

mmc0: mmc@13450000 {
	compatible = "ingenic,jz4780-mmc";
	reg = <0x13450000 0x1000>;

	interrupt-parent = <&intc>;
	interrupts = <37>;

	clocks = <&cgu JZ4780_CLK_MSC0>;
	clock-names = "mmc";

	dmas = <&dma JZ4780_DMA_MSC0_RX 0xffffffff>, <&dma JZ4780_DMA_MSC0_TX 0xffffffff>;
	dma-names = "rx", "tx";
};
```

## Documentation/devicetree/bindings/mmc/k3-dw-mshc.txt
```
* Hisilicon specific extensions to the Synopsys Designware Mobile
  Storage Host Controller

Read synopsys-dw-mshc.txt for more details

The Synopsys designware mobile storage host controller is used to interface
a SoC with storage medium such as eMMC or SD/MMC cards. This file documents
differences between the core Synopsys dw mshc controller properties described
by synopsys-dw-mshc.txt and the properties used by the Hisilicon specific
extensions to the Synopsys Designware Mobile Storage Host Controller.

Required Properties:

* compatible: should be one of the following.
  - "hisilicon,hi3660-dw-mshc": for controllers with hi3660 specific extensions.
  - "hisilicon,hi4511-dw-mshc": for controllers with hi4511 specific extensions.
  - "hisilicon,hi6220-dw-mshc": for controllers with hi6220 specific extensions.

Optional Properties:
- hisilicon,peripheral-syscon: phandle of syscon used to control peripheral.

Example:

	/* for Hi3620 */

	/* SoC portion */
	dwmmc_0: dwmmc0@fcd03000 {
		compatible = "hisilicon,hi4511-dw-mshc";
		reg = <0xfcd03000 0x1000>;
		interrupts = <0 16 4>;
		#address-cells = <1>;
		#size-cells = <0>;
		clocks = <&mmc_clock HI3620_SD_CIUCLK>, <&clock HI3620_DDRC_PER_CLK>;
		clock-names = "ciu", "biu";
	};

	/* Board portion */
	dwmmc0@fcd03000 {
		vmmc-supply = <&ldo12>;
		fifo-depth = <0x100>;
		pinctrl-names = "default";
		pinctrl-0 = <&sd_pmx_pins &sd_cfg_func1 &sd_cfg_func2>;
		bus-width = <4>;
		disable-wp;
		cd-gpios = <&gpio10 3 0>;
		cap-mmc-highspeed;
		cap-sd-highspeed;
	};

	/* for Hi6220 */

	dwmmc_1: dwmmc1@f723e000 {
		compatible = "hisilicon,hi6220-dw-mshc";
		bus-width = <0x4>;
		disable-wp;
		cap-sd-highspeed;
		sd-uhs-sdr12;
		sd-uhs-sdr25;
		card-detect-delay = <200>;
		hisilicon,peripheral-syscon = <&ao_ctrl>;
		reg = <0x0 0xf723e000 0x0 0x1000>;
		interrupts = <0x0 0x49 0x4>;
		clocks = <&clock_sys HI6220_MMC1_CIUCLK>, <&clock_sys HI6220_MMC1_CLK>;
		clock-names = "ciu", "biu";
		cd-gpios = <&gpio1 0 1>;
		pinctrl-names = "default", "idle";
		pinctrl-0 = <&sd_pmx_func &sd_clk_cfg_func &sd_cfg_func>;
		pinctrl-1 = <&sd_pmx_idle &sd_clk_cfg_idle &sd_cfg_idle>;
		vqmmc-supply = <&ldo7>;
		vmmc-supply = <&ldo10>;
	};
```

## Documentation/devicetree/bindings/mmc/kona-sdhci.txt
```
Broadcom BCM281xx SDHCI

This file documents differences between the core properties in mmc.txt
and the properties present in the bcm281xx SDHCI

Required properties:
- compatible : Should be "brcm,kona-sdhci"
- DEPRECATED: compatible : Should be "bcm,kona-sdhci"
- clocks: phandle + clock specifier pair of the external clock

Refer to clocks/clock-bindings.txt for generic clock consumer properties.

Example:

sdio2: sdio@0x3f1a0000 {
	compatible = "brcm,kona-sdhci";
	reg = <0x3f1a0000 0x10000>;
	clocks = <&sdio3_clk>;
	interrupts = <0x0 74 0x4>;
};
```

## Documentation/devicetree/bindings/mmc/litex,mmc.yaml
```yaml
# SPDX-License-Identifier: GPL-2.0-or-later OR BSD-2-Clause
%YAML 1.2
---
$id: http://devicetree.org/schemas/mmc/litex,mmc.yaml#
$schema: http://devicetree.org/meta-schemas/core.yaml#

title: LiteX LiteSDCard device

maintainers:
  - Gabriel Somlo <gsomlo@gmail.com>

description: |
  LiteSDCard is a small footprint, configurable SDCard core for FPGA based
  system on chips.

  The hardware source is Open Source and can be found on at
  https://github.com/enjoy-digital/litesdcard/.

allOf:
  - $ref: mmc-controller.yaml#

properties:
  compatible:
    const: litex,mmc

  reg:
    items:
      - description: PHY registers
      - description: CORE registers
      - description: DMA Reader buffer
      - description: DMA Writer buffer
      - description: IRQ registers
    minItems: 4

  reg-names:
    items:
      - const: phy
      - const: core
      - const: reader
      - const: writer
      - const: irq
    minItems: 4

  clocks:
    maxItems: 1
    description:
      Handle to reference clock.

  vmmc-supply:
    description:
      Handle to fixed-voltage supply for the card power.

  interrupts:
    maxItems: 1

required:
  - compatible
  - reg
  - reg-names
  - clocks
  - vmmc-supply

additionalProperties: false

examples:
  - |
    mmc: mmc@12005000 {
        compatible = "litex,mmc";
        reg = <0x12005000 0x100>,
              <0x12003800 0x100>,
              <0x12003000 0x100>,
              <0x12004800 0x100>,
              <0x12004000 0x100>;
        reg-names = "phy", "core", "reader", "writer", "irq";
        clocks = <&reference_clk>;
        vmmc-supply = <&vreg_mmc>;
        interrupts = <4>;
    };
```

## Documentation/devicetree/bindings/mmc/loongson,ls2k0500-mmc.yaml
```yaml
# SPDX-License-Identifier: (GPL-2.0-only OR BSD-2-Clause)
%YAML 1.2
---
$id: http://devicetree.org/schemas/mmc/loongson,ls2k0500-mmc.yaml#
$schema: http://devicetree.org/meta-schemas/core.yaml#

title: The SD/SDIO/eMMC host controller for Loongson-2K family SoCs

description:
  The MMC host controller on the Loongson-2K0500/2K1000 (using an externally
  shared apbdma controller) provides the SD and SDIO device interfaces.
  The two MMC host controllers on the Loongson-2K2000 are similar,
  except that they use internal exclusive DMA. one controller provides
  the eMMC interface and the other provides the SD/SDIO interface.

maintainers:
  - Binbin Zhou <zhoubinbin@loongson.cn>

allOf:
  - $ref: mmc-controller.yaml#

properties:
  compatible:
    enum:
      - loongson,ls2k0500-mmc
      - loongson,ls2k1000-mmc
      - loongson,ls2k2000-mmc

  reg:
    minItems: 1
    items:
      - description: Loongson-2K MMC controller registers.
      - description: APB DMA config register for Loongson-2K MMC controller.

  interrupts:
    maxItems: 1

  clocks:
    maxItems: 1

  dmas:
    maxItems: 1

  dma-names:
    const: rx-tx

required:
  - compatible
  - reg
  - interrupts
  - clocks

unevaluatedProperties: false

if:
  properties:
    compatible:
      contains:
        enum:
          - loongson,ls2k0500-mmc
          - loongson,ls2k1000-mmc

then:
  properties:
    reg:
      minItems: 2

  required:
    - dmas
    - dma-names

else:
  properties:
    reg:
      maxItems: 1

examples:
  - |
    #include <dt-bindings/gpio/gpio.h>
    #include <dt-bindings/interrupt-controller/irq.h>
    #include <dt-bindings/clock/loongson,ls2k-clk.h>

    mmc@1fe2c000 {
        compatible = "loongson,ls2k1000-mmc";
        reg = <0x1fe2c000 0x68>,
              <0x1fe00438 0x8>;
        interrupt-parent = <&liointc0>;
        interrupts = <31 IRQ_TYPE_LEVEL_HIGH>;
        clocks = <&clk LOONGSON2_APB_CLK>;
        dmas = <&apbdma1 0>;
        dma-names = "rx-tx";
        bus-width = <4>;
        cd-gpios = <&gpio0 22 GPIO_ACTIVE_LOW>;
    };

  - |
    #include <dt-bindings/interrupt-controller/irq.h>
    #include <dt-bindings/clock/loongson,ls2k-clk.h>

    mmc@79990000 {
        compatible = "loongson,ls2k2000-mmc";
        reg = <0x79990000 0x1000>;
        interrupt-parent = <&pic>;
        interrupts = <51 IRQ_TYPE_LEVEL_HIGH>;
        clocks = <&clk LOONGSON2_EMMC_CLK>;
        bus-width = <8>;
        non-removable;
        cap-mmc-highspeed;
        mmc-hs200-1_8v;
        no-sd;
        no-sdio;
    };
```

## Documentation/devicetree/bindings/mmc/marvell,dove-sdhci.yaml
```yaml
# SPDX-License-Identifier: (GPL-2.0-only OR BSD-2-Clause)
%YAML 1.2
---
$id: http://devicetree.org/schemas/mmc/marvell,dove-sdhci.yaml#
$schema: http://devicetree.org/meta-schemas/core.yaml#

title: Marvell sdhci-dove controller

maintainers:
  - Adrian Hunter <adrian.hunter@intel.com>
  - Ulf Hansson <ulf.hansson@linaro.org>

allOf:
  - $ref: mmc-controller.yaml#

properties:
  compatible:
    const: marvell,dove-sdhci

  reg:
    maxItems: 1

  interrupts:
    minItems: 1
    maxItems: 2

  clocks:
    maxItems: 1

required:
  - compatible
  - reg
  - interrupts

unevaluatedProperties: false

examples:
  - |
    sdio0: mmc@92000 {
      compatible = "marvell,dove-sdhci";
      reg = <0x92000 0x100>;
      interrupts = <35>;
      clocks = <&gate_clk 9>;
    };
```
