## Documentation/devicetree/bindings/mmc/microchip,dw-sparx5-sdhci.yaml
```yaml
# SPDX-License-Identifier: (GPL-2.0-only OR BSD-2-Clause)
%YAML 1.2
---
$id: http://devicetree.org/schemas/mmc/microchip,dw-sparx5-sdhci.yaml#
$schema: http://devicetree.org/meta-schemas/core.yaml#

title: Microchip Sparx5 Mobile Storage Host Controller

allOf:
  - $ref: "mmc-controller.yaml"

maintainers:
  - Lars Povlsen <lars.povlsen@microchip.com>

# Everything else is described in the common file
properties:
  compatible:
    const: microchip,dw-sparx5-sdhci

  reg:
    maxItems: 1

  interrupts:
    maxItems: 1

  clocks:
    maxItems: 1
    description:
      Handle to "core" clock for the sdhci controller.

  clock-names:
    items:
      - const: core

  microchip,clock-delay:
    description: Delay clock to card to meet setup time requirements.
      Each step increase by 1.25ns.
    $ref: "/schemas/types.yaml#/definitions/uint32"
    minimum: 1
    maximum: 15

required:
  - compatible
  - reg
  - interrupts
  - clocks
  - clock-names

unevaluatedProperties: false

examples:
  - |
    #include <dt-bindings/interrupt-controller/arm-gic.h>
    #include <dt-bindings/clock/microchip,sparx5.h>
    sdhci0: mmc@600800000 {
        compatible = "microchip,dw-sparx5-sdhci";
        reg = <0x00800000 0x1000>;
        pinctrl-0 = <&emmc_pins>;
        pinctrl-names = "default";
        clocks = <&clks CLK_ID_AUX1>;
        clock-names = "core";
        assigned-clocks = <&clks CLK_ID_AUX1>;
        assigned-clock-rates = <800000000>;
        interrupts = <GIC_SPI 4 IRQ_TYPE_LEVEL_HIGH>;
        bus-width = <8>;
        microchip,clock-delay = <10>;
    };
```

## Documentation/devicetree/bindings/mmc/microchip,sdhci-pic32.txt
```
* Microchip PIC32 SDHCI Controller

This file documents differences between the core properties in mmc.txt
and the properties used by the sdhci-pic32 driver.

Required properties:
- compatible: Should be "microchip,pic32mzda-sdhci"
- interrupts: Should contain interrupt
- clock-names: Should be "base_clk", "sys_clk".
               See: Documentation/devicetree/bindings/resource-names.txt
- clocks: Phandle to the clock.
          See: Documentation/devicetree/bindings/clock/clock-bindings.txt
- pinctrl-names: A pinctrl state names "default" must be defined.
- pinctrl-0: Phandle referencing pin configuration of the SDHCI controller.
             See: Documentation/devicetree/bindings/pinctrl/pinctrl-bindings.txt

Example:

	sdhci@1f8ec000 {
		compatible = "microchip,pic32mzda-sdhci";
		reg = <0x1f8ec000 0x100>;
		interrupts = <191 IRQ_TYPE_LEVEL_HIGH>;
		clocks = <&rootclk REF4CLK>, <&rootclk PB5CLK>;
		clock-names = "base_clk", "sys_clk";
		bus-width = <4>;
		cap-sd-highspeed;
		pinctrl-names = "default";
		pinctrl-0 = <&pinctrl_sdhc1>;
	};
```

## Documentation/devicetree/bindings/mmc/microchip,sdhci-pic32.yaml
```yaml
# SPDX-License-Identifier: (GPL-2.0-only OR BSD-2-Clause)
%YAML 1.2
---
$id: http://devicetree.org/schemas/mmc/microchip,sdhci-pic32.yaml#
$schema: http://devicetree.org/meta-schemas/core.yaml#

title: Microchip PIC32 SDHI Controller

description:
  The Microchip PIC32 family of microcontrollers (MCUs) includes models with
  Secure Digital Host Controller Interface (SDHCI) controllers, allowing them
  to interface with Secure Digital (SD) cards. This interface is used for reading,
  writing, and managing data on SD cards, enabling storage and data transfer
  capabilities in embedded systems.

allOf:
  - $ref: mmc-controller.yaml

maintainers:
  - Ulf Hansson <ulf.hansson@linaro.org>

properties:
  compatible:
    const: microchip,pic32mzda-sdhci

  reg:
    maxItems: 1

  interrupts:
    maxItems: 1

  clocks:
    maxItems: 2

  clock-names:
    items:
      - const: base_clk
      - const: sys_clk

required:
  - compatible
  - reg
  - interrupts
  - clocks
  - clock-names
  - pinctrl-names
  - pinctrl-0

unevaluatedProperties: false

examples:
  - |
    #include <dt-bindings/interrupt-controller/irq.h>
    #include <dt-bindings/clock/microchip,pic32-clock.h>
    mmc@1f8ec000 {
        compatible = "microchip,pic32mzda-sdhci";
        reg = <0x1f8ec000 0x100>;
        interrupts = <191 IRQ_TYPE_LEVEL_HIGH>;
        clocks = <&rootclk REF4CLK>, <&rootclk PB5CLK>;
        clock-names = "base_clk", "sys_clk";
        bus-width = <4>;
        cap-sd-highspeed;
        pinctrl-names = "default";
        pinctrl-0 = <&pinctrl_sdhc1>;
    };
...
```

## Documentation/devicetree/bindings/mmc/mmc-card.txt
```
mmc-card / eMMC bindings
------------------------

This documents describes the devicetree bindings for a mmc-host controller
child node describing a mmc-card / an eMMC, see "Use of Function subnodes"
in mmc.txt

Required properties:
-compatible : Must be "mmc-card"
-reg        : Must be <0>

Optional properties:
-broken-hpi : Use this to indicate that the mmc-card has a broken hpi
              implementation, and that hpi should not be used

Example:

&mmc2 {
	pinctrl-names = "default";
	pinctrl-0 = <&mmc2_pins_a>;
	vmmc-supply = <&reg_vcc3v3>;
	bus-width = <8>;
	non-removable;
	status = "okay";

	mmccard: mmccard@0 {
		reg = <0>;
		compatible = "mmc-card";
		broken-hpi;
	};
};
```

## Documentation/devicetree/bindings/mmc/mmc-card.yaml
```yaml
# SPDX-License-Identifier: GPL-2.0
%YAML 1.2
---
$id: http://devicetree.org/schemas/mmc/mmc-card.yaml#
$schema: http://devicetree.org/meta-schemas/core.yaml#

title: MMC Card / eMMC Generic

maintainers:
  - Ulf Hansson <ulf.hansson@linaro.org>

description: |
  This documents describes the devicetree bindings for a mmc-host controller
  child node describing a mmc-card / an eMMC.

  It's possible to define a fixed partition table for an eMMC for the user
  partition, the 2 BOOT partition (boot1/2) and the 4 GP (gp1/2/3/4) if supported
  by the eMMC.

properties:
  compatible:
    const: mmc-card

  reg:
    const: 0

  broken-hpi:
    $ref: /schemas/types.yaml#/definitions/flag
    description:
      Use this to indicate that the mmc-card has a broken hpi
      implementation, and that hpi should not be used.

patternProperties:
  "^partitions(-boot[12]|-gp[14])?$":
    type: object
    additionalProperties: true

    properties:
      compatible:
        contains:
          enum:
            - fixed-partitions
            - fixed-layout

required:
  - compatible
  - reg

additionalProperties: false

examples:
  - |
    mmc {
        #address-cells = <1>;
        #size-cells = <0>;

        card@0 {
            compatible = "mmc-card";
            reg = <0>;
            broken-hpi;

            partitions {
                compatible = "fixed-partitions";

                #address-cells = <1>;
                #size-cells = <1>;

                partition@0 {
                    label = "kernel"; /* Kernel */
                    reg = <0x0 0x2000000>; /* 32 MB */
                };

                partition@2000000 {
                    label = "rootfs";
                    reg = <0x2000000 0x40000000>; /* 1GB */
                };
            };

            partitions-boot1 {
                compatible = "fixed-partitions";

                #address-cells = <1>;
                #size-cells = <1>;

                partition@0 {
                    label = "bl";
                    reg = <0x0 0x2000000>; /* 32MB */
                    read-only;
                };
            };

            partitions-boot2 {
                compatible = "fixed-layout";

                #address-cells = <1>;
                #size-cells = <1>;

                mac-addr@4400 {
                    compatible = "mac-base";
                    reg = <0x4400 0x6>;
                    #nvmem-cell-cells = <1>;
                };

                bd-addr@5400 {
                    compatible = "mac-base";
                    reg = <0x5400 0x6>;
                    #nvmem-cell-cells = <1>;
                };
            };
        };
    };

...
```

## Documentation/devicetree/bindings/mmc/mmc-controller.yaml
```yaml
# SPDX-License-Identifier: GPL-2.0
%YAML 1.2
---
$id: http://devicetree.org/schemas/mmc/mmc-controller.yaml#
$schema: http://devicetree.org/meta-schemas/core.yaml#

title: MMC Controller Common Properties

maintainers:
  - Ulf Hansson <ulf.hansson@linaro.org>

description:
  These properties are common to multiple MMC host controllers. Any host
  that requires the respective functionality should implement them using
  these definitions.

  It is possible to assign a fixed index mmcN to an MMC host controller
  (and the corresponding mmcblkN devices) by defining an alias in the
  /aliases device tree node.

$ref: mmc-controller-common.yaml#

properties:
  $nodename:
    pattern: "^mmc(@.*)?$"

unevaluatedProperties: true

examples:
  - |
    mmc3: mmc@1c12000 {
        #address-cells = <1>;
        #size-cells = <0>;
        reg = <0x1c12000 0x200>;
        pinctrl-names = "default";
        pinctrl-0 = <&mmc3_pins_a>;
        vmmc-supply = <&reg_vmmc3>;
        bus-width = <4>;
        non-removable;
        mmc-pwrseq = <&sdhci0_pwrseq>;

        brcmf: wifi@1 {
            reg = <1>;
            compatible = "brcm,bcm4329-fmac";
            interrupt-parent = <&pio>;
            interrupts = <10 8>;
            interrupt-names = "host-wake";
        };
    };
```
