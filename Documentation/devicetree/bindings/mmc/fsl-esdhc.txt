## Documentation/devicetree/bindings/mmc/fsl-esdhc.txt
```
* Freescale Enhanced Secure Digital Host Controller (eSDHC)

The Enhanced Secure Digital Host Controller provides an interface
for MMC, SD, and SDIO types of memory cards.

This file documents differences between the core properties described
by mmc.txt and the properties used by the sdhci-esdhc driver.

Required properties:
  - compatible : should be "fsl,esdhc", or "fsl,<chip>-esdhc".
    Possible compatibles for PowerPC:
	"fsl,mpc8536-esdhc"
	"fsl,mpc8378-esdhc"
	"fsl,p2020-esdhc"
	"fsl,p4080-esdhc"
	"fsl,t1040-esdhc"
	"fsl,t4240-esdhc"
    Possible compatibles for ARM:
	"fsl,ls1012a-esdhc"
	"fsl,ls1088a-esdhc"
	"fsl,ls1043a-esdhc"
	"fsl,ls1046a-esdhc"
	"fsl,ls2080a-esdhc"
  - clock-frequency : specifies eSDHC base clock frequency.

Optional properties:
  - sdhci,wp-inverted : specifies that eSDHC controller reports
    inverted write-protect state; New devices should use the generic
    "wp-inverted" property.
  - sdhci,1-bit-only : specifies that a controller can only handle
    1-bit data transfers. New devices should use the generic
    "bus-width = <1>" property.
  - sdhci,auto-cmd12: specifies that a controller can only handle auto
    CMD12.
  - voltage-ranges : two cells are required, first cell specifies minimum
    slot voltage (mV), second cell specifies maximum slot voltage (mV).
    Several ranges could be specified.
  - little-endian : If the host controller is little-endian mode, specify
    this property. The default endian mode is big-endian.

Example:

sdhci@2e000 {
	compatible = "fsl,mpc8378-esdhc", "fsl,esdhc";
	reg = <0x2e000 0x1000>;
	interrupts = <42 0x8>;
	interrupt-parent = <&ipic>;
	/* Filled in by U-Boot */
	clock-frequency = <0>;
	voltage-ranges = <3300 3300>;
};
```

## Documentation/devicetree/bindings/mmc/fsl-imx-esdhc.yaml
```yaml
# SPDX-License-Identifier: (GPL-2.0-only OR BSD-2-Clause)
%YAML 1.2
---
$id: http://devicetree.org/schemas/mmc/fsl-imx-esdhc.yaml#
$schema: http://devicetree.org/meta-schemas/core.yaml#

title: Freescale Enhanced Secure Digital Host Controller (eSDHC) for i.MX

maintainers:
  - Shawn Guo <shawnguo@kernel.org>

allOf:
  - $ref: sdhci-common.yaml#

description: |
  The Enhanced Secure Digital Host Controller on Freescale i.MX family
  provides an interface for MMC, SD, and SDIO types of memory cards.

  This file documents differences between the core properties described
  by mmc.txt and the properties used by the sdhci-esdhc-imx driver.

properties:
  compatible:
    oneOf:
      - enum:
          - fsl,imx25-esdhc
          - fsl,imx35-esdhc
          - fsl,imx51-esdhc
          - fsl,imx53-esdhc
          - fsl,imx6q-usdhc
          - fsl,imx6sl-usdhc
          - fsl,imx6sx-usdhc
          - fsl,imx7d-usdhc
          - fsl,imx7ulp-usdhc
          - fsl,imx8mm-usdhc
          - fsl,imxrt1050-usdhc
          - nxp,s32g2-usdhc
      - items:
          - const: fsl,imx50-esdhc
          - const: fsl,imx53-esdhc
      - items:
          - enum:
              - fsl,imx6sll-usdhc
              - fsl,imx6ull-usdhc
              - fsl,imx6ul-usdhc
          - const: fsl,imx6sx-usdhc
      - items:
          - const: fsl,imx7d-usdhc
          - const: fsl,imx6sl-usdhc
      - items:
          - enum:
              - fsl,imx8mq-usdhc
          - const: fsl,imx7d-usdhc
      - items:
          - enum:
              - fsl,imx8mn-usdhc
              - fsl,imx8mp-usdhc
              - fsl,imx93-usdhc
              - fsl,imx8ulp-usdhc
          - const: fsl,imx8mm-usdhc
      - items:
          - enum:
              - fsl,imx8dxl-usdhc
              - fsl,imx8qm-usdhc
          - const: fsl,imx8qxp-usdhc
      - items:
          - enum:
              - fsl,imx8mm-usdhc
              - fsl,imx8mn-usdhc
              - fsl,imx8mp-usdhc
              - fsl,imx8qm-usdhc
              - fsl,imx8qxp-usdhc
          - const: fsl,imx7d-usdhc
        deprecated: true
      - items:
          - enum:
              - fsl,imx8mn-usdhc
              - fsl,imx8mp-usdhc
          - const: fsl,imx8mm-usdhc
          - const: fsl,imx7d-usdhc
        deprecated: true
      - items:
          - enum:
              - fsl,imx8dxl-usdhc
              - fsl,imx8qm-usdhc
          - const: fsl,imx8qxp-usdhc
          - const: fsl,imx7d-usdhc
        deprecated: true
      - items:
          - enum:
              - fsl,imxrt1170-usdhc
          - const: fsl,imxrt1050-usdhc

  reg:
    maxItems: 1

  interrupts:
    maxItems: 1

  fsl,wp-controller:
    description: |
      boolean, if present, indicate to use controller internal write protection.
    type: boolean

  fsl,delay-line:
    $ref: /schemas/types.yaml#/definitions/uint32
    description: |
      Specify the number of delay cells for override mode.
      This is used to set the clock delay for DLL(Delay Line) on override mode
      to select a proper data sampling window in case the clock quality is not good
      because the signal path is too long on the board. Please refer to eSDHC/uSDHC
      chapter, DLL (Delay Line) section in RM for details.
    default: 0

  voltage-ranges:
    $ref: /schemas/types.yaml#/definitions/uint32-matrix
    description: |
      Specify the voltage range in case there are software transparent level
      shifters on the outputs of the controller. Two cells are required, first
      cell specifies minimum slot voltage (mV), second cell specifies maximum
      slot voltage (mV).
    items:
      items:
        - description: value for minimum slot voltage
        - description: value for maximum slot voltage
    maxItems: 1

  fsl,tuning-start-tap:
    $ref: /schemas/types.yaml#/definitions/uint32
    description: |
      Specify the start delay cell point when send first CMD19 in tuning procedure.
    default: 0

  fsl,tuning-step:
    $ref: /schemas/types.yaml#/definitions/uint32
    description: |
      Specify the increasing delay cell steps in tuning procedure.
      The uSDHC use one delay cell as default increasing step to do tuning process.
      This property allows user to change the tuning step to more than one delay
      cell which is useful for some special boards or cards when the default
      tuning step can't find the proper delay window within limited tuning retries.
    default: 0

  fsl,strobe-dll-delay-target:
    $ref: /schemas/types.yaml#/definitions/uint32
    description: |
      Specify the strobe dll control slave delay target.
      This delay target programming host controller loopback read clock, and this
      property allows user to change the delay target for the strobe input read clock.
      If not use this property, driver default set the delay target to value 7.
      Only eMMC HS400 mode need to take care of this property.
    default: 0

  clocks:
    maxItems: 3
    description:
      Handle clocks for the sdhc controller.

  clock-names:
    items:
      - const: ipg
      - const: ahb
      - const: per

  power-domains:
    maxItems: 1

  pinctrl-names:
    oneOf:
      - minItems: 3
        items:
          - const: default
          - const: state_100mhz
          - const: state_200mhz
          - const: sleep
      - minItems: 1
        items:
          - const: default
          - const: sleep

required:
  - compatible
  - reg
  - interrupts

unevaluatedProperties: false

examples:
  - |
    mmc@70004000 {
        compatible = "fsl,imx51-esdhc";
        reg = <0x70004000 0x4000>;
        interrupts = <1>;
        fsl,wp-controller;
    };

    mmc@70008000 {
        compatible = "fsl,imx51-esdhc";
        reg = <0x70008000 0x4000>;
        interrupts = <2>;
        cd-gpios = <&gpio1 6 0>; /* GPIO1_6 */
        wp-gpios = <&gpio1 5 0>; /* GPIO1_5 */
    };
```

## Documentation/devicetree/bindings/mmc/fsl-imx-mmc.txt
```
* Freescale Secure Digital Host Controller for i.MX2/3 series

This file documents differences to the properties defined in mmc.txt.

Required properties:
- compatible : Should be "fsl,<chip>-mmc", chip can be imx21 or imx31

Optional properties:
- dmas: One DMA phandle with arguments as defined by the devicetree bindings
	of the used DMA controller.
- dma-names: Has to be "rx-tx".

Example:

sdhci1: sdhci@10014000 {
	compatible = "fsl,imx27-mmc", "fsl,imx21-mmc";
	reg = <0x10014000 0x1000>;
	interrupts = <11>;
	dmas = <&dma 7>;
	dma-names = "rx-tx";
	bus-width = <4>;
	cd-gpios = <&gpio3 29>;
	status = "okay";
};
```

## Documentation/devicetree/bindings/mmc/fsl-imx-mmc.yaml
```yaml
# SPDX-License-Identifier: (GPL-2.0-only OR BSD-2-Clause)
%YAML 1.2
---
$id: http://devicetree.org/schemas/mmc/fsl-imx-mmc.yaml#
$schema: http://devicetree.org/meta-schemas/core.yaml#

title: Freescale Secure Digital Host Controller for i.MX2/3 series

maintainers:
  - Markus Pargmann <mpa@pengutronix.de>

allOf:
  - $ref: "mmc-controller.yaml"

properties:
  compatible:
    oneOf:
      - const: fsl,imx21-mmc
      - const: fsl,imx31-mmc
      - items:
          - const: fsl,imx27-mmc
          - const: fsl,imx21-mmc

  reg:
    maxItems: 1

  interrupts:
    maxItems: 1

  dmas:
    maxItems: 1

  dma-names:
    const: rx-tx

required:
  - compatible
  - reg
  - interrupts

unevaluatedProperties: false

examples:
  - |
    mmc@10014000 {
        compatible = "fsl,imx27-mmc", "fsl,imx21-mmc";
        reg = <0x10014000 0x1000>;
        interrupts = <11>;
        dmas = <&dma 7>;
        dma-names = "rx-tx";
        bus-width = <4>;
        cd-gpios = <&gpio3 29>;
    };
```

## Documentation/devicetree/bindings/mmc/fujitsu,sdhci-fujitsu.yaml
```yaml
# SPDX-License-Identifier: GPL-2.0-only OR BSD-2-Clause
%YAML 1.2
---
$id: http://devicetree.org/schemas/mmc/fujitsu,sdhci-fujitsu.yaml#
$schema: http://devicetree.org/meta-schemas/core.yaml#

title: Fujitsu/Socionext SDHCI controller (F_SDH30)

maintainers:
  - Kunihiko Hayashi <hayashi.kunihiko@socionext.com>

allOf:
  - $ref: mmc-controller.yaml#

properties:
  compatible:
    oneOf:
      - items:
          - const: socionext,synquacer-sdhci
          - const: fujitsu,mb86s70-sdhci-3.0
      - enum:
          - fujitsu,mb86s70-sdhci-3.0
          - socionext,f-sdh30-e51-mmc

  reg:
    maxItems: 1

  clocks:
    maxItems: 2

  clock-names:
    items:
      - const: iface
      - const: core

  dma-coherent: true

  interrupts:
    maxItems: 2

  resets:
    maxItems: 1

  fujitsu,cmd-dat-delay-select:
    type: boolean
    description: |
      Indicating that this host requires the CMD_DAT_DELAY control to be enabled

unevaluatedProperties: false

required:
  - compatible
  - reg
  - clocks
  - clock-names

examples:
  - |
    sdhci1: mmc@36600000 {
        compatible = "fujitsu,mb86s70-sdhci-3.0";
        reg = <0x36600000 0x1000>;
        bus-width = <4>;
        vqmmc-supply = <&vccq_sdhci1>;
        clocks = <&clock 2 2 0>, <&clock 2 3 0>;
        clock-names = "iface", "core";
    };
```

## Documentation/devicetree/bindings/mmc/hi3798cv200-dw-mshc.txt
```
* Hisilicon Hi3798CV200 specific extensions to the Synopsys Designware Mobile
  Storage Host Controller

Read synopsys-dw-mshc.txt for more details

The Synopsys designware mobile storage host controller is used to interface
a SoC with storage medium such as eMMC or SD/MMC cards. This file documents
differences between the core Synopsys dw mshc controller properties described
by synopsys-dw-mshc.txt and the properties used by the Hisilicon Hi3798CV200
specific extensions to the Synopsys Designware Mobile Storage Host Controller.

Required Properties:
- compatible: Should contain "hisilicon,hi3798cv200-dw-mshc".
- clocks: A list of phandle + clock-specifier pairs for the clocks listed
  in clock-names.
- clock-names: Should contain the following:
	"ciu" - The ciu clock described in synopsys-dw-mshc.txt.
	"biu" - The biu clock described in synopsys-dw-mshc.txt.
	"ciu-sample" - Hi3798CV200 extended phase clock for ciu sampling.
	"ciu-drive"  - Hi3798CV200 extended phase clock for ciu driving.

Example:

	emmc: mmc@9830000 {
		compatible = "hisilicon,hi3798cv200-dw-mshc";
		reg = <0x9830000 0x10000>;
		interrupts = <GIC_SPI 35 IRQ_TYPE_LEVEL_HIGH>;
		clocks = <&crg HISTB_MMC_CIU_CLK>,
			 <&crg HISTB_MMC_BIU_CLK>,
			 <&crg HISTB_MMC_SAMPLE_CLK>,
			 <&crg HISTB_MMC_DRV_CLK>;
		clock-names = "ciu", "biu", "ciu-sample", "ciu-drive";
		fifo-depth = <256>;
		clock-frequency = <200000000>;
		cap-mmc-highspeed;
		mmc-ddr-1_8v;
		mmc-hs200-1_8v;
		non-removable;
		bus-width = <8>;
	};
```

## Documentation/devicetree/bindings/mmc/hisilicon,hi3660-dw-mshc.yaml
```yaml
# SPDX-License-Identifier: (GPL-2.0-only OR BSD-2-Clause)
%YAML 1.2
---
$id: http://devicetree.org/schemas/mmc/hisilicon,hi3660-dw-mshc.yaml#
$schema: http://devicetree.org/meta-schemas/core.yaml#

title: Hisilicon specific extensions to the Synopsys Designware Mobile Storage Host Controller

maintainers:
  - Zhangfei Gao <zhangfei.gao@linaro.org>

description:
  The Synopsys designware mobile storage host controller is used to interface
  a SoC with storage medium such as eMMC or SD/MMC cards. This file documents
  differences between the core Synopsys dw mshc controller properties described
  by synopsys-dw-mshc.txt and the properties used by the Hisilicon specific
  extensions to the Synopsys Designware Mobile Storage Host Controller.

allOf:
  - $ref: /schemas/mmc/synopsys-dw-mshc-common.yaml#

properties:
  compatible:
    oneOf:
      - enum:
          - hisilicon,hi3660-dw-mshc
          - hisilicon,hi4511-dw-mshc
          - hisilicon,hi6220-dw-mshc
      - items:
          - const: hisilicon,hi3670-dw-mshc
          - const: hisilicon,hi3660-dw-mshc

  reg:
    maxItems: 1

  interrupts:
    maxItems: 1

  clocks:
    items:
      - description: card interface unit clock
      - description: bus interface unit clock

  clock-names:
    items:
      - const: ciu
      - const: biu

  hisilicon,peripheral-syscon:
    $ref: /schemas/types.yaml#/definitions/phandle
    description: phandle of syscon used to control peripheral.

required:
  - compatible
  - reg
  - interrupts
  - clocks
  - clock-names

unevaluatedProperties: false

examples:
  - |
    #include <dt-bindings/clock/hi3620-clock.h>
    #include <dt-bindings/gpio/gpio.h>
    #include <dt-bindings/interrupt-controller/arm-gic.h>

    mmc@fcd03000 {
        compatible = "hisilicon,hi4511-dw-mshc";
        reg = <0xfcd03000 0x1000>;
        interrupts = <GIC_SPI 16 IRQ_TYPE_LEVEL_HIGH>;
        #address-cells = <1>;
        #size-cells = <0>;
        clocks = <&mmc_clock HI3620_SD_CIUCLK>, <&clock HI3620_DDRC_PER_CLK>;
        clock-names = "ciu", "biu";
        vmmc-supply = <&ldo12>;
        fifo-depth = <0x100>;
        pinctrl-names = "default";
        pinctrl-0 = <&sd_pmx_pins &sd_cfg_func1 &sd_cfg_func2>;
        bus-width = <4>;
        disable-wp;
        cd-gpios = <&gpio10 3 GPIO_ACTIVE_HIGH>;
        cap-mmc-highspeed;
        cap-sd-highspeed;
    };

  - |
    #include <dt-bindings/clock/hi6220-clock.h>
    #include <dt-bindings/gpio/gpio.h>
    #include <dt-bindings/interrupt-controller/arm-gic.h>

    soc {
      #address-cells = <2>;
      #size-cells = <2>;

      mmc@f723e000 {
          compatible = "hisilicon,hi6220-dw-mshc";
          reg = <0x0 0xf723e000 0x0 0x1000>;
          interrupts = <GIC_SPI 73 IRQ_TYPE_LEVEL_HIGH>;
          clocks = <&clock_sys HI6220_MMC1_CIUCLK>,
                   <&clock_sys HI6220_MMC1_CLK>;
          clock-names = "ciu", "biu";
          bus-width = <4>;
          disable-wp;
          cap-sd-highspeed;
          sd-uhs-sdr12;
          sd-uhs-sdr25;
          card-detect-delay = <200>;
          hisilicon,peripheral-syscon = <&ao_ctrl>;
          cd-gpios = <&gpio1 0 GPIO_ACTIVE_LOW>;
          pinctrl-names = "default", "idle";
          pinctrl-0 = <&sd_pmx_func &sd_clk_cfg_func &sd_cfg_func>;
          pinctrl-1 = <&sd_pmx_idle &sd_clk_cfg_idle &sd_cfg_idle>;
          vqmmc-supply = <&ldo7>;
          vmmc-supply = <&ldo10>;
      };
    };
```
