## Documentation/devicetree/bindings/mmc/sdhci-sprd.txt
```
* Spreadtrum SDHCI controller (sdhci-sprd)

The Secure Digital (SD) Host controller on Spreadtrum SoCs provides an interface
for MMC, SD and SDIO types of cards.

This file documents differences between the core properties in mmc.txt
and the properties used by the sdhci-sprd driver.

Required properties:
- compatible: Should contain "sprd,sdhci-r11".
- reg: physical base address of the controller and length.
- interrupts: Interrupts used by the SDHCI controller.
- clocks: Should contain phandle for the clock feeding the SDHCI controller
- clock-names: Should contain the following:
	"sdio" - SDIO source clock (required)
	"enable" - gate clock which used for enabling/disabling the device (required)
	"2x_enable" - gate clock controlling the device for some special platforms (optional)

Optional properties:
- assigned-clocks: the same with "sdio" clock
- assigned-clock-parents: the default parent of "sdio" clock
- pinctrl-names: should be "default", "state_uhs"
- pinctrl-0: should contain default/high speed pin control
- pinctrl-1: should contain uhs mode pin control

PHY DLL delays are used to delay the data valid window, and align the window
to sampling clock. PHY DLL delays can be configured by following properties,
and each property contains 4 cells which are used to configure the clock data
write line delay value, clock read command line delay value, clock read data
positive edge delay value and clock read data negative edge delay value.
Each cell's delay value unit is cycle of the PHY clock.

- sprd,phy-delay-legacy: Delay value for legacy timing.
- sprd,phy-delay-sd-highspeed: Delay value for SD high-speed timing.
- sprd,phy-delay-sd-uhs-sdr50: Delay value for SD UHS SDR50 timing.
- sprd,phy-delay-sd-uhs-sdr104: Delay value for SD UHS SDR50 timing.
- sprd,phy-delay-mmc-highspeed: Delay value for MMC high-speed timing.
- sprd,phy-delay-mmc-ddr52: Delay value for MMC DDR52 timing.
- sprd,phy-delay-mmc-hs200: Delay value for MMC HS200 timing.
- sprd,phy-delay-mmc-hs400: Delay value for MMC HS400 timing.
- sprd,phy-delay-mmc-hs400es: Delay value for MMC HS400 enhanced strobe timing.

Examples:

sdio0: sdio@20600000 {
	compatible  = "sprd,sdhci-r11";
	reg = <0 0x20600000 0 0x1000>;
	interrupts = <GIC_SPI 60 IRQ_TYPE_LEVEL_HIGH>;

	clock-names = "sdio", "enable";
	clocks = <&ap_clk CLK_EMMC_2X>,
		 <&apahb_gate CLK_EMMC_EB>;
	assigned-clocks = <&ap_clk CLK_EMMC_2X>;
	assigned-clock-parents = <&rpll CLK_RPLL_390M>;

	pinctrl-names = "default", "state_uhs";
	pinctrl-0 = <&sd0_pins_default>;
	pinctrl-1 = <&sd0_pins_uhs>;

	sprd,phy-delay-sd-uhs-sdr104 = <0x3f 0x7f 0x2e 0x2e>;
	bus-width = <8>;
	non-removable;
	no-sdio;
	no-sd;
	cap-mmc-hw-reset;
	status = "okay";
};
```

## Documentation/devicetree/bindings/mmc/sdhci-st.txt
```
* STMicroelectronics sdhci-st MMC/SD controller

This file documents the differences between the core properties in
Documentation/devicetree/bindings/mmc/mmc.txt and the properties
used by the sdhci-st driver.

Required properties:
- compatible:		Must be "st,sdhci" and it can be compatible to "st,sdhci-stih407"
			to set the internal glue logic used for configuring the MMC
			subsystem (mmcss) inside the FlashSS (available in STiH407 SoC
			family).

- clock-names:		Should be "mmc" and "icn".  (NB: The latter is not compulsory)
			See: Documentation/devicetree/bindings/resource-names.txt
- clocks:		Phandle to the clock.
			See: Documentation/devicetree/bindings/clock/clock-bindings.txt

- interrupts:		One mmc interrupt should be described here.
- interrupt-names:	Should be "mmcirq".

- pinctrl-names:	A pinctrl state names "default" must be defined.
- pinctrl-0:		Phandle referencing pin configuration of the sd/emmc controller.
			See: Documentation/devicetree/bindings/pinctrl/pinctrl-binding.txt

- reg:			This must provide the host controller base address and it can also
			contain the FlashSS Top register for TX/RX delay used by the driver
			to configure DLL inside the flashSS, if so reg-names must also be
			specified.

Optional properties:
- reg-names:		Should be "mmc" and "top-mmc-delay". "top-mmc-delay" is optional
			for eMMC on stih407 family silicon to configure DLL inside FlashSS.

- non-removable:	Non-removable slot. Also used for configuring mmcss in STiH407 SoC
			family.
			See:  Documentation/devicetree/bindings/mmc/mmc.txt.

- bus-width:		Number of data lines.
			See:  Documentation/devicetree/bindings/mmc/mmc.txt.

- max-frequency:	Can be 200MHz, 100MHz or 50MHz (default) and used for
			configuring the CCONFIG3 in the mmcss.
			See:  Documentation/devicetree/bindings/mmc/mmc.txt.

- resets:		Phandle and reset specifier pair to softreset line of HC IP.
			See: Documentation/devicetree/bindings/reset/reset.txt

- vqmmc-supply:		Phandle to the regulator dt node, mentioned as the vcc/vdd
			supply in eMMC/SD specs.

- sd-uhs-sdr50:	To enable the SDR50 in the mmcss.
			See:  Documentation/devicetree/bindings/mmc/mmc.txt.

- sd-uhs-sdr104:	To enable the SDR104 in the mmcss.
			See:  Documentation/devicetree/bindings/mmc/mmc.txt.

- sd-uhs-ddr50:		To enable the DDR50 in the mmcss.
			See:  Documentation/devicetree/bindings/mmc/mmc.txt.

Example:

/* Example stih416e eMMC configuration */

mmc0: sdhci@fe81e000 {
	compatible	= "st,sdhci";
	reg		= <0xfe81e000 0x1000>;
	interrupts	= <GIC_SPI 127 IRQ_TYPE_NONE>;
	interrupt-names	= "mmcirq";
	pinctrl-names	= "default";
	pinctrl-0	= <&pinctrl_mmc0>;
	clock-names	= "mmc";
	clocks		= <&clk_s_a1_ls 1>;
	bus-width	= <8>

/* Example SD stih407 family configuration */

mmc1: sdhci@09080000 {
	compatible	= "st,sdhci-stih407", "st,sdhci";
	reg		= <0x09080000 0x7ff>;
	reg-names	= "mmc";
	interrupts	= <GIC_SPI 90 IRQ_TYPE_NONE>;
	interrupt-names	= "mmcirq";
	pinctrl-names	= "default";
	pinctrl-0	= <&pinctrl_sd1>;
	clock-names	= "mmc";
	clocks		= <&clk_s_c0_flexgen CLK_MMC_1>;
	resets		= <&softreset STIH407_MMC1_SOFTRESET>;
	bus-width	= <4>;
};

/* Example eMMC stih407 family configuration */

mmc0: sdhci@09060000 {
	compatible	= "st,sdhci-stih407", "st,sdhci";
	reg		= <0x09060000 0x7ff>, <0x9061008 0x20>;
	reg-names	= "mmc", "top-mmc-delay";
	interrupts	= <GIC_SPI 92 IRQ_TYPE_NONE>;
	interrupt-names	= "mmcirq";
	pinctrl-names	= "default";
	pinctrl-0	= <&pinctrl_mmc0>;
	clock-names	= "mmc";
	clocks		= <&clk_s_c0_flexgen CLK_MMC_0>;
	vqmmc-supply	= <&vmmc_reg>;
	max-frequency	= <200000000>;
	bus-width	= <8>;
	non-removable;
	sd-uhs-sdr50;
	sd-uhs-sdr104;
	sd-uhs-ddr50;
};
```

## Documentation/devicetree/bindings/mmc/sdhci.txt
```
The properties specific for SD host controllers. For properties shared by MMC
host controllers refer to the mmc[1] bindings.

  [1] Documentation/devicetree/bindings/mmc/mmc.txt

Optional properties:
- sdhci-caps-mask: The sdhci capabilities register is incorrect. This 64bit
  property corresponds to the bits in the sdhci capabilty register. If the bit
  is on in the mask then the bit is incorrect in the register and should be
  turned off, before applying sdhci-caps.
- sdhci-caps: The sdhci capabilities register is incorrect. This 64bit
  property corresponds to the bits in the sdhci capability register. If the
  bit is on in the property then the bit should be turned on.
```

## Documentation/devicetree/bindings/mmc/snps,dwcmshc-sdhci.yaml
```yaml
# SPDX-License-Identifier: GPL-2.0-only
%YAML 1.2
---
$id: http://devicetree.org/schemas/mmc/snps,dwcmshc-sdhci.yaml#
$schema: http://devicetree.org/meta-schemas/core.yaml#

title: Synopsys Designware Mobile Storage Host Controller

maintainers:
  - Ulf Hansson <ulf.hansson@linaro.org>
  - Jisheng Zhang <Jisheng.Zhang@synaptics.com>

properties:
  compatible:
    oneOf:
      - items:
          - enum:
              - rockchip,rk3528-dwcmshc
              - rockchip,rk3562-dwcmshc
              - rockchip,rk3576-dwcmshc
          - const: rockchip,rk3588-dwcmshc
      - items:
          - const: sophgo,sg2044-dwcmshc
          - const: sophgo,sg2042-dwcmshc
      - enum:
          - rockchip,rk3568-dwcmshc
          - rockchip,rk3588-dwcmshc
          - snps,dwcmshc-sdhci
          - sophgo,cv1800b-dwcmshc
          - sophgo,sg2002-dwcmshc
          - sophgo,sg2042-dwcmshc
          - thead,th1520-dwcmshc
          - eswin,eic7700-dwcmshc

  reg:
    maxItems: 1

  interrupts:
    maxItems: 1

  clocks:
    minItems: 1
    maxItems: 5

  clock-names:
    minItems: 1
    maxItems: 5

  power-domains:
    maxItems: 1

  resets:
    maxItems: 5

  reset-names:
    maxItems: 5

  rockchip,txclk-tapnum:
    description: Specify the number of delay for tx sampling.
    $ref: /schemas/types.yaml#/definitions/uint8

  eswin,hsp-sp-csr:
    $ref: /schemas/types.yaml#/definitions/phandle-array
    items:
      - items:
          - description: Phandle to HSP(High-Speed Peripheral) device
          - description: Offset of the stability status register for internal
                         clock.
          - description: Offset of the stability register for host regulator
                         voltage.
    description:
      HSP CSR is to control and get status of different high-speed peripherals
      (such as Ethernet, USB, SATA, etc.) via register, which can tune
      board-level's parameters of PHY, etc.

  eswin,drive-impedance-ohms:
    description: Specifies the drive impedance in Ohm.
    enum: [33, 40, 50, 66, 100]

required:
  - compatible
  - reg
  - interrupts
  - clocks
  - clock-names

allOf:
  - $ref: mmc-controller.yaml#

  - if:
      properties:
        compatible:
          contains:
            const: sophgo,sg2042-dwcmshc

    then:
      properties:
        clocks:
          items:
            - description: core clock
            - description: bus clock
            - description: timer clock
        clock-names:
          items:
            - const: core
            - const: bus
            - const: timer
    else:
      properties:
        clocks:
          minItems: 1
          items:
            - description: core clock
            - description: bus clock for optional
            - description: axi clock for rockchip specified
            - description: block clock for rockchip specified
            - description: timer clock for rockchip specified
        clock-names:
          minItems: 1
          items:
            - const: core
            - const: bus
            - const: axi
            - const: block
            - const: timer

  - if:
      properties:
        compatible:
          contains:
            const: eswin,eic7700-dwcmshc
    then:
      properties:
        resets:
          minItems: 4
          maxItems: 4
        reset-names:
          items:
            - const: axi
            - const: phy
            - const: prstn
            - const: txrx
      required:
        - eswin,hsp-sp-csr
        - eswin,drive-impedance-ohms
    else:
      properties:
        resets:
          maxItems: 5
        reset-names:
          items:
            - const: core
            - const: bus
            - const: axi
            - const: block
            - const: timer

  - if:
      properties:
        compatible:
          contains:
            const: rockchip,rk3576-dwcmshc

    then:
      required:
        - power-domains

unevaluatedProperties: false

examples:
  - |
    mmc@fe310000 {
      compatible = "rockchip,rk3568-dwcmshc";
      reg = <0xfe310000 0x10000>;
      interrupts = <0 25 0x4>;
      clocks = <&cru 17>, <&cru 18>, <&cru 19>, <&cru 20>, <&cru 21>;
      clock-names = "core", "bus", "axi", "block", "timer";
      bus-width = <8>;
      #address-cells = <1>;
      #size-cells = <0>;
    };
  - |
    mmc@aa0000 {
      compatible = "snps,dwcmshc-sdhci";
      reg = <0xaa000 0x1000>;
      interrupts = <0 25 0x4>;
      clocks = <&cru 17>, <&cru 18>;
      clock-names = "core", "bus";
      bus-width = <8>;
      #address-cells = <1>;
      #size-cells = <0>;
    };

...
```

## Documentation/devicetree/bindings/mmc/socfpga-dw-mshc.txt
```
* Altera SOCFPGA specific extensions to the Synopsys Designware Mobile
  Storage Host Controller

The Synopsys designware mobile storage host controller is used to interface
a SoC with storage medium such as eMMC or SD/MMC cards. This file documents
differences between the core Synopsys dw mshc controller properties described
by synopsys-dw-mshc.txt and the properties used by the Altera SOCFPGA specific
extensions to the Synopsys Designware Mobile Storage Host Controller.

Required Properties:

* compatible: should be
	- "altr,socfpga-dw-mshc": for Altera's SOCFPGA platform

Example:

	mmc: dwmmc0@ff704000 {
		compatible = "altr,socfpga-dw-mshc";
		reg = <0xff704000 0x1000>;
		interrupts = <0 129 4>;
		#address-cells = <1>;
		#size-cells = <0>;
	};
```

## Documentation/devicetree/bindings/mmc/socionext,milbeaut-m10v-sdhci-3.0.yaml
```yaml
# SPDX-License-Identifier: (GPL-2.0-only OR BSD-2-Clause)
%YAML 1.2
---
$id: http://devicetree.org/schemas/mmc/socionext,milbeaut-m10v-sdhci-3.0.yaml#
$schema: http://devicetree.org/meta-schemas/core.yaml#

title: SOCIONEXT Milbeaut SDHCI controller

maintainers:
  - Taichi Sugaya <sugaya.taichi@socionext.com>
  - Takao Orito <orito.takao@socionext.com>

description:
  The SOCIONEXT Milbeaut SDHCI controller is a specialized SD Host
  Controller found in some of Socionext's Milbeaut image processing SoCs.
  It features a dedicated "bridge controller." This bridge controller
  implements special functions like reset control, clock management for
  various SDR modes (SDR12, SDR25, SDR50) and physical pin property settings.

allOf:
  - $ref: sdhci-common.yaml#

properties:
  compatible:
    const: socionext,milbeaut-m10v-sdhci-3.0

  reg:
    maxItems: 1

  interrupts:
    maxItems: 1

  clocks:
    maxItems: 2

  clock-names:
    items:
      - const: core
      - const: iface

  fujitsu,cmd-dat-delay-select:
    description:
      Its presence indicates that the controller requires a specific command
      and data line delay selection mechanism for proper operation, particularly
      when dealing with high-speed SD/eMMC modes.
    type: boolean

  voltage-ranges:
    $ref: /schemas/types.yaml#/definitions/uint32-matrix
    items:
      items:
        - description: minimum slot voltage (mV).
        - description: maximum slot voltage (mV).
    maxItems: 1

required:
  - compatible
  - reg
  - interrupts
  - clocks
  - clock-names

unevaluatedProperties: false

examples:
  - |
    #include <dt-bindings/interrupt-controller/arm-gic.h>
    mmc@1b010000 {
        compatible = "socionext,milbeaut-m10v-sdhci-3.0";
        reg = <0x1b010000 0x10000>;
        interrupts = <GIC_SPI 265 IRQ_TYPE_LEVEL_HIGH>;
        voltage-ranges = <3300 3300>;
        bus-width = <4>;
        clocks = <&clk 7>, <&ahb_clk>;
        clock-names = "core", "iface";
        cap-sdio-irq;
        fujitsu,cmd-dat-delay-select;
    };
...
```
