## Documentation/devicetree/bindings/mmc/socionext,uniphier-sd.yaml
```yaml
# SPDX-License-Identifier: GPL-2.0-only OR BSD-2-Clause
%YAML 1.2
---
$id: http://devicetree.org/schemas/mmc/socionext,uniphier-sd.yaml#
$schema: http://devicetree.org/meta-schemas/core.yaml#

title: UniPhier SD/SDIO/eMMC controller

maintainers:
  - Masahiro Yamada <yamada.masahiro@socionext.com>

properties:
  compatible:
    description: version 2.91, 3.1, 3.1.1, respectively
    enum:
      - socionext,uniphier-sd-v2.91
      - socionext,uniphier-sd-v3.1
      - socionext,uniphier-sd-v3.1.1

  reg:
    maxItems: 1

  interrupts:
    maxItems: 1

  clocks:
    maxItems: 1

  reset-names:
    description: |
      There are three reset signals at maximum
        host:   mandatory for all variants
        bridge: exist only for version 2.91
        hw:     optional. exist if eMMC hw reset line is available
    oneOf:
      - const: host
      - items:
          - const: host
          - const: bridge
      - items:
          - const: host
          - const: hw
      - items:
          - const: host
          - const: bridge
          - const: hw

  resets:
    minItems: 1
    maxItems: 3

allOf:
  - $ref: mmc-controller.yaml

  - if:
      properties:
        compatible:
          contains:
            const: socionext,uniphier-sd-v2.91
    then:
      properties:
        reset-names:
          contains:
            const: bridge
    else:
      properties:
        reset-names:
          not:
            contains:
              const: bridge

required:
  - compatible
  - reg
  - interrupts
  - clocks
  - reset-names
  - resets

examples:
  - |
    sd: mmc@5a400000 {
        compatible = "socionext,uniphier-sd-v2.91";
        reg = <0x5a400000 0x200>;
        interrupts = <0 76 4>;
        pinctrl-names = "default", "uhs";
        pinctrl-0 = <&pinctrl_sd>;
        pinctrl-1 = <&pinctrl_sd_uhs>;
        clocks = <&mio_clk 0>;
        reset-names = "host", "bridge";
        resets = <&mio_rst 0>, <&mio_rst 3>;
        dma-names = "rx-tx";
        dmas = <&dmac 4>;
        bus-width = <4>;
        cap-sd-highspeed;
        sd-uhs-sdr12;
        sd-uhs-sdr25;
        sd-uhs-sdr50;
    };
```

## Documentation/devicetree/bindings/mmc/spacemit,sdhci.yaml
```yaml
# SPDX-License-Identifier: (GPL-2.0-only OR BSD-2-Clause)
%YAML 1.2
---
$id: http://devicetree.org/schemas/mmc/spacemit,sdhci.yaml#
$schema: http://devicetree.org/meta-schemas/core.yaml#

title: SpacemiT SDHCI Controller

maintainers:
  - Yixun Lan <dlan@gentoo.org>

allOf:
  - $ref: mmc-controller.yaml#

properties:
  compatible:
    enum:
      - spacemit,k1-sdhci
      - spacemit,k3-sdhci

  reg:
    maxItems: 1

  interrupts:
    maxItems: 1

  clocks:
    items:
      - description: core clock, used by internal controller
      - description: io clock, output for SD, SDIO, eMMC device

  clock-names:
    items:
      - const: core
      - const: io

  resets:
    items:
      - description: axi reset, connect to AXI bus, shared by all controllers
      - description: sdh reset, connect to individual controller separately

  reset-names:
    items:
      - const: axi
      - const: sdh

  pinctrl-names:
    minItems: 1
    items:
      - const: default
      - const: uhs

  pinctrl-0:
    description: Default pinctrl state for 3.3V operation

  pinctrl-1:
    description: Optional pinctrl state for 1.8V UHS operation with "uhs" name

required:
  - compatible
  - reg
  - interrupts
  - clocks
  - clock-names

unevaluatedProperties: false

examples:
  - |
    mmc@d4281000 {
      compatible = "spacemit,k1-sdhci";
      reg = <0xd4281000 0x200>;
      interrupts = <101>;
      interrupt-parent = <&plic>;
      clocks = <&clk_apmu 10>, <&clk_apmu 13>;
      clock-names = "core", "io";
      pinctrl-names = "default", "uhs";
      pinctrl-0 = <&sdhci_default_cfg>;
      pinctrl-1 = <&sdhci_uhs_cfg>;
    };
```

## Documentation/devicetree/bindings/mmc/sprd,sdhci-r11.yaml
```yaml
# SPDX-License-Identifier: GPL-2.0 OR BSD-2-Clause
%YAML 1.2
---
$id: http://devicetree.org/schemas/mmc/sprd,sdhci-r11.yaml#
$schema: http://devicetree.org/meta-schemas/core.yaml#

title: Spreadtrum SDHCI controller

maintainers:
  - Orson Zhai <orsonzhai@gmail.com>
  - Baolin Wang <baolin.wang7@gmail.com>
  - Chunyan Zhang <zhang.lyra@gmail.com>

properties:
  compatible:
    const: sprd,sdhci-r11

  reg:
    maxItems: 1

  interrupts:
    maxItems: 1

  clocks:
    minItems: 2
    items:
      - description: SDIO source clock
      - description: gate clock for enabling/disabling the device
      - description: gate clock controlling the device for some special platforms (optional)

  clock-names:
    minItems: 2
    items:
      - const: sdio
      - const: enable
      - const: 2x_enable

  pinctrl-0:
    description: default/high speed pin control
    maxItems: 1

  pinctrl-1:
    description: UHS mode pin control
    maxItems: 1

  pinctrl-names:
    minItems: 1
    items:
      - const: default
      - const: state_uhs

patternProperties:
  "^sprd,phy-delay-(legacy|mmc-(ddr52|highspeed|hs[24]00|hs400es)|sd-(highspeed|uhs-sdr(50|104)))$":
    $ref: /schemas/types.yaml#/definitions/uint32-array
    items:
      - description: clock data write line delay value
      - description: clock read command line delay value
      - description: clock read data positive edge delay value
      - description: clock read data negative edge delay value
    description:
      PHY DLL delays are used to delay the data valid window, and align
      the window to the sampling clock. Each cell's delay value unit is
      cycle of the PHY clock.

required:
  - compatible
  - reg
  - interrupts
  - clocks
  - clock-names

allOf:
  - $ref: sdhci-common.yaml#

unevaluatedProperties: false

examples:
  - |
    #include <dt-bindings/clock/sprd,sc9860-clk.h>
    #include <dt-bindings/interrupt-controller/arm-gic.h>
    #include <dt-bindings/interrupt-controller/irq.h>

    mmc@50430000 {
      compatible = "sprd,sdhci-r11";
      reg = <0x50430000 0x1000>;
      interrupts = <GIC_SPI 41 IRQ_TYPE_LEVEL_HIGH>;

      clocks = <&aon_prediv CLK_EMMC_2X>,
               <&apahb_gate CLK_EMMC_EB>,
               <&aon_gate CLK_EMMC_2X_EN>;
      clock-names = "sdio", "enable", "2x_enable";

      pinctrl-0 = <&sd0_pins_default>;
      pinctrl-1 = <&sd0_pins_uhs>;
      pinctrl-names = "default", "state_uhs";

      bus-width = <8>;
      cap-mmc-hw-reset;
      mmc-hs400-enhanced-strobe;
      mmc-hs400-1_8v;
      mmc-hs200-1_8v;
      mmc-ddr-1_8v;
      non-removable;
      no-sdio;
      no-sd;

      sprd,phy-delay-mmc-ddr52 = <0x3f 0x75 0x14 0x14>;
      sprd,phy-delay-mmc-hs200 = <0x0 0x8c 0x8c 0x8c>;
      sprd,phy-delay-mmc-hs400 = <0x44 0x7f 0x2e 0x2e>;
      sprd,phy-delay-mmc-hs400es = <0x3f 0x3f 0x2e 0x2e>;
    };
...
```

## Documentation/devicetree/bindings/mmc/st,sdhci.yaml
```yaml
# SPDX-License-Identifier: (GPL-2.0-only OR BSD-2-Clause)
%YAML 1.2
---
$id: http://devicetree.org/schemas/mmc/st,sdhci.yaml#
$schema: http://devicetree.org/meta-schemas/core.yaml#

title: STMicroelectronics SDHCI-ST MMC/SD Controller

maintainers:
  - Peter Griffin <peter.griffin@linaro.org>

description:
  The STMicroelectronics SDHCI-ST MMC/SD host controller is compliant with
  the SD Host Controller Interface (SDHCI) specification and is used to
  interface with MMC, SD and SDIO cards. The ST SDHCI controller extends the
  standard SDHCI capabilities with platform-specific configurations such as
  additional register regions, clock inputs, and delay control mechanisms
  required for signal timing adjustments to support high-speed modes across
  different ST SoCs.

allOf:
  - $ref: mmc-controller.yaml#
  - if:
      properties:
        reg:
          minItems: 2
      required:
        - reg
    then:
      required:
        - reg-names

properties:
  compatible:
    oneOf:
      - const: st,sdhci
      - items:
          - const: st,sdhci-stih407
          - const: st,sdhci

  reg:
    minItems: 1
    items:
      - description: MMC controller base registers
      - description: FlashSS Top registers for TX/RX DLL delay configuration

  reg-names:
    minItems: 1
    items:
      - const: mmc
      - const: top-mmc-delay

  clocks:
    minItems: 1
    items:
      - description: Clock for the MMC controller
      - description: Interconnect (ICN) clock

  clock-names:
    minItems: 1
    items:
      - const: mmc
      - const: icn

  interrupts:
    maxItems: 1

  interrupt-names:
    const: mmcirq

  resets:
    maxItems: 1

  max-frequency:
    enum: [200000000, 100000000, 50000000]
    default: 50000000

required:
  - reg
  - compatible
  - clocks
  - clock-names
  - interrupts
  - interrupt-names

unevaluatedProperties: false

examples:
  - |
    #include <dt-bindings/interrupt-controller/arm-gic.h>
    #include <dt-bindings/clock/stih407-clks.h>
    mmc@9060000 {
        compatible = "st,sdhci-stih407", "st,sdhci";
        reg = <0x09060000 0x7ff>, <0x9061008 0x20>;
        reg-names = "mmc", "top-mmc-delay";
        interrupts = <GIC_SPI 92 IRQ_TYPE_LEVEL_HIGH>;
        interrupt-names = "mmcirq";
        pinctrl-names = "default";
        pinctrl-0 = <&pinctrl_mmc0>;
        clock-names = "mmc", "icn";
        clocks = <&clk_s_c0_flexgen CLK_MMC_0>,
                 <&clk_s_c0_flexgen CLK_RX_ICN_HVA>;
        bus-width = <8>;
    };
...
```

## Documentation/devicetree/bindings/mmc/starfive,jh7110-mmc.yaml
```yaml
# SPDX-License-Identifier: GPL-2.0-only OR BSD-2-Clause
%YAML 1.2
---
$id: http://devicetree.org/schemas/mmc/starfive,jh7110-mmc.yaml#
$schema: http://devicetree.org/meta-schemas/core.yaml#

title: StarFive Designware Mobile Storage Host Controller

description:
  StarFive uses the Synopsys designware mobile storage host controller
  to interface a SoC with storage medium such as eMMC or SD/MMC cards.

allOf:
  - $ref: synopsys-dw-mshc-common.yaml#

maintainers:
  - William Qiu <william.qiu@starfivetech.com>

properties:
  compatible:
    const: starfive,jh7110-mmc

  reg:
    maxItems: 1

  clocks:
    items:
      - description: biu clock
      - description: ciu clock

  clock-names:
    items:
      - const: biu
      - const: ciu

  interrupts:
    maxItems: 1

  starfive,sysreg:
    $ref: /schemas/types.yaml#/definitions/phandle-array
    items:
      - items:
          - description: phandle to System Register Controller syscon node
          - description: offset of SYS_SYSCONSAIF__SYSCFG register for MMC controller
          - description: shift of SYS_SYSCONSAIF__SYSCFG register for MMC controller
          - description: mask of SYS_SYSCONSAIF__SYSCFG register for MMC controller
    description:
      Should be four parameters, the phandle to System Register Controller
      syscon node and the offset/shift/mask of SYS_SYSCONSAIF__SYSCFG register
      for MMC controller.

required:
  - compatible
  - reg
  - clocks
  - clock-names
  - interrupts
  - starfive,sysreg

unevaluatedProperties: false

examples:
  - |
    mmc@16010000 {
        compatible = "starfive,jh7110-mmc";
        reg = <0x16010000 0x10000>;
        clocks = <&syscrg 91>,
                 <&syscrg 93>;
        clock-names = "biu","ciu";
        resets = <&syscrg 64>;
        reset-names = "reset";
        interrupts = <74>;
        fifo-depth = <32>;
        fifo-watermark-aligned;
        data-addr = <0>;
        starfive,sysreg = <&sys_syscon 0x14 0x1a 0x7c000000>;
    };
```

## Documentation/devicetree/bindings/mmc/starfive,jh7110-sdio.yaml
```yaml
# SPDX-License-Identifier: GPL-2.0-only OR BSD-2-Clause
%YAML 1.2
---
$id: http://devicetree.org/schemas/mmc/starfive,jh7110-sdio.yaml#
$schema: http://devicetree.org/meta-schemas/core.yaml#

title: StarFive JH7110 SDIO Device Tree Bindings

description: |
  Bindings for the JH7110 RISC-V SoC from StarFive Ltd.

maintainers:
  - William Qiu <william,qiu@starfivetech.com>

properties:
  compatible:
    const: starfive,jh7110-sdio

  reg:
    maxItems: 1

  clocks:
    minItems: 1
    items:
	-description: biu clock
	-description: ciu clock

  clock-names:
    minItems: 1
    items:
	-const: biu
	-const: ciu

  resets:
    maxItems: 1

  reset-names:
    maxItems: 1
	-const: reset

  interrupts:
    maxItems: 1

  fifo-depth:
    maxItems: 1

  data-addr:
    maxItem: 1

required:
  - compatible
  - reg
  - clocks
  - clock-names
  - resets
  - reset-names
  - interrupts
  - fifo-depth
  - data-addr

examples:
  - |
    sdio0: sdio0@16010000 {
			compatible = "starfive,jh7110-sdio";
			reg = <0x0 0x16010000 0x0 0x10000>;
			clocks = <&clkgen JH7110_SDIO0_CLK_AHB>,
				 <&clkgen JH7110_SDIO0_CLK_SDCARD>;
			clock-names = "biu","ciu";
			resets = <&rstgen RSTN_U0_DW_SDIO_AHB>;
			reset-names = "reset";
			interrupts = <74>;
			fifo-depth = <32>;
			fifo-watermark-aligned;
			data-addr = <0>;
			starfive,sys-syscon = <&sys_syscon 0x14 0x1a 0x7c000000>;
			status = "disabled";
		};
```

## Documentation/devicetree/bindings/mmc/sunplus,mmc.yaml
```yaml
# SPDX-License-Identifier: (GPL-2.0-only OR BSD-2-Clause)
# Copyright (C) Sunplus Ltd. Co. 2021
%YAML 1.2
---
$id: http://devicetree.org/schemas/mmc/sunplus,mmc.yaml#
$schema: http://devicetree.org/meta-schemas/core.yaml#

title: Sunplus MMC Controller

maintainers:
  - Tony Huang <tonyhuang.sunplus@gmail.com>
  - Li-hao Kuo <lhjeff911@gmail.com>

allOf:
  - $ref: mmc-controller.yaml

properties:
  compatible:
    enum:
      - sunplus,sp7021-mmc

  reg:
    maxItems: 1

  interrupts:
    maxItems: 1

  clocks:
    maxItems: 1

  resets:
    maxItems: 1

required:
  - compatible
  - reg
  - interrupts
  - clocks
  - resets

unevaluatedProperties: false

examples:
  - |
    #include <dt-bindings/interrupt-controller/irq.h>
    #include <dt-bindings/interrupt-controller/arm-gic.h>
    mmc0: mmc@9c003b00 {
        compatible = "sunplus,sp7021-mmc";
        reg = <0x9c003b00 0x180>;
        interrupts = <20 IRQ_TYPE_LEVEL_HIGH>;
        clocks = <&clkc 0x4e>;
        resets = <&rstc 0x3e>;
        bus-width = <8>;
        max-frequency = <52000000>;
        non-removable;
        disable-wp;
        cap-mmc-highspeed;
        mmc-ddr-3_3v;
        no-sdio;
        no-sd;
    };
```

## Documentation/devicetree/bindings/mmc/sunxi-mmc.txt
```
* Allwinner sunxi MMC controller

The highspeed MMC host controller on Allwinner SoCs provides an interface
for MMC, SD and SDIO types of memory cards.

Supported maximum speeds are the ones of the eMMC standard 4.5 as well
as the speed of SD standard 3.0.
Absolute maximum transfer rate is 200MB/s

Required properties:
 - compatible : should be one of:
   * "allwinner,sun4i-a10-mmc"
   * "allwinner,sun5i-a13-mmc"
   * "allwinner,sun7i-a20-mmc"
   * "allwinner,sun9i-a80-mmc"
 - reg : mmc controller base registers
 - clocks : a list with 4 phandle + clock specifier pairs
 - clock-names : must contain "ahb", "mmc", "output" and "sample"
 - interrupts : mmc controller interrupt

Optional properties:
 - resets : phandle + reset specifier pair
 - reset-names : must contain "ahb"
 - for cd, bus-width and additional generic mmc parameters
   please refer to mmc.txt within this directory

Examples:
	- Within .dtsi:
	mmc0: mmc@01c0f000 {
		compatible = "allwinner,sun5i-a13-mmc";
		reg = <0x01c0f000 0x1000>;
		clocks = <&ahb_gates 8>, <&mmc0_clk>, <&mmc0_output_clk>, <&mmc0_sample_clk>;
		clock-names = "ahb", "mod", "output", "sample";
		interrupts = <0 32 4>;
		status = "disabled";
	};

	- Within dts:
	mmc0: mmc@01c0f000 {
		pinctrl-names = "default", "default";
		pinctrl-0 = <&mmc0_pins_a>;
		pinctrl-1 = <&mmc0_cd_pin_reference_design>;
		bus-width = <4>;
		cd-gpios = <&pio 7 1 0>; /* PH1 */
		cd-inverted;
		status = "okay";
	};
```
