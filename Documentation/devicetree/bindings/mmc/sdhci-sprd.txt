## Documentation/devicetree/bindings/mmc/synopsis-dw-mshc.txt
```
* Synopsis Designware Mobile Storage Host Controller

The Synopsis designware mobile storage host controller is used to interface
a SoC with storage medium such as eMMC or SD/MMC cards. This file documents
differences between the core mmc properties described by mmc.txt and the
properties used by the Synopsis Designware Mobile Storage Host Controller.

Required Properties:

* compatible: should be
	- snps,dw-mshc: for controllers compliant with synopsis dw-mshc.
* #address-cells: should be 1.
* #size-cells: should be 0.

# Slots: The slot specific information are contained within child-nodes with
  each child-node representing a supported slot. There should be atleast one
  child node representing a card slot. The name of the child node representing
  the slot is recommended to be slot@n where n is the unique number of the slot
  connnected to the controller. The following are optional properties which
  can be included in the slot child node.

	* reg: specifies the physical slot number. The valid values of this
	  property is 0 to (num-slots -1), where num-slots is the value
	  specified by the num-slots property.

	* bus-width: as documented in mmc core bindings.

	* wp-gpios: specifies the write protect gpio line. The format of the
	  gpio specifier depends on the gpio controller. If a GPIO is not used
	  for write-protect, this property is optional.

	* disable-wp: If the wp-gpios property isn't present then (by default)
	  we'd assume that the write protect is hooked up directly to the
	  controller's special purpose write protect line (accessible via
	  the WRTPRT register).  However, it's possible that we simply don't
	  want write protect.  In that case specify 'disable-wp'.
	  NOTE: This property is not required for slots known to always
	  connect to eMMC or SDIO cards.

Optional properties:

* clocks: from common clock binding: handle to biu and ciu clocks for the
  bus interface unit clock and the card interface unit clock.

* clock-names: from common clock binding: Shall be "biu" and "ciu".
  If the biu clock is missing we'll simply skip enabling it.  If the
  ciu clock is missing we'll just assume that the clock is running at
  clock-frequency.  It is an error to omit both the ciu clock and the
  clock-frequency.

* clock-frequency: should be the frequency (in Hz) of the ciu clock.  If this
  is specified and the ciu clock is specified then we'll try to set the ciu
  clock to this at probe time.

* num-slots: specifies the number of slots supported by the controller.
  The number of physical slots actually used could be equal or less than the
  value specified by num-slots. If this property is not specified, the value
  of num-slot property is assumed to be 1.

* fifo-depth: The maximum size of the tx/rx fifo's. If this property is not
  specified, the default value of the fifo size is determined from the
  controller registers.

* card-detect-delay: Delay in milli-seconds before detecting card after card
  insert event. The default value is 0.

* supports-highspeed: Enables support for high speed cards (upto 50MHz)

* broken-cd: as documented in mmc core bindings.

* vmmc-supply: The phandle to the regulator to use for vmmc.  If this is
  specified we'll defer probe until we can find this regulator.

Aliases:

- All the MSHC controller nodes should be represented in the aliases node using
  the following format 'mshc{n}' where n is a unique number for the alias.

Example:

The MSHC controller node can be split into two portions, SoC specific and
board specific portions as listed below.

	dwmmc0@12200000 {
		compatible = "snps,dw-mshc";
		clocks = <&clock 351>, <&clock 132>;
		clock-names = "biu", "ciu";
		reg = <0x12200000 0x1000>;
		interrupts = <0 75 0>;
		#address-cells = <1>;
		#size-cells = <0>;
	};

	dwmmc0@12200000 {
		clock-frequency = <400000000>;
		num-slots = <1>;
		supports-highspeed;
		broken-cd;
		fifo-depth = <0x80>;
		card-detect-delay = <200>;
		vmmc-supply = <&buck8>;

		slot@0 {
			reg = <0>;
			bus-width = <8>;
		};
	};
```

## Documentation/devicetree/bindings/mmc/synopsys-dw-mshc-common.yaml
```yaml
# SPDX-License-Identifier: GPL-2.0
%YAML 1.2
---
$id: http://devicetree.org/schemas/mmc/synopsys-dw-mshc-common.yaml#
$schema: http://devicetree.org/meta-schemas/core.yaml#

title: Synopsys Designware Mobile Storage Host Controller Common Properties

allOf:
  - $ref: "mmc-controller.yaml#"

maintainers:
  - Ulf Hansson <ulf.hansson@linaro.org>

# Everything else is described in the common file
properties:
  resets:
    maxItems: 1

  reset-names:
    const: reset

  clock-frequency:
    description:
      Should be the frequency (in Hz) of the ciu clock.  If this
      is specified and the ciu clock is specified then we'll try to set the ciu
      clock to this at probe time.

  fifo-depth:
    description:
      The maximum size of the tx/rx fifo's. If this property is not
      specified, the default value of the fifo size is determined from the
      controller registers.
    $ref: /schemas/types.yaml#/definitions/uint32

  card-detect-delay:
    description:
      Delay in milli-seconds before detecting card after card
      insert event. The default value is 0.
    $ref: /schemas/types.yaml#/definitions/uint32
    default: 0

  data-addr:
    description:
      Override fifo address with value provided by DT. The default FIFO reg
      offset is assumed as 0x100 (version < 0x240A) and 0x200(version >= 0x240A)
      by driver. If the controller does not follow this rule, please use
      this property to set fifo address in device tree.
    $ref: /schemas/types.yaml#/definitions/uint32

  fifo-watermark-aligned:
    description:
      Data done irq is expected if data length is less than
      watermark in PIO mode. But fifo watermark is requested to be aligned
      with data length in some SoC so that TX/RX irq can be generated with
      data done irq. Add this watermark quirk to mark this requirement and
      force fifo watermark setting accordingly.
    $ref: /schemas/types.yaml#/definitions/flag

  dmas:
    maxItems: 1

  dma-names:
    const: rx-tx

additionalProperties: true
```

## Documentation/devicetree/bindings/mmc/synopsys-dw-mshc.txt
```
* Synopsys Designware Mobile Storage Host Controller

The Synopsys designware mobile storage host controller is used to interface
a SoC with storage medium such as eMMC or SD/MMC cards. This file documents
differences between the core mmc properties described by mmc.txt and the
properties used by the Synopsys Designware Mobile Storage Host Controller.

Required Properties:

* compatible: should be
	- snps,dw-mshc: for controllers compliant with synopsys dw-mshc.
* #address-cells: should be 1.
* #size-cells: should be 0.

# Slots: The slot specific information are contained within child-nodes with
  each child-node representing a supported slot. There should be atleast one
  child node representing a card slot. The name of the child node representing
  the slot is recommended to be slot@n where n is the unique number of the slot
  connnected to the controller. The following are optional properties which
  can be included in the slot child node.

	* reg: specifies the physical slot number. The valid values of this
	  property is 0 to (num-slots -1), where num-slots is the value
	  specified by the num-slots property.

	* bus-width: as documented in mmc core bindings.

	* wp-gpios: specifies the write protect gpio line. The format of the
	  gpio specifier depends on the gpio controller. If a GPIO is not used
	  for write-protect, this property is optional.

	* disable-wp: If the wp-gpios property isn't present then (by default)
	  we'd assume that the write protect is hooked up directly to the
	  controller's special purpose write protect line (accessible via
	  the WRTPRT register).  However, it's possible that we simply don't
	  want write protect.  In that case specify 'disable-wp'.
	  NOTE: This property is not required for slots known to always
	  connect to eMMC or SDIO cards.

Optional properties:

* resets: phandle + reset specifier pair, intended to represent hardware
  reset signal present internally in some host controller IC designs.
  See Documentation/devicetree/bindings/reset/reset.txt for details.

* reset-names: request name for using "resets" property. Must be "reset".
	(It will be used together with "resets" property.)

* clocks: from common clock binding: handle to biu and ciu clocks for the
  bus interface unit clock and the card interface unit clock.

* clock-names: from common clock binding: Shall be "biu" and "ciu".
  If the biu clock is missing we'll simply skip enabling it.  If the
  ciu clock is missing we'll just assume that the clock is running at
  clock-frequency.  It is an error to omit both the ciu clock and the
  clock-frequency.

* clock-frequency: should be the frequency (in Hz) of the ciu clock.  If this
  is specified and the ciu clock is specified then we'll try to set the ciu
  clock to this at probe time.

* clock-freq-min-max (DEPRECATED): Minimum and Maximum clock frequency for card output
  clock(cclk_out). If it's not specified, max is 200MHZ and min is 400KHz by default.
	  (Use the "max-frequency" instead of "clock-freq-min-max".)

* num-slots: specifies the number of slots supported by the controller.
  The number of physical slots actually used could be equal or less than the
  value specified by num-slots. If this property is not specified, the value
  of num-slot property is assumed to be 1.

* fifo-depth: The maximum size of the tx/rx fifo's. If this property is not
  specified, the default value of the fifo size is determined from the
  controller registers.

* card-detect-delay: Delay in milli-seconds before detecting card after card
  insert event. The default value is 0.

* vmmc-supply: The phandle to the regulator to use for vmmc.  If this is
  specified we'll defer probe until we can find this regulator.

* dmas: List of DMA specifiers with the controller specific format as described
  in the generic DMA client binding. Refer to dma.txt for details.

* dma-names: request names for generic DMA client binding. Must be "rx-tx".
  Refer to dma.txt for details.

Aliases:

- All the MSHC controller nodes should be represented in the aliases node using
  the following format 'mshc{n}' where n is a unique number for the alias.

Example:

The MSHC controller node can be split into two portions, SoC specific and
board specific portions as listed below.

	dwmmc0@12200000 {
		compatible = "snps,dw-mshc";
		clocks = <&clock 351>, <&clock 132>;
		clock-names = "biu", "ciu";
		reg = <0x12200000 0x1000>;
		interrupts = <0 75 0>;
		#address-cells = <1>;
		#size-cells = <0>;
		resets = <&rst 20>;
		reset-names = "reset";
	};

[board specific internal DMA resources]

	dwmmc0@12200000 {
		clock-frequency = <400000000>;
		clock-freq-min-max = <400000 200000000>;
		num-slots = <1>;
		broken-cd;
		fifo-depth = <0x80>;
		card-detect-delay = <200>;
		vmmc-supply = <&buck8>;
		bus-width = <8>;
		cap-mmc-highspeed;
		cap-sd-highspeed;
	};

[board specific generic DMA request binding]

	dwmmc0@12200000 {
		clock-frequency = <400000000>;
		clock-freq-min-max = <400000 200000000>;
		num-slots = <1>;
		broken-cd;
		fifo-depth = <0x80>;
		card-detect-delay = <200>;
		vmmc-supply = <&buck8>;
		bus-width = <8>;
		cap-mmc-highspeed;
		cap-sd-highspeed;
		dmas = <&pdma 12>;
		dma-names = "rx-tx";
	};
```

## Documentation/devicetree/bindings/mmc/synopsys-dw-mshc.yaml
```yaml
# SPDX-License-Identifier: GPL-2.0
%YAML 1.2
---
$id: http://devicetree.org/schemas/mmc/synopsys-dw-mshc.yaml#
$schema: http://devicetree.org/meta-schemas/core.yaml#

title: Synopsys Designware Mobile Storage Host Controller

maintainers:
  - Ulf Hansson <ulf.hansson@linaro.org>

# Everything else is described in the common file
properties:
  compatible:
    enum:
      - altr,socfpga-dw-mshc
      - img,pistachio-dw-mshc
      - snps,dw-mshc

  reg:
    maxItems: 1

  interrupts:
    maxItems: 1

  clocks:
    minItems: 2
    maxItems: 2
    description:
      Handle to "biu" and "ciu" clocks for the
      bus interface unit clock and the card interface unit clock.

  clock-names:
    items:
      - const: biu
      - const: ciu

  iommus:
    maxItems: 1

  altr,sysmgr-syscon:
    $ref: /schemas/types.yaml#/definitions/phandle-array
    items:
      - items:
          - description: phandle to the sysmgr node
          - description: register offset that controls the SDMMC clock phase
          - description: register shift for the smplsel(drive in) setting
    description:
      This property is optional. Contains the phandle to System Manager block
      that contains the SDMMC clock-phase control register. The first value is
      the pointer to the sysmgr, the 2nd value is the register offset for the
      SDMMC clock phase register, and the 3rd value is the bit shift for the
      smplsel(drive in) setting.

allOf:
  - $ref: synopsys-dw-mshc-common.yaml#

  - if:
      properties:
        compatible:
          contains:
            const: altr,socfpga-dw-mshc
    then:
      properties:
        altr,sysmgr-syscon: true
    else:
      properties:
        iommus: false
        altr,sysmgr-syscon: false

required:
  - compatible
  - reg
  - interrupts
  - clocks
  - clock-names

unevaluatedProperties: false

examples:
  - |
    mmc@12200000 {
      compatible = "snps,dw-mshc";
      reg = <0x12200000 0x1000>;
      interrupts = <0 75 0>;
      clocks = <&clock 351>, <&clock 132>;
      clock-names = "biu", "ciu";
      dmas = <&pdma 12>;
      dma-names = "rx-tx";
      resets = <&rst 20>;
      reset-names = "reset";
      vmmc-supply = <&buck8>;
      #address-cells = <1>;
      #size-cells = <0>;
      broken-cd;
      bus-width = <8>;
      cap-mmc-highspeed;
      cap-sd-highspeed;
      card-detect-delay = <200>;
      max-frequency = <200000000>;
      clock-frequency = <400000000>;
      data-addr = <0x200>;
      fifo-depth = <0x80>;
      fifo-watermark-aligned;
    };
```

## Documentation/devicetree/bindings/mmc/ti,da830-mmc.yaml
```yaml
# SPDX-License-Identifier: (GPL-2.0-only OR BSD-2-Clause)
%YAML 1.2
---
$id: http://devicetree.org/schemas/mmc/ti,da830-mmc.yaml#
$schema: http://devicetree.org/meta-schemas/core.yaml#

title: TI Highspeed MMC host controller for DaVinci

description:
  The Highspeed MMC Host Controller on TI DaVinci family
  provides an interface for MMC, SD and SDIO types of memory cards.

allOf:
  - $ref: mmc-controller.yaml

maintainers:
  - Kishon Vijay Abraham I <kishon@kernel.org>

properties:
  compatible:
    enum:
      - ti,da830-mmc
      - ti,dm355-mmc

  reg:
    maxItems: 1

  clocks:
    maxItems: 1

  interrupts:
    maxItems: 2

  dmas:
    maxItems: 2

  dma-names:
    items:
      - const: rx
      - const: tx

required:
  - compatible
  - reg

unevaluatedProperties: false

examples:
  - |
    #include <dt-bindings/interrupt-controller/irq.h>
    mmc@1c40000 {
        compatible = "ti,da830-mmc";
        reg = <0x40000 0x1000>;
        interrupts = <16 IRQ_TYPE_LEVEL_HIGH>,
                     <17 IRQ_TYPE_LEVEL_HIGH>;
        bus-width = <4>;
        max-frequency = <50000000>;
        dmas = <&edma 16>, <&edma 17>;
        dma-names = "rx", "tx";
    };
...
```
