## Documentation/devicetree/bindings/mmc/ti,omap2420-mmc.yaml
```yaml
# SPDX-License-Identifier: (GPL-2.0-only OR BSD-2-Clause)
%YAML 1.2
---
$id: http://devicetree.org/schemas/mmc/ti,omap2420-mmc.yaml#
$schema: http://devicetree.org/meta-schemas/core.yaml#

title: Texas Instruments MMC host controller for OMAP1 and 2420

maintainers:
  - Eduard Bostina <egbostina@gmail.com>

description: |
  The MMC Host Controller on TI OMAP1 and 2420 family provides
  an interface for MMC, SD, and SDIO types of memory cards.

allOf:
  - $ref: /schemas/mmc/mmc-controller.yaml#

properties:
  compatible:
    const: ti,omap2420-mmc

  reg:
    maxItems: 1

  interrupts:
    maxItems: 1

  ti,hwmods:
    description: |
      Name of the hwmod associated to the MMC controller. Must be
      "msdi<n>" where n is the controller instance starting from 1.
    $ref: /schemas/types.yaml#/definitions/string
    pattern: "^msdi([1-9]|[1-9][0-9]+)$"

  dmas:
    maxItems: 2

  dma-names:
    items:
      - const: tx
      - const: rx

required:
  - compatible
  - reg
  - interrupts

unevaluatedProperties: false

examples:
  - |
    mmc@4809c000 {
        compatible = "ti,omap2420-mmc";
        ti,hwmods = "msdi1";
        reg = <0x4809c000 0x80>;
        interrupts = <83>;
        dmas = <&sdma 61 &sdma 62>;
        dma-names = "tx", "rx";
    };
```

## Documentation/devicetree/bindings/mmc/ti,omap2430-sdhci.yaml
```yaml
# SPDX-License-Identifier: (GPL-2.0-only OR BSD-2-Clause)
%YAML 1.2
---
$id: http://devicetree.org/schemas/mmc/ti,omap2430-sdhci.yaml#
$schema: http://devicetree.org/meta-schemas/core.yaml#

title: TI OMAP SDHCI Controller

maintainers:
  - Kishon Vijay Abraham I <kishon@ti.com>

description:
  For UHS devices which require tuning, the device tree should have a
  cpu_thermal node which maps to the appropriate thermal zone. This
  is used to get the temperature of the zone during tuning.

properties:
  compatible:
    enum:
      - ti,omap2430-sdhci
      - ti,omap3-sdhci
      - ti,omap4-sdhci
      - ti,omap5-sdhci
      - ti,dra7-sdhci
      - ti,k2g-sdhci
      - ti,am335-sdhci
      - ti,am437-sdhci

  reg:
    maxItems: 1

  interrupts:
    maxItems: 1

  clocks:
    maxItems: 2

  clock-names:
    items:
      - const: fck
      - const: mmchsdb_fck

  dmas:
    maxItems: 2

  dma-names:
    items:
      - const: tx
      - const: rx

  pinctrl-names:
    minItems: 1
    maxItems: 14
    items:
      enum:
        - default
        - default-rev11
        - hs
        - sdr12
        - sdr12-rev11
        - sdr25
        - sdr25-rev11
        - sdr50
        - ddr50-rev11
        - sdr104-rev11
        - ddr50
        - sdr104
        - ddr_1_8v-rev11
        - ddr_1_8v
        - ddr_3_3v
        - hs-rev11
        - hs200_1_8v-rev11
        - hs200_1_8v
        - sleep

  pinctrl-0:
    maxItems: 1

  pinctrl-1:
    maxItems: 1

  pinctrl-2:
    maxItems: 1

  pinctrl-3:
    maxItems: 1

  pinctrl-4:
    maxItems: 1

  pinctrl-5:
    maxItems: 1

  pinctrl-6:
    maxItems: 1

  pinctrl-7:
    maxItems: 1

  pinctrl-8:
    maxItems: 1

  power-domains:
    maxItems: 1

  pbias-supply:
    description:
      It is used to specify the voltage regulator that provides the bias
      voltage for certain analog or I/O pads.

  ti,non-removable:
    description:
      It indicates that a component is not meant to be easily removed or
      replaced by the user, such as an embedded battery or a non-removable
      storage slot like eMMC.
    type: boolean
    deprecated: true

  clock-frequency:
    $ref: /schemas/types.yaml#/definitions/uint32
    description:
      It represents the speed at which a clock signal associated with a device
      or bus operates, measured in Hertz (Hz). This value is crucial for configuring
      hardware components that require a specific clock speed.

required:
  - compatible
  - reg
  - interrupts

allOf:
  - $ref: sdhci-common.yaml#
  - if:
      properties:
        compatible:
          contains:
            enum:
              - ti,dra7-sdhci
              - ti,k2g-sdhci
    then:
      required:
        - max-frequency
  - if:
      properties:
        compatible:
          contains:
            const: ti,k2g-sdhci
    then:
      required:
        - clocks
        - clock-names

unevaluatedProperties: false

examples:
  - |
    #include <dt-bindings/interrupt-controller/arm-gic.h>
    mmc@4809c000 {
        compatible = "ti,dra7-sdhci";
        reg = <0x4809c000 0x400>;
        interrupts = <GIC_SPI 64 IRQ_TYPE_LEVEL_HIGH>;
        max-frequency = <192000000>;
        sdhci-caps-mask = <0x0 0x400000>;
        bus-width = <4>;
        vmmc-supply = <&vmmc>; /* phandle to regulator node */
        dmas = <&sdma 61>, <&sdma 62>;
        dma-names = "tx", "rx";
    };
...
```

## Documentation/devicetree/bindings/mmc/ti-omap-hsmmc.txt
```
* TI Highspeed MMC host controller for OMAP and 66AK2G family.

The Highspeed MMC Host Controller on TI OMAP and 66AK2G family
provides an interface for MMC, SD, and SDIO types of memory cards.

This file documents differences between the core properties described
by mmc.txt and the properties used by the omap_hsmmc driver.

Required properties:
--------------------
- compatible:
 Should be "ti,omap2-hsmmc", for OMAP2 controllers
 Should be "ti,omap3-hsmmc", for OMAP3 controllers
 Should be "ti,omap3-pre-es3-hsmmc" for OMAP3 controllers pre ES3.0
 Should be "ti,omap4-hsmmc", for OMAP4 controllers
 Should be "ti,am33xx-hsmmc", for AM335x controllers
 Should be "ti,k2g-hsmmc", "ti,omap4-hsmmc" for 66AK2G controllers.

SoC specific required properties:
---------------------------------
The following are mandatory properties for OMAPs, AM33xx and AM43xx SoCs only:
- ti,hwmods: Must be "mmc<n>", n is controller instance starting 1.

The following are mandatory properties for 66AK2G SoCs only:
- power-domains:Should contain a phandle to a PM domain provider node
		and an args specifier containing the MMC device id
		value. This property is as per the binding,
		Documentation/devicetree/bindings/soc/ti/sci-pm-domain.txt
- clocks:	Must contain an entry for each entry in clock-names. Should
		be defined as per the he appropriate clock bindings consumer
		usage in Documentation/devicetree/bindings/clock/ti,sci-clk.txt
- clock-names:	Shall be "fck" for the functional clock,
		and "mmchsdb_fck" for the debounce clock.


Optional properties:
--------------------
- ti,dual-volt:		boolean, supports dual voltage cards
- <supply-name>-supply:	phandle to the regulator device tree node
			  "supply-name" examples are "vmmc",
			  "vmmc_aux"(deprecated)/"vqmmc" etc
- ti,non-removable:	non-removable slot (like eMMC)
- ti,needs-special-reset:	Requires a special softreset sequence
- ti,needs-special-hs-handling:	HSMMC IP needs special setting
				  for handling High Speed
- dmas:			List of DMA specifiers with the controller specific
			format as described in the generic DMA client
			binding. A tx and rx specifier is required.
- dma-names:		List of DMA request names. These strings correspond
			1:1 with the DMA specifiers listed in dmas.
			The string naming is to be "rx" and "tx" for
			RX and TX DMA requests, respectively.

Examples:

[hwmod populated DMA resources]

	mmc1: mmc@4809c000 {
		compatible = "ti,omap4-hsmmc";
		reg = <0x4809c000 0x400>;
		ti,hwmods = "mmc1";
		ti,dual-volt;
		bus-width = <4>;
		vmmc-supply = <&vmmc>; /* phandle to regulator node */
		ti,non-removable;
	};

[generic DMA request binding]

	mmc1: mmc@4809c000 {
		compatible = "ti,omap4-hsmmc";
		reg = <0x4809c000 0x400>;
		ti,hwmods = "mmc1";
		ti,dual-volt;
		bus-width = <4>;
		vmmc-supply = <&vmmc>; /* phandle to regulator node */
		ti,non-removable;
		dmas = <&edma 24
			&edma 25>;
		dma-names = "tx", "rx";
	};

[workaround for missing swakeup on am33xx]

This SOC is missing the swakeup line, it will not detect SDIO irq
while in suspend.

                             ------
                             | PRCM |
                              ------
                               ^ |
                       swakeup | | fclk
                               | v
       ------                -------               -----
      | card | -- CIRQ -->  | hsmmc | -- IRQ -->  | CPU |
       ------                -------               -----

In suspend the fclk is off and the module is disfunctional. Even register reads
will fail. A small logic in the host will request fclk restore, when an
external event is detected. Once the clock is restored, the host detects the
event normally. Since am33xx doesn't have this line it never wakes from
suspend.

The workaround is to reconfigure the dat1 line as a GPIO upon suspend. To make
this work, we need to set the named pinctrl states "default" and "idle".
Prepare idle to remux dat1 as a gpio, and default to remux it back as sdio
dat1. The MMC driver will then toggle between idle and default state during
runtime.

In summary:
1. select matching 'compatible' section, see example below.
2. specify pinctrl states "default" and "idle", "sleep" is optional.
3. specify the gpio irq used for detecting sdio irq in suspend

If configuration is incomplete, a warning message is emitted "falling back to
polling". Also check the "sdio irq mode" in /sys/kernel/debug/mmc0/regs. Mind
not every application needs SDIO irq, e.g. MMC cards.

	mmc1: mmc@48060100 {
		compatible = "ti,am33xx-hsmmc";
		...
		pinctrl-names = "default", "idle", "sleep"
		pinctrl-0 = <&mmc1_pins>;
		pinctrl-1 = <&mmc1_idle>;
		pinctrl-2 = <&mmc1_sleep>;
		...
		interrupts-extended = <&intc 64 &gpio2 28 GPIO_ACTIVE_LOW>;
	};

	mmc1_idle : pinmux_cirq_pin {
		pinctrl-single,pins = <
		        0x0f8 0x3f      /* GPIO2_28 */
		>;
	};
```

## Documentation/devicetree/bindings/mmc/ti-omap.txt
```
* TI MMC host controller for OMAP1 and 2420

The MMC Host Controller on TI OMAP1 and 2420 family provides
an interface for MMC, SD, and SDIO types of memory cards.

This file documents differences between the core properties described
by mmc.txt and the properties used by the omap mmc driver.

Note that this driver will not work with omap2430 or later omaps,
please see the omap hsmmc driver for the current omaps.

Required properties:
- compatible: Must be "ti,omap2420-mmc", for OMAP2420 controllers
- ti,hwmods: For 2420, must be "msdi<n>", where n is controller
  instance starting 1

Examples:

	msdi1: mmc@4809c000 {
		compatible = "ti,omap2420-mmc";
		ti,hwmods = "msdi1";
		reg = <0x4809c000 0x80>;
		interrupts = <83>;
		dmas = <&sdma 61 &sdma 62>;
		dma-names = "tx", "rx";
	};

* TI MMC host controller for OMAP1 and 2420

The MMC Host Controller on TI OMAP1 and 2420 family provides
an interface for MMC, SD, and SDIO types of memory cards.

This file documents differences between the core properties described
by mmc.txt and the properties used by the omap mmc driver.

Note that this driver will not work with omap2430 or later omaps,
please see the omap hsmmc driver for the current omaps.

Required properties:
- compatible: Must be "ti,omap2420-mmc", for OMAP2420 controllers
- ti,hwmods: For 2420, must be "msdi<n>", where n is controller
  instance starting 1

Examples:

	msdi1: mmc@4809c000 {
		compatible = "ti,omap2420-mmc";
		ti,hwmods = "msdi1";
		reg = <0x4809c000 0x80>;
		interrupts = <83>;
		dmas = <&sdma 61 &sdma 62>;
		dma-names = "tx", "rx";
	};
```

## Documentation/devicetree/bindings/mmc/tmio_mmc.txt
```
* Toshiba Mobile IO SD/MMC controller

The tmio-mmc driver doesn't probe its devices actively, instead its binding to
devices is managed by either MFD drivers or by the sh_mobile_sdhi platform
driver. Those drivers supply the tmio-mmc driver with platform data, that either
describe hardware capabilities, known to them, or are obtained by them from
their own platform data or from their DT information. In the latter case all
compulsory and any optional properties, common to all SD/MMC drivers, as
described in mmc.txt, can be used. Additionally the following tmio_mmc-specific
optional bindings can be used.

Required properties:
- compatible:	"renesas,sdhi-shmobile" - a generic sh-mobile SDHI unit
		"renesas,sdhi-sh73a0" - SDHI IP on SH73A0 SoC
		"renesas,sdhi-r7s72100" - SDHI IP on R7S72100 SoC
		"renesas,sdhi-r8a73a4" - SDHI IP on R8A73A4 SoC
		"renesas,sdhi-r8a7740" - SDHI IP on R8A7740 SoC
		"renesas,sdhi-r8a7778" - SDHI IP on R8A7778 SoC
		"renesas,sdhi-r8a7779" - SDHI IP on R8A7779 SoC
		"renesas,sdhi-r8a7790" - SDHI IP on R8A7790 SoC
		"renesas,sdhi-r8a7791" - SDHI IP on R8A7791 SoC
		"renesas,sdhi-r8a7792" - SDHI IP on R8A7792 SoC
		"renesas,sdhi-r8a7793" - SDHI IP on R8A7793 SoC
		"renesas,sdhi-r8a7794" - SDHI IP on R8A7794 SoC
		"renesas,sdhi-r8a7795" - SDHI IP on R8A7795 SoC
		"renesas,sdhi-r8a7796" - SDHI IP on R8A7796 SoC

- clocks: Most controllers only have 1 clock source per channel. However, on
	  some variations of this controller, the internal card detection
	  logic that exists in this controller is sectioned off to be run by a
	  separate second clock source to allow the main core clock to be turned
	  off to save power.
	  If 2 clocks are specified by the hardware, you must name them as
	  "core" and "cd". If the controller only has 1 clock, naming is not
	  required.
	  Below is the number clocks for each supported SoC:
	   1: SH73A0, R8A73A4, R8A7740, R8A7778, R8A7779, R8A7790
	      R8A7791, R8A7792, R8A7793, R8A7794, R8A7795, R8A7796
	   2: R7S72100

Optional properties:
- toshiba,mmc-wrprotect-disable: write-protect detection is unavailable
- pinctrl-names: should be "default", "state_uhs"
- pinctrl-0: should contain default/high speed pin ctrl
- pinctrl-1: should contain uhs mode pin ctrl
```

## Documentation/devicetree/bindings/mmc/uniphier-sd.txt
```
UniPhier SD/eMMC controller

Required properties:
- compatible: should be one of the following:
    "socionext,uniphier-sd-v2.91"  - IP version 2.91
    "socionext,uniphier-sd-v3.1"   - IP version 3.1
    "socionext,uniphier-sd-v3.1.1" - IP version 3.1.1
- reg: offset and length of the register set for the device.
- interrupts: a single interrupt specifier.
- clocks: a single clock specifier of the controller clock.
- reset-names: should contain the following:
    "host"   - mandatory for all versions
    "bridge" - should exist only for "socionext,uniphier-sd-v2.91"
    "hw"     - should exist if eMMC hw reset line is available
- resets: a list of reset specifiers, corresponding to the reset-names

Optional properties:
- pinctrl-names: if present, should contain the following:
    "default" - should exist for all instances
    "uhs"     - should exist for SD instance with UHS support
- pinctrl-0: pin control state for the default mode
- pinctrl-1: pin control state for the UHS mode
- dma-names: should be "rx-tx" if present.
  This property can exist only for "socionext,uniphier-sd-v2.91".
- dmas: a single DMA channel specifier
  This property can exist only for "socionext,uniphier-sd-v2.91".
- bus-width: see mmc.txt
- cap-sd-highspeed: see mmc.txt
- cap-mmc-highspeed: see mmc.txt
- sd-uhs-sdr12: see mmc.txt
- sd-uhs-sdr25: see mmc.txt
- sd-uhs-sdr50: see mmc.txt
- cap-mmc-hw-reset: should exist if reset-names contains "hw". see mmc.txt
- non-removable: see mmc.txt

Example:

	sd: sdhc@5a400000 {
		compatible = "socionext,uniphier-sd-v2.91";
		reg = <0x5a400000 0x200>;
		interrupts = <0 76 4>;
		pinctrl-names = "default", "uhs";
		pinctrl-0 = <&pinctrl_sd>;
		pinctrl-1 = <&pinctrl_sd_uhs>;
		clocks = <&mio_clk 0>;
		reset-names = "host", "bridge";
		resets = <&mio_rst 0>, <&mio_rst 3>;
		dma-names = "rx-tx";
		dmas = <&dmac 4>;
		bus-width = <4>;
		cap-sd-highspeed;
		sd-uhs-sdr12;
		sd-uhs-sdr25;
		sd-uhs-sdr50;
	};
```
