## Documentation/devicetree/bindings/mmc/sdhci-pxa.txt
```
* Marvell sdhci-pxa v2/v3 controller

This file documents differences between the core properties in mmc.txt
and the properties used by the sdhci-pxav2 and sdhci-pxav3 drivers.

Required properties:
- compatible: Should be "mrvl,pxav2-mmc", "mrvl,pxav3-mmc" or
  "marvell,armada-380-sdhci".
- reg:
  * for "mrvl,pxav2-mmc" and "mrvl,pxav3-mmc", one register area for
    the SDHCI registers.

  * for "marvell,armada-380-sdhci", three register areas. The first
    one for the SDHCI registers themselves, the second one for the
    AXI/Mbus bridge registers of the SDHCI unit, the third one for the
    SDIO3 Configuration register
- reg names: should be "sdhci", "mbus", "conf-sdio3". only mandatory
  for "marvell,armada-380-sdhci"
- clocks: Array of clocks required for SDHCI; requires at least one for
    I/O clock.
- clock-names: Array of names corresponding to clocks property; shall be
    "io" for I/O clock and "core" for optional core clock.

Optional properties:
- mrvl,clk-delay-cycles: Specify a number of cycles to delay for tuning.

Example:

sdhci@d4280800 {
	compatible = "mrvl,pxav3-mmc";
	reg = <0xd4280800 0x800>;
	bus-width = <8>;
	interrupts = <27>;
	clocks = <&chip CLKID_SDIO1XIN>, <&chip CLKID_SDIO1>;
	clock-names = "io", "core";
	non-removable;
	mrvl,clk-delay-cycles = <31>;
};

sdhci@d8000 {
	compatible = "marvell,armada-380-sdhci";
	reg-names = "sdhci", "mbus", "conf-sdio3";
	reg = <0xd8000 0x1000>,
		<0xdc000 0x100>;
		<0x18454 0x4>;
	interrupts = <0 25 0x4>;
	clocks = <&gateclk 17>;
	clock-names = "io";
	mrvl,clk-delay-cycles = <0x1F>;
};
```

## Documentation/devicetree/bindings/mmc/sdhci-pxa.yaml
```yaml
# SPDX-License-Identifier: GPL-2.0-only
%YAML 1.2
---
$id: http://devicetree.org/schemas/mmc/sdhci-pxa.yaml#
$schema: http://devicetree.org/meta-schemas/core.yaml#

title: Marvell PXA SDHCI v1/v2/v3

maintainers:
  - Ulf Hansson <ulf.hansson@linaro.org>

allOf:
  - $ref: mmc-controller.yaml#
  - if:
      properties:
        compatible:
          contains:
            const: marvell,armada-380-sdhci
    then:
      properties:
        reg:
          minItems: 3
        reg-names:
          minItems: 3
      required:
        - reg-names
    else:
      properties:
        reg:
          maxItems: 1
        reg-names:
          maxItems: 1
  - if:
      properties:
        compatible:
          contains:
            const: mrvl,pxav1-mmc
    then:
      properties:
        pinctrl-names:
          description:
            Optional for supporting PXA168 SDIO IRQ errata to switch CMD pin between
            SDIO CMD and GPIO mode.
          items:
            - const: default
            - const: state_cmd_gpio
          minItems: 1

        pinctrl-1:
          description:
            Should switch CMD pin to GPIO mode as a high output.
  - if:
      properties:
        compatible:
          contains:
            const: mrvl,pxav3-mmc
    then:
      properties:
        pinctrl-names:
          description:
            Optional for increasing stability of the controller at fast bus clocks.
          items:
            - const: default
            - const: state_uhs
          minItems: 1

        pinctrl-1:
          description:
            Should switch the drive strength of the data pins to high.

properties:
  compatible:
    enum:
      - mrvl,pxav1-mmc
      - mrvl,pxav2-mmc
      - mrvl,pxav3-mmc
      - marvell,armada-380-sdhci

  reg:
    minItems: 1
    maxItems: 3

  reg-names:
    items:
      - const: sdhci
      - const: mbus
      - const: conf-sdio3

  interrupts:
    maxItems: 1

  clocks:
    minItems: 1
    maxItems: 2

  clock-names:
    minItems: 1
    items:
      - const: io
      - const: core

  pinctrl-names: true

  pinctrl-0:
    description:
      Should contain default pinctrl.

  pinctrl-1: true

  mrvl,clk-delay-cycles:
    description: Specify a number of cycles to delay for tuning.
    $ref: /schemas/types.yaml#/definitions/uint32

required:
  - compatible
  - reg
  - interrupts
  - clocks
  - clock-names

unevaluatedProperties: false

examples:
  - |
    #include <dt-bindings/clock/berlin2.h>
    mmc@d4280800 {
        compatible = "mrvl,pxav3-mmc";
        reg = <0xd4280800 0x800>;
        bus-width = <8>;
        interrupts = <27>;
        clocks = <&chip CLKID_SDIO1XIN>, <&chip CLKID_SDIO1>;
        clock-names = "io", "core";
        non-removable;
        mrvl,clk-delay-cycles = <31>;
    };
  - |
    mmc@d8000 {
        compatible = "marvell,armada-380-sdhci";
        reg-names = "sdhci", "mbus", "conf-sdio3";
        reg = <0xd8000 0x1000>,
              <0xdc000 0x100>,
              <0x18454 0x4>;
        interrupts = <0 25 0x4>;
        clocks = <&gateclk 17>;
        clock-names = "io";
        mrvl,clk-delay-cycles = <0x1F>;
    };

...
```

## Documentation/devicetree/bindings/mmc/sdhci-sirf.txt
```
* SiRFprimII/marco/atlas6 SDHCI Controller

This file documents differences between the core properties in mmc.txt
and the properties used by the sdhci-sirf driver.

Required properties:
- compatible: sirf,prima2-sdhc

Optional properties:
- cd-gpios: card detect gpio, with zero flags.

Example:

	sd0: sdhci@56000000 {
		compatible = "sirf,prima2-sdhc";
		reg = <0xcd000000 0x100000>;
		cd-gpios = <&gpio 6 0>;
	};
```

## Documentation/devicetree/bindings/mmc/sdhci-spear.txt
```
* SPEAr SDHCI Controller

This file documents differences between the core properties in mmc.txt
and the properties used by the sdhci-spear driver.

Required properties:
- compatible: "st,spear300-sdhci"

Optional properties:
- cd-gpios: card detect gpio, with zero flags.

Example:

	sdhci@fc000000 {
		compatible = "st,spear300-sdhci";
		reg = <0xfc000000 0x1000>;
		cd-gpios = <&gpio0 6 0>;
	};
```
