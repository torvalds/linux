## Documentation/devicetree/bindings/mmc/sdhci-am654.txt
```
Device Tree Bindings for the SDHCI Controllers present on TI's AM654 SOCs

The bindings follow the mmc[1], clock[2] and interrupt[3] bindings.
Only deviations are documented here.

  [1] Documentation/devicetree/bindings/mmc/mmc.txt
  [2] Documentation/devicetree/bindings/clock/clock-bindings.txt
  [3] Documentation/devicetree/bindings/interrupt-controller/interrupts.txt

Required Properties:
	- compatible: should be one of:
			"ti,am654-sdhci-5.1": SDHCI on AM654 device.
			"ti,j721e-sdhci-8bit": 8 bit SDHCI on J721E device.
			"ti,j721e-sdhci-4bit": 4 bit SDHCI on J721E device.
			"ti,j7200-sdhci-8bit": 8 bit SDHCI on J7200 device.
			"ti,j7200-sdhci-4bit": 4 bit SDHCI on J7200 device.
	- reg: Must be two entries.
		- The first should be the sdhci register space
		- The second should the subsystem/phy register space
	- clocks: Handles to the clock inputs.
	- clock-names: Tuple including "clk_xin" and "clk_ahb"
	- interrupts: Interrupt specifiers
	Output tap delay for each speed mode:
	- ti,otap-del-sel-legacy
	- ti,otap-del-sel-mmc-hs
	- ti,otap-del-sel-sd-hs
	- ti,otap-del-sel-sdr12
	- ti,otap-del-sel-sdr25
	- ti,otap-del-sel-sdr50
	- ti,otap-del-sel-sdr104
	- ti,otap-del-sel-ddr50
	- ti,otap-del-sel-ddr52
	- ti,otap-del-sel-hs200
	- ti,otap-del-sel-hs400
	  These bindings must be provided otherwise the driver will disable the
	  corresponding speed mode (i.e. all nodes must provide at least -legacy)

Optional Properties (Required for ti,am654-sdhci-5.1,
				  ti,j721e-sdhci-8bit,
				  ti,j7200-sdhci-8bit):
	- ti,trm-icp: DLL trim select
	- ti,driver-strength-ohm: driver strength in ohms.
				  Valid values are 33, 40, 50, 66 and 100 ohms.
Optional Properties:
	- ti,strobe-sel: strobe select delay for HS400 speed mode. Default value: 0x0.
	- ti,clkbuf-sel: Clock Delay Buffer Select

Example:

	sdhci0: sdhci@4f80000 {
		compatible = "ti,am654-sdhci-5.1";
		reg = <0x0 0x4f80000 0x0 0x260>, <0x0 0x4f90000 0x0 0x134>;
		power-domains = <&k3_pds 47>;
		clocks = <&k3_clks 47 0>, <&k3_clks 47 1>;
		clock-names = "clk_ahb", "clk_xin";
		interrupts = <GIC_SPI 136 IRQ_TYPE_LEVEL_HIGH>;
		sdhci-caps-mask = <0x80000007 0x0>;
		mmc-ddr-1_8v;
		ti,otap-del-sel-legacy = <0x0>;
		ti,otap-del-sel-mmc-hs = <0x0>;
		ti,otap-del-sel-ddr52 = <0x5>;
		ti,otap-del-sel-hs200 = <0x5>;
		ti,otap-del-sel-hs400 = <0x0>;
		ti,trm-icp = <0x8>;
	};
```

## Documentation/devicetree/bindings/mmc/sdhci-am654.yaml
```yaml
# SPDX-License-Identifier: (GPL-2.0-only OR BSD-2-Clause)
# Copyright (C) 2020 Texas Instruments Incorporated - http://www.ti.com/
%YAML 1.2
---
$id: "http://devicetree.org/schemas/mmc/sdhci-am654.yaml#"
$schema: "http://devicetree.org/meta-schemas/core.yaml#"

title: TI AM654 MMC Controller

maintainers:
  - Ulf Hansson <ulf.hansson@linaro.org>

allOf:
  - $ref: mmc-controller.yaml#

properties:
  compatible:
    enum:
      - ti,am654-sdhci-5.1
      - ti,j721e-sdhci-8bit
      - ti,j721e-sdhci-4bit
      - ti,j7200-sdhci-8bit
      - ti,j721e-sdhci-4bit

  reg:
    maxItems: 2

  interrupts:
    maxItems: 1

  power-domains:
    maxItems: 1

  clocks:
    minItems: 1
    maxItems: 2
    description: Handles to input clocks

  clock-names:
    minItems: 1
    maxItems: 2
    items:
      - const: clk_ahb
      - const: clk_xin

  # PHY output tap delays:
  # Used to delay the data valid window and align it to the sampling clock.
  # Binding needs to be provided for each supported speed mode otherwise the
  # corresponding mode will be disabled.

  ti,otap-del-sel-legacy:
    description: Output tap delay for SD/MMC legacy timing
    $ref: "/schemas/types.yaml#/definitions/uint32"
    minimum: 0
    maximum: 0xf

  ti,otap-del-sel-mmc-hs:
    description: Output tap delay for MMC high speed timing
    $ref: "/schemas/types.yaml#/definitions/uint32"
    minimum: 0
    maximum: 0xf

  ti,otap-del-sel-sd-hs:
    description: Output tap delay for SD high speed timing
    $ref: "/schemas/types.yaml#/definitions/uint32"
    minimum: 0
    maximum: 0xf

  ti,otap-del-sel-sdr12:
    description: Output tap delay for SD UHS SDR12 timing
    $ref: "/schemas/types.yaml#/definitions/uint32"
    minimum: 0
    maximum: 0xf

  ti,otap-del-sel-sdr25:
    description: Output tap delay for SD UHS SDR25 timing
    $ref: "/schemas/types.yaml#/definitions/uint32"
    minimum: 0
    maximum: 0xf

  ti,otap-del-sel-sdr50:
    description: Output tap delay for SD UHS SDR50 timing
    $ref: "/schemas/types.yaml#/definitions/uint32"
    minimum: 0
    maximum: 0xf

  ti,otap-del-sel-sdr104:
    description: Output tap delay for SD UHS SDR104 timing
    $ref: "/schemas/types.yaml#/definitions/uint32"
    minimum: 0
    maximum: 0xf

  ti,otap-del-sel-ddr50:
    description: Output tap delay for SD UHS DDR50 timing
    $ref: "/schemas/types.yaml#/definitions/uint32"
    minimum: 0
    maximum: 0xf

  ti,otap-del-sel-ddr52:
    description: Output tap delay for eMMC DDR52 timing
    $ref: "/schemas/types.yaml#/definitions/uint32"
    minimum: 0
    maximum: 0xf

  ti,otap-del-sel-hs200:
    description: Output tap delay for eMMC HS200 timing
    $ref: "/schemas/types.yaml#/definitions/uint32"
    minimum: 0
    maximum: 0xf

  ti,otap-del-sel-hs400:
    description: Output tap delay for eMMC HS400 timing
    $ref: "/schemas/types.yaml#/definitions/uint32"
    minimum: 0
    maximum: 0xf

  # PHY input tap delays:
  # Used to delay the data valid window and align it to the sampling clock for
  # modes that don't support tuning

  ti,itap-del-sel-legacy:
    description: Input tap delay for SD/MMC legacy timing
    $ref: "/schemas/types.yaml#/definitions/uint32"
    minimum: 0
    maximum: 0x1f

  ti,itap-del-sel-mmc-hs:
    description: Input tap delay for MMC high speed timing
    $ref: "/schemas/types.yaml#/definitions/uint32"
    minimum: 0
    maximum: 0x1f

  ti,itap-del-sel-sd-hs:
    description: Input tap delay for SD high speed timing
    $ref: "/schemas/types.yaml#/definitions/uint32"
    minimum: 0
    maximum: 0x1f

  ti,itap-del-sel-sdr12:
    description: Input tap delay for SD UHS SDR12 timing
    $ref: "/schemas/types.yaml#/definitions/uint32"
    minimum: 0
    maximum: 0x1f

  ti,itap-del-sel-sdr25:
    description: Input tap delay for SD UHS SDR25 timing
    $ref: "/schemas/types.yaml#/definitions/uint32"
    minimum: 0
    maximum: 0x1f

  ti,itap-del-sel-ddr52:
    description: Input tap delay for MMC DDR52 timing
    $ref: "/schemas/types.yaml#/definitions/uint32"
    minimum: 0
    maximum: 0x1f

  ti,trm-icp:
    description: DLL trim select
    $ref: "/schemas/types.yaml#/definitions/uint32"
    minimum: 0
    maximum: 0xf

  ti,driver-strength-ohm:
    description: DLL drive strength in ohms
    $ref: "/schemas/types.yaml#/definitions/uint32"
    enum:
      - 33
      - 40
      - 50
      - 66
      - 100

  ti,strobe-sel:
    description: strobe select delay for HS400 speed mode.
    $ref: "/schemas/types.yaml#/definitions/uint32"

  ti,clkbuf-sel:
    description: Clock Delay Buffer Select
    $ref: "/schemas/types.yaml#/definitions/uint32"

required:
  - compatible
  - reg
  - interrupts
  - clocks
  - clock-names
  - ti,otap-del-sel-legacy

unevaluatedProperties: false

examples:
  - |
    #include <dt-bindings/interrupt-controller/irq.h>
    #include <dt-bindings/interrupt-controller/arm-gic.h>

    bus {
        #address-cells = <2>;
        #size-cells = <2>;

        mmc0: mmc@4f80000 {
            compatible = "ti,am654-sdhci-5.1";
            reg = <0x0 0x4f80000 0x0 0x260>, <0x0 0x4f90000 0x0 0x134>;
            power-domains = <&k3_pds 47>;
            clocks = <&k3_clks 47 0>, <&k3_clks 47 1>;
            clock-names = "clk_ahb", "clk_xin";
            interrupts = <GIC_SPI 136 IRQ_TYPE_LEVEL_HIGH>;
            sdhci-caps-mask = <0x80000007 0x0>;
            mmc-ddr-1_8v;
            ti,otap-del-sel-legacy = <0x0>;
            ti,otap-del-sel-mmc-hs = <0x0>;
            ti,otap-del-sel-ddr52 = <0x5>;
            ti,otap-del-sel-hs200 = <0x5>;
            ti,otap-del-sel-hs400 = <0x0>;
            ti,itap-del-sel-legacy = <0x10>;
            ti,itap-del-sel-mmc-hs = <0xa>;
            ti,itap-del-sel-ddr52 = <0x3>;
            ti,trm-icp = <0x8>;
        };
    };
```

## Documentation/devicetree/bindings/mmc/sdhci-atmel.txt
```
* Atmel SDHCI controller

This file documents the differences between the core properties in
Documentation/devicetree/bindings/mmc/mmc.txt and the properties used by the
sdhci-of-at91 driver.

Required properties:
- compatible:		Must be "atmel,sama5d2-sdhci" or "microchip,sam9x60-sdhci".
- clocks:		Phandlers to the clocks.
- clock-names:		Must be "hclock", "multclk", "baseclk" for
			"atmel,sama5d2-sdhci".
			Must be "hclock", "multclk" for "microchip,sam9x60-sdhci".

Optional properties:
- assigned-clocks:	The same with "multclk".
- assigned-clock-rates	The rate of "multclk" in order to not rely on the
			gck configuration set by previous components.
- microchip,sdcal-inverted: when present, polarity on the SDCAL SoC pin is
  inverted. The default polarity for this signal is described in the datasheet.
  For instance on SAMA5D2, the pin is usually tied to the GND with a resistor
  and a capacitor (see "SDMMC I/O Calibration" chapter).

Example:

mmc0: sdio-host@a0000000 {
	compatible = "atmel,sama5d2-sdhci";
	reg = <0xa0000000 0x300>;
	interrupts = <31 IRQ_TYPE_LEVEL_HIGH 0>;
	clocks = <&sdmmc0_hclk>, <&sdmmc0_gclk>, <&main>;
	clock-names = "hclock", "multclk", "baseclk";
	assigned-clocks = <&sdmmc0_gclk>;
	assigned-clock-rates = <480000000>;
};
```

## Documentation/devicetree/bindings/mmc/sdhci-cadence.txt
```
* Cadence SD/SDIO/eMMC Host Controller

Required properties:
- compatible: should be one of the following:
    "cdns,sd4hc"               - default of the IP
    "socionext,uniphier-sd4hc" - for Socionext UniPhier SoCs
- reg: offset and length of the register set for the device.
- interrupts: a single interrupt specifier.
- clocks: phandle to the input clock.

Optional properties:
For eMMC configuration, supported speed modes are not indicated by the SDHCI
Capabilities Register.  Instead, the following properties should be specified
if supported.  See mmc.txt for details.
- mmc-ddr-1_8v
- mmc-ddr-1_2v
- mmc-hs200-1_8v
- mmc-hs200-1_2v
- mmc-hs400-1_8v
- mmc-hs400-1_2v

Some PHY delays can be configured by following properties.
PHY DLL input delays:
They are used to delay the data valid window, and align the window
to sampling clock. The delay starts from 5ns (for delay parameter equal to 0)
and it is increased by 2.5ns in each step.
- cdns,phy-input-delay-sd-highspeed:
  Value of the delay in the input path for SD high-speed timing
  Valid range = [0:0x1F].
- cdns,phy-input-delay-legacy:
  Value of the delay in the input path for legacy timing
  Valid range = [0:0x1F].
- cdns,phy-input-delay-sd-uhs-sdr12:
  Value of the delay in the input path for SD UHS SDR12 timing
  Valid range = [0:0x1F].
- cdns,phy-input-delay-sd-uhs-sdr25:
  Value of the delay in the input path for SD UHS SDR25 timing
  Valid range = [0:0x1F].
- cdns,phy-input-delay-sd-uhs-sdr50:
  Value of the delay in the input path for SD UHS SDR50 timing
  Valid range = [0:0x1F].
- cdns,phy-input-delay-sd-uhs-ddr50:
  Value of the delay in the input path for SD UHS DDR50 timing
  Valid range = [0:0x1F].
- cdns,phy-input-delay-mmc-highspeed:
  Value of the delay in the input path for MMC high-speed timing
  Valid range = [0:0x1F].
- cdns,phy-input-delay-mmc-ddr:
  Value of the delay in the input path for eMMC high-speed DDR timing
  Valid range = [0:0x1F].

PHY DLL clock delays:
Each delay property represents the fraction of the clock period.
The approximate delay value will be
(<delay property value>/128)*sdmclk_clock_period.
- cdns,phy-dll-delay-sdclk:
  Value of the delay introduced on the sdclk output
  for all modes except HS200, HS400 and HS400_ES.
  Valid range = [0:0x7F].
- cdns,phy-dll-delay-sdclk-hsmmc:
  Value of the delay introduced on the sdclk output
  for HS200, HS400 and HS400_ES speed modes.
  Valid range = [0:0x7F].
- cdns,phy-dll-delay-strobe:
  Value of the delay introduced on the dat_strobe input
  used in HS400 / HS400_ES speed modes.
  Valid range = [0:0x7F].

Example:
	emmc: sdhci@5a000000 {
		compatible = "socionext,uniphier-sd4hc", "cdns,sd4hc";
		reg = <0x5a000000 0x400>;
		interrupts = <0 78 4>;
		clocks = <&clk 4>;
		bus-width = <8>;
		mmc-ddr-1_8v;
		mmc-hs200-1_8v;
		mmc-hs400-1_8v;
		cdns,phy-dll-delay-sdclk = <0>;
	};
```

## Documentation/devicetree/bindings/mmc/sdhci-common.yaml
```yaml
# SPDX-License-Identifier: GPL-2.0 OR BSD-2-Clause
%YAML 1.2
---
$id: http://devicetree.org/schemas/mmc/sdhci-common.yaml#
$schema: http://devicetree.org/meta-schemas/core.yaml#

title: SDHCI Controller Common Properties

maintainers:
  - Adrian Hunter <adrian.hunter@intel.com>

description:
  Common properties present on Secure Digital Host Controller Interface (SDHCI)
  devices.

properties:
  sdhci-caps:
    $ref: /schemas/types.yaml#/definitions/uint64
    description:
      Additionally present SDHCI capabilities - values for SDHCI_CAPABILITIES
      and SDHCI_CAPABILITIES_1 registers.

  sdhci-caps-mask:
    $ref: /schemas/types.yaml#/definitions/uint64
    description:
      Masked SDHCI capabilities to remove from SDHCI_CAPABILITIES and
      SDHCI_CAPABILITIES_1 registers.

allOf:
  - $ref: mmc-controller.yaml#

additionalProperties: true
```

## Documentation/devicetree/bindings/mmc/sdhci-dove.txt
```
* Marvell sdhci-dove controller

This file documents differences between the core properties in mmc.txt
and the properties used by the sdhci-pxav2 and sdhci-pxav3 drivers.

- compatible: Should be "marvell,dove-sdhci".

Example:

sdio0: sdio@92000 {
	compatible = "marvell,dove-sdhci";
	reg = <0x92000 0x100>;
	interrupts = <35>;
};
```

## Documentation/devicetree/bindings/mmc/sdhci-fujitsu.txt
```
* Fujitsu SDHCI controller

This file documents differences between the core properties in mmc.txt
and the properties used by the sdhci_f_sdh30 driver.

Required properties:
- compatible: "fujitsu,mb86s70-sdhci-3.0"
- clocks: Must contain an entry for each entry in clock-names. It is a
  list of phandles and clock-specifier pairs.
  See ../clocks/clock-bindings.txt for details.
- clock-names: Should contain the following two entries:
	"iface" - clock used for sdhci interface
	"core"  - core clock for sdhci controller

Optional properties:
- vqmmc-supply: phandle to the regulator device tree node, mentioned
  as the VCCQ/VDD_IO supply in the eMMC/SD specs.
- fujitsu,cmd-dat-delay-select: boolean property indicating that this host
  requires the CMD_DAT_DELAY control to be enabled.

Example:

	sdhci1: mmc@36600000 {
		compatible = "fujitsu,mb86s70-sdhci-3.0";
		reg = <0 0x36600000 0x1000>;
		interrupts = <0 172 0x4>,
			     <0 173 0x4>;
		bus-width = <4>;
		vqmmc-supply = <&vccq_sdhci1>;
		clocks = <&clock 2 2 0>, <&clock 2 3 0>;
		clock-names = "iface", "core";
	};
```
