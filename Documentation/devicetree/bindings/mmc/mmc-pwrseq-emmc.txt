## Documentation/devicetree/bindings/mmc/nvidia,tegra20-sdhci.yaml
```yaml
# SPDX-License-Identifier: (GPL-2.0-only OR BSD-2-Clause)
%YAML 1.2
---
$id: http://devicetree.org/schemas/mmc/nvidia,tegra20-sdhci.yaml#
$schema: http://devicetree.org/meta-schemas/core.yaml#

title: NVIDIA Tegra Secure Digital Host Controller

maintainers:
  - Thierry Reding <thierry.reding@gmail.com>
  - Jon Hunter <jonathanh@nvidia.com>

description: |
  This controller on Tegra family SoCs provides an interface for MMC, SD, and
  SDIO types of memory cards.

  This file documents differences between the core properties described by
  mmc-controller.yaml and the properties for the Tegra SDHCI controller.

properties:
  compatible:
    oneOf:
      - enum:
          - nvidia,tegra20-sdhci
          - nvidia,tegra30-sdhci
          - nvidia,tegra114-sdhci
          - nvidia,tegra124-sdhci
          - nvidia,tegra210-sdhci
          - nvidia,tegra186-sdhci
          - nvidia,tegra194-sdhci

      - items:
          - const: nvidia,tegra132-sdhci
          - const: nvidia,tegra124-sdhci

      - items:
          - enum:
              - nvidia,tegra194-sdhci
              - nvidia,tegra234-sdhci
          - const: nvidia,tegra186-sdhci

  reg:
    maxItems: 1

  interrupts:
    maxItems: 1

  assigned-clocks: true
  assigned-clock-parents: true
  assigned-clock-rates: true

  clocks:
    minItems: 1
    maxItems: 2

  clock-names:
    minItems: 1
    maxItems: 2

  resets:
    items:
      - description: module reset

  reset-names:
    items:
      - const: sdhci

  power-gpios:
    description: specify GPIOs for power control
    maxItems: 1

  interconnects:
    items:
      - description: memory read client
      - description: memory write client

  interconnect-names:
    items:
      - const: dma-mem # read
      - const: write

  iommus:
    maxItems: 1

  operating-points-v2: true

  power-domains:
    items:
      - description: phandle to the core power domain

  nvidia,default-tap:
    description: Specify the default inbound sampling clock trimmer value for
      non-tunable modes.

      The values are used for compensating trace length differences by
      adjusting the sampling point. The values are programmed to the Vendor
      Clock Control Register. Please refer to the reference manual of the SoC
      for correct values.

      The DQS trim values are only used on controllers which support HS400
      timing. Only SDMMC4 on Tegra210 and Tegra186 supports HS400.
    $ref: /schemas/types.yaml#/definitions/uint32

  nvidia,default-trim:
    description: Specify the default outbound clock trimmer value.
    $ref: /schemas/types.yaml#/definitions/uint32

  nvidia,dqs-trim:
    description: Specify DQS trim value for HS400 timing.
    $ref: /schemas/types.yaml#/definitions/uint32

  nvidia,pad-autocal-pull-down-offset-1v8:
    description: Specify drive strength calibration offsets for 1.8 V
      signaling modes.
    $ref: /schemas/types.yaml#/definitions/uint32

  nvidia,pad-autocal-pull-down-offset-1v8-timeout:
    description: Specify drive strength used as a fallback in case the
      automatic calibration times out on a 1.8 V signaling mode.
    $ref: /schemas/types.yaml#/definitions/uint32

  nvidia,pad-autocal-pull-down-offset-3v3:
    description: Specify drive strength calibration offsets for 3.3 V
      signaling modes.
    $ref: /schemas/types.yaml#/definitions/uint32

  nvidia,pad-autocal-pull-down-offset-3v3-timeout:
    description: Specify drive strength used as a fallback in case the
      automatic calibration times out on a 3.3 V signaling mode.
    $ref: /schemas/types.yaml#/definitions/uint32

  nvidia,pad-autocal-pull-down-offset-sdr104:
    description: Specify drive strength calibration offsets for SDR104 mode.
    $ref: /schemas/types.yaml#/definitions/uint32

  nvidia,pad-autocal-pull-down-offset-hs400:
    description: Specify drive strength calibration offsets for HS400 mode.
    $ref: /schemas/types.yaml#/definitions/uint32

  nvidia,pad-autocal-pull-up-offset-1v8:
    description: Specify drive strength calibration offsets for 1.8 V
      signaling modes.
    $ref: /schemas/types.yaml#/definitions/uint32

  nvidia,pad-autocal-pull-up-offset-1v8-timeout:
    description: Specify drive strength used as a fallback in case the
      automatic calibration times out on a 1.8 V signaling mode.
    $ref: /schemas/types.yaml#/definitions/uint32

  nvidia,pad-autocal-pull-up-offset-3v3:
    description: Specify drive strength calibration offsets for 3.3 V
      signaling modes.

      The property values are drive codes which are programmed into the
      PD_OFFSET and PU_OFFSET sections of the SDHCI_TEGRA_AUTO_CAL_CONFIG
      register. A higher value corresponds to higher drive strength. Please
      refer to the reference manual of the SoC for correct values. The SDR104
      and HS400 timing specific values are used in corresponding modes if
      specified.
    $ref: /schemas/types.yaml#/definitions/uint32

  nvidia,pad-autocal-pull-up-offset-3v3-timeout:
    description: Specify drive strength used as a fallback in case the
      automatic calibration times out on a 3.3 V signaling mode.
    $ref: /schemas/types.yaml#/definitions/uint32

  nvidia,pad-autocal-pull-up-offset-sdr104:
    description: Specify drive strength calibration offsets for SDR104 mode.
    $ref: /schemas/types.yaml#/definitions/uint32

  nvidia,pad-autocal-pull-up-offset-hs400:
    description: Specify drive strength calibration offsets for HS400 mode.
    $ref: /schemas/types.yaml#/definitions/uint32

  nvidia,only-1-8v:
    description: The presence of this property indicates that the controller
      operates at a 1.8 V fixed I/O voltage.
    $ref: /schemas/types.yaml#/definitions/flag

required:
  - compatible
  - reg
  - interrupts
  - clocks
  - resets
  - reset-names

allOf:
  - $ref: mmc-controller.yaml
  - if:
      properties:
        compatible:
          contains:
            enum:
              - nvidia,tegra20-sdhci
              - nvidia,tegra30-sdhci
              - nvidia,tegra114-sdhci
              - nvidia,tegra124-sdhci
    then:
      properties:
        clocks:
          items:
            - description: module clock
    else:
      properties:
        clocks:
          items:
            - description: module clock
            - description: timeout clock

        clock-names:
          items:
            - const: sdhci
            - const: tmclk
      required:
        - clock-names

  - if:
      properties:
        compatible:
          contains:
            const: nvidia,tegra210-sdhci
    then:
      properties:
        pinctrl-names:
          oneOf:
            - items:
                - const: sdmmc-3v3
                  description: pad configuration for 3.3 V
                - const: sdmmc-1v8
                  description: pad configuration for 1.8 V
                - const: sdmmc-3v3-drv
                  description: pull-up/down configuration for 3.3 V
                - const: sdmmc-1v8-drv
                  description: pull-up/down configuration for 1.8 V
            - items:
                - const: sdmmc-3v3-drv
                  description: pull-up/down configuration for 3.3 V
                - const: sdmmc-1v8-drv
                  description: pull-up/down configuration for 1.8 V
            - items:
                - const: sdmmc-1v8-drv
                  description: pull-up/down configuration for 1.8 V
      required:
        - clock-names
  - if:
      properties:
        compatible:
          contains:
            enum:
              - nvidia,tegra186-sdhci
              - nvidia,tegra194-sdhci
    then:
      properties:
        pinctrl-names:
          items:
            - const: sdmmc-3v3
              description: pad configuration for 3.3 V
            - const: sdmmc-1v8
              description: pad configuration for 1.8 V
      required:
        - clock-names

unevaluatedProperties: false

examples:
  - |
    #include <dt-bindings/interrupt-controller/arm-gic.h>

    mmc@c8000200 {
        compatible = "nvidia,tegra20-sdhci";
        reg = <0xc8000200 0x200>;
        interrupts = <47>;
        clocks = <&tegra_car 14>;
        resets = <&tegra_car 14>;
        reset-names = "sdhci";
        cd-gpios = <&gpio 69 0>; /* gpio PI5 */
        wp-gpios = <&gpio 57 0>; /* gpio PH1 */
        power-gpios = <&gpio 155 0>; /* gpio PT3 */
        bus-width = <8>;
    };

  - |
    #include <dt-bindings/clock/tegra210-car.h>
    #include <dt-bindings/interrupt-controller/arm-gic.h>

    mmc@700b0000 {
        compatible = "nvidia,tegra210-sdhci";
        reg = <0x700b0000 0x200>;
        interrupts = <GIC_SPI 14 IRQ_TYPE_LEVEL_HIGH>;
        clocks = <&tegra_car TEGRA210_CLK_SDMMC1>,
                 <&tegra_car TEGRA210_CLK_SDMMC_LEGACY>;
        clock-names = "sdhci", "tmclk";
        resets = <&tegra_car 14>;
        reset-names = "sdhci";
        pinctrl-names = "sdmmc-3v3", "sdmmc-1v8",
                        "sdmmc-3v3-drv", "sdmmc-1v8-drv";
        pinctrl-0 = <&sdmmc1_3v3>;
        pinctrl-1 = <&sdmmc1_1v8>;
        pinctrl-2 = <&sdmmc1_3v3_drv>;
        pinctrl-3 = <&sdmmc1_1v8_drv>;
        nvidia,pad-autocal-pull-up-offset-3v3 = <0x00>;
        nvidia,pad-autocal-pull-down-offset-3v3 = <0x7d>;
        nvidia,pad-autocal-pull-up-offset-1v8 = <0x7b>;
        nvidia,pad-autocal-pull-down-offset-1v8 = <0x7b>;
        nvidia,default-tap = <0x2>;
        nvidia,default-trim = <0x4>;
        assigned-clocks = <&tegra_car TEGRA210_CLK_SDMMC4>,
                          <&tegra_car TEGRA210_CLK_PLL_C4_OUT0>,
                          <&tegra_car TEGRA210_CLK_PLL_C4>;
        assigned-clock-parents = <&tegra_car TEGRA210_CLK_PLL_C4_OUT0>;
        assigned-clock-rates = <200000000>, <1000000000>, <1000000000>;
    };
```

## Documentation/devicetree/bindings/mmc/nvidia-sdhci.txt
```
* NVIDIA Tegra Secure Digital Host Controller

This controller on Tegra family SoCs provides an interface for MMC, SD,
and SDIO types of memory cards.

Required properties:
- compatible : Should be "nvidia,<chip>-sdhci"
- reg : Should contain SD/MMC registers location and length
- interrupts : Should contain SD/MMC interrupt

Optional properties:
- cd-gpios : Specify GPIOs for card detection
- wp-gpios : Specify GPIOs for write protection
- power-gpios : Specify GPIOs for power control
- support-8bit : Boolean, indicates if 8-bit mode should be used.

Example:

sdhci@c8000200 {
	compatible = "nvidia,tegra20-sdhci";
	reg = <0xc8000200 0x200>;
	interrupts = <47>;
	cd-gpios = <&gpio 69 0>; /* gpio PI5 */
	wp-gpios = <&gpio 57 0>; /* gpio PH1 */
	power-gpios = <&gpio 155 0>; /* gpio PT3 */
	support-8bit;
};
```

## Documentation/devicetree/bindings/mmc/orion-sdio.txt
```
* Marvell orion-sdio controller

This file documents differences between the core properties in mmc.txt
and the properties used by the orion-sdio driver.

- compatible: Should be "marvell,orion-sdio"
- clocks: reference to the clock of the SDIO interface

Example:

	mvsdio@d00d4000 {
		compatible = "marvell,orion-sdio";
		reg = <0xd00d4000 0x200>;
		interrupts = <54>;
		clocks = <&gateclk 17>;
	};
```

## Documentation/devicetree/bindings/mmc/owl-mmc.yaml
```yaml
# SPDX-License-Identifier: (GPL-2.0-only OR BSD-2-Clause)
%YAML 1.2
---
$id: http://devicetree.org/schemas/mmc/owl-mmc.yaml#
$schema: http://devicetree.org/meta-schemas/core.yaml#

title: Actions Semi Owl SoCs SD/MMC/SDIO controller

allOf:
  - $ref: "mmc-controller.yaml"

maintainers:
  - Manivannan Sadhasivam <manivannan.sadhasivam@linaro.org>

properties:
  compatible:
    const: actions,owl-mmc

  reg:
    maxItems: 1

  interrupts:
    maxItems: 1

  clocks:
    minItems: 1

  resets:
    maxItems: 1

  dmas:
    maxItems: 1

  dma-names:
    const: mmc

required:
  - compatible
  - reg
  - interrupts
  - clocks
  - resets
  - dmas
  - dma-names

unevaluatedProperties: false

examples:
  - |
    mmc0: mmc@e0330000 {
        compatible = "actions,owl-mmc";
        reg = <0xe0330000 0x4000>;
        interrupts = <0 42 4>;
        clocks = <&cmu 56>;
        resets = <&cmu 23>;
        dmas = <&dma 2>;
        dma-names = "mmc";
        bus-width = <4>;
    };

...
```

## Documentation/devicetree/bindings/mmc/pxa-mmc.txt
```
* PXA MMC drivers

Driver bindings for the PXA MCI (MMC/SDIO) interfaces

Required properties:
- compatible: Should be "marvell,pxa-mmc".
- vmmc-supply: A regulator for VMMC

Optional properties:
- marvell,detect-delay-ms: sets the detection delay timeout in ms.

In addition to the properties described in this document, the details
described in mmc.txt are supported.

Examples:

mmc0: mmc@41100000 {
	compatible = "marvell,pxa-mmc";
	reg = <0x41100000 0x1000>;
	interrupts = <23>;
	vmmc-supply = <&mmc_regulator>;
	cd-gpios = <&gpio 23 0>;
	wp-gpios = <&gpio 24 0>;
};
```

## Documentation/devicetree/bindings/mmc/renesas,mmcif.txt
```
* Renesas Multi Media Card Interface (MMCIF) Controller

This file documents differences between the core properties in mmc.txt
and the properties used by the MMCIF device.


Required properties:

- compatible: should be "renesas,mmcif-<soctype>", "renesas,sh-mmcif" as a
  fallback. Examples with <soctype> are:
	- "renesas,mmcif-r7s72100" for the MMCIF found in r7s72100 SoCs
	- "renesas,mmcif-r8a73a4" for the MMCIF found in r8a73a4 SoCs
	- "renesas,mmcif-r8a7740" for the MMCIF found in r8a7740 SoCs
	- "renesas,mmcif-r8a7743" for the MMCIF found in r8a7743 SoCs
	- "renesas,mmcif-r8a7744" for the MMCIF found in r8a7744 SoCs
	- "renesas,mmcif-r8a7745" for the MMCIF found in r8a7745 SoCs
	- "renesas,mmcif-r8a7778" for the MMCIF found in r8a7778 SoCs
	- "renesas,mmcif-r8a7790" for the MMCIF found in r8a7790 SoCs
	- "renesas,mmcif-r8a7791" for the MMCIF found in r8a7791 SoCs
	- "renesas,mmcif-r8a7793" for the MMCIF found in r8a7793 SoCs
	- "renesas,mmcif-r8a7794" for the MMCIF found in r8a7794 SoCs
	- "renesas,mmcif-sh73a0" for the MMCIF found in sh73a0 SoCs

- interrupts: Some SoCs have only 1 shared interrupt, while others have either
  2 or 3 individual interrupts (error, int, card detect). Below is the number
  of interrupts for each SoC:
    1: r8a73a4, r8a7743, r8a7744, r8a7745, r8a7778, r8a7790, r8a7791, r8a7793,
       r8a7794
    2: r8a7740, sh73a0
    3: r7s72100

- clocks: reference to the functional clock

- dmas: reference to the DMA channels, one per channel name listed in the
  dma-names property.
- dma-names: must contain "tx" for the transmit DMA channel and "rx" for the
  receive DMA channel.
- max-frequency: Maximum operating clock frequency, driver uses default clock
  frequency if it is not set.


Example: R8A7790 (R-Car H2) MMCIF0

	mmcif0: mmc@ee200000 {
		compatible = "renesas,mmcif-r8a7790", "renesas,sh-mmcif";
		reg = <0 0xee200000 0 0x80>;
		interrupts = <0 169 IRQ_TYPE_LEVEL_HIGH>;
		clocks = <&mstp3_clks R8A7790_CLK_MMCIF0>;
		dmas = <&dmac0 0xd1>, <&dmac0 0xd2>;
		dma-names = "tx", "rx";
		max-frequency = <97500000>;
	};
```
