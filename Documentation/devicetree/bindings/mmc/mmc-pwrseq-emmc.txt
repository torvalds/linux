## Documentation/devicetree/bindings/mmc/mmc-pwrseq-emmc.txt
```
* The simple eMMC hardware reset provider

The purpose of this driver is to perform standard eMMC hw reset
procedure, as descibed by Jedec 4.4 specification. This procedure is
performed just after MMC core enabled power to the given mmc host (to
fix possible issues if bootloader has left eMMC card in initialized or
unknown state), and before performing complete system reboot (also in
case of emergency reboot call). The latter is needed on boards, which
doesn't have hardware reset logic connected to emmc card and (limited or
broken) ROM bootloaders are unable to read second stage from the emmc
card if the card is left in unknown or already initialized state.

Required properties:
- compatible : contains "mmc-pwrseq-emmc".
- reset-gpios : contains a GPIO specifier. The reset GPIO is asserted
	and then deasserted to perform eMMC card reset. To perform
	reset procedure as described in Jedec 4.4 specification, the
	gpio line should be defined as GPIO_ACTIVE_LOW.

Example:

	sdhci0_pwrseq {
		compatible = "mmc-pwrseq-emmc";
		reset-gpios = <&gpio1 12 GPIO_ACTIVE_LOW>;
	}
```

## Documentation/devicetree/bindings/mmc/mmc-pwrseq-emmc.yaml
```yaml
# SPDX-License-Identifier: GPL-2.0
%YAML 1.2
---
$id: http://devicetree.org/schemas/mmc/mmc-pwrseq-emmc.yaml#
$schema: http://devicetree.org/meta-schemas/core.yaml#

title: Simple eMMC hardware reset provider

maintainers:
  - Ulf Hansson <ulf.hansson@linaro.org>

description:
  The purpose of this driver is to perform standard eMMC hw reset
  procedure, as described by Jedec 4.4 specification. This procedure is
  performed just after MMC core enabled power to the given mmc host (to
  fix possible issues if bootloader has left eMMC card in initialized or
  unknown state), and before performing complete system reboot (also in
  case of emergency reboot call). The latter is needed on boards, which
  doesn't have hardware reset logic connected to emmc card and (limited or
  broken) ROM bootloaders are unable to read second stage from the emmc
  card if the card is left in unknown or already initialized state.

properties:
  compatible:
    const: mmc-pwrseq-emmc

  reset-gpios:
    minItems: 1
    description:
      contains a GPIO specifier. The reset GPIO is asserted
      and then deasserted to perform eMMC card reset. To perform
      reset procedure as described in Jedec 4.4 specification, the
      gpio line should be defined as GPIO_ACTIVE_LOW.

required:
  - compatible
  - reset-gpios

additionalProperties: false

examples:
  - |
    #include <dt-bindings/gpio/gpio.h>
    sdhci0_pwrseq {
      compatible = "mmc-pwrseq-emmc";
      reset-gpios = <&gpio1 12 GPIO_ACTIVE_LOW>;
    };
...
```

## Documentation/devicetree/bindings/mmc/mmc-pwrseq-sd8787.txt
```
* Marvell SD8787 power sequence provider

Required properties:
- compatible: must be "mmc-pwrseq-sd8787".
- powerdown-gpios: contains a power down GPIO specifier with the
		   default active state
- reset-gpios: contains a reset GPIO specifier with the default
		   active state

Example:

	wifi_pwrseq: wifi_pwrseq {
		compatible = "mmc-pwrseq-sd8787";
		powerdown-gpios = <&twl_gpio 0 GPIO_ACTIVE_LOW>;
		reset-gpios = <&twl_gpio 1 GPIO_ACTIVE_LOW>;
	}
```

## Documentation/devicetree/bindings/mmc/mmc-pwrseq-sd8787.yaml
```yaml
# SPDX-License-Identifier: GPL-2.0
%YAML 1.2
---
$id: http://devicetree.org/schemas/mmc/mmc-pwrseq-sd8787.yaml#
$schema: http://devicetree.org/meta-schemas/core.yaml#

title: Marvell SD8787 power sequence provider

maintainers:
  - Ulf Hansson <ulf.hansson@linaro.org>

properties:
  compatible:
    enum:
      - mmc-pwrseq-sd8787
      - mmc-pwrseq-wilc1000

  powerdown-gpios:
    minItems: 1
    description:
      contains a power down GPIO specifier with the default active state

  reset-gpios:
    minItems: 1
    description:
      contains a reset GPIO specifier with the default active state

required:
  - compatible
  - powerdown-gpios
  - reset-gpios

additionalProperties: false

examples:
  - |
    #include <dt-bindings/gpio/gpio.h>
    pwrseq {
      compatible = "mmc-pwrseq-sd8787";
      powerdown-gpios = <&twl_gpio 0 GPIO_ACTIVE_LOW>;
      reset-gpios = <&twl_gpio 1 GPIO_ACTIVE_LOW>;
    };
...
```

## Documentation/devicetree/bindings/mmc/mmc-pwrseq-simple.txt
```
* The simple MMC power sequence provider

The purpose of the simple MMC power sequence provider is to supports a set of
common properties between various SOC designs. It thus enables us to use the
same provider for several SOC designs.

Required properties:
- compatible : contains "mmc-pwrseq-simple".

Optional properties:
- reset-gpios : contains a list of GPIO specifiers. The reset GPIOs are asserted
	at initialization and prior we start the power up procedure of the card.
	They will be de-asserted right after the power has been provided to the
	card.
- clocks : Must contain an entry for the entry in clock-names.
  See ../clocks/clock-bindings.txt for details.
- clock-names : Must include the following entry:
  "ext_clock" (External clock provided to the card).
- post-power-on-delay-ms : Delay in ms after powering the card and
	de-asserting the reset-gpios (if any)

Example:

	sdhci0_pwrseq {
		compatible = "mmc-pwrseq-simple";
		reset-gpios = <&gpio1 12 GPIO_ACTIVE_LOW>;
		clocks = <&clk_32768_ck>;
		clock-names = "ext_clock";
	}
```

## Documentation/devicetree/bindings/mmc/mmc-pwrseq-simple.yaml
```yaml
# SPDX-License-Identifier: GPL-2.0
%YAML 1.2
---
$id: http://devicetree.org/schemas/mmc/mmc-pwrseq-simple.yaml#
$schema: http://devicetree.org/meta-schemas/core.yaml#

title: Simple MMC power sequence provider binding

maintainers:
  - Ulf Hansson <ulf.hansson@linaro.org>

description:
  The purpose of the simple MMC power sequence provider is to supports a set
  of common properties between various SOC designs. It thus enables us to use
  the same provider for several SOC designs.

properties:
  compatible:
    const: mmc-pwrseq-simple

  reset-gpios:
    minItems: 1
    description:
      contains a list of GPIO specifiers. The reset GPIOs are asserted
      at initialization and prior we start the power up procedure of the card.
      They will be de-asserted right after the power has been provided to the
      card.

  clocks:
    minItems: 1
    description: Handle for the entry in clock-names.

  clock-names:
    items:
      - const: ext_clock
    description: External clock provided to the card.

  post-power-on-delay-ms:
    description:
      Delay in ms after powering the card and de-asserting the
      reset-gpios (if any).
    $ref: /schemas/types.yaml#/definitions/uint32

  power-off-delay-us:
    description:
      Delay in us after asserting the reset-gpios (if any)
      during power off of the card.
    $ref: /schemas/types.yaml#/definitions/uint32

required:
  - compatible

examples:
  - |
    #include <dt-bindings/gpio/gpio.h>
    sdhci0_pwrseq {
      compatible = "mmc-pwrseq-simple";
      reset-gpios = <&gpio1 12 GPIO_ACTIVE_LOW>;
      clocks = <&clk_32768_ck>;
      clock-names = "ext_clock";
    };
...
```

## Documentation/devicetree/bindings/mmc/mmc-slot.yaml
```yaml
# SPDX-License-Identifier: (GPL-2.0-only OR BSD-2-Clause)
%YAML 1.2
---
$id: http://devicetree.org/schemas/mmc/mmc-slot.yaml#
$schema: http://devicetree.org/meta-schemas/core.yaml#

title: MMC slot properties

maintainers:
  - Ulf Hansson <ulf.hansson@linaro.org>

description:
  These properties defines slot properties for MMC controlers that
  have multiple slots or ports provided by the same controller and
  sharing the same resources.

$ref: mmc-controller-common.yaml#

properties:
  $nodename:
    pattern: "^slot(@.*)?$"

  compatible:
    const: mmc-slot

  reg:
    description:
      the slot (or "port") ID
    maxItems: 1

required:
  - reg

unevaluatedProperties: false

examples:
  - |
    mmc {
      #address-cells = <1>;
      #size-cells = <0>;
      slot@0 {
        compatible = "mmc-slot";
        reg = <0>;
        bus-width = <4>;
      };
    };

...
```

## Documentation/devicetree/bindings/mmc/mmc-spi-slot.txt
```
MMC/SD/SDIO slot directly connected to a SPI bus

This file documents differences between the core properties described
by mmc.txt and the properties used by the mmc_spi driver.

Required properties:
- spi-max-frequency : maximum frequency for this device (Hz).
- voltage-ranges : two cells are required, first cell specifies minimum
  slot voltage (mV), second cell specifies maximum slot voltage (mV).
  Several ranges could be specified.

Optional properties:
- gpios : may specify GPIOs in this order: Card-Detect GPIO,
  Write-Protect GPIO. Note that this does not follow the
  binding from mmc.txt, for historical reasons.

Example:

	mmc-slot@0 {
		compatible = "fsl,mpc8323rdb-mmc-slot",
			     "mmc-spi-slot";
		reg = <0>;
		gpios = <&qe_pio_d 14 1
			 &qe_pio_d 15 0>;
		voltage-ranges = <3300 3300>;
		spi-max-frequency = <50000000>;
		interrupts = <42>;
		interrupt-parent = <&PIC>;
	};
```

## Documentation/devicetree/bindings/mmc/mmc-spi-slot.yaml
```yaml
# SPDX-License-Identifier: (GPL-2.0-only OR BSD-2-Clause)
%YAML 1.2
---
$id: http://devicetree.org/schemas/mmc/mmc-spi-slot.yaml#
$schema: http://devicetree.org/meta-schemas/core.yaml#

title: MMC/SD/SDIO slot directly connected to a SPI bus

maintainers:
  - Ulf Hansson <ulf.hansson@linaro.org>

allOf:
  - $ref: "mmc-controller.yaml"
  - $ref: /schemas/spi/spi-peripheral-props.yaml

description: |
  The extra properties used by an mmc connected via SPI.

properties:
  compatible:
    const: mmc-spi-slot

  reg:
    maxItems: 1

  spi-max-frequency: true

  interrupts:
    maxItems: 1

  voltage-ranges:
    $ref: /schemas/types.yaml#/definitions/uint32-array
    description: |
      Two cells are required, first cell specifies minimum slot voltage (mV),
      second cell specifies maximum slot voltage (mV).
    items:
      - description: |
          value for minimum slot voltage in mV
        default: 3200
      - description: |
          value for maximum slot voltage in mV
        default: 3400

  gpios:
    description: |
      For historical reasons, this does not follow the generic mmc-controller
      binding.
    minItems: 1
    items:
      - description: Card-Detect GPIO
      - description: Write-Protect GPIO

required:
  - compatible
  - reg
  - spi-max-frequency

unevaluatedProperties: false

examples:
  - |
    #include <dt-bindings/gpio/gpio.h>
    spi {
      #address-cells = <1>;
      #size-cells = <0>;
      mmc@0 {
        compatible = "mmc-spi-slot";
        reg = <0>;
        gpios = <&gpio 14 GPIO_ACTIVE_LOW>, <&gpio 15 GPIO_ACTIVE_HIGH>;
        voltage-ranges = <3300 3300>;
        spi-max-frequency = <50000000>;
        interrupts = <42>;
        interrupt-parent = <&PIC>;
      };
    };

...
```

## Documentation/devicetree/bindings/mmc/mmci.txt
```
* ARM PrimeCell MultiMedia Card Interface (MMCI) PL180/1

The ARM PrimeCell MMCI PL180 and PL181 provides an interface for
reading and writing to MultiMedia and SD cards alike.

This file documents differences between the core properties described
by mmc.txt and the properties used by the mmci driver. Using "st" as
the prefix for a property, indicates support by the ST Micro variant.

Required properties:
- compatible             : contains "arm,pl18x", "arm,primecell".
- vmmc-supply            : phandle to the regulator device tree node, mentioned
                           as the VCC/VDD supply in the eMMC/SD specs.

Optional properties:
- arm,primecell-periphid : contains the PrimeCell Peripheral ID, it overrides
                           the ID provided by the HW
- resets                 : phandle to internal reset line.
			   Should be defined for sdmmc variant.
- vqmmc-supply           : phandle to the regulator device tree node, mentioned
                           as the VCCQ/VDD_IO supply in the eMMC/SD specs.
specific for ux500 variant:
- st,sig-dir-dat0        : bus signal direction pin used for DAT[0].
- st,sig-dir-dat2        : bus signal direction pin used for DAT[2].
- st,sig-dir-dat31       : bus signal direction pin used for DAT[3] and DAT[1].
- st,sig-dir-dat74       : bus signal direction pin used for DAT[4] to DAT[7].
- st,sig-dir-cmd         : cmd signal direction pin used for CMD.
- st,sig-pin-fbclk       : feedback clock signal pin used.

specific for sdmmc variant:
- st,sig-dir             : signal direction polarity used for cmd, dat0 dat123.
- st,neg-edge            : data & command phase relation, generated on
                           sd clock falling edge.
- st,use-ckin            : use ckin pin from an external driver to sample
                           the receive data (example: with voltage
			   switch transceiver).

Deprecated properties:
- mmc-cap-mmc-highspeed  : indicates whether MMC is high speed capable.
- mmc-cap-sd-highspeed   : indicates whether SD is high speed capable.

Example:

sdi0_per1@80126000 {
	compatible = "arm,pl18x", "arm,primecell";
	reg = <0x80126000 0x1000>;
	interrupts = <0 60 IRQ_TYPE_LEVEL_HIGH>;

	dmas = <&dma 29 0 0x2>, /* Logical - DevToMem */
	       <&dma 29 0 0x0>; /* Logical - MemToDev */
	dma-names = "rx", "tx";

	clocks = <&prcc_kclk 1 5>, <&prcc_pclk 1 5>;
	clock-names = "sdi", "apb_pclk";

	max-frequency = <100000000>;
	bus-width = <4>;
	cap-sd-highspeed;
	cap-mmc-highspeed;
	cd-gpios  = <&gpio2 31 0x4>; // 95
	st,sig-dir-dat0;
	st,sig-dir-dat2;
	st,sig-dir-cmd;
	st,sig-pin-fbclk;

	vmmc-supply = <&ab8500_ldo_aux3_reg>;
	vqmmc-supply = <&vmmci>;

	pinctrl-names = "default", "sleep";
	pinctrl-0 = <&sdi0_default_mode>;
	pinctrl-1 = <&sdi0_sleep_mode>;
};
```

## Documentation/devicetree/bindings/mmc/moxa,moxart-mmc.txt
```
MOXA ART MMC Host Controller Interface

  Inherits from mmc binding[1].

  [1] Documentation/devicetree/bindings/mmc/mmc.txt

Required properties:

- compatible :	Must be "moxa,moxart-mmc" or "faraday,ftsdc010"
- reg :		Should contain registers location and length
- interrupts :	Should contain the interrupt number
- clocks :	Should contain phandle for the clock feeding the MMC controller

Optional properties:

- dmas :	Should contain two DMA channels, line request number must be 5 for
		both channels
- dma-names :	Must be "tx", "rx"

Example:

	mmc: mmc@98e00000 {
		compatible = "moxa,moxart-mmc";
		reg = <0x98e00000 0x5C>;
		interrupts = <5 0>;
		clocks = <&clk_apb>;
		dmas =  <&dma 5>,
			<&dma 5>;
		dma-names = "tx", "rx";
	};
```
