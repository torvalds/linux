## Documentation/devicetree/bindings/mmc/atmel-hsmci.txt
```
* Atmel High Speed MultiMedia Card Interface

This controller on atmel products provides an interface for MMC, SD and SDIO
types of memory cards.

This file documents differences between the core properties described
by mmc.txt and the properties used by the atmel-mci driver.

1) MCI node

Required properties:
- compatible: should be "atmel,hsmci"
- #address-cells: should be one. The cell is the slot id.
- #size-cells: should be zero.
- at least one slot node
- clock-names: tuple listing input clock names.
	Required elements: "mci_clk"
- clocks: phandles to input clocks.

The node contains child nodes for each slot that the platform uses

Example MCI node:

mmc0: mmc@f0008000 {
	compatible = "atmel,hsmci";
	reg = <0xf0008000 0x600>;
	interrupts = <12 4>;
	#address-cells = <1>;
	#size-cells = <0>;
	clock-names = "mci_clk";
	clocks = <&mci0_clk>;

	[ child node definitions...]
};

2) slot nodes

Required properties:
- reg: should contain the slot id.
- bus-width: number of data lines connected to the controller

Optional properties:
- cd-gpios: specify GPIOs for card detection
- cd-inverted: invert the value of external card detect gpio line
- wp-gpios: specify GPIOs for write protection

Example slot node:

slot@0 {
	reg = <0>;
	bus-width = <4>;
	cd-gpios = <&pioD 15 0>
	cd-inverted;
};

Example full MCI node:
mmc0: mmc@f0008000 {
	compatible = "atmel,hsmci";
	reg = <0xf0008000 0x600>;
	interrupts = <12 4>;
	#address-cells = <1>;
	#size-cells = <0>;
	slot@0 {
		reg = <0>;
		bus-width = <4>;
		cd-gpios = <&pioD 15 0>
		cd-inverted;
	};
	slot@1 {
		reg = <1>;
		bus-width = <4>;
	};
};
```

## Documentation/devicetree/bindings/mmc/bcm,kona-sdhci.txt
```
Broadcom BCM281xx SDHCI

This file documents differences between the core properties in mmc.txt
and the properties present in the bcm281xx SDHCI

Required properties:
- compatible : Should be "bcm,kona-sdhci"

Example:

sdio2: sdio@0x3f1a0000 {
	compatible = "bcm,kona-sdhci";
	reg = <0x3f1a0000 0x10000>;
	interrupts = <0x0 74 0x4>;
};
```

## Documentation/devicetree/bindings/mmc/bluefield-dw-mshc.txt
```
* Mellanox Bluefield SoC specific extensions to the Synopsys Designware
  Mobile Storage Host Controller

Read synopsys-dw-mshc.txt for more details

The Synopsys designware mobile storage host controller is used to interface
a SoC with storage medium such as eMMC or SD/MMC cards. This file documents
differences between the core Synopsys dw mshc controller properties described
by synopsys-dw-mshc.txt and the properties used by the Mellanox Bluefield SoC
specific extensions to the Synopsys Designware Mobile Storage Host Controller.

Required Properties:

* compatible: should be one of the following.
  - "mellanox,bluefield-dw-mshc": for controllers with Mellanox Bluefield SoC
    specific extensions.

Example:

	/* Mellanox Bluefield SoC MMC */
	mmc@6008000 {
		compatible = "mellanox,bluefield-dw-mshc";
		reg = <0x6008000 0x400>;
		interrupts = <32>;
		fifo-depth = <0x100>;
		clock-frequency = <24000000>;
		bus-width = <8>;
		cap-mmc-highspeed;
	};
```

## Documentation/devicetree/bindings/mmc/brcm,bcm2835-sdhci.txt
```
Broadcom BCM2835 SDHCI controller

This file documents differences between the core properties described
by mmc.txt and the properties that represent the BCM2835 controller.

Required properties:
- compatible : Should be "brcm,bcm2835-sdhci".
- clocks : The clock feeding the SDHCI controller.

Example:

sdhci: sdhci {
	compatible = "brcm,bcm2835-sdhci";
	reg = <0x7e300000 0x100>;
	interrupts = <2 30>;
	clocks = <&clk_mmc>;
	bus-width = <4>;
};
```

## Documentation/devicetree/bindings/mmc/brcm,bcm2835-sdhost.txt
```
Broadcom BCM2835 SDHOST controller

This file documents differences between the core properties described
by mmc.txt and the properties that represent the BCM2835 controller.

Required properties:
- compatible: Should be "brcm,bcm2835-sdhost".
- clocks: The clock feeding the SDHOST controller.

Optional properties:
- dmas: DMA channel for read and write.
          See Documentation/devicetree/bindings/dma/dma.txt for details

Example:

sdhost: mmc@7e202000 {
	compatible = "brcm,bcm2835-sdhost";
	reg = <0x7e202000 0x100>;
	interrupts = <2 24>;
	clocks = <&clocks BCM2835_CLOCK_VPU>;
	dmas = <&dma 13>;
	dma-names = "rx-tx";
};
```

## Documentation/devicetree/bindings/mmc/brcm,bcm2835-sdhost.yaml
```yaml
# SPDX-License-Identifier: (GPL-2.0-only OR BSD-2-Clause)
%YAML 1.2
---
$id: http://devicetree.org/schemas/mmc/brcm,bcm2835-sdhost.yaml#
$schema: http://devicetree.org/meta-schemas/core.yaml#

title: Broadcom BCM2835 SDHOST controller

maintainers:
  - Stefan Wahren <stefan.wahren@i2se.com>

allOf:
  - $ref: mmc-controller.yaml

properties:
  compatible:
    const: brcm,bcm2835-sdhost

  reg:
    maxItems: 1

  interrupts:
    maxItems: 1

  clocks:
    maxItems: 1

  dmas:
    maxItems: 1

  dma-names:
    const: rx-tx

required:
  - compatible
  - reg
  - interrupts
  - clocks

unevaluatedProperties: false

examples:
  - |
    #include <dt-bindings/clock/bcm2835.h>

    sdhost: mmc@7e202000 {
      compatible = "brcm,bcm2835-sdhost";
      reg = <0x7e202000 0x100>;
      interrupts = <2 24>;
      clocks = <&clocks BCM2835_CLOCK_VPU>;
      dmas = <&dma 13>;
      dma-names = "rx-tx";
      bus-width = <4>;
    };
```

## Documentation/devicetree/bindings/mmc/brcm,bcm7425-sdhci.txt
```
* BROADCOM BRCMSTB/BMIPS SDHCI Controller

This file documents differences between the core properties in mmc.txt
and the properties used by the sdhci-brcmstb driver.

NOTE: The driver disables all UHS speed modes by default and depends
on Device Tree properties to enable them for SoC/Board combinations
that support them.

Required properties:
- compatible: "brcm,bcm7425-sdhci"

Refer to clocks/clock-bindings.txt for generic clock consumer properties.

Example:

	sdhci@f03e0100 {
		compatible = "brcm,bcm7425-sdhci";
		reg = <0xf03e0000 0x100>;
		interrupts = <0x0 0x26 0x0>;
		sdhci,auto-cmd12;
		clocks = <&sw_sdio>;
		sd-uhs-sdr50;
		sd-uhs-ddr50;
	};

	sdhci@f03e0300 {
		non-removable;
		bus-width = <0x8>;
		compatible = "brcm,bcm7425-sdhci";
		reg = <0xf03e0200 0x100>;
		interrupts = <0x0 0x27 0x0>;
		sdhci,auto-cmd12;
		clocks = <sw_sdio>;
		mmc-hs200-1_8v;
	};
```

## Documentation/devicetree/bindings/mmc/brcm,iproc-sdhci.yaml
```yaml
# SPDX-License-Identifier: GPL-2.0
%YAML 1.2
---
$id: http://devicetree.org/schemas/mmc/brcm,iproc-sdhci.yaml#
$schema: http://devicetree.org/meta-schemas/core.yaml#

title: Broadcom IPROC SDHCI controller

maintainers:
  - Ray Jui <ray.jui@broadcom.com>
  - Scott Branden <scott.branden@broadcom.com>
  - Nicolas Saenz Julienne <nsaenz@kernel.org>

allOf:
  - $ref: mmc-controller.yaml#

properties:
  compatible:
    enum:
      - brcm,bcm2835-sdhci
      - brcm,bcm2711-emmc2
      - brcm,sdhci-iproc-cygnus
      - brcm,sdhci-iproc

  reg:
    minItems: 1

  interrupts:
    maxItems: 1

  clocks:
    maxItems: 1
    description:
      Handle to core clock for the sdhci controller.

  sdhci,auto-cmd12:
    type: boolean
    description: Specifies that controller should use auto CMD12

required:
  - compatible
  - reg
  - interrupts
  - clocks

unevaluatedProperties: false

examples:
  - |
    #include <dt-bindings/interrupt-controller/irq.h>
    #include <dt-bindings/interrupt-controller/arm-gic.h>
    #include <dt-bindings/clock/bcm-cygnus.h>

    mmc@18041000 {
      compatible = "brcm,sdhci-iproc-cygnus";
      reg = <0x18041000 0x100>;
      interrupts = <GIC_SPI 108 IRQ_TYPE_LEVEL_HIGH>;
      clocks = <&lcpll0_clks BCM_CYGNUS_LCPLL0_SDIO_CLK>;
      bus-width = <4>;
      sdhci,auto-cmd12;
      no-1-8-v;
    };
...
```

## Documentation/devicetree/bindings/mmc/brcm,kona-sdhci.yaml
```yaml
# SPDX-License-Identifier: GPL-2.0-only OR BSD-2-Clause
%YAML 1.2
---
$id: http://devicetree.org/schemas/mmc/brcm,kona-sdhci.yaml#
$schema: http://devicetree.org/meta-schemas/core.yaml#

title: Broadcom Kona family SDHCI controller

maintainers:
  - Florian Fainelli <f.fainelli@gmail.com>

allOf:
  - $ref: sdhci-common.yaml#

properties:
  compatible:
    const: brcm,kona-sdhci

  reg:
    maxItems: 1

  clocks:
    maxItems: 1

  interrupts:
    maxItems: 1

required:
  - compatible
  - reg
  - clocks
  - interrupts

unevaluatedProperties: false

examples:
  - |
    #include <dt-bindings/interrupt-controller/arm-gic.h>
    #include <dt-bindings/interrupt-controller/irq.h>
    #include <dt-bindings/clock/bcm281xx.h>

    mmc@3f1a0000 {
        compatible = "brcm,kona-sdhci";
        reg = <0x3f1a0000 0x10000>;
        clocks = <&master_ccu BCM281XX_MASTER_CCU_SDIO3>;
        interrupts = <GIC_SPI 74 IRQ_TYPE_LEVEL_HIGH>;
    };
...
```

## Documentation/devicetree/bindings/mmc/brcm,sdhci-brcmstb.txt
```
* BROADCOM BRCMSTB/BMIPS SDHCI Controller

This file documents differences between the core properties in mmc.txt
and the properties used by the sdhci-brcmstb driver.

NOTE: The driver disables all UHS speed modes by default and depends
on Device Tree properties to enable them for SoC/Board combinations
that support them.

Required properties:
- compatible: should be one of the following
  - "brcm,bcm7425-sdhci"
  - "brcm,bcm7445-sdhci"
  - "brcm,bcm7216-sdhci"

Refer to clocks/clock-bindings.txt for generic clock consumer properties.

Example:

	sdhci@84b0000 {
		sd-uhs-sdr50;
		sd-uhs-ddr50;
		sd-uhs-sdr104;
		sdhci,auto-cmd12;
		compatible = "brcm,bcm7216-sdhci",
			   "brcm,bcm7445-sdhci",
			   "brcm,sdhci-brcmstb";
		reg = <0x84b0000 0x260 0x84b0300 0x200>;
		reg-names = "host", "cfg";
		interrupts = <0x0 0x26 0x4>;
		interrupt-names = "sdio0_0";
		clocks = <&scmi_clk 245>;
		clock-names = "sw_sdio";
	};

	sdhci@84b1000 {
		mmc-ddr-1_8v;
		mmc-hs200-1_8v;
		mmc-hs400-1_8v;
		mmc-hs400-enhanced-strobe;
		supports-cqe;
		non-removable;
		bus-width = <0x8>;
		compatible = "brcm,bcm7216-sdhci",
			   "brcm,bcm7445-sdhci",
			   "brcm,sdhci-brcmstb";
		reg = <0x84b1000 0x260 0x84b1300 0x200>;
		reg-names = "host", "cfg";
		interrupts = <0x0 0x27 0x4>;
		interrupt-names = "sdio1_0";
		clocks = <&scmi_clk 245>;
		clock-names = "sw_sdio";
	};
```

## Documentation/devicetree/bindings/mmc/brcm,sdhci-brcmstb.yaml
```yaml
# SPDX-License-Identifier: (GPL-2.0-only OR BSD-2-Clause)
%YAML 1.2
---
$id: http://devicetree.org/schemas/mmc/brcm,sdhci-brcmstb.yaml#
$schema: http://devicetree.org/meta-schemas/core.yaml#

title: Broadcom BRCMSTB/BMIPS SDHCI Controller

maintainers:
  - Al Cooper <alcooperx@gmail.com>
  - Florian Fainelli <f.fainelli@gmail.com>

properties:
  compatible:
    oneOf:
      - items:
          - enum:
              - brcm,bcm7216-sdhci
          - const: brcm,bcm7445-sdhci
          - const: brcm,sdhci-brcmstb
      - items:
          - enum:
              - brcm,bcm2712-sdhci
              - brcm,bcm74165b0-sdhci
              - brcm,bcm7445-sdhci
              - brcm,bcm7425-sdhci
          - const: brcm,sdhci-brcmstb

  reg:
    maxItems: 2

  reg-names:
    items:
      - const: host
      - const: cfg

  interrupts:
    maxItems: 1

  clocks:
    minItems: 1
    items:
      - description: handle to core clock for the sdhci controller
      - description: handle to improved 150Mhz clock for sdhci controller (Optional clock)

  clock-names:
    minItems: 1
    items:
      - const: sw_sdio
      - const: sdio_freq # Optional clock

  clock-frequency:
    description:
      Maximum operating frequency of sdio_freq sdhci controller clock
    $ref: /schemas/types.yaml#/definitions/uint32
    minimum: 100000000
    maximum: 150000000

  sdhci,auto-cmd12:
    type: boolean
    description: Specifies that controller should use auto CMD12

allOf:
  - $ref: mmc-controller.yaml#
  - if:
      properties:
        clock-names:
          contains:
            const: sdio_freq

    then:
      required:
        - clock-frequency

required:
  - compatible
  - reg
  - interrupts
  - clocks
  - clock-names

unevaluatedProperties: false

examples:
  - |
    mmc@84b0000 {
      compatible = "brcm,bcm7216-sdhci",
                   "brcm,bcm7445-sdhci",
                   "brcm,sdhci-brcmstb";
      reg = <0x84b0000 0x260>, <0x84b0300 0x200>;
      reg-names = "host", "cfg";
      sd-uhs-sdr50;
      sd-uhs-ddr50;
      sd-uhs-sdr104;
      sdhci,auto-cmd12;
      interrupts = <0x0 0x26 0x4>;
      clocks = <&scmi_clk 245>;
      clock-names = "sw_sdio";
    };

    mmc@84b1000 {
      compatible = "brcm,bcm7216-sdhci",
                   "brcm,bcm7445-sdhci",
                   "brcm,sdhci-brcmstb";
      reg = <0x84b1000 0x260>, <0x84b1300 0x200>;
      reg-names = "host", "cfg";
      mmc-ddr-1_8v;
      mmc-hs200-1_8v;
      mmc-hs400-1_8v;
      mmc-hs400-enhanced-strobe;
      supports-cqe;
      non-removable;
      bus-width = <0x8>;
      interrupts = <0x0 0x27 0x4>;
      clocks = <&scmi_clk 245>;
      clock-names = "sw_sdio";
    };
```

## Documentation/devicetree/bindings/mmc/brcm,sdhci-iproc.txt
```
Broadcom IPROC SDHCI controller

This file documents differences between the core properties described
by mmc.txt and the properties that represent the IPROC SDHCI controller.

Required properties:
- compatible : Should be one of the following
	       "brcm,bcm2835-sdhci"
	       "brcm,sdhci-iproc-cygnus"

- clocks : The clock feeding the SDHCI controller.

Optional properties:
  - sdhci,auto-cmd12: specifies that controller should use auto CMD12.

Example:

sdhci0: sdhci@0x18041000 {
	compatible = "brcm,sdhci-iproc-cygnus";
	reg = <0x18041000 0x100>;
	interrupts = <GIC_SPI 108 IRQ_TYPE_LEVEL_HIGH>;
	clocks = <&lcpll0_clks BCM_CYGNUS_LCPLL0_SDIO_CLK>;
	bus-width = <4>;
	sdhci,auto-cmd12;
	no-1-8-v;
};
```

## Documentation/devicetree/bindings/mmc/bst,c1200-sdhci.yaml
```yaml
# SPDX-License-Identifier: (GPL-2.0-only OR BSD-2-Clause)
%YAML 1.2
---
$id: http://devicetree.org/schemas/mmc/bst,c1200-sdhci.yaml#
$schema: http://devicetree.org/meta-schemas/core.yaml#

title: Black Sesame Technologies DWCMSHC SDHCI Controller

maintainers:
  - Ge Gordon <gordon.ge@bst.ai>

allOf:
  - $ref: sdhci-common.yaml#

properties:
  compatible:
    const: bst,c1200-sdhci

  reg:
    items:
      - description: Core SDHCI registers
      - description: CRM registers

  interrupts:
    maxItems: 1

  clocks:
    maxItems: 1

  clock-names:
    items:
      - const: core

  memory-region:
    maxItems: 1

  dma-coherent: true

required:
  - compatible
  - reg
  - interrupts
  - clocks
  - clock-names

unevaluatedProperties: false

examples:
  - |
    #include <dt-bindings/interrupt-controller/arm-gic.h>
    #include <dt-bindings/interrupt-controller/irq.h>

    bus {
        #address-cells = <2>;
        #size-cells = <2>;

        mmc@22200000 {
            compatible = "bst,c1200-sdhci";
            reg = <0x0 0x22200000 0x0 0x1000>,
                  <0x0 0x23006000 0x0 0x1000>;
            interrupts = <GIC_SPI 144 IRQ_TYPE_LEVEL_HIGH>;
            clocks = <&clk_mmc>;
            clock-names = "core";
            memory-region = <&mmc0_reserved>;
            max-frequency = <200000000>;
            bus-width = <8>;
            non-removable;
            dma-coherent;
        };
    };
```
