## Documentation/devicetree/bindings/mips/cavium/ciu.txt
```
* Central Interrupt Unit

Properties:
- compatible: "cavium,octeon-3860-ciu"

  Compatibility with all cn3XXX, cn5XXX and cn63XX SOCs.

- interrupt-controller:  This is an interrupt controller.

- reg: The base address of the CIU's register bank.

- #interrupt-cells: Must be <2>.  The first cell is the bank within
   the CIU and may have a value of 0 or 1.  The second cell is the bit
   within the bank and may have a value between 0 and 63.

Example:
	interrupt-controller@1070000000000 {
		compatible = "cavium,octeon-3860-ciu";
		interrupt-controller;
		/* Interrupts are specified by two parts:
		 * 1) Controller register (0 or 1)
		 * 2) Bit within the register (0..63)
		 */
		#interrupt-cells = <2>;
		reg = <0x10700 0x00000000 0x0 0x7000>;
	};
```

## Documentation/devicetree/bindings/mips/cavium/ciu2.txt
```
* Central Interrupt Unit

Properties:
- compatible: "cavium,octeon-6880-ciu2"

  Compatibility with 68XX SOCs.

- interrupt-controller:  This is an interrupt controller.

- reg: The base address of the CIU's register bank.

- #interrupt-cells: Must be <2>.  The first cell is the bank within
  the CIU and may have a value between 0 and 63.  The second cell is
  the bit within the bank and may also have a value between 0 and 63.

Example:
	interrupt-controller@1070100000000 {
		compatible = "cavium,octeon-6880-ciu2";
		interrupt-controller;
		/* Interrupts are specified by two parts:
		 * 1) Controller register (0..63)
		 * 2) Bit within the register (0..63)
		 */
		#address-cells = <0>;
		#interrupt-cells = <2>;
		reg = <0x10701 0x00000000 0x0 0x4000000>;
	};
```

## Documentation/devicetree/bindings/mips/cavium/ciu3.txt
```
* Central Interrupt Unit v3

Properties:
- compatible: "cavium,octeon-7890-ciu3"

  Compatibility with 78XX and 73XX SOCs.

- interrupt-controller:  This is an interrupt controller.

- reg: The base address of the CIU's register bank.

- #interrupt-cells: Must be <2>.  The first cell is source number.
  The second cell indicates the triggering semantics, and may have a
  value of either 4 for level semantics, or 1 for edge semantics.

Example:
	interrupt-controller@1010000000000 {
		compatible = "cavium,octeon-7890-ciu3";
		interrupt-controller;
		/* Interrupts are specified by two parts:
		 * 1) Source number (20 significant bits)
		 * 2) Trigger type: (4 == level, 1 == edge)
		 */
		#address-cells = <0>;
		#interrupt-cells = <2>;
		reg = <0x10100 0x00000000 0x0 0xb0000000>;
	};
```

## Documentation/devicetree/bindings/mips/cavium/dma-engine.txt
```
* DMA Engine.

The Octeon DMA Engine transfers between the Boot Bus and main memory.
The DMA Engine will be referred to by phandle by any device that is
connected to it.

Properties:
- compatible: "cavium,octeon-5750-bootbus-dma"

  Compatibility with all cn52XX, cn56XX and cn6XXX SOCs.

- reg: The base address of the DMA Engine's register bank.

- interrupts: A single interrupt specifier.

Example:
	dma0: dma-engine@1180000000100 {
		compatible = "cavium,octeon-5750-bootbus-dma";
		reg = <0x11800 0x00000100 0x0 0x8>;
		interrupts = <0 63>;
	};
```

## Documentation/devicetree/bindings/mips/cavium/sata-uctl.txt
```
* UCTL SATA controller glue

UCTL is the bridge unit between the I/O interconnect (an internal bus)
and the SATA AHCI host controller (UAHC). It performs the following functions:
	- provides interfaces for the applications to access the UAHC AHCI
	  registers on the CN71XX I/O space.
	- provides a bridge for UAHC to fetch AHCI command table entries and data
	  buffers from Level 2 Cache.
	- posts interrupts to the CIU.
	- contains registers that:
		- control the behavior of the UAHC
		- control the clock/reset generation to UAHC
		- control endian swapping for all UAHC registers and DMA accesses

Properties:

- compatible: "cavium,octeon-7130-sata-uctl"

  Compatibility with the cn7130 SOC.

- reg: The base address of the UCTL register bank.

- #address-cells, #size-cells, ranges and dma-ranges must be present and hold
	suitable values to map all child nodes.

Example:

	uctl@118006c000000 {
		compatible = "cavium,octeon-7130-sata-uctl";
		reg = <0x11800 0x6c000000 0x0 0x100>;
		ranges; /* Direct mapping */
		dma-ranges;
		#address-cells = <2>;
		#size-cells = <2>;

		sata: sata@16c0000000000 {
			compatible = "cavium,octeon-7130-ahci";
			reg = <0x16c00 0x00000000 0x0 0x200>;
			interrupt-parent = <&cibsata>;
			interrupts = <2 4>; /* Bit: 2, level */
		};
	};
```

## Documentation/devicetree/bindings/mips/cavium/uctl.txt
```
* UCTL USB controller glue

Properties:
- compatible: "cavium,octeon-6335-uctl"

  Compatibility with all cn6XXX SOCs.

- reg: The base address of the UCTL register bank.

- #address-cells: Must be <2>.

- #size-cells: Must be <2>.

- ranges: Empty to signify direct mapping of the children.

- refclk-frequency: A single cell containing the reference clock
  frequency in Hz.

- refclk-type: A string describing the reference clock connection
  either "crystal" or "external".

Example:
	uctl@118006f000000 {
		compatible = "cavium,octeon-6335-uctl";
		reg = <0x11800 0x6f000000 0x0 0x100>;
		ranges; /* Direct mapping */
		#address-cells = <2>;
		#size-cells = <2>;
		/* 12MHz, 24MHz and 48MHz allowed */
		refclk-frequency = <24000000>;
		/* Either "crystal" or "external" */
		refclk-type = "crystal";

		ehci@16f0000000000 {
			compatible = "cavium,octeon-6335-ehci","usb-ehci";
			reg = <0x16f00 0x00000000 0x0 0x100>;
			interrupts = <0 56>;
			big-endian-regs;
		};
		ohci@16f0000000400 {
			compatible = "cavium,octeon-6335-ohci","usb-ohci";
			reg = <0x16f00 0x00000400 0x0 0x100>;
			interrupts = <0 56>;
			big-endian-regs;
		};
	};
```

## Documentation/devicetree/bindings/mips/cpu_irq.txt
```
MIPS CPU interrupt controller

On MIPS the mips_cpu_irq_of_init() helper can be used to initialize the 8 CPU
IRQs from a devicetree file and create a irq_domain for IRQ controller.

With the irq_domain in place we can describe how the 8 IRQs are wired to the
platforms internal interrupt controller cascade.

Below is an example of a platform describing the cascade inside the devicetree
and the code used to load it inside arch_init_irq().

Required properties:
- compatible : Should be "mti,cpu-interrupt-controller"

Example devicetree:
	cpu-irq: cpu-irq {
		#address-cells = <0>;

		interrupt-controller;
		#interrupt-cells = <1>;

		compatible = "mti,cpu-interrupt-controller";
	};

	intc: intc@200 {
		compatible = "ralink,rt2880-intc";
		reg = <0x200 0x100>;

		interrupt-controller;
		#interrupt-cells = <1>;

		interrupt-parent = <&cpu-irq>;
		interrupts = <2>;
	};


Example platform irq.c:
static struct of_device_id __initdata of_irq_ids[] = {
	{ .compatible = "mti,cpu-interrupt-controller", .data = mips_cpu_irq_of_init },
	{ .compatible = "ralink,rt2880-intc", .data = intc_of_init },
	{},
};

void __init arch_init_irq(void)
{
	of_irq_init(of_irq_ids);
}
```

## Documentation/devicetree/bindings/mips/cpus.yaml
```yaml
# SPDX-License-Identifier: (GPL-2.0-only OR BSD-2-Clause)
%YAML 1.2
---
$id: http://devicetree.org/schemas/mips/cpus.yaml#
$schema: http://devicetree.org/meta-schemas/core.yaml#

title: MIPS CPUs

maintainers:
  - Thomas Bogendoerfer <tsbogend@alpha.franken.de>
  - 周琰杰 (Zhou Yanjie) <zhouyanjie@wanyeetech.com>

description: |
  The device tree allows to describe the layout of CPUs in a system through
  the "cpus" node, which in turn contains a number of subnodes (ie "cpu")
  defining properties for every CPU.

properties:
  compatible:
    enum:
      - brcm,bmips3300
      - brcm,bmips4350
      - brcm,bmips4380
      - brcm,bmips5000
      - brcm,bmips5200
      - ingenic,xburst-mxu1.0
      - ingenic,xburst-fpu1.0-mxu1.1
      - ingenic,xburst-fpu2.0-mxu2.0
      - ingenic,xburst2-fpu2.1-mxu2.1-smt
      - loongson,gs264
      - mips,m14Kc
      - mips,mips4Kc
      - mips,mips4KEc
      - mips,mips24Kc
      - mips,mips24KEc
      - mips,mips74Kc
      - mips,mips1004Kc
      - mti,interaptiv
      - mti,mips24KEc
      - mti,mips14KEc
      - mti,mips14Kc

  reg:
    maxItems: 1

  clocks:
    maxItems: 1

  device_type: true

allOf:
  - if:
      properties:
        compatible:
          contains:
            enum:
              - ingenic,xburst-mxu1.0
              - ingenic,xburst-fpu1.0-mxu1.1
              - ingenic,xburst-fpu2.0-mxu2.0
              - ingenic,xburst2-fpu2.1-mxu2.1-smt
    then:
      required:
        - device_type
        - clocks

required:
  - compatible
  - reg

additionalProperties: false

examples:
  - |
    cpus {
      #size-cells = <0>;
      #address-cells = <1>;

      cpu@0 {
        compatible = "mips,mips1004Kc";
        device_type = "cpu";
        reg = <0>;
      };

      cpu@1 {
        compatible = "mips,mips1004Kc";
        device_type = "cpu";
        reg = <1>;
      };
    };

  - |
    // Example 2 (Ingenic CPU)
    #include <dt-bindings/clock/ingenic,jz4780-cgu.h>

    cpus {
      #address-cells = <1>;
      #size-cells = <0>;

      cpu@0 {
        compatible = "ingenic,xburst-fpu1.0-mxu1.1";
        device_type = "cpu";
        reg = <0>;

        clocks = <&cgu JZ4780_CLK_CPU>;
      };

      cpu@1 {
        compatible = "ingenic,xburst-fpu1.0-mxu1.1";
        device_type = "cpu";
        reg = <1>;

        clocks = <&cgu JZ4780_CLK_CORE1>;
      };
    };
...
```

## Documentation/devicetree/bindings/mips/econet.yaml
```yaml
# SPDX-License-Identifier: GPL-2.0-only OR BSD-2-Clause
%YAML 1.2
---
$id: http://devicetree.org/schemas/mips/econet.yaml#
$schema: http://devicetree.org/meta-schemas/core.yaml#

title: EcoNet MIPS SoCs

maintainers:
  - Caleb James DeLisle <cjd@cjdns.fr>

properties:
  $nodename:
    const: '/'

  compatible:
    oneOf:
      - description: Boards with EcoNet EN751221 family SoC
        items:
          - enum:
              - smartfiber,xp8421-b
          - const: econet,en751221

additionalProperties: true

...
```

## Documentation/devicetree/bindings/mips/img/pistachio.txt
```
Imagination Pistachio SoC
=========================

Required properties:
--------------------
 - compatible: Must include "img,pistachio".

CPU nodes:
----------
A "cpus" node is required.  Required properties:
 - #address-cells: Must be 1.
 - #size-cells: Must be 0.
A CPU sub-node is also required for at least CPU 0.  Since the topology may
be probed via CPS, it is not necessary to specify secondary CPUs.  Required
propertis:
 - device_type: Must be "cpu".
 - compatible: Must be "mti,interaptiv".
 - reg: CPU number.
 - clocks: Must include the CPU clock.  See ../../clock/clock-bindings.txt for
   details on clock bindings.
Example:
	cpus {
		#address-cells = <1>;
		#size-cells = <0>;

		cpu0: cpu@0 {
			device_type = "cpu";
			compatible = "mti,interaptiv";
			reg = <0>;
			clocks = <&clk_core CLK_MIPS>;
		};
	};


Boot protocol:
--------------
In accordance with the MIPS UHI specification[1], the bootloader must pass the
following arguments to the kernel:
 - $a0: -2.
 - $a1: KSEG0 address of the flattened device-tree blob.

[1] http://prplfoundation.org/wiki/MIPS_documentation
```

## Documentation/devicetree/bindings/mips/img/xilfpga.txt
```
Imagination University Program MIPSfpga
=======================================

Under the Imagination University Program, a microAptiv UP core has been
released for academic usage.

As we are dealing with a MIPS core instantiated on an FPGA, specifications
are fluid and can be varied in RTL.

This binding document is provided as baseline guidance for the example
project provided by IMG.

The example project runs on the Nexys4DDR board by Digilent powered by
the ARTIX-7 FPGA by Xilinx.

Relevant details about the example project and the Nexys4DDR board:

- microAptiv UP core m14Kc
- 50MHz clock speed
- 128Mbyte DDR RAM	at 0x0000_0000
- 8Kbyte RAM		at 0x1000_0000
- axi_intc		at 0x1020_0000
- axi_uart16550		at 0x1040_0000
- axi_gpio		at 0x1060_0000
- axi_i2c		at 0x10A0_0000
- custom_gpio		at 0x10C0_0000
- axi_ethernetlite	at 0x10E0_0000
- 8Kbyte BootRAM	at 0x1FC0_0000

Required properties:
--------------------
 - compatible: Must include "digilent,nexys4ddr","img,xilfpga".

CPU nodes:
----------
A "cpus" node is required.  Required properties:
 - #address-cells: Must be 1.
 - #size-cells: Must be 0.
A CPU sub-node is also required for at least CPU 0. Required properties:
 - device_type: Must be "cpu".
 - compatible: Must be "mips,m14Kc".
 - reg: Must be <0>.
 - clocks: phandle to ext clock for fixed-clock received by MIPS core.

Example:

	compatible = "img,xilfpga","digilent,nexys4ddr";
	cpus {
		#address-cells = <1>;
		#size-cells = <0>;

		cpu0: cpu@0 {
			device_type = "cpu";
			compatible = "mips,m14Kc";
			reg = <0>;
			clocks	= <&ext>;
		};
	};

	ext: ext {
		compatible = "fixed-clock";
		#clock-cells = <0>;
		clock-frequency = <50000000>;
	};

Boot protocol:
--------------

The BootRAM is a writeable "RAM" in FPGA at 0x1FC0_0000.
This is for easy reprogrammibility via JTAG.

The BootRAM initializes the cache and the axi_uart peripheral.

DDR initialization is already handled by a HW IP block.

When the example project bitstream is loaded, the cpu_reset button
needs to be pressed.

The bootram initializes the cache and axi_uart.
Then outputs MIPSFPGA\n\r on the serial port on the Nexys4DDR board.

At this point, the board is ready to load the Linux kernel
vmlinux file via JTAG.
```

## Documentation/devicetree/bindings/mips/ingenic/devices.yaml
```yaml
# SPDX-License-Identifier: (GPL-2.0-only OR BSD-2-Clause)
%YAML 1.2
---
$id: http://devicetree.org/schemas/mips/ingenic/devices.yaml#
$schema: http://devicetree.org/meta-schemas/core.yaml#

title: Ingenic XBurst based Platforms Device Tree Bindings

maintainers:
  - 周琰杰 (Zhou Yanjie) <zhouyanjie@wanyeetech.com>

description:
  Devices with a Ingenic XBurst CPU shall have the following properties.

properties:
  $nodename:
    const: '/'
  compatible:
    oneOf:

      - description: Qi Hardware Ben NanoNote
        items:
          - const: qi,lb60
          - const: ingenic,jz4740

      - description: YLM RetroMini RS-90
        items:
          - const: ylm,rs90
          - const: ingenic,jz4725b

      - description: Game Consoles Worldwide GCW Zero
        items:
          - const: gcw,zero
          - const: ingenic,jz4770

      - description: MIPS Creator CI20
        items:
          - const: img,ci20
          - const: ingenic,jz4780

      - description: YSH & ATIL General Board, CU1000 Module with Neo Backplane
        items:
          - const: yna,cu1000-neo
          - const: ingenic,x1000e

      - description: YSH & ATIL General Board, CU1830 Module with Neo Backplane
        items:
          - const: yna,cu1830-neo
          - const: ingenic,x1830

      - description: YSH & ATIL General Board, CU2000 Module with Neo Backplane
        items:
          - const: yna,cu2000-neo
          - const: ingenic,x2000e

additionalProperties: true

...
```
