## Documentation/devicetree/bindings/mips/ingenic/ingenic,cpu.yaml
```yaml
# SPDX-License-Identifier: (GPL-2.0-only OR BSD-2-Clause)
%YAML 1.2
---
$id: http://devicetree.org/schemas/mips/ingenic/ingenic,cpu.yaml#
$schema: http://devicetree.org/meta-schemas/core.yaml#

title: Bindings for Ingenic XBurst family CPUs

maintainers:
  - 周琰杰 (Zhou Yanjie) <zhouyanjie@wanyeetech.com>

description:
  Ingenic XBurst family CPUs shall have the following properties.

properties:
  compatible:
    oneOf:

      - description: Ingenic XBurst®1 CPU Cores
        enum:
          - ingenic,xburst-mxu1.0
          - ingenic,xburst-fpu1.0-mxu1.1
          - ingenic,xburst-fpu2.0-mxu2.0

      - description: Ingenic XBurst®2 CPU Cores
        enum:
          - ingenic,xburst2-fpu2.1-mxu2.1-smt

  reg:
    maxItems: 1

  clocks:
    maxItems: 1

required:
  - device_type
  - compatible
  - reg
  - clocks

examples:
  - |
    #include <dt-bindings/clock/jz4780-cgu.h>

    cpus {
        #address-cells = <1>;
        #size-cells = <0>;

        cpu0: cpu@0 {
                device_type = "cpu";
                compatible = "ingenic,xburst-fpu1.0-mxu1.1";
                reg = <0>;

                clocks = <&cgu JZ4780_CLK_CPU>;
                clock-names = "cpu";
        };

        cpu1: cpu@1 {
                device_type = "cpu";
                compatible = "ingenic,xburst-fpu1.0-mxu1.1";
                reg = <1>;

                clocks = <&cgu JZ4780_CLK_CORE1>;
                clock-names = "cpu";
        };
    };
...
```

## Documentation/devicetree/bindings/mips/lantiq/fpi-bus.txt
```
Lantiq XWAY SoC FPI BUS binding
============================


-------------------------------------------------------------------------------
Required properties:
- compatible			: Should be one of
					"lantiq,xrx200-fpi"
- reg				: The address and length of the XBAR
				  configuration register.
				  Address and length of the FPI bus itself.
- lantiq,rcu			: A phandle to the RCU syscon
- lantiq,offset-endianness	: Offset of the endianness configuration
				  register

-------------------------------------------------------------------------------
Example for the FPI on the xrx200 SoCs:
	fpi@10000000 {
		compatible = "lantiq,xrx200-fpi";
		ranges = <0x0 0x10000000 0xf000000>;
		reg =	<0x1f400000 0x1000>,
			<0x10000000 0xf000000>;
		lantiq,rcu = <&rcu0>;
		lantiq,offset-endianness = <0x4c>;
		#address-cells = <1>;
		#size-cells = <1>;

		gptu@e100a00 {
			......
		};
	};
```

## Documentation/devicetree/bindings/mips/lantiq/lantiq,cgu.yaml
```yaml
# SPDX-License-Identifier: (GPL-2.0-only OR BSD-2-Clause)
%YAML 1.2
---
$id: http://devicetree.org/schemas/mips/lantiq/lantiq,cgu.yaml#
$schema: http://devicetree.org/meta-schemas/core.yaml#

title: Lantiq Xway SoC series Clock Generation Unit (CGU)

maintainers:
  - John Crispin <john@phrozen.org>

properties:
  compatible:
    items:
      - enum:
          - lantiq,cgu-xway

  reg:
    maxItems: 1

required:
  - compatible
  - reg

additionalProperties: false

examples:
  - |
    cgu@103000 {
        compatible = "lantiq,cgu-xway";
        reg = <0x103000 0x1000>;
    };
```
