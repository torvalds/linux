## Documentation/devicetree/bindings/powerpc/fsl/interlaken-lac.txt
```
===============================================================================
Freescale Interlaken Look-Aside Controller Device Bindings
Copyright 2012 Freescale Semiconductor Inc.

CONTENTS
  - Interlaken Look-Aside Controller (LAC) Node
  - Example LAC Node
  - Interlaken Look-Aside Controller (LAC) Software Portal Node
  - Interlaken Look-Aside Controller (LAC) Software Portal Child Nodes
  - Example LAC SWP Node with Child Nodes

==============================================================================
Interlaken Look-Aside Controller (LAC) Node

DESCRIPTION

The Interlaken is a narrow, high speed channelized chip-to-chip interface. To
facilitate interoperability between a data path device and a look-aside
co-processor, the Interlaken Look-Aside protocol is defined for short
transaction-related transfers. Although based on the Interlaken protocol,
Interlaken Look-Aside is not directly compatible with Interlaken and can be
considered a different operation mode.

The Interlaken LA controller connects internal platform to Interlaken serial
interface. It accepts LA command through software portals, which are system
memory mapped 4KB spaces. The LA commands are then translated into the
Interlaken control words and data words, which are sent on TX side to TCAM
through SerDes lanes.

There are two 4KiB spaces defined within the LAC global register memory map.
There is a full register set at 0x0000-0x0FFF (also known as the "hypervisor"
version), and a subset at 0x1000-0x1FFF.  The former is a superset of the
latter, and includes certain registers that should not be accessible to
partitioned software.  Separate nodes are used for each region, with a phandle
linking the hypervisor node to the normal operating node.

PROPERTIES

  - compatible
	Usage: required
	Value type: <string>
	Definition: Must include "fsl,interlaken-lac". This represents only
		those LAC CCSR registers not protected in partitioned
		software. The version of the device is determined by the LAC
		IP Block Revision Register (IPBRR0) at offset 0x0BF8.

		Table of correspondences between IPBRR0 values and example
		chips:
			Value		Device
			-----------	-------
			0x02000100	T4240

		The Hypervisor node has a different compatible. It must include
		"fsl,interlaken-lac-hv". This node represents the protected
		LAC register space and is required except inside a partition
		where access to the hypervisor node is to be denied.

  - fsl,non-hv-node
	Usage: required in "fsl,interlaken-lac-hv"
	Value type: <phandle>
	Definition: Points to the non-protected LAC CCSR mapped register space
		node.

  - reg
	Usage: required
	Value type: <prop-encoded-array>
	Definition: A standard property. The first resource represents the
		Interlaken LAC configuration registers.

  - interrupts:
	Usage: required in non-hv node only
	Value type: <prop-encoded-array>
	Definition: Interrupt mapping for Interlaken LAC error IRQ.

EXAMPLE
	lac: lac@229000 {
		compatible = "fsl,interlaken-lac"
		reg = <0x229000 0x1000>;
		interrupts = <16 2 1 18>;
	};

	lac-hv@228000 {
		compatible = "fsl,interlaken-lac-hv"
		reg = <0x228000 0x1000>;
		fsl,non-hv-node = <&lac>;
	};

===============================================================================
Interlaken Look-Aside Controller (LAC) Software Portal Container Node

DESCRIPTION
The Interlaken Look-Aside Controller (LAC) utilizes Software Portals to accept
Interlaken Look-Aside (ILA) commands. The Interlaken LAC software portal
memory map occupies 128KB of memory space. The software portal memory space is
intended to be cache-enabled. WIMG for each software space is required to be
0010 if stashing is enabled; otherwise, WIMG can be 0000 or 0010.

PROPERTIES

  - #address-cells
	Usage: required
	Value type: <u32>
	Definition: A standard property. Must have a value of 1.

  - #size-cells
	Usage: required
	Value type: <u32>
	Definition: A standard property. Must have a value of 1.

  - compatible
	Usage: required
	Value type: <string>
	Definition: Must include "fsl,interlaken-lac-portals"

  - ranges
	Usage: required
	Value type: <prop-encoded-array>
	Definition: A standard property. Specifies the address and length
		of the LAC portal memory space.

===============================================================================
Interlaken Look-Aside Controller (LAC) Software Portals Child Nodes

DESCRIPTION
There are up to 24 available software portals with each software portal
requiring 4KB of consecutive memory within the software portal memory mapped
space.

PROPERTIES

  - compatible
	Usage: required
	Value type: <string>
	Definition: Must include "fsl,interlaken-lac-portal-vX.Y" where X is
		the Major version (IP_MJ) found in the LAC IP Block Revision
		Register (IPBRR0), at offset 0x0BF8, and Y is the Minor version
		(IP_MN).

		Table of correspondences between version values and example chips:
		    Value	Device
		    ------	-------
		      1.0	T4240

  - reg
	Usage: required
	Value type: <prop-encoded-array>
	Definition: A standard property.  The first resource represents the
		Interlaken LAC software portal registers.

  - fsl,liodn
	Value type: <u32>
	Definition: The logical I/O device number (LIODN) for this device.  The
		LIODN is a number expressed by this device and used to perform
		look-ups in the IOMMU (PAMU) address table when performing
		DMAs. This property is automatically added by u-boot.

===============================================================================
EXAMPLE

lac-portals {
	#address-cells = <0x1>;
	#size-cells = <0x1>;
	compatible = "fsl,interlaken-lac-portals";
	ranges = <0x0 0xf 0xf4400000 0x20000>;

	lportal0: lac-portal@0 {
		compatible = "fsl,interlaken-lac-portal-v1.0";
		fsl,liodn = <0x204>;
		reg = <0x0 0x1000>;
	};

	lportal1: lac-portal@1000 {
		compatible = "fsl,interlaken-lac-portal-v1.0";
		fsl,liodn = <0x205>;
		reg = <0x1000 0x1000>;
	};

	lportal2: lac-portal@2000 {
		compatible = "fsl,interlaken-lac-portal-v1.0";
		fsl,liodn = <0x206>;
		reg = <0x2000 0x1000>;
	};

	lportal3: lac-portal@3000 {
		compatible = "fsl,interlaken-lac-portal-v1.0";
		fsl,liodn = <0x207>;
		reg = <0x3000 0x1000>;
	};

	lportal4: lac-portal@4000 {
		compatible = "fsl,interlaken-lac-portal-v1.0";
		fsl,liodn = <0x208>;
		reg = <0x4000 0x1000>;
	};

	lportal5: lac-portal@5000 {
		compatible = "fsl,interlaken-lac-portal-v1.0";
		fsl,liodn = <0x209>;
		reg = <0x5000 0x1000>;
	};

	lportal6: lac-portal@6000 {
		compatible = "fsl,interlaken-lac-portal-v1.0";
		fsl,liodn = <0x20A>;
		reg = <0x6000 0x1000>;
	};

	lportal7: lac-portal@7000 {
		compatible = "fsl,interlaken-lac-portal-v1.0";
		fsl,liodn = <0x20B>;
		reg = <0x7000 0x1000>;
	};

	lportal8: lac-portal@8000 {
		compatible = "fsl,interlaken-lac-portal-v1.0";
		fsl,liodn = <0x20C>;
		reg = <0x8000 0x1000>;
	};

	lportal9: lac-portal@9000 {
		compatible = "fsl,interlaken-lac-portal-v1.0";
		fsl,liodn = <0x20D>;
		reg = <0x9000 0x1000>;
	};

	lportal10: lac-portal@A000 {
		compatible = "fsl,interlaken-lac-portal-v1.0";
		fsl,liodn = <0x20E>;
		reg = <0xA000 0x1000>;
	};

	lportal11: lac-portal@B000 {
		compatible = "fsl,interlaken-lac-portal-v1.0";
		fsl,liodn = <0x20F>;
		reg = <0xB000 0x1000>;
	};

	lportal12: lac-portal@C000 {
		compatible = "fsl,interlaken-lac-portal-v1.0";
		fsl,liodn = <0x210>;
		reg = <0xC000 0x1000>;
	};

	lportal13: lac-portal@D000 {
		compatible = "fsl,interlaken-lac-portal-v1.0";
		fsl,liodn = <0x211>;
		reg = <0xD000 0x1000>;
	};

	lportal14: lac-portal@E000 {
		compatible = "fsl,interlaken-lac-portal-v1.0";
		fsl,liodn = <0x212>;
		reg = <0xE000 0x1000>;
	};

	lportal15: lac-portal@F000 {
		compatible = "fsl,interlaken-lac-portal-v1.0";
		fsl,liodn = <0x213>;
		reg = <0xF000 0x1000>;
	};

	lportal16: lac-portal@10000 {
		compatible = "fsl,interlaken-lac-portal-v1.0";
		fsl,liodn = <0x214>;
		reg = <0x10000 0x1000>;
	};

	lportal17: lac-portal@11000 {
		compatible = "fsl,interlaken-lac-portal-v1.0";
		fsl,liodn = <0x215>;
		reg = <0x11000 0x1000>;
	};

	lportal8: lac-portal@1200 {
		compatible = "fsl,interlaken-lac-portal-v1.0";
		fsl,liodn = <0x216>;
		reg = <0x12000 0x1000>;
	};

	lportal19: lac-portal@13000 {
		compatible = "fsl,interlaken-lac-portal-v1.0";
		fsl,liodn = <0x217>;
		reg = <0x13000 0x1000>;
	};

	lportal20: lac-portal@14000 {
		compatible = "fsl,interlaken-lac-portal-v1.0";
		fsl,liodn = <0x218>;
		reg = <0x14000 0x1000>;
	};

	lportal21: lac-portal@15000 {
		compatible = "fsl,interlaken-lac-portal-v1.0";
		fsl,liodn = <0x219>;
		reg = <0x15000 0x1000>;
	};

	lportal22: lac-portal@16000 {
		compatible = "fsl,interlaken-lac-portal-v1.0";
		fsl,liodn = <0x21A>;
		reg = <0x16000 0x1000>;
	};

	lportal23: lac-portal@17000 {
		compatible = "fsl,interlaken-lac-portal-v1.0";
		fsl,liodn = <0x21B>;
		reg = <0x17000 0x1000>;
	};
};
```

## Documentation/devicetree/bindings/powerpc/fsl/l2cache.txt
```
Freescale L2 Cache Controller

L2 cache is present in Freescale's QorIQ and QorIQ Qonverge platforms.
The cache bindings explained below are Devicetree Specification compliant

Required Properties:

- compatible	: Should include one of the following:
		  "fsl,8540-l2-cache-controller"
		  "fsl,8541-l2-cache-controller"
		  "fsl,8544-l2-cache-controller"
		  "fsl,8548-l2-cache-controller"
		  "fsl,8555-l2-cache-controller"
		  "fsl,8568-l2-cache-controller"
		  "fsl,b4420-l2-cache-controller"
		  "fsl,b4860-l2-cache-controller"
		  "fsl,bsc9131-l2-cache-controller"
		  "fsl,bsc9132-l2-cache-controller"
		  "fsl,c293-l2-cache-controller"
		  "fsl,mpc8536-l2-cache-controller"
		  "fsl,mpc8540-l2-cache-controller"
		  "fsl,mpc8541-l2-cache-controller"
		  "fsl,mpc8544-l2-cache-controller"
		  "fsl,mpc8548-l2-cache-controller"
		  "fsl,mpc8555-l2-cache-controller"
		  "fsl,mpc8560-l2-cache-controller"
		  "fsl,mpc8568-l2-cache-controller"
		  "fsl,mpc8569-l2-cache-controller"
		  "fsl,mpc8572-l2-cache-controller"
		  "fsl,p1010-l2-cache-controller"
		  "fsl,p1011-l2-cache-controller"
		  "fsl,p1012-l2-cache-controller"
		  "fsl,p1013-l2-cache-controller"
		  "fsl,p1014-l2-cache-controller"
		  "fsl,p1015-l2-cache-controller"
		  "fsl,p1016-l2-cache-controller"
		  "fsl,p1020-l2-cache-controller"
		  "fsl,p1021-l2-cache-controller"
		  "fsl,p1022-l2-cache-controller"
		  "fsl,p1023-l2-cache-controller"
		  "fsl,p1024-l2-cache-controller"
		  "fsl,p1025-l2-cache-controller"
		  "fsl,p2010-l2-cache-controller"
		  "fsl,p2020-l2-cache-controller"
		  "fsl,t2080-l2-cache-controller"
		  "fsl,t4240-l2-cache-controller"
		  and "cache".
- reg		: Address and size of L2 cache controller registers
- cache-size	: Size of the entire L2 cache
- interrupts	: Error interrupt of L2 controller
- cache-line-size : Size of L2 cache lines

Example:

	L2: l2-cache-controller@20000 {
		compatible = "fsl,bsc9132-l2-cache-controller", "cache";
		reg = <0x20000 0x1000>;
		cache-line-size = <32>; // 32 bytes
		cache-size = <0x40000>; // L2,256K
		interrupts = <16 2 1 0>;
	};
```

## Documentation/devicetree/bindings/powerpc/fsl/lbc.txt
```
* Chipselect/Local Bus

Properties:
- name : Should be localbus
- #address-cells : Should be either two or three.  The first cell is the
                   chipselect number, and the remaining cells are the
                   offset into the chipselect.
- #size-cells : Either one or two, depending on how large each chipselect
                can be.
- ranges : Each range corresponds to a single chipselect, and cover
           the entire access window as configured.

Example:
	localbus@f0010100 {
		compatible = "fsl,mpc8272-localbus",
			   "fsl,pq2-localbus";
		#address-cells = <2>;
		#size-cells = <1>;
		reg = <0xf0010100 0x40>;

		ranges = <0x0 0x0 0xfe000000 0x02000000
			  0x1 0x0 0xf4500000 0x00008000
			  0x2 0x0 0xfd810000 0x00010000>;

		flash@0,0 {
			compatible = "jedec-flash";
			reg = <0x0 0x0 0x2000000>;
			bank-width = <4>;
			device-width = <1>;
		};

		board-control@1,0 {
			reg = <0x1 0x0 0x20>;
			compatible = "fsl,mpc8272ads-bcsr";
		};

		simple-periph@2,0 {
			compatible = "fsl,elbc-gpcm-uio";
			reg = <0x2 0x0 0x10000>;
			elbc-gpcm-br = <0xfd810800>;
			elbc-gpcm-or = <0xffff09f7>;
		};
	};
```

## Documentation/devicetree/bindings/powerpc/fsl/mcu-mpc8349emitx.txt
```
Freescale MPC8349E-mITX-compatible Power Management Micro Controller Unit (MCU)

Required properties:
- compatible : "fsl,<mcu-chip>-<board>", "fsl,mcu-mpc8349emitx".
- reg : should specify I2C address (0x0a).
- #gpio-cells : should be 2.
- gpio-controller : should be present.

Example:

mcu@a {
	#gpio-cells = <2>;
	compatible = "fsl,mc9s08qg8-mpc8349emitx",
		     "fsl,mcu-mpc8349emitx";
	reg = <0x0a>;
	gpio-controller;
};
```

## Documentation/devicetree/bindings/powerpc/fsl/mpc5121-psc.txt
```
MPC5121 PSC Device Tree Bindings

PSC in UART mode
----------------

For PSC in UART mode the needed PSC serial devices
are specified by fsl,mpc5121-psc-uart nodes in the
fsl,mpc5121-immr SoC node. Additionally the PSC FIFO
Controller node fsl,mpc5121-psc-fifo is required there:

fsl,mpc512x-psc-uart nodes
--------------------------

Required properties :
 - compatible : Should contain "fsl,<soc>-psc-uart" and "fsl,<soc>-psc"
   Supported <soc>s: mpc5121, mpc5125
 - reg : Offset and length of the register set for the PSC device
 - interrupts : <a b> where a is the interrupt number of the
   PSC FIFO Controller and b is a field that represents an
   encoding of the sense and level information for the interrupt.
 - interrupt-parent : the phandle for the interrupt controller that
   services interrupts for this device.

Recommended properties :
 - fsl,rx-fifo-size : the size of the RX fifo slice (a multiple of 4)
 - fsl,tx-fifo-size : the size of the TX fifo slice (a multiple of 4)

PSC in SPI mode
---------------

Similar to the UART mode a PSC can be operated in SPI mode. The compatible used
for that is fsl,mpc5121-psc-spi. It requires a fsl,mpc5121-psc-fifo as well.
The required and recommended properties are identical to the
fsl,mpc5121-psc-uart nodes, just use spi instead of uart in the compatible
string.

fsl,mpc512x-psc-fifo node
-------------------------

Required properties :
 - compatible : Should be "fsl,<soc>-psc-fifo"
   Supported <soc>s: mpc5121, mpc5125
 - reg : Offset and length of the register set for the PSC
         FIFO Controller
 - interrupts : <a b> where a is the interrupt number of the
   PSC FIFO Controller and b is a field that represents an
   encoding of the sense and level information for the interrupt.
 - interrupt-parent : the phandle for the interrupt controller that
   services interrupts for this device.

Recommended properties :
 - clocks : specifies the clock needed to operate the fifo controller
 - clock-names : name(s) for the clock(s) listed in clocks

Example for a board using PSC0 and PSC1 devices in serial mode:

serial@11000 {
	compatible = "fsl,mpc5121-psc-uart", "fsl,mpc5121-psc";
	cell-index = <0>;
	reg = <0x11000 0x100>;
	interrupts = <40 0x8>;
	interrupt-parent = < &ipic >;
	fsl,rx-fifo-size = <16>;
	fsl,tx-fifo-size = <16>;
};

serial@11100 {
	compatible = "fsl,mpc5121-psc-uart", "fsl,mpc5121-psc";
	cell-index = <1>;
	reg = <0x11100 0x100>;
	interrupts = <40 0x8>;
	interrupt-parent = < &ipic >;
	fsl,rx-fifo-size = <16>;
	fsl,tx-fifo-size = <16>;
};

pscfifo@11f00 {
	compatible = "fsl,mpc5121-psc-fifo";
	reg = <0x11f00 0x100>;
	interrupts = <40 0x8>;
	interrupt-parent = < &ipic >;
};
```
