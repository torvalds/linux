## Documentation/devicetree/bindings/powerpc/fsl/dma.txt
```
* Freescale DMA Controllers

** Freescale Elo DMA Controller
   This is a little-endian 4-channel DMA controller, used in Freescale mpc83xx
   series chips such as mpc8315, mpc8349, mpc8379 etc.

Required properties:

- compatible        : must include "fsl,elo-dma"
- reg               : DMA General Status Register, i.e. DGSR which contains
                      status for all the 4 DMA channels
- ranges            : describes the mapping between the address space of the
                      DMA channels and the address space of the DMA controller
- cell-index        : controller index.  0 for controller @ 0x8100
- interrupts        : interrupt specifier for DMA IRQ
- interrupt-parent  : optional, if needed for interrupt mapping

- DMA channel nodes:
        - compatible        : must include "fsl,elo-dma-channel"
                              However, see note below.
        - reg               : DMA channel specific registers
        - cell-index        : DMA channel index starts at 0.

Optional properties:
        - interrupts        : interrupt specifier for DMA channel IRQ
                              (on 83xx this is expected to be identical to
                              the interrupts property of the parent node)
        - interrupt-parent  : optional, if needed for interrupt mapping

Example:
	dma@82a8 {
		#address-cells = <1>;
		#size-cells = <1>;
		compatible = "fsl,mpc8349-dma", "fsl,elo-dma";
		reg = <0x82a8 4>;
		ranges = <0 0x8100 0x1a4>;
		interrupt-parent = <&ipic>;
		interrupts = <71 8>;
		cell-index = <0>;
		dma-channel@0 {
			compatible = "fsl,mpc8349-dma-channel", "fsl,elo-dma-channel";
			cell-index = <0>;
			reg = <0 0x80>;
			interrupt-parent = <&ipic>;
			interrupts = <71 8>;
		};
		dma-channel@80 {
			compatible = "fsl,mpc8349-dma-channel", "fsl,elo-dma-channel";
			cell-index = <1>;
			reg = <0x80 0x80>;
			interrupt-parent = <&ipic>;
			interrupts = <71 8>;
		};
		dma-channel@100 {
			compatible = "fsl,mpc8349-dma-channel", "fsl,elo-dma-channel";
			cell-index = <2>;
			reg = <0x100 0x80>;
			interrupt-parent = <&ipic>;
			interrupts = <71 8>;
		};
		dma-channel@180 {
			compatible = "fsl,mpc8349-dma-channel", "fsl,elo-dma-channel";
			cell-index = <3>;
			reg = <0x180 0x80>;
			interrupt-parent = <&ipic>;
			interrupts = <71 8>;
		};
	};

** Freescale EloPlus DMA Controller
   This is a 4-channel DMA controller with extended addresses and chaining,
   mainly used in Freescale mpc85xx/86xx, Pxxx and BSC series chips, such as
   mpc8540, mpc8641 p4080, bsc9131 etc.

Required properties:

- compatible        : must include "fsl,eloplus-dma"
- reg               : DMA General Status Register, i.e. DGSR which contains
                      status for all the 4 DMA channels
- cell-index        : controller index.  0 for controller @ 0x21000,
                                         1 for controller @ 0xc000
- ranges            : describes the mapping between the address space of the
                      DMA channels and the address space of the DMA controller

- DMA channel nodes:
        - compatible        : must include "fsl,eloplus-dma-channel"
                              However, see note below.
        - cell-index        : DMA channel index starts at 0.
        - reg               : DMA channel specific registers
        - interrupts        : interrupt specifier for DMA channel IRQ
        - interrupt-parent  : optional, if needed for interrupt mapping

Example:
	dma@21300 {
		#address-cells = <1>;
		#size-cells = <1>;
		compatible = "fsl,mpc8540-dma", "fsl,eloplus-dma";
		reg = <0x21300 4>;
		ranges = <0 0x21100 0x200>;
		cell-index = <0>;
		dma-channel@0 {
			compatible = "fsl,mpc8540-dma-channel", "fsl,eloplus-dma-channel";
			reg = <0 0x80>;
			cell-index = <0>;
			interrupt-parent = <&mpic>;
			interrupts = <20 2>;
		};
		dma-channel@80 {
			compatible = "fsl,mpc8540-dma-channel", "fsl,eloplus-dma-channel";
			reg = <0x80 0x80>;
			cell-index = <1>;
			interrupt-parent = <&mpic>;
			interrupts = <21 2>;
		};
		dma-channel@100 {
			compatible = "fsl,mpc8540-dma-channel", "fsl,eloplus-dma-channel";
			reg = <0x100 0x80>;
			cell-index = <2>;
			interrupt-parent = <&mpic>;
			interrupts = <22 2>;
		};
		dma-channel@180 {
			compatible = "fsl,mpc8540-dma-channel", "fsl,eloplus-dma-channel";
			reg = <0x180 0x80>;
			cell-index = <3>;
			interrupt-parent = <&mpic>;
			interrupts = <23 2>;
		};
	};

** Freescale Elo3 DMA Controller
   DMA controller which has same function as EloPlus except that Elo3 has 8
   channels while EloPlus has only 4, it is used in Freescale Txxx and Bxxx
   series chips, such as t1040, t4240, b4860.

Required properties:

- compatible        : must include "fsl,elo3-dma"
- reg               : contains two entries for DMA General Status Registers,
                      i.e. DGSR0 which includes status for channel 1~4, and
                      DGSR1 for channel 5~8
- ranges            : describes the mapping between the address space of the
                      DMA channels and the address space of the DMA controller

- DMA channel nodes:
        - compatible        : must include "fsl,eloplus-dma-channel"
        - reg               : DMA channel specific registers
        - interrupts        : interrupt specifier for DMA channel IRQ
        - interrupt-parent  : optional, if needed for interrupt mapping

Example:
dma@100300 {
	#address-cells = <1>;
	#size-cells = <1>;
	compatible = "fsl,elo3-dma";
	reg = <0x100300 0x4>,
	      <0x100600 0x4>;
	ranges = <0x0 0x100100 0x500>;
	dma-channel@0 {
		compatible = "fsl,eloplus-dma-channel";
		reg = <0x0 0x80>;
		interrupts = <28 2 0 0>;
	};
	dma-channel@80 {
		compatible = "fsl,eloplus-dma-channel";
		reg = <0x80 0x80>;
		interrupts = <29 2 0 0>;
	};
	dma-channel@100 {
		compatible = "fsl,eloplus-dma-channel";
		reg = <0x100 0x80>;
		interrupts = <30 2 0 0>;
	};
	dma-channel@180 {
		compatible = "fsl,eloplus-dma-channel";
		reg = <0x180 0x80>;
		interrupts = <31 2 0 0>;
	};
	dma-channel@300 {
		compatible = "fsl,eloplus-dma-channel";
		reg = <0x300 0x80>;
		interrupts = <76 2 0 0>;
	};
	dma-channel@380 {
		compatible = "fsl,eloplus-dma-channel";
		reg = <0x380 0x80>;
		interrupts = <77 2 0 0>;
	};
	dma-channel@400 {
		compatible = "fsl,eloplus-dma-channel";
		reg = <0x400 0x80>;
		interrupts = <78 2 0 0>;
	};
	dma-channel@480 {
		compatible = "fsl,eloplus-dma-channel";
		reg = <0x480 0x80>;
		interrupts = <79 2 0 0>;
	};
};

Note on DMA channel compatible properties: The compatible property must say
"fsl,elo-dma-channel" or "fsl,eloplus-dma-channel" to be used by the Elo DMA
driver (fsldma).  Any DMA channel used by fsldma cannot be used by another
DMA driver, such as the SSI sound drivers for the MPC8610.  Therefore, any DMA
channel that should be used for another driver should not use
"fsl,elo-dma-channel" or "fsl,eloplus-dma-channel".  For the SSI drivers, for
example, the compatible property should be "fsl,ssi-dma-channel".  See ssi.txt
for more information.
```

## Documentation/devicetree/bindings/powerpc/fsl/ecm.txt
```
=====================================================================
E500 LAW & Coherency Module Device Tree Binding
Copyright (C) 2009 Freescale Semiconductor Inc.
=====================================================================

Local Access Window (LAW) Node

The LAW node represents the region of CCSR space where local access
windows are configured.  For ECM based devices this is the first 4k
of CCSR space that includes CCSRBAR, ALTCBAR, ALTCAR, BPTR, and some
number of local access windows as specified by fsl,num-laws.

PROPERTIES

  - compatible
      Usage: required
      Value type: <string>
      Definition: Must include "fsl,ecm-law"

  - reg
      Usage: required
      Value type: <prop-encoded-array>
      Definition: A standard property.  The value specifies the
          physical address offset and length of the CCSR space
          registers.

  - fsl,num-laws
      Usage: required
      Value type: <u32>
      Definition: The value specifies the number of local access
          windows for this device.

=====================================================================

E500 Coherency Module Node

The E500 LAW node represents the region of CCSR space where ECM config
and error reporting registers exist, this is the second 4k (0x1000)
of CCSR space.

PROPERTIES

  - compatible
      Usage: required
      Value type: <string>
      Definition: Must include "fsl,CHIP-ecm", "fsl,ecm" where
      CHIP is the processor (mpc8572, mpc8544, etc.)

  - reg
      Usage: required
      Value type: <prop-encoded-array>
      Definition: A standard property.  The value specifies the
          physical address offset and length of the CCSR space
          registers.

   - interrupts
      Usage: required
      Value type: <prop-encoded-array>

   - interrupt-parent
      Usage: required
      Value type: <phandle>

=====================================================================
```

## Documentation/devicetree/bindings/powerpc/fsl/fsl,mpc83xx.yaml
```yaml
# SPDX-License-Identifier: (GPL-2.0-only OR BSD-2-Clause)
%YAML 1.2
---
$id: http://devicetree.org/schemas/powerpc/fsl/fsl,mpc83xx.yaml#
$schema: http://devicetree.org/meta-schemas/core.yaml#

title: Freescale PowerQUICC II Pro (MPC83xx) platforms

maintainers:
  - J. Neuschäfer <j.ne@posteo.net>

properties:
  $nodename:
    const: '/'
  compatible:
    oneOf:
      - description: MPC83xx Reference Design Boards
        items:
          - enum:
              - fsl,mpc8308rdb
              - fsl,mpc8315erdb
              - fsl,mpc8360rdk
              - fsl,mpc8377rdb
              - fsl,mpc8377wlan
              - fsl,mpc8378rdb
              - fsl,mpc8379rdb

      - description: MPC8313E Reference Design Board
        items:
          - const: MPC8313ERDB
          - const: MPC831xRDB
          - const: MPC83xxRDB

      - description: MPC8323E Reference Design Board
        items:
          - const: MPC8323ERDB
          - const: MPC832xRDB
          - const: MPC83xxRDB

      - description: MPC8349E-mITX(-GP) Reference Design Platform
        items:
          - enum:
              - MPC8349EMITX
              - MPC8349EMITXGP
          - const: MPC834xMITX
          - const: MPC83xxMITX

      - description: Keymile KMETER1 board
        const: keymile,KMETER1

      - description: MPC8308 P1M board
        const: denx,mpc8308_p1m

patternProperties:
  "^soc@.*$":
    type: object
    properties:
      compatible:
        oneOf:
          - items:
              - enum:
                  - fsl,mpc8315-immr
                  - fsl,mpc8308-immr
              - const: simple-bus
          - items:
              - const: fsl,mpc8360-immr
              - const: fsl,immr
              - const: fsl,soc
              - const: simple-bus
          - const: simple-bus

additionalProperties: true

examples:
  - |
    / {
        compatible = "fsl,mpc8315erdb";
        model = "MPC8315E-RDB";
        #address-cells = <1>;
        #size-cells = <1>;

        soc@e0000000 {
            compatible = "fsl,mpc8315-immr", "simple-bus";
            reg = <0xe0000000 0x00000200>;
            #address-cells = <1>;
            #size-cells = <1>;
            device_type = "soc";
            ranges = <0 0xe0000000 0x00100000>;
            bus-frequency = <0>;
        };
    };

...
```

## Documentation/devicetree/bindings/powerpc/fsl/gtm.txt
```
* Freescale General-purpose Timers Module

Required properties:
  - compatible : should be
    "fsl,<chip>-gtm", "fsl,gtm" for SOC GTMs
    "fsl,<chip>-qe-gtm", "fsl,qe-gtm", "fsl,gtm" for QE GTMs
    "fsl,<chip>-cpm2-gtm", "fsl,cpm2-gtm", "fsl,gtm" for CPM2 GTMs
  - reg : should contain gtm registers location and length (0x40).
  - interrupts : should contain four interrupts.
  - interrupt-parent : interrupt source phandle.
  - clock-frequency : specifies the frequency driving the timer.

Example:

timer@500 {
	compatible = "fsl,mpc8360-gtm", "fsl,gtm";
	reg = <0x500 0x40>;
	interrupts = <90 8 78 8 84 8 72 8>;
	interrupt-parent = <&ipic>;
	/* filled by u-boot */
	clock-frequency = <0>;
};

timer@440 {
	compatible = "fsl,mpc8360-qe-gtm", "fsl,qe-gtm", "fsl,gtm";
	reg = <0x440 0x40>;
	interrupts = <12 13 14 15>;
	interrupt-parent = <&qeic>;
	/* filled by u-boot */
	clock-frequency = <0>;
};
```

## Documentation/devicetree/bindings/powerpc/fsl/guts.txt
```
* Global Utilities Block

The global utilities block controls power management, I/O device
enabling, power-on-reset configuration monitoring, general-purpose
I/O signal configuration, alternate function selection for multiplexed
signals, and clock control.

Required properties:

 - compatible : Should define the compatible device type for
   global-utilities.
   Possible compatibles:
	"fsl,qoriq-device-config-1.0"
	"fsl,qoriq-device-config-2.0"
	"fsl,<chip>-device-config"
	"fsl,<chip>-guts"
 - reg : Offset and length of the register set for the device.

Recommended properties:

 - fsl,has-rstcr : Indicates that the global utilities register set
   contains a functioning "reset control register" (i.e. the board
   is wired to reset upon setting the HRESET_REQ bit in this register).

 - fsl,liodn-bits : Indicates the number of defined bits in the LIODN
   registers, for those SOCs that have a PAMU device.

Examples:
	global-utilities@e0000 {	/* global utilities block */
		compatible = "fsl,mpc8548-guts";
		reg = <e0000 1000>;
		fsl,has-rstcr;
	};

	guts: global-utilities@e0000 {
		compatible = "fsl,qoriq-device-config-1.0";
		reg = <0xe0000 0xe00>;
		fsl,has-rstcr;
		#sleep-cells = <1>;
		fsl,liodn-bits = <12>;
	};
```
