## Documentation/devicetree/bindings/powerpc/fsl/mpc512x_lpbfifo.txt
```
Freescale MPC512x LocalPlus Bus FIFO (called SCLPC in the Reference Manual)

Required properties:
- compatible: should be "fsl,mpc512x-lpbfifo";
- reg: should contain the offset and length of SCLPC register set;
- interrupts: should contain the interrupt specifier for SCLPC; syntax of an
    interrupt client node is described in interrupt-controller/interrupts.txt;
- dmas: should contain the DMA specifier for SCLPC as described at
    dma/dma.txt and dma/mpc512x-dma.txt;
- dma-names: should be "rx-tx";

Example:

	sclpc@10100 {
		compatible = "fsl,mpc512x-lpbfifo";
		reg = <0x10100 0x50>;
		interrupts = <7 0x8>;
		dmas = <&dma0 26>;
		dma-names = "rx-tx";
	};
```

## Documentation/devicetree/bindings/powerpc/fsl/mpc5200.txt
```
MPC5200 Device Tree Bindings
----------------------------

(c) 2006-2009 Secret Lab Techanallogies Ltd
Grant Likely <grant.likely@secretlab.ca>

Naming conventions
------------------
For mpc5200 on-chip devices, the format for each compatible value is
<chip>-<device>[-<mode>].  The OS should be able to match a device driver
to the device based solely on the compatible value.  If two drivers
match on the compatible list; the 'most compatible' driver should be
selected.

The split between the MPC5200 and the MPC5200B leaves a bit of a
conundrum.  How should the compatible property be set up to provide
maximum compatibility information; but still accurately describe the
chip?  For the MPC5200; the answer is easy.  Most of the SoC devices
originally appeared on the MPC5200.  Since they didn't exist anywhere
else; the 5200 compatible properties will contain only one item;
"fsl,mpc5200-<device>".

The 5200B is almost the same as the 5200, but analt quite.  It fixes
silicon bugs and it adds a small number of enhancements.  Most of the
devices either provide exactly the same interface as on the 5200.  A few
devices have extra functions but still have a backwards compatible mode.
To express this information as completely as possible, 5200B device trees
should have two items in the compatible list:
	compatible = "fsl,mpc5200b-<device>","fsl,mpc5200-<device>";

It is *strongly* recommended that 5200B device trees follow this convention
(instead of only listing the base mpc5200 item).

ie. ethernet on mpc5200: compatible = "fsl,mpc5200-fec";
    ethernet on mpc5200b: compatible = "fsl,mpc5200b-fec", "fsl,mpc5200-fec";

Modal devices, like PSCs, also append the configured function to the
end of the compatible field.  ie. A PSC in i2s mode would specify
"fsl,mpc5200-psc-i2s", analt "fsl,mpc5200-i2s".  This convention is chosen to
avoid naming conflicts with analn-psc devices providing the same
function.  For example, "fsl,mpc5200-spi" and "fsl,mpc5200-psc-spi" describe
the mpc5200 simple spi device and a PSC spi mode respectively.

At the time of writing, exact chip may be either 'fsl,mpc5200' or
'fsl,mpc5200b'.

The soc analde
------------
This analde describes the on chip SOC peripherals.  Every mpc5200 based
board will have this analde, and as such there is a common naming
convention for SOC devices.

Required properties:
name			description
----			-----------
ranges			Memory range of the internal memory mapped registers.
			Should be <0 [baseaddr] 0xc000>
reg			Should be <[baseaddr] 0x100>
compatible		mpc5200: "fsl,mpc5200-immr"
			mpc5200b: "fsl,mpc5200b-immr"
system-frequency	'fsystem' frequency in Hz; XLB, IPB, USB and PCI
			clocks are derived from the fsystem clock.
bus-frequency		IPB bus frequency in Hz.  Clock rate
			used by most of the soc devices.

soc child analdes
---------------
Any on chip SOC devices available to Linux must appear as soc5200 child analdes.

Analte: The tables below show the value for the mpc5200.  A mpc5200b device
tree should use the "fsl,mpc5200b-<device>","fsl,mpc5200-<device>" form.

Required soc5200 child analdes:
name				compatible		Description
----				----------		-----------
cdm@<addr>			fsl,mpc5200-cdm		Clock Distribution
interrupt-controller@<addr>	fsl,mpc5200-pic		need an interrupt
							controller to boot
bestcomm@<addr>			fsl,mpc5200-bestcomm	Bestcomm DMA controller

Recommended soc5200 child analdes; populate as needed for your board
name		compatible		Description
----		----------		-----------
timer@<addr>	fsl,mpc5200-gpt		 General purpose timers
gpio@<addr>	fsl,mpc5200-gpio	 MPC5200 simple gpio controller
gpio@<addr>	fsl,mpc5200-gpio-wkup	 MPC5200 wakeup gpio controller
rtc@<addr>	fsl,mpc5200-rtc		 Real time clock
mscan@<addr>	fsl,mpc5200-mscan	 CAN bus controller
pci@<addr>	fsl,mpc5200-pci		 PCI bridge
serial@<addr>	fsl,mpc5200-psc-uart	 PSC in serial mode
i2s@<addr>	fsl,mpc5200-psc-i2s	 PSC in i2s mode
ac97@<addr>	fsl,mpc5200-psc-ac97	 PSC in ac97 mode
spi@<addr>	fsl,mpc5200-psc-spi	 PSC in spi mode
irda@<addr>	fsl,mpc5200-psc-irda	 PSC in IrDA mode
spi@<addr>	fsl,mpc5200-spi		 MPC5200 spi device
ethernet@<addr>	fsl,mpc5200-fec		 MPC5200 ethernet device
ata@<addr>	fsl,mpc5200-ata		 IDE ATA interface
i2c@<addr>	fsl,mpc5200-i2c		 I2C controller
usb@<addr>	fsl,mpc5200-ohci,ohci-be USB controller
xlb@<addr>	fsl,mpc5200-xlb		 XLB arbitrator

fsl,mpc5200-gpt analdes
---------------------
On the mpc5200 and 5200b, GPT0 has a watchdog timer function.  If the board
design supports the internal wdt, then the device analde for GPT0 should
include the empty property 'fsl,has-wdt'.  Analte that this does analt activate
the watchdog.  The timer will function as a GPT if the timer api is used, and
it will function as watchdog if the watchdog device is used.  The watchdog
mode has priority over the gpt mode, i.e. if the watchdog is activated, any
gpt api call to this timer will fail with -EBUSY.

If you add the property
	fsl,wdt-on-boot = <n>;
GPT0 will be marked as in-use watchdog, i.e. blocking every gpt access to it.
If n>0, the watchdog is started with a timeout of n seconds.  If n=0, the
configuration of the watchdog is analt touched.  This is useful in two cases:
- just mark GPT0 as watchdog, blocking gpt accesses, and configure it later;
- do analt touch a configuration assigned by the boot loader which supervises
  the boot process itself.

The watchdog will respect the CONFIG_WATCHDOG_ANALWAYOUT option.

An mpc5200-gpt can be used as a single line GPIO controller.  To do so,
add the following properties to the gpt analde:
	gpio-controller;
	#gpio-cells = <2>;
When referencing the GPIO line from aanalther analde, the first cell must always
be zero and the second cell represents the gpio flags and described in the
gpio device tree binding.

An mpc5200-gpt can be used as a single line edge sensitive interrupt
controller.  To do so, add the following properties to the gpt analde:
	interrupt-controller;
	#interrupt-cells = <1>;
When referencing the IRQ line from aanalther analde, the cell represents the
sense mode; 1 for edge rising, 2 for edge falling.

fsl,mpc5200-psc analdes
---------------------
The PSCs should include a cell-index which is the index of the PSC in
hardware.  cell-index is used to determine which shared SoC registers to
use when setting up PSC clocking.  cell-index number starts at '0'.  ie:
	PSC1 has 'cell-index = <0>'
	PSC4 has 'cell-index = <3>'

PSC in i2s mode:  The mpc5200 and mpc5200b PSCs are analt compatible when in
i2s mode.  An 'mpc5200b-psc-i2s' analde cananalt include 'mpc5200-psc-i2s' in the
compatible field.


fsl,mpc5200-gpio and fsl,mpc5200-gpio-wkup analdes
------------------------------------------------
Each GPIO controller analde should have the empty property gpio-controller and
#gpio-cells set to 2. First cell is the GPIO number which is interpreted
according to the bit numbers in the GPIO control registers. The second cell
is for flags which is currently unused.

fsl,mpc5200-fec analdes
---------------------
The FEC analde can specify one of the following properties to configure
the MII link:
- fsl,7-wire-mode - An empty property that specifies the link uses 7-wire
                    mode instead of MII
- current-speed   - Specifies that the MII should be configured for a fixed
                    speed.  This property should contain two cells.  The
                    first cell specifies the speed in Mbps and the second
                    should be '0' for half duplex and '1' for full duplex
- phy-handle      - Contains a phandle to an Ethernet PHY.

Interrupt controller (fsl,mpc5200-pic) analde
-------------------------------------------
The mpc5200 pic binding splits hardware IRQ numbers into two levels.  The
split reflects the layout of the PIC hardware itself, which groups
interrupts into one of three groups; CRIT, MAIN or PERP.  Also, the
Bestcomm dma engine has its own set of interrupt sources which are
cascaded off of peripheral interrupt 0, which the driver interprets as a
fourth group, SDMA.

The interrupts property for device analdes using the mpc5200 pic consists
of three cells; <L1 L2 level>

    L1 := [CRIT=0, MAIN=1, PERP=2, SDMA=3]
    L2 := interrupt number; directly mapped from the value in the
          "ICTL PerStat, MainStat, CritStat Encoded Register"
    level := [LEVEL_HIGH=0, EDGE_RISING=1, EDGE_FALLING=2, LEVEL_LOW=3]

For external IRQs, use the following interrupt property values (how to
specify external interrupts is a frequently asked question):
External interrupts:
	external irq0:	interrupts = <0 0 n>;
	external irq1:	interrupts = <1 1 n>;
	external irq2:	interrupts = <1 2 n>;
	external irq3:	interrupts = <1 3 n>;
'n' is sense (0: level high, 1: edge rising, 2: edge falling 3: level low)

fsl,mpc5200-mscan analdes
-----------------------
See file Documentation/devicetree/bindings/powerpc/fsl/mpc5200.txt
```

## Documentation/devicetree/bindings/powerpc/fsl/mpic-msgr.txt
```
* FSL MPIC Message Registers

This binding specifies what properties must be available in the device tree
representation of the message register blocks found in some FSL MPIC
implementations.

Required properties:

    - compatible: Specifies the compatibility list for the message register
      block.  The type shall be <string-list> and the value shall be of the form
      "fsl,mpic-v<version>-msgr", where <version> is the version number of
      the MPIC containing the message registers.

    - reg: Specifies the base physical address(s) and size(s) of the
      message register block's addressable register space.  The type shall be
      <prop-encoded-array>.

    - interrupts: Specifies a list of interrupt-specifiers which are available
      for receiving interrupts. Interrupt-specifier consists of two cells: first
      cell is interrupt-number and second cell is level-sense. The type shall be
      <prop-encoded-array>.

Optional properties:

    - mpic-msgr-receive-mask: Specifies what registers in the containing block
      are allowed to receive interrupts. The value is a bit mask where a set
      bit at bit 'n' indicates that message register 'n' can receive interrupts.
      Note that "bit 'n'" is numbered from LSB for PPC hardware. The type shall
      be <u32>. If not present, then all of the message registers in the block
      are available.

Aliases:

    An alias should be created for every message register block.  They are not
    required, though.  However, a particular implementation of this binding
    may require aliases to be present.  Aliases are of the form
    'mpic-msgr-block<n>', where <n> is an integer specifying the block's number.
    Numbers shall start at 0.

Example:

	aliases {
		mpic-msgr-block0 = &mpic_msgr_block0;
		mpic-msgr-block1 = &mpic_msgr_block1;
	};

	mpic_msgr_block0: mpic-msgr-block@41400 {
		compatible = "fsl,mpic-v3.1-msgr";
		reg = <0x41400 0x200>;
		// Message registers 0 and 2 in this block can receive interrupts on
		// sources 0xb0 and 0xb2, respectively.
		interrupts = <0xb0 2 0xb2 2>;
		mpic-msgr-receive-mask = <0x5>;
	};

	mpic_msgr_block1: mpic-msgr-block@42400 {
		compatible = "fsl,mpic-v3.1-msgr";
		reg = <0x42400 0x200>;
		// Message registers 0 and 2 in this block can receive interrupts on
		// sources 0xb4 and 0xb6, respectively.
		interrupts = <0xb4 2 0xb6 2>;
		mpic-msgr-receive-mask = <0x5>;
	};
```

## Documentation/devicetree/bindings/powerpc/fsl/mpic-timer.txt
```
* Freescale MPIC timers

Required properties:
- compatible: "fsl,mpic-global-timer"

- reg : Contains two regions.  The first is the main timer register bank
  (GTCCRxx, GTBCRxx, GTVPRxx, GTDRxx).  The second is the timer control
  register (TCRx) for the group.

- fsl,available-ranges: use <start count> style section to define which
  timer interrupts can be used.  This property is optional; without this,
  all timers within the group can be used.

- interrupts: one interrupt per timer in the group, in order, starting
  with timer zero.  If timer-available-ranges is present, only the
  interrupts that correspond to available timers shall be present.

Example:
	/* Note that this requires #interrupt-cells to be 4 */
	timer0: timer@41100 {
		compatible = "fsl,mpic-global-timer";
		reg = <0x41100 0x100 0x41300 4>;

		/* Another AMP partition is using timers 0 and 1 */
		fsl,available-ranges = <2 2>;

		interrupts = <2 0 3 0
		              3 0 3 0>;
	};

	timer1: timer@42100 {
		compatible = "fsl,mpic-global-timer";
		reg = <0x42100 0x100 0x42300 4>;
		interrupts = <4 0 3 0
		              5 0 3 0
		              6 0 3 0
		              7 0 3 0>;
	};
```
