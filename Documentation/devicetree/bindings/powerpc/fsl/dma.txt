## Documentation/devicetree/bindings/powerpc/fsl/pmc.txt
```
* Power Management Controller

Properties:
- compatible: "fsl,<chip>-pmc".

  "fsl,mpc8349-pmc" should be listed for any chip whose PMC is
  compatible.  "fsl,mpc8313-pmc" should also be listed for any chip
  whose PMC is compatible, and implies deep-sleep capability.

  "fsl,mpc8548-pmc" should be listed for any chip whose PMC is
  compatible.  "fsl,mpc8536-pmc" should also be listed for any chip
  whose PMC is compatible, and implies deep-sleep capability.

  "fsl,mpc8641d-pmc" should be listed for any chip whose PMC is
  compatible; all statements below that apply to "fsl,mpc8548-pmc" also
  apply to "fsl,mpc8641d-pmc".

  Compatibility does not include bit assignments in SCCR/PMCDR/DEVDISR; these
  bit assignments are indicated via the sleep specifier in each device's
  sleep property.

- reg: For devices compatible with "fsl,mpc8349-pmc", the first resource
  is the PMC block, and the second resource is the Clock Configuration
  block.

  For devices compatible with "fsl,mpc8548-pmc", the first resource
  is a 32-byte block beginning with DEVDISR.

- interrupts: For "fsl,mpc8349-pmc"-compatible devices, the first
  resource is the PMC block interrupt.

- fsl,mpc8313-wakeup-timer: For "fsl,mpc8313-pmc"-compatible devices,
  this is a phandle to an "fsl,gtm" node on which timer 4 can be used as
  a wakeup source from deep sleep.

Sleep specifiers:

  fsl,mpc8349-pmc: Sleep specifiers consist of one cell.  For each bit
  that is set in the cell, the corresponding bit in SCCR will be saved
  and cleared on suspend, and restored on resume.  This sleep controller
  supports disabling and resuming devices at any time.

  fsl,mpc8536-pmc: Sleep specifiers consist of three cells, the third of
  which will be ORed into PMCDR upon suspend, and cleared from PMCDR
  upon resume.  The first two cells are as described for fsl,mpc8578-pmc.
  This sleep controller only supports disabling devices during system
  sleep, or permanently.

  fsl,mpc8548-pmc: Sleep specifiers consist of one or two cells, the
  first of which will be ORed into DEVDISR (and the second into
  DEVDISR2, if present -- this cell should be zero or absent if the
  hardware does not have DEVDISR2) upon a request for permanent device
  disabling.  This sleep controller does not support configuring devices
  to disable during system sleep (unless supported by another compatible
  match), or dynamically.

Example:

	power@b00 {
		compatible = "fsl,mpc8313-pmc", "fsl,mpc8349-pmc";
		reg = <0xb00 0x100 0xa00 0x100>;
		interrupts = <80 8>;
	};
```

## Documentation/devicetree/bindings/powerpc/fsl/pmc.yaml
```yaml
# SPDX-License-Identifier: (GPL-2.0-only OR BSD-2-Clause)
%YAML 1.2
---
$id: http://devicetree.org/schemas/powerpc/fsl/pmc.yaml#
$schema: http://devicetree.org/meta-schemas/core.yaml#

title: Power Management Controller

maintainers:
  - J. Neuschäfer <j.ne@posteo.net>

description: |
  The Power Management Controller in several MPC8xxx SoCs helps save power by
  controlling chip-wide low-power states as well as peripheral clock gating.

  Sleep of peripheral devices is configured by the `sleep` property, for
  example `sleep = <&pmc 0x00000030>`. Any cells after the &pmc phandle are
  called a sleep specifier.

  For "fsl,mpc8349-pmc", sleep specifiers consist of one cell.  For each bit that
  is set in the cell, the corresponding bit in SCCR will be saved and cleared
  on suspend, and restored on resume.  This sleep controller supports disabling
  and resuming devices at any time.

  For "fsl,mpc8536-pmc", sleep specifiers consist of three cells, the third of
  which will be ORed into PMCDR upon suspend, and cleared from PMCDR upon
  resume.  The first two cells are as described for fsl,mpc8548-pmc.  This
  sleep controller only supports disabling devices during system sleep, or
  permanently.

  For "fsl,mpc8548-pmc" or "fsl,mpc8641d-pmc", Sleep specifiers consist of one
  or two cells, the first of which will be ORed into DEVDISR (and the second
  into DEVDISR2, if present -- this cell should be zero or absent if the
  hardware does not have DEVDISR2) upon a request for permanent device
  disabling.  This sleep controller does not support configuring devices to
  disable during system sleep (unless supported by another compatible match),
  or dynamically.

properties:
  compatible:
    oneOf:
      - items:
          - const: fsl,mpc8315-pmc
          - const: fsl,mpc8313-pmc
          - const: fsl,mpc8349-pmc

      - items:
          - enum:
              - fsl,mpc8313-pmc
              - fsl,mpc8323-pmc
              - fsl,mpc8360-pmc
              - fsl,mpc8377-pmc
              - fsl,mpc8378-pmc
              - fsl,mpc8379-pmc
          - const: fsl,mpc8349-pmc

      - items:
          - const: fsl,p1022-pmc
          - const: fsl,mpc8536-pmc
          - const: fsl,mpc8548-pmc

      - items:
          - enum:
              - fsl,mpc8536-pmc
              - fsl,mpc8568-pmc
              - fsl,mpc8569-pmc
          - const: fsl,mpc8548-pmc

      - enum:
          - fsl,mpc8548-pmc
          - fsl,mpc8641d-pmc

    description: |
      "fsl,mpc8349-pmc" should be listed for any chip whose PMC is
      compatible.  "fsl,mpc8313-pmc" should also be listed for any chip
      whose PMC is compatible, and implies deep-sleep capability.

      "fsl,mpc8548-pmc" should be listed for any chip whose PMC is
      compatible.  "fsl,mpc8536-pmc" should also be listed for any chip
      whose PMC is compatible, and implies deep-sleep capability.

      "fsl,mpc8641d-pmc" should be listed for any chip whose PMC is
      compatible; all statements below that apply to "fsl,mpc8548-pmc" also
      apply to "fsl,mpc8641d-pmc".

      Compatibility does not include bit assignments in SCCR/PMCDR/DEVDISR; these
      bit assignments are indicated via the sleep specifier in each device's
      sleep property.

  reg:
    minItems: 1
    maxItems: 2

  interrupts:
    maxItems: 1

  fsl,mpc8313-wakeup-timer:
    $ref: /schemas/types.yaml#/definitions/phandle
    description:
      For "fsl,mpc8313-pmc"-compatible devices, this is a phandle to an
      "fsl,gtm" node on which timer 4 can be used as a wakeup source from deep
      sleep.

allOf:
  - if:
      properties:
        compatible:
          contains:
            const: fsl,mpc8349-pmc
    then:
      properties:
        reg:
          items:
            - description: PMC block
            - description: Clock Configuration block

  - if:
      properties:
        compatible:
          contains:
            enum:
              - fsl,mpc8548-pmc
              - fsl,mpc8641d-pmc
    then:
      properties:
        reg:
          items:
            - description: 32-byte block beginning with DEVDISR

required:
  - compatible
  - reg

additionalProperties: false

examples:
  - |
    #include <dt-bindings/interrupt-controller/irq.h>

    pmc: power@b00 {
        compatible = "fsl,mpc8377-pmc", "fsl,mpc8349-pmc";
        reg = <0xb00 0x100>, <0xa00 0x100>;
        interrupts = <80 IRQ_TYPE_LEVEL_LOW>;
    };

  - |
    power@e0070 {
        compatible = "fsl,mpc8548-pmc";
        reg = <0xe0070 0x20>;
    };

...
```

## Documentation/devicetree/bindings/powerpc/fsl/raideng.txt
```
* Freescale 85xx RAID Engine nodes

RAID Engine nodes are defined to describe on-chip RAID accelerators.  Each RAID
Engine should have a separate node.

Supported chips:
P5020, P5040

Required properties:

- compatible:	Should contain "fsl,raideng-v1.0" as the value
		This identifies RAID Engine block. 1 in 1.0 represents
		major number whereas 0 represents minor number. The
		version matches the hardware IP version.
- reg:		offset and length of the register set for the device
- ranges:	standard ranges property specifying the translation
		between child address space and parent address space

Example:
	/* P5020 */
	raideng: raideng@320000 {
		compatible = "fsl,raideng-v1.0";
		#address-cells = <1>;
		#size-cells = <1>;
		reg	= <0x320000 0x10000>;
		ranges	= <0 0x320000 0x10000>;
	};


There must be a sub-node for each job queue present in RAID Engine
This node must be a sub-node of the main RAID Engine node

- compatible:	Should contain "fsl,raideng-v1.0-job-queue" as the value
		This identifies the job queue interface
- reg:		offset and length of the register set for job queue
- ranges:	standard ranges property specifying the translation
		between child address space and parent address space

Example:
	/* P5020 */
	raideng_jq0@1000 {
		compatible = "fsl,raideng-v1.0-job-queue";
		reg	   = <0x1000 0x1000>;
		ranges	   = <0x0 0x1000 0x1000>;
	};


There must be a sub-node for each job ring present in RAID Engine
This node must be a sub-node of job queue node

- compatible:	Must contain "fsl,raideng-v1.0-job-ring" as the value
		This identifies job ring. Should contain either
		"fsl,raideng-v1.0-hp-ring" or "fsl,raideng-v1.0-lp-ring"
		depending upon whether ring has high or low priority
- reg:		offset and length of the register set for job ring
- interrupts:	interrupt mapping for job ring IRQ

Optional property:

- fsl,liodn:	Specifies the LIODN to be used for Job Ring. This
		property is normally set by firmware. Value
		is of 12-bits which is the LIODN number for this JR.
		This property is used by the IOMMU (PAMU) to distinquish
		transactions from this JR and than be able to do address
		translation & protection accordingly.

Example:
	/* P5020 */
	raideng_jq0@1000 {
		compatible = "fsl,raideng-v1.0-job-queue";
		reg	   = <0x1000 0x1000>;
		ranges	   = <0x0 0x1000 0x1000>;

		raideng_jr0: jr@0 {
			compatible = "fsl,raideng-v1.0-job-ring", "fsl,raideng-v1.0-hp-ring";
			reg	   = <0x0 0x400>;
			interrupts = <139 2 0 0>;
			interrupt-parent = <&mpic>;
			fsl,liodn = <0x41>;
		};
	};
```

## Documentation/devicetree/bindings/powerpc/fsl/scfg.txt
```
Freescale Supplement configuration unit (SCFG)

SCFG is the supplemental configuration unit, that provides SoC specific
configuration and status registers for the chip. Such as getting PEX port
status.

Required properties:

- compatible: should be "fsl,<chip>-scfg"
- reg: should contain base address and length of SCFG memory-mapped
registers

Example:

	scfg: global-utilities@fc000 {
		compatible = "fsl,t1040-scfg";
		reg = <0xfc000 0x1000>;
	};
```

## Documentation/devicetree/bindings/powerpc/fsl/sec.txt
```
Freescale SoC SEC Security Engines

Required properties:

- compatible : Should contain entries for this and backward compatible
  SEC versions, high to low, e.g., "fsl,sec2.1", "fsl,sec2.0"
- reg : Offset and length of the register set for the device
- interrupts : the SEC's interrupt number
- fsl,num-channels : An integer representing the number of channels
  available.
- fsl,channel-fifo-len : An integer representing the number of
  descriptor pointers each channel fetch fifo can hold.
- fsl,exec-units-mask : The bitmask representing what execution units
  (EUs) are available. It's a single 32-bit cell. EU information
  should be encoded following the SEC's Descriptor Header Dword
  EU_SEL0 field documentation, i.e. as follows:

	bit 0  = reserved - should be 0
	bit 1  = set if SEC has the ARC4 EU (AFEU)
	bit 2  = set if SEC has the DES/3DES EU (DEU)
	bit 3  = set if SEC has the message digest EU (MDEU/MDEU-A)
	bit 4  = set if SEC has the random number generator EU (RNG)
	bit 5  = set if SEC has the public key EU (PKEU)
	bit 6  = set if SEC has the AES EU (AESU)
	bit 7  = set if SEC has the Kasumi EU (KEU)
	bit 8  = set if SEC has the CRC EU (CRCU)
	bit 11 = set if SEC has the message digest EU extended alg set (MDEU-B)

remaining bits are reserved for future SEC EUs.

- fsl,descriptor-types-mask : The bitmask representing what descriptors
  are available. It's a single 32-bit cell. Descriptor type information
  should be encoded following the SEC's Descriptor Header Dword DESC_TYPE
  field documentation, i.e. as follows:

	bit 0  = set if SEC supports the aesu_ctr_nonsnoop desc. type
	bit 1  = set if SEC supports the ipsec_esp descriptor type
	bit 2  = set if SEC supports the common_nonsnoop desc. type
	bit 3  = set if SEC supports the 802.11i AES ccmp desc. type
	bit 4  = set if SEC supports the hmac_snoop_no_afeu desc. type
	bit 5  = set if SEC supports the srtp descriptor type
	bit 6  = set if SEC supports the non_hmac_snoop_no_afeu desc.type
	bit 7  = set if SEC supports the pkeu_assemble descriptor type
	bit 8  = set if SEC supports the aesu_key_expand_output desc.type
	bit 9  = set if SEC supports the pkeu_ptmul descriptor type
	bit 10 = set if SEC supports the common_nonsnoop_afeu desc. type
	bit 11 = set if SEC supports the pkeu_ptadd_dbl descriptor type

  ..and so on and so forth.

Optional properties:

- interrupt-parent : the phandle for the interrupt controller that
  services interrupts for this device.

Example:

	/* MPC8548E */
	crypto@30000 {
		compatible = "fsl,sec2.1", "fsl,sec2.0";
		reg = <0x30000 0x10000>;
		interrupts = <29 2>;
		interrupt-parent = <&mpic>;
		fsl,num-channels = <4>;
		fsl,channel-fifo-len = <24>;
		fsl,exec-units-mask = <0xfe>;
		fsl,descriptor-types-mask = <0x12b0ebf>;
	};
```
