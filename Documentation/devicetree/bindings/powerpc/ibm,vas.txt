## Documentation/devicetree/bindings/ptp/ptp-qoriq.txt
```
* Freescale QorIQ 1588 timer based PTP clock

General Properties:

  - compatible   Should be "fsl,etsec-ptp" for eTSEC
                 Should be "fsl,fman-ptp-timer" for DPAA FMan
  - reg          Offset and length of the register set for the device
  - interrupts   There should be at least two interrupts. Some devices
                 have as many as four PTP related interrupts.

Clock Properties:

  - fsl,cksel        Timer reference clock source.
  - fsl,tclk-period  Timer reference clock period in nanoseconds.
  - fsl,tmr-prsc     Prescaler, divides the output clock.
  - fsl,tmr-add      Frequency compensation value.
  - fsl,tmr-fiper1   Fixed interval period pulse generator.
  - fsl,tmr-fiper2   Fixed interval period pulse generator.
  - fsl,max-adj      Maximum frequency adjustment in parts per billion.

  These properties set the operational parameters for the PTP
  clock. You must choose these carefully for the clock to work right.
  Here is how to figure good values:

  TimerOsc     = selected reference clock   MHz
  tclk_period  = desired clock period       nanoseconds
  NominalFreq  = 1000 / tclk_period         MHz
  FreqDivRatio = TimerOsc / NominalFreq     (must be greater that 1.0)
  tmr_add      = ceil(2^32 / FreqDivRatio)
  OutputClock  = NominalFreq / tmr_prsc     MHz
  PulseWidth   = 1 / OutputClock            microseconds
  FiperFreq1   = desired frequency in Hz
  FiperDiv1    = 1000000 * OutputClock / FiperFreq1
  tmr_fiper1   = tmr_prsc * tclk_period * FiperDiv1 - tclk_period
  max_adj      = 1000000000 * (FreqDivRatio - 1.0) - 1

  The calculation for tmr_fiper2 is the same as for tmr_fiper1. The
  driver expects that tmr_fiper1 will be correctly set to produce a 1
  Pulse Per Second (PPS) signal, since this will be offered to the PPS
  subsystem to synchronize the Linux clock.

  Reference clock source is determined by the value, which is holded
  in CKSEL bits in TMR_CTRL register. "fsl,cksel" property keeps the
  value, which will be directly written in those bits, that is why,
  according to reference manual, the next clock sources can be used:

  For eTSEC,
  <0> - external high precision timer reference clock (TSEC_TMR_CLK
        input is used for this purpose);
  <1> - eTSEC system clock;
  <2> - eTSEC1 transmit clock;
  <3> - RTC clock input.

  For DPAA FMan,
  <0> - external high precision timer reference clock (TMR_1588_CLK)
  <1> - MAC system clock (1/2 FMan clock)
  <2> - reserved
  <3> - RTC clock oscillator

  When this attribute is not used, the IEEE 1588 timer reference clock
  will use the eTSEC system clock (for Gianfar) or the MAC system
  clock (for DPAA).

Example:

	ptp_clock@24e00 {
		compatible = "fsl,etsec-ptp";
		reg = <0x24E00 0xB0>;
		interrupts = <12 0x8 13 0x8>;
		interrupt-parent = < &ipic >;
		fsl,cksel       = <1>;
		fsl,tclk-period = <10>;
		fsl,tmr-prsc    = <100>;
		fsl,tmr-add     = <0x999999A4>;
		fsl,tmr-fiper1  = <0x3B9AC9F6>;
		fsl,tmr-fiper2  = <0x00018696>;
		fsl,max-adj     = <659999998>;
	};
```

## Documentation/devicetree/bindings/ptp/timestamper.txt
```
Time stamps from MII bus sanaloping devices

This binding supports analn-PHY devices that sanalop the MII bus and
provide time stamps.  In contrast to PHY time stamping drivers (which
can simply attach their interface directly to the PHY instance), stand
alone MII time stamping drivers use this binding to specify the
connection between the sanaloping device and a given network interface.

Analn-PHY MII time stamping drivers typically talk to the control
interface over aanalther bus like I2C, SPI, UART, or via a memory mapped
peripheral.  This controller device is associated with one or more
time stamping channels, each of which sanalops on a MII bus.

The "timestamper" property lives in a phy analde and links a time
stamping channel from the controller device to that phy's MII bus.

Example:

	tstamper: timestamper@10000000 {
		compatible = "ines,ptp-ctrl";
		reg = <0x10000000 0x80>;
	};

	ethernet@20000000 {
		mdio {
			ethernet-phy@1 {
				timestamper = <&tstamper 0>;
			};
		};
	};

	ethernet@30000000 {
		mdio {
			ethernet-phy@2 {
				timestamper = <&tstamper 1>;
			};
		};
	};

In this example, time stamps from the MII bus attached to phy@1 will
appear on time stamp channel 0 (zero), and those from phy@2 appear on
channel 1.
```

## Documentation/devicetree/bindings/pwm/adi,axi-pwmgen.yaml
```yaml
# SPDX-License-Identifier: GPL-2.0-only OR BSD-2-Clause
%YAML 1.2
---
$id: http://devicetree.org/schemas/pwm/adi,axi-pwmgen.yaml#
$schema: http://devicetree.org/meta-schemas/core.yaml#

title: Analog Devices AXI PWM generator

maintainers:
  - Michael Hennerich <Michael.Hennerich@analog.com>
  - Nuno Sá <nuno.sa@analog.com>

description:
  The Analog Devices AXI PWM generator can generate PWM signals
  with variable pulse width and period.

  https://analogdevicesinc.github.io/hdl/library/axi_pwm_gen/index.html

allOf:
  - $ref: pwm.yaml#

properties:
  compatible:
    const: adi,axi-pwmgen-2.00.a

  reg:
    maxItems: 1

  "#pwm-cells":
    const: 3

  clocks:
    minItems: 1
    maxItems: 2

  clock-names:
    minItems: 1
    items:
      - const: axi
      - const: ext

required:
  - reg
  - clocks
  - clock-names

unevaluatedProperties: false

examples:
  - |
    pwm@44b00000 {
        compatible = "adi,axi-pwmgen-2.00.a";
        reg = <0x44b00000 0x1000>;
        clocks = <&fpga_clk>, <&spi_clk>;
        clock-names = "axi", "ext";
        #pwm-cells = <3>;
    };
```

## Documentation/devicetree/bindings/pwm/airoha,en7581-pwm.yaml
```yaml
# SPDX-License-Identifier: (GPL-2.0-only OR BSD-2-Clause)
%YAML 1.2
---
$id: http://devicetree.org/schemas/pwm/airoha,en7581-pwm.yaml#
$schema: http://devicetree.org/meta-schemas/core.yaml#

title: Airoha EN7581 PWM Controller

maintainers:
  - Lorenzo Bianconi <lorenzo@kernel.org>

allOf:
  - $ref: pwm.yaml#

properties:
  compatible:
    const: airoha,en7581-pwm

  "#pwm-cells":
    const: 3

required:
  - compatible
  - "#pwm-cells"

additionalProperties: false

examples:
  - |
    pwm {
      compatible = "airoha,en7581-pwm";

      #pwm-cells = <3>;
    };
```

## Documentation/devicetree/bindings/pwm/allwinner,sun4i-a10-pwm.yaml
```yaml
# SPDX-License-Identifier: GPL-2.0
%YAML 1.2
---
$id: http://devicetree.org/schemas/pwm/allwinner,sun4i-a10-pwm.yaml#
$schema: http://devicetree.org/meta-schemas/core.yaml#

title: Allwinner A10 PWM Device Tree Bindings

maintainers:
  - Chen-Yu Tsai <wens@csie.org>
  - Maxime Ripard <mripard@kernel.org>

properties:
  "#pwm-cells":
    const: 3

  compatible:
    oneOf:
      - const: allwinner,sun4i-a10-pwm
      - const: allwinner,sun5i-a10s-pwm
      - const: allwinner,sun5i-a13-pwm
      - const: allwinner,sun7i-a20-pwm
      - const: allwinner,sun8i-h3-pwm
      - items:
          - const: allwinner,sun8i-a83t-pwm
          - const: allwinner,sun8i-h3-pwm
      - items:
          - const: allwinner,sun8i-v3s-pwm
          - const: allwinner,sun7i-a20-pwm
      - items:
          - const: allwinner,sun50i-a64-pwm
          - const: allwinner,sun5i-a13-pwm
      - items:
          - const: allwinner,sun50i-h5-pwm
          - const: allwinner,sun5i-a13-pwm
      - const: allwinner,sun50i-h6-pwm

  reg:
    maxItems: 1

  clocks:
    minItems: 1
    items:
      - description: Module Clock
      - description: Bus Clock

  # Even though it only applies to subschemas under the conditionals,
  # not listing them here will trigger a warning because of the
  # additionalsProperties set to false.
  clock-names: true

  resets:
    maxItems: 1

if:
  properties:
    compatible:
      contains:
        const: allwinner,sun50i-h6-pwm

then:
  properties:
    clocks:
      maxItems: 2

    clock-names:
      items:
        - const: mod
        - const: bus

  required:
    - clock-names
    - resets

else:
  properties:
    clocks:
      maxItems: 1

required:
  - "#pwm-cells"
  - compatible
  - reg
  - clocks

additionalProperties: false

examples:
  - |
    pwm: pwm@1c20e00 {
        compatible = "allwinner,sun7i-a20-pwm";
        reg = <0x01c20e00 0xc>;
        clocks = <&osc24M>;
        #pwm-cells = <3>;
    };

  - |
    #include <dt-bindings/clock/sun50i-h6-ccu.h>
    #include <dt-bindings/reset/sun50i-h6-ccu.h>

    pwm@300a000 {
      compatible = "allwinner,sun50i-h6-pwm";
      reg = <0x0300a000 0x400>;
      clocks = <&osc24M>, <&ccu CLK_BUS_PWM>;
      clock-names = "mod", "bus";
      resets = <&ccu RST_BUS_PWM>;
      #pwm-cells = <3>;
    };

...
```

## Documentation/devicetree/bindings/pwm/apple,s5l-fpwm.yaml
```yaml
# SPDX-License-Identifier: GPL-2.0-only OR BSD-2-Clause
%YAML 1.2
---
$id: http://devicetree.org/schemas/pwm/apple,s5l-fpwm.yaml#
$schema: http://devicetree.org/meta-schemas/core.yaml#

title: Apple FPWM controller

maintainers:
  - asahi@lists.linux.dev
  - Sasha Finkelstein <fnkl.kernel@gmail.com>

description: PWM controller used for keyboard backlight on ARM Macs

properties:
  compatible:
    items:
      - enum:
          - apple,t8103-fpwm
          - apple,t8112-fpwm
          - apple,t6000-fpwm
          - apple,t6020-fpwm
      - const: apple,s5l-fpwm

  reg:
    maxItems: 1

  clocks:
    maxItems: 1

  power-domains:
    maxItems: 1

  "#pwm-cells":
    const: 2

required:
  - compatible
  - reg
  - clocks

additionalProperties: false

examples:
  - |
    pwm@235044000 {
      compatible = "apple,t8103-fpwm", "apple,s5l-fpwm";
      reg = <0x35044000 0x4000>;
      power-domains = <&ps_fpwm1>;
      clocks = <&clkref>;
      #pwm-cells = <2>;
    };
```

## Documentation/devicetree/bindings/pwm/argon40,fan-hat.yaml
```yaml
# SPDX-License-Identifier: (GPL-2.0 OR BSD-2-Clause)
%YAML 1.2
---
$id: http://devicetree.org/schemas/pwm/argon40,fan-hat.yaml#
$schema: http://devicetree.org/meta-schemas/core.yaml#

title: Argon40 Fan HAT PWM controller

maintainers:
  - Marek Vasut <marek.vasut+renesas@mailbox.org>

description:
  The trivial PWM on Argon40 Fan HAT, which is a RaspberryPi blower fan
  hat which can be controlled over I2C, generates a fixed 30 kHz period
  PWM signal with configurable 0..100% duty cycle to control the fan
  speed.

allOf:
  - $ref: pwm.yaml#

properties:
  compatible:
    const: argon40,fan-hat

  reg:
    maxItems: 1

  "#pwm-cells":
    const: 3

required:
  - compatible
  - reg

additionalProperties: false

examples:
  - |
    i2c {
      #address-cells = <1>;
      #size-cells = <0>;

      pwm@1a {
        compatible = "argon40,fan-hat";
        reg = <0x1a>;
        #pwm-cells = <3>;
      };
    };
```

## Documentation/devicetree/bindings/pwm/aspeed,ast2600-pwm.yaml
```yaml
# SPDX-License-Identifier: (GPL-2.0-only OR BSD-2-Clause)
# Copyright (C) 2021 Aspeed, Inc.
%YAML 1.2
---
$id: http://devicetree.org/schemas/pwm/aspeed,ast2600-pwm.yaml#
$schema: http://devicetree.org/meta-schemas/core.yaml#

title: Aspeed Ast2600 PWM controller

maintainers:
  - Billy Tsai <billy_tsai@aspeedtech.com>

description: |
  The Aspeed PWM controller can support upto 16 PWM outputs.
  This module is part of the ast2600-pwm-tach multi-function device. For more
  details see ../mfd/aspeed,ast2600-pwm-tach.yaml.

properties:
  compatible:
    enum:
      - aspeed,ast2600-pwm

  "#pwm-cells":
    const: 3

  "#address-cells":
    const: 1

  "#size-cells":
    const: 0

  pinctrl-0: true

  pinctrl-names:
    const: default

required:
  - compatible
  - "#pwm-cells"
  - "#address-cells"
  - "#size-cells"

additionalProperties:
  description: Set extend properties for each pwm channel.
  type: object
  properties:
    reg:
      description:
        The pwm channel index.
      maxItems: 1

    aspeed,wdt-reload-enable:
      type: boolean
      description:
        Enable the function of wdt reset reload duty point.

    aspeed,wdt-reload-duty-point:
      description:
        Define the duty point after wdt reset, 0 = 100%
      minimum: 0
      maximum: 255

  required:
    - reg
```
