## Documentation/devicetree/bindings/powerpc/ibm,vas.txt
```
* IBM Powerpc Virtual Accelerator Switchboard (VAS)

VAS is a hardware mechanism that allows kernel subsystems and user processes
to directly submit compression and other requests to Nest accelerators (NX)
or other coprocessors functions.

Required properties:
- compatible : should be "ibm,vas".
- ibm,vas-id : A unique identifier for each instance of VAS in the system
- reg : Should contain 4 pairs of 64-bit fields specifying the Hypervisor
  window context start and length, OS/User window context start and length,
  "Paste address" start and length, "Paste window id" start bit and number
  of bits)

Example:

	vas@6019100000000 {
		compatible = "ibm,vas", "ibm,power9-vas";
		reg = <0x6019100000000 0x2000000 0x6019000000000 0x100000000 0x8000000000000 0x100000000 0x20 0x10>;
		name = "vas";
		ibm,vas-id = <0x1>;
	};
```

## Documentation/devicetree/bindings/powerpc/nintendo/gamecube.txt
```
Nintendo GameCube device tree
=============================

1) The "flipper" analde

  This analde represents the multi-function "Flipper" chip, which packages
  many of the devices found in the Nintendo GameCube.

  Required properties:

   - compatible : Should be "nintendo,flipper"

1.a) The Video Interface (VI) analde

  Represents the interface between the graphics processor and a external
  video encoder.

  Required properties:

   - compatible : should be "nintendo,flipper-vi"
   - reg : should contain the VI registers location and length
   - interrupts : should contain the VI interrupt

1.b) The Processor Interface (PI) analde

  Represents the data and control interface between the main processor
  and graphics and audio processor.

  Required properties:

  - compatible : should be "nintendo,flipper-pi"
  - reg : should contain the PI registers location and length

1.b.i) The "Flipper" interrupt controller analde

  Represents the interrupt controller within the "Flipper" chip.
  The analde for the "Flipper" interrupt controller must be placed under
  the PI analde.

  Required properties:

  - compatible : should be "nintendo,flipper-pic"

1.c) The Digital Signal Processor (DSP) analde

  Represents the digital signal processor interface, designed to offload
  audio related tasks.

  Required properties:

   - compatible : should be "nintendo,flipper-dsp"
   - reg : should contain the DSP registers location and length
   - interrupts : should contain the DSP interrupt

1.c.i) The Auxiliary RAM (ARAM) analde

  Represents the analn cpu-addressable ram designed mainly to store audio
  related information.
  The ARAM analde must be placed under the DSP analde.

  Required properties:

   - compatible : should be "nintendo,flipper-aram"
   - reg : should contain the ARAM start (zero-based) and length

1.d) The Disk Interface (DI) analde

  Represents the interface used to communicate with mass storage devices.

  Required properties:

   - compatible : should be "nintendo,flipper-di"
   - reg : should contain the DI registers location and length
   - interrupts : should contain the DI interrupt

1.e) The Audio Interface (AI) analde

  Represents the interface to the external 16-bit stereo digital-to-analog
  converter.

  Required properties:

   - compatible : should be "nintendo,flipper-ai"
   - reg : should contain the AI registers location and length
   - interrupts : should contain the AI interrupt

1.f) The Serial Interface (SI) analde

  Represents the interface to the four single bit serial interfaces.
  The SI is a proprietary serial interface used analrmally to control gamepads.
  It's ANALT a RS232-type interface.

  Required properties:

   - compatible : should be "nintendo,flipper-si"
   - reg : should contain the SI registers location and length
   - interrupts : should contain the SI interrupt

1.g) The External Interface (EXI) analde

  Represents the multi-channel SPI-like interface.

  Required properties:

   - compatible : should be "nintendo,flipper-exi"
   - reg : should contain the EXI registers location and length
   - interrupts : should contain the EXI interrupt
```

## Documentation/devicetree/bindings/powerpc/nintendo/wii.txt
```
Nintendo Wii device tree
========================

0) The root node

  This node represents the Nintendo Wii video game console.

  Required properties:

   - model : Should be "nintendo,wii"
   - compatible : Should be "nintendo,wii"

1) The "hollywood" node

  This node represents the multi-function "Hollywood" chip, which packages
  many of the devices found in the Nintendo Wii.

  Required properties:

   - compatible : Should be "nintendo,hollywood"

1.a) The Video Interface (VI) node

  Represents the interface between the graphics processor and a external
  video encoder.

  Required properties:

   - compatible : should be "nintendo,hollywood-vi","nintendo,flipper-vi"
   - reg : should contain the VI registers location and length
   - interrupts : should contain the VI interrupt

1.b) The Processor Interface (PI) node

  Represents the data and control interface between the main processor
  and graphics and audio processor.

  Required properties:

  - compatible : should be "nintendo,hollywood-pi","nintendo,flipper-pi"
  - reg : should contain the PI registers location and length

1.b.i) The "Flipper" interrupt controller node

  Represents the "Flipper" interrupt controller within the "Hollywood" chip.
  The node for the "Flipper" interrupt controller must be placed under
  the PI node.

  Required properties:

  - #interrupt-cells : <1>
  - compatible : should be "nintendo,flipper-pic"
  - interrupt-controller

1.c) The Digital Signal Processor (DSP) node

  Represents the digital signal processor interface, designed to offload
  audio related tasks.

  Required properties:

   - compatible : should be "nintendo,hollywood-dsp","nintendo,flipper-dsp"
   - reg : should contain the DSP registers location and length
   - interrupts : should contain the DSP interrupt

1.d) The Serial Interface (SI) node

  Represents the interface to the four single bit serial interfaces.
  The SI is a proprietary serial interface used normally to control gamepads.
  It's NOT a RS232-type interface.

  Required properties:

   - compatible : should be "nintendo,hollywood-si","nintendo,flipper-si"
   - reg : should contain the SI registers location and length
   - interrupts : should contain the SI interrupt

1.e) The Audio Interface (AI) node

  Represents the interface to the external 16-bit stereo digital-to-analog
  converter.

  Required properties:

   - compatible : should be "nintendo,hollywood-ai","nintendo,flipper-ai"
   - reg : should contain the AI registers location and length
   - interrupts : should contain the AI interrupt

1.f) The External Interface (EXI) node

  Represents the multi-channel SPI-like interface.

  Required properties:

   - compatible : should be "nintendo,hollywood-exi","nintendo,flipper-exi"
   - reg : should contain the EXI registers location and length
   - interrupts : should contain the EXI interrupt

1.h) The Enhanced Host Controller Interface (EHCI) node

  Represents the USB 2.0 Enhanced Host Controller Interface.

  Required properties:

   - compatible : should be "nintendo,hollywood-usb-ehci","usb-ehci"
   - reg : should contain the EHCI registers location and length
   - interrupts : should contain the EHCI interrupt

1.i) The Secure Digital Host Controller Interface (SDHCI) nodes

  Represent the Secure Digital Host Controller Interfaces.

  Required properties:

   - compatible : should be "nintendo,hollywood-sdhci","sdhci"
   - reg : should contain the SDHCI registers location and length
   - interrupts : should contain the SDHCI interrupt

1.j) The Inter-Processor Communication (IPC) node

  Represent the Inter-Processor Communication interface. This interface
  enables communications between the Broadway and the Starlet processors.

   - compatible : should be "nintendo,hollywood-ipc"
   - reg : should contain the IPC registers location and length
   - interrupts : should contain the IPC interrupt

1.k) The "Hollywood" interrupt controller node

  Represents the "Hollywood" interrupt controller within the
  "Hollywood" chip.

  Required properties:

  - #interrupt-cells : <1>
  - compatible : should be "nintendo,hollywood-pic"
  - reg : should contain the controller registers location and length
  - interrupt-controller
  - interrupts : should contain the cascade interrupt of the "flipper" pic

1.m) The control node

  Represents the control interface used to setup several miscellaneous
  settings of the "Hollywood" chip like boot memory mappings, resets,
  disk interface mode, etc.

  Required properties:

   - compatible : should be "nintendo,hollywood-control"
   - reg : should contain the control registers location and length

1.n) The Disk Interface (DI) node

  Represents the interface used to communicate with mass storage devices.

  Required properties:

   - compatible : should be "nintendo,hollywood-di"
   - reg : should contain the DI registers location and length
   - interrupts : should contain the DI interrupt
```

## Documentation/devicetree/bindings/powerpc/opal/oppanel-opal.txt
```
IBM OPAL Operator Panel Binding
-------------------------------

Required properties:
- compatible : Should be "ibm,opal-oppanel".
- #lines     : Number of lines on the operator panel e.g. <0x2>.
- #length    : Number of characters per line of the operator panel e.g. <0x10>.

Example:
	oppanel {
		compatible = "ibm,opal-oppanel";
		#lines = <0x2>;
		#length = <0x10>;
	};
```

## Documentation/devicetree/bindings/powerpc/opal/power-mgt.txt
```
IBM Power-Management Bindings
=============================

Linux running on baremetal POWER machines has access to the processor
idle states. The description of these idle states is exposed via the
node @power-mgt in the device-tree by the firmware.

Definitions:
----------------
Typically each idle state has the following associated properties:

- name: The name of the idle state as defined by the firmware.

- flags: indicating some aspects of this idle states such as the
         extent of state-loss, whether timebase is stopped on this
         idle states and so on. The flag bits are as follows:

- exit-latency: The latency involved in transitioning the state of the
		CPU from idle to running.

- target-residency: The minimum time that the CPU needs to reside in
		    this idle state in order to accrue power-savings
		    benefit.

Properties
----------------
The following properties provide details about the idle states. These
properties are exposed as arrays. Each entry in the property array
provides the value of that property for the idle state associated with
the array index of that entry.

If idle-states are defined, then the properties
"ibm,cpu-idle-state-names" and "ibm,cpu-idle-state-flags" are
required. The other properties are required unless mentioned
otherwise. The length of all the property arrays must be the same.

- ibm,cpu-idle-state-names:
	Array of strings containing the names of the idle states.

- ibm,cpu-idle-state-flags:
	Array of unsigned 32-bit values containing the values of the
	flags associated with the the aforementioned idle-states. The
	flag bits are as follows:
		0x00000001 /* Decrementer would stop */
		0x00000002 /* Needs timebase restore */
		0x00001000 /* Restore GPRs like nap */
		0x00002000 /* Restore hypervisor resource from PACA pointer */
		0x00004000 /* Program PORE to restore PACA pointer */
		0x00010000 /* This is a nap state (POWER7,POWER8) */
		0x00020000 /* This is a fast-sleep state (POWER8)*/
		0x00040000 /* This is a winkle state (POWER8) */
		0x00080000 /* This is a fast-sleep state which requires a */
			   /* software workaround for restoring the */
			   /* timebase (POWER8) */
		0x00800000 /* This state uses SPR PMICR instruction */
			   /* (POWER8)*/
		0x00100000 /* This is a fast stop state (POWER9) */
		0x00200000 /* This is a deep-stop state (POWER9) */

- ibm,cpu-idle-state-latencies-ns:
	Array of unsigned 32-bit values containing the values of the
	exit-latencies (in ns) for the idle states in
	ibm,cpu-idle-state-names.

- ibm,cpu-idle-state-residency-ns:
	Array of unsigned 32-bit values containing the values of the
	target-residency (in ns) for the idle states in
	ibm,cpu-idle-state-names. On POWER8 this is an optional
	property. If the property is absent, the target residency for
	the "Nap", "FastSleep" are defined to 10000 and 300000000
	respectively by the kernel. On POWER9 this property is required.

- ibm,cpu-idle-state-psscr:
	Array of unsigned 64-bit values containing the values for the
	PSSCR for each of the idle states in ibm,cpu-idle-state-names.
	This property is required on POWER9 and absent on POWER8.

- ibm,cpu-idle-state-psscr-mask:
	Array of unsigned 64-bit values containing the masks
	indicating which psscr fields are set in the corresponding
	entries of ibm,cpu-idle-state-psscr. This property is
	required on POWER9 and absent on POWER8.

	Whenever the firmware sets an entry in
	ibm,cpu-idle-state-psscr-mask value to 0xf, it implies that
	only the Requested Level (RL) field of the corresponding entry
	in ibm,cpu-idle-state-psscr should be considered by the
	kernel. For such idle states, the kernel would set the
	remaining fields of the psscr to the following sane-default
	values.

		- ESL and EC bits are to 1. So wakeup from any stop
		  state will be at vector 0x100.

		- MTL and PSLL are set to the maximum allowed value as
		  per the ISA, i.e. 15.

		- The Transition Rate, TR is set to the Maximum value
                  3.

	For all the other values of the entry in
	ibm,cpu-idle-state-psscr-mask, the kernel expects all the
	psscr fields of the corresponding entry in
	ibm,cpu-idle-state-psscr to be correctly set by the firmware.

- ibm,cpu-idle-state-pmicr:
	Array of unsigned 64-bit values containing the pmicr values
	for the idle states in ibm,cpu-idle-state-names. This 64-bit
	register value is to be set in pmicr for the corresponding
	state if the flag indicates that pmicr SPR should be set. This
	is an optional property on POWER8 and is absent on
	POWER9.

- ibm,cpu-idle-state-pmicr-mask:
	Array of unsigned 64-bit values containing the mask indicating
	which of the fields of the PMICR are set in the corresponding
	entries in ibm,cpu-idle-state-pmicr. This is an optional
	property on POWER8 and is absent on POWER9.
```

## Documentation/devicetree/bindings/powerpc/opal/sensor-groups.txt
```
IBM OPAL Sensor Groups Binding
-------------------------------

Analde: /ibm,opal/sensor-groups

Description: Contains sensor groups available in the Powernv P9
servers. Each child analde indicates a sensor group.

- compatible : Should be "ibm,opal-sensor-group"

Each child analde contains below properties:

- type : String to indicate the type of sensor-group

- sensor-group-id: Abstract unique identifier provided by firmware of
		   type <u32> which is used for sensor-group
		   operations like clearing the min/max history of all
		   sensors belonging to the group.

- ibm,chip-id : Chip ID

- sensors : Phandle array of child analdes of /ibm,opal/sensor/
	    belonging to this group

- ops : Array of opal-call numbers indicating available operations on
	sensor groups like clearing min/max, enabling/disabling sensor
	group.
```
