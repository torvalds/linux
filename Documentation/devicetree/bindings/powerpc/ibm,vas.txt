## Documentation/devicetree/bindings/powerpc/sleep.yaml
```yaml
# SPDX-License-Identifier: GPL-2.0-only
%YAML 1.2
---
$id: http://devicetree.org/schemas/powerpc/sleep.yaml#
$schema: http://devicetree.org/meta-schemas/core.yaml#

title: PowerPC sleep property

maintainers:
  - Rob Herring <robh@kernel.org>

description: |
  Devices on SOCs often have mechanisms for placing devices into low-power
  states that are decoupled from the devices' own register blocks.  Sometimes,
  this information is more complicated than a cell-index property can
  reasonably describe.  Thus, each device controlled in such a manner
  may contain a "sleep" property which describes these connections.

  The sleep property consists of one or more sleep resources, each of
  which consists of a phandle to a sleep controller, followed by a
  controller-specific sleep specifier of zero or more cells.

  The semantics of what type of low power modes are possible are defined
  by the sleep controller.  Some examples of the types of low power modes
  that may be supported are:

   - Dynamic: The device may be disabled or enabled at any time.
   - System Suspend: The device may request to be disabled or remain
     awake during system suspend, but will not be disabled until then.
   - Permanent: The device is disabled permanently (until the next hard
     reset).

  Some devices may share a clock domain with each other, such that they should
  only be suspended when none of the devices are in use.  Where reasonable,
  such nodes should be placed on a virtual bus, where the bus has the sleep
  property.  If the clock domain is shared among devices that cannot be
  reasonably grouped in this manner, then create a virtual sleep controller
  (similar to an interrupt nexus, except that defining a standardized
  sleep-map should wait until its necessity is demonstrated).

select: true

properties:
  sleep:
    $ref: /schemas/types.yaml#/definitions/phandle-array

additionalProperties: true
```

## Documentation/devicetree/bindings/pps/pps-gpio.txt
```
Device-Tree Bindings for a PPS Signal on GPIO

These properties describe a PPS (pulse-per-second) signal connected to
a GPIO pin.

Required properties:
- compatible: should be "pps-gpio"
- gpios: one PPS GPIO in the format described by ../gpio/gpio.txt

Additional required properties for the PPS ECHO functionality:
- echo-gpios: one PPS ECHO GPIO in the format described by ../gpio/gpio.txt
- echo-active-ms: duration in ms of the active portion of the echo pulse

Optional properties:
- assert-falling-edge: when present, assert is indicated by a falling edge
                       (instead of by a rising edge)

Example:
	pps {
		pinctrl-names = "default";
		pinctrl-0 = <&pinctrl_pps>;

		gpios = <&gpio1 26 GPIO_ACTIVE_HIGH>;
		assert-falling-edge;

		echo-gpios = <&gpio1 27 GPIO_ACTIVE_HIGH>;
		echo-active-ms = <100>;

		compatible = "pps-gpio";
	};
```

## Documentation/devicetree/bindings/pps/pps-gpio.yaml
```yaml
# SPDX-License-Identifier: (GPL-2.0-only OR BSD-2-Clause)
%YAML 1.2
---
$id: http://devicetree.org/schemas/pps/pps-gpio.yaml#
$schema: http://devicetree.org/meta-schemas/core.yaml#

title: PPS Signal via GPIO

maintainers:
  - Fabio Estevam <festevam@gmail.com>

properties:
  compatible:
    const: pps-gpio

  gpios:
    description: The GPIO that provides the PPS signal.
    maxItems: 1

  echo-gpios:
    description: The GPIO that provides the PPS ECHO signal.
    maxItems: 1

  echo-active-ms:
    description: Duration in ms of the active portion of the echo pulse.

  assert-falling-edge:
    description: Indicates a falling edge assert, when present. Rising edge if absent.
    type: boolean

required:
  - compatible
  - gpios

additionalProperties: false

examples:
  - |
    #include <dt-bindings/gpio/gpio.h>

    pps {
        compatible = "pps-gpio";
        pinctrl-names = "default";
        pinctrl-0 = <&pinctrl_pps>;
        gpios = <&gpio1 26 GPIO_ACTIVE_HIGH>;
        assert-falling-edge;
        echo-gpios = <&gpio1 27 GPIO_ACTIVE_HIGH>;
        echo-active-ms = <100>;
    };
```

## Documentation/devicetree/bindings/ptp/amazon,vmclock.yaml
```yaml
# SPDX-License-Identifier: (GPL-2.0-only OR BSD-2-Clause)
%YAML 1.2
---
$id: http://devicetree.org/schemas/ptp/amazon,vmclock.yaml#
$schema: http://devicetree.org/meta-schemas/core.yaml#

title: Virtual Machine Clock

maintainers:
  - David Woodhouse <dwmw2@infradead.org>

description:
  The vmclock device provides a precise clock source and allows for
  accurate timekeeping across live migration and snapshot/restore
  operations. The full specification of the shared data structure is
  available at https://uapi-group.org/specifications/specs/vmclock/

properties:
  compatible:
    const: amazon,vmclock

  reg:
    description:
      Specifies the shared memory region containing the vmclock_abi structure.
    maxItems: 1

  interrupts:
    description:
      Interrupt used to notify when the contents of the vmclock_abi structure
      have been updated.
    maxItems: 1

required:
  - compatible
  - reg

additionalProperties: false

examples:
  - |
    #include <dt-bindings/interrupt-controller/arm-gic.h>
    ptp@80000000 {
      compatible = "amazon,vmclock";
      reg = <0x80000000 0x1000>;
      interrupts = <GIC_SPI 36 IRQ_TYPE_EDGE_RISING>;
    };
```

## Documentation/devicetree/bindings/ptp/brcm,ptp-dte.txt
```
* Broadcom Digital Timing Engine(DTE) based PTP clock

Required properties:
- compatible: should contain the core compatibility string
              and the SoC compatibility string. The SoC
              compatibility string is to handle SoC specific
              hardware differences.
              Core compatibility string:
                 "brcm,ptp-dte"
              SoC compatibility strings:
                 "brcm,iproc-ptp-dte" - for iproc based SoC's
- reg: address and length of the DTE block's NCO registers

Example:

ptp: ptp-dte@180af650 {
	compatible = "brcm,iproc-ptp-dte", "brcm,ptp-dte";
	reg = <0x180af650 0x10>;
};
```

## Documentation/devicetree/bindings/ptp/fsl,ptp.yaml
```yaml
# SPDX-License-Identifier: (GPL-2.0-only OR BSD-2-Clause)
%YAML 1.2
---
$id: http://devicetree.org/schemas/ptp/fsl,ptp.yaml#
$schema: http://devicetree.org/meta-schemas/core.yaml#

title: Freescale QorIQ 1588 timer based PTP clock

maintainers:
  - Frank Li <Frank.Li@nxp.com>

properties:
  compatible:
    oneOf:
      - enum:
          - fsl,etsec-ptp
          - fsl,fman-ptp-timer
          - fsl,dpaa2-ptp
      - items:
          - const: pci1957,ee02
          - const: fsl,enetc-ptp

  reg:
    maxItems: 1

  interrupts:
    maxItems: 1

  clocks:
    maxItems: 1

  fsl,cksel:
    $ref: /schemas/types.yaml#/definitions/uint32
    description: |
      Timer reference clock source.

      Reference clock source is determined by the value, which is holded
      in CKSEL bits in TMR_CTRL register. "fsl,cksel" property keeps the
      value, which will be directly written in those bits, that is why,
      according to reference manual, the next clock sources can be used:

      For eTSEC,
      <0> - external high precision timer reference clock (TSEC_TMR_CLK
            input is used for this purpose);
      <1> - eTSEC system clock;
      <2> - eTSEC1 transmit clock;
      <3> - RTC clock input.

      For DPAA FMan,
      <0> - external high precision timer reference clock (TMR_1588_CLK)
      <1> - MAC system clock (1/2 FMan clock)
      <2> - reserved
      <3> - RTC clock oscillator

  fsl,tclk-period:
    $ref: /schemas/types.yaml#/definitions/uint32
    description: Timer reference clock period in nanoseconds.

  fsl,tmr-prsc:
    $ref: /schemas/types.yaml#/definitions/uint32
    description: Prescaler, divides the output clock.

  fsl,tmr-add:
    $ref: /schemas/types.yaml#/definitions/uint32
    description: Frequency compensation value.

  fsl,tmr-fiper1:
    $ref: /schemas/types.yaml#/definitions/uint32
    description: Fixed interval period pulse generator.

  fsl,tmr-fiper2:
    $ref: /schemas/types.yaml#/definitions/uint32
    description: Fixed interval period pulse generator.

  fsl,tmr-fiper3:
    $ref: /schemas/types.yaml#/definitions/uint32
    description:
      Fixed interval period pulse generator.
      Supported only on DPAA2 and ENETC hardware.

  fsl,max-adj:
    $ref: /schemas/types.yaml#/definitions/uint32
    description: |
      Maximum frequency adjustment in parts per billion.

      These properties set the operational parameters for the PTP
      clock. You must choose these carefully for the clock to work right.
      Here is how to figure good values:

      TimerOsc     = selected reference clock   MHz
      tclk_period  = desired clock period       nanoseconds
      NominalFreq  = 1000 / tclk_period         MHz
      FreqDivRatio = TimerOsc / NominalFreq     (must be greater that 1.0)
      tmr_add      = ceil(2^32 / FreqDivRatio)
      OutputClock  = NominalFreq / tmr_prsc     MHz
      PulseWidth   = 1 / OutputClock            microseconds
      FiperFreq1   = desired frequency in Hz
      FiperDiv1    = 1000000 * OutputClock / FiperFreq1
      tmr_fiper1   = tmr_prsc * tclk_period * FiperDiv1 - tclk_period
      max_adj      = 1000000000 * (FreqDivRatio - 1.0) - 1

      The calculation for tmr_fiper2 is the same as for tmr_fiper1. The
      driver expects that tmr_fiper1 will be correctly set to produce a 1
      Pulse Per Second (PPS) signal, since this will be offered to the PPS
      subsystem to synchronize the Linux clock.

      When this attribute is not used, the IEEE 1588 timer reference clock
      will use the eTSEC system clock (for Gianfar) or the MAC system
      clock (for DPAA).

  fsl,extts-fifo:
    $ref: /schemas/types.yaml#/definitions/flag
    description:
      The presence of this property indicates hardware
      support for the external trigger stamp FIFO

  little-endian:
    $ref: /schemas/types.yaml#/definitions/flag
    description:
      The presence of this property indicates the 1588 timer
      support for the external trigger stamp FIFO.
      IP block is little-endian mode. The default endian mode
      is big-endian.

required:
  - compatible
  - reg

allOf:
  - if:
      properties:
        compatible:
          contains:
            const: fsl,enetc-ptp
    then:
      $ref: /schemas/pci/pci-device.yaml

additionalProperties: false

examples:
  - |
    #include <dt-bindings/interrupt-controller/irq.h>

    phc@24e00 {
        compatible = "fsl,etsec-ptp";
        reg = <0x24e00 0xb0>;
        interrupts = <12 IRQ_TYPE_LEVEL_LOW>;
        interrupt-parent = <&ipic>;
        fsl,cksel       = <1>;
        fsl,tclk-period = <10>;
        fsl,tmr-prsc    = <100>;
        fsl,tmr-add     = <0x999999a4>;
        fsl,tmr-fiper1  = <0x3b9ac9f6>;
        fsl,tmr-fiper2  = <0x00018696>;
        fsl,max-adj     = <659999998>;
    };
```

## Documentation/devicetree/bindings/ptp/nxp,ptp-netc.yaml
```yaml
# SPDX-License-Identifier: (GPL-2.0-only OR BSD-2-Clause)
%YAML 1.2
---
$id: http://devicetree.org/schemas/ptp/nxp,ptp-netc.yaml#
$schema: http://devicetree.org/meta-schemas/core.yaml#

title: NXP NETC V4 Timer PTP clock

description:
  NETC V4 Timer provides current time with nanosecond resolution, precise
  periodic pulse, pulse on timeout (alarm), and time capture on external
  pulse support. And it supports time synchronization as required for
  IEEE 1588 and IEEE 802.1AS-2020.

maintainers:
  - Wei Fang <wei.fang@nxp.com>
  - Clark Wang <xiaoning.wang@nxp.com>

properties:
  compatible:
    enum:
      - pci1131,ee02

  reg:
    maxItems: 1

  clocks:
    maxItems: 1
    description:
      The reference clock of NETC Timer, can be selected between 3 different
      clock sources using an integrated hardware mux TMR_CTRL[CK_SEL].
      The "ccm" means the reference clock comes from CCM of SoC.
      The "ext" means the reference clock comes from external IO pins.
      If not present, indicates that the system clock of NETC IP is selected
      as the reference clock.

  clock-names:
    enum:
      - ccm
      - ext

required:
  - compatible
  - reg

allOf:
  - $ref: /schemas/pci/pci-device.yaml

unevaluatedProperties: false

examples:
  - |
    pcie {
        #address-cells = <3>;
        #size-cells = <2>;

        ptp-timer@18,0 {
            compatible = "pci1131,ee02";
            reg = <0x00c000 0 0 0 0>;
            clocks = <&scmi_clk 18>;
            clock-names = "ccm";
        };
    };
```

## Documentation/devicetree/bindings/ptp/ptp-idt82p33.yaml
```yaml
# SPDX-License-Identifier: (GPL-2.0 OR BSD-2-Clause)
%YAML 1.2
---
$id: http://devicetree.org/schemas/ptp/ptp-idt82p33.yaml#
$schema: http://devicetree.org/meta-schemas/core.yaml#

title: IDT 82P33 PTP Clock

description: |
  IDT 82P33XXX Synchronization Management Unit (SMU) based PTP clock

maintainers:
  - Min Li <min.li.xe@renesas.com>

properties:
  compatible:
    enum:
      - idt,82p33810
      - idt,82p33813
      - idt,82p33814
      - idt,82p33831
      - idt,82p33910
      - idt,82p33913
      - idt,82p33914
      - idt,82p33931

  reg:
    maxItems: 1

required:
  - compatible
  - reg

additionalProperties: false

examples:
  - |
    i2c {
        #address-cells = <1>;
        #size-cells = <0>;
        phc@51 {
            compatible = "idt,82p33810";
            reg = <0x51>;
        };
    };
```

## Documentation/devicetree/bindings/ptp/ptp-idtcm.yaml
```yaml
# SPDX-License-Identifier: (GPL-2.0 OR BSD-2-Clause)
%YAML 1.2
---
$id: http://devicetree.org/schemas/ptp/ptp-idtcm.yaml#
$schema: http://devicetree.org/meta-schemas/core.yaml#

title: IDT ClockMatrix (TM) PTP Clock Device Tree Bindings

maintainers:
  - Vincent Cheng <vincent.cheng.xh@renesas.com>

properties:
  compatible:
    enum:
      # For System Synchronizer
      - idt,8a34000
      - idt,8a34001
      - idt,8a34002
      - idt,8a34003
      - idt,8a34004
      - idt,8a34005
      - idt,8a34006
      - idt,8a34007
      - idt,8a34008
      - idt,8a34009
      # For Port Synchronizer
      - idt,8a34010
      - idt,8a34011
      - idt,8a34012
      - idt,8a34013
      - idt,8a34014
      - idt,8a34015
      - idt,8a34016
      - idt,8a34017
      - idt,8a34018
      - idt,8a34019
      # For Universal Frequency Translator (UFT)
      - idt,8a34040
      - idt,8a34041
      - idt,8a34042
      - idt,8a34043
      - idt,8a34044
      - idt,8a34045
      - idt,8a34046
      - idt,8a34047
      - idt,8a34048
      - idt,8a34049

  reg:
    maxItems: 1
    description:
      I2C slave address of the device.

required:
  - compatible
  - reg

additionalProperties: false

examples:
  - |
    i2c {
        #address-cells = <1>;
        #size-cells = <0>;
        phc@5b {
            compatible = "idt,8a34000";
            reg = <0x5b>;
        };
    };
```

## Documentation/devicetree/bindings/ptp/ptp-ines.txt
```
ZHAW InES PTP time stamping IP core

The IP core needs two different kinds of nodes.  The control node
lives somewhere in the memory map and specifies the address of the
control registers.  There can be up to three port handles placed as
attributes of PHY nodes.  These associate a particular MII bus with a
port index within the IP core.

Required properties of the control node:

- compatible:		"ines,ptp-ctrl"
- reg:			physical address and size of the register bank

Required format of the port handle within the PHY node:

- timestamper:		provides control node reference and
			the port channel within the IP core

Example:

	tstamper: timestamper@60000000 {
		compatible = "ines,ptp-ctrl";
		reg = <0x60000000 0x80>;
	};

	ethernet@80000000 {
		...
		mdio {
			...
			ethernet-phy@3 {
				...
				timestamper = <&tstamper 0>;
			};
		};
	};
```
