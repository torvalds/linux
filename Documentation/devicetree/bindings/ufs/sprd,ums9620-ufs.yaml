## Documentation/devicetree/bindings/ufs/ufshcd-pltfrm.txt
```
* Universal Flash Storage (UFS) Host Controller

UFSHC nodes are defined to describe on-chip UFS host controllers.
Each UFS controller instance should have its own node.

Required properties:
- compatible		: must contain "jedec,ufs-1.1", may also list one or more
					  of the following:
					  "qcom,msm8994-ufshc"
					  "qcom,msm8996-ufshc"
					  "qcom,ufshc"
- interrupts        : <interrupt mapping for UFS host controller IRQ>
- reg               : <registers mapping>

Optional properties:
- phys                  : phandle to UFS PHY node
- phy-names             : the string "ufsphy" when is found in a node, along
                          with "phys" attribute, provides phandle to UFS PHY node
- vdd-hba-supply        : phandle to UFS host controller supply regulator node
- vcc-supply            : phandle to VCC supply regulator node
- vccq-supply           : phandle to VCCQ supply regulator node
- vccq2-supply          : phandle to VCCQ2 supply regulator node
- vcc-supply-1p8        : For embedded UFS devices, valid VCC range is 1.7-1.95V
                          or 2.7-3.6V. This boolean property when set, specifies
			  to use low voltage range of 1.7-1.95V. Note for external
			  UFS cards this property is invalid and valid VCC range is
			  always 2.7-3.6V.
- vcc-max-microamp      : specifies max. load that can be drawn from vcc supply
- vccq-max-microamp     : specifies max. load that can be drawn from vccq supply
- vccq2-max-microamp    : specifies max. load that can be drawn from vccq2 supply
- <name>-fixed-regulator : boolean property specifying that <name>-supply is a fixed regulator

- clocks                : List of phandle and clock specifier pairs
- clock-names           : List of clock input name strings sorted in the same
                          order as the clocks property.
- freq-table-hz		: Array of <min max> operating frequencies stored in the same
                          order as the clocks property. If this property is not
			  defined or a value in the array is "0" then it is assumed
			  that the frequency is set by the parent clock or a
			  fixed rate clock source.
-lanes-per-direction	: number of lanes available per direction - either 1 or 2.
			  Note that it is assume same number of lanes is used both
			  directions at once. If not specified, default is 2 lanes per direction.

Note: If above properties are not defined it can be assumed that the supply
regulators or clocks are always on.

Example:
	ufshc@0xfc598000 {
		compatible = "jedec,ufs-1.1";
		reg = <0xfc598000 0x800>;
		interrupts = <0 28 0>;

		vdd-hba-supply = <&xxx_reg0>;
		vdd-hba-fixed-regulator;
		vcc-supply = <&xxx_reg1>;
		vcc-supply-1p8;
		vccq-supply = <&xxx_reg2>;
		vccq2-supply = <&xxx_reg3>;
		vcc-max-microamp = 500000;
		vccq-max-microamp = 200000;
		vccq2-max-microamp = 200000;

		clocks = <&core 0>, <&ref 0>, <&iface 0>;
		clock-names = "core_clk", "ref_clk", "iface_clk";
		freq-table-hz = <100000000 200000000>, <0 0>, <0 0>;
		phys = <&ufsphy1>;
		phy-names = "ufsphy";
	};
```

## Documentation/devicetree/bindings/unittest.txt
```
1) OF unittest platform device

** unittest

Required properties:
- compatible: must be "unittest"

All other properties are optional.

Example:
	unittest {
		compatible = "unittest";
	};

2) OF unittest i2c adapter platform device

** platform device unittest adapter

Required properties:
- compatible: must be unittest-i2c-bus

Children nodes contain unittest i2c devices.

Example:
	unittest-i2c-bus {
		compatible = "unittest-i2c-bus";
	};

3) OF unittest i2c device

** I2C unittest device

Required properties:
- compatible: must be unittest-i2c-dev

All other properties are optional

Example:
	unittest-i2c-dev {
		compatible = "unittest-i2c-dev";
	};

4) OF unittest i2c mux device

** I2C unittest mux

Required properties:
- compatible: must be unittest-i2c-mux

Children nodes contain unittest i2c bus nodes per channel.

Example:
	unittest-i2c-mux {
		compatible = "unittest-i2c-mux";
		#address-cells = <1>;
		#size-cells = <0>;
		channel-0 {
			reg = <0>;
			#address-cells = <1>;
			#size-cells = <0>;
			i2c-dev {
				reg = <8>;
				compatible = "unittest-i2c-dev";
			};
		};
	};
```

## Documentation/devicetree/bindings/usb/allwinner,sun4i-a10-musb.txt
```
Allwinner sun4i A10 musb DRC/OTG controller
-------------------------------------------

Required properties:
 - compatible      : "allwinner,sun4i-a10-musb", "allwinner,sun6i-a31-musb"
                     or "allwinner,sun8i-a33-musb"
 - reg             : mmio address range of the musb controller
 - clocks          : clock specifier for the musb controller ahb gate clock
 - reset           : reset specifier for the ahb reset (A31 and newer only)
 - interrupts      : interrupt to which the musb controller is connected
 - interrupt-names : must be "mc"
 - phys            : phy specifier for the otg phy
 - phy-names       : must be "usb"
 - dr_mode         : Dual-Role mode must be "host" or "otg"
 - extcon          : extcon specifier for the otg phy

Example:

	usb_otg: usb@01c13000 {
		compatible = "allwinner,sun4i-a10-musb";
		reg = <0x01c13000 0x0400>;
		clocks = <&ahb_gates 0>;
		interrupts = <38>;
		interrupt-names = "mc";
		phys = <&usbphy 0>;
		phy-names = "usb";
		extcon = <&usbphy 0>;
		status = "disabled";
	};
```

## Documentation/devicetree/bindings/usb/allwinner,sun4i-a10-musb.yaml
```yaml
# SPDX-License-Identifier: GPL-2.0
%YAML 1.2
---
$id: http://devicetree.org/schemas/usb/allwinner,sun4i-a10-musb.yaml#
$schema: http://devicetree.org/meta-schemas/core.yaml#

title: Allwinner A10 mUSB OTG Controller

maintainers:
  - Chen-Yu Tsai <wens@csie.org>
  - Maxime Ripard <mripard@kernel.org>

properties:
  compatible:
    oneOf:
      - enum:
          - allwinner,sun4i-a10-musb
          - allwinner,sun6i-a31-musb
          - allwinner,sun8i-a33-musb
          - allwinner,sun8i-h3-musb
          - allwinner,suniv-f1c100s-musb
      - items:
          - enum:
              - allwinner,sun8i-a83t-musb
              - allwinner,sun20i-d1-musb
              - allwinner,sun50i-h6-musb
          - const: allwinner,sun8i-a33-musb
      - items:
          - const: allwinner,sun50i-h616-musb
          - const: allwinner,sun8i-h3-musb

  reg:
    maxItems: 1

  interrupts:
    maxItems: 1

  interrupt-names:
    const: mc

  clocks:
    maxItems: 1

  resets:
    maxItems: 1

  phys:
    maxItems: 1

  phy-names:
    const: usb

  extcon:
    description: Extcon specifier for the OTG PHY

  dr_mode:
    enum:
      - host
      - otg
      - peripheral

  allwinner,sram:
    description: Phandle to the device SRAM
    $ref: /schemas/types.yaml#/definitions/phandle-array

required:
  - compatible
  - reg
  - interrupts
  - interrupt-names
  - clocks
  - phys
  - phy-names
  - dr_mode
  - extcon

if:
  properties:
    compatible:
      contains:
        enum:
          - allwinner,sun6i-a31-musb
          - allwinner,sun8i-a33-musb
          - allwinner,sun8i-h3-musb

then:
  required:
    - resets

additionalProperties: false

examples:
  - |
    usb_otg: usb@1c13000 {
      compatible = "allwinner,sun4i-a10-musb";
      reg = <0x01c13000 0x0400>;
      clocks = <&ahb_gates 0>;
      interrupts = <38>;
      interrupt-names = "mc";
      phys = <&usbphy 0>;
      phy-names = "usb";
      extcon = <&usbphy 0>;
      dr_mode = "peripheral";
    };

...
```

## Documentation/devicetree/bindings/usb/am33xx-usb.txt
```
  AM33xx MUSB
~~~~~~~~~~~~~~~
- compatible: ti,am33xx-usb
- reg: offset and length of the usbss register sets
- ti,hwmods : must be "usb_otg_hs"

The glue layer contains multiple child nodes. It is required to have
at least a control module node, USB node and a PHY node. The second USB
node and its PHY node are optional. The DMA node is also optional.

Reset module
~~~~~~~~~~~~
- compatible: ti,am335x-usb-ctrl-module
- reg: offset and length of the "USB control registers" in the "Control
  Module" block. A second offset and length for the USB wake up control
  in the same memory block.
- reg-names: "phy_ctrl" for the "USB control registers" and "wakeup" for
  the USB wake up control register.

USB PHY
~~~~~~~
compatible: ti,am335x-usb-phy
reg: offset and length of the "USB PHY" register space
ti,ctrl_mod: reference to the "reset module" node
reg-names: phy
The PHY should have a "phy" alias numbered properly in the alias
node.

USB
~~~
- compatible: ti,musb-am33xx
- reg: offset and length of "USB Controller Registers", and offset and
  length of "USB Core" register space.
- reg-names: control for the ""USB Controller Registers" and "mc" for
  "USB Core" register space
- interrupts: USB interrupt number
- interrupt-names: mc
- dr_mode: Should be one of "host", "peripheral" or "otg".
- mentor,multipoint: Should be "1" indicating the musb controller supports
  multipoint. This is a MUSB configuration-specific setting.
- mentor,num-eps: Specifies the number of endpoints. This is also a
  MUSB configuration-specific setting. Should be set to "16"
- mentor,ram-bits: Specifies the ram address size. Should be set to "12"
- mentor,power: Should be "500". This signifies the controller can supply up to
  500mA when operating in host mode.
- phys: reference to the USB phy
- dmas: specifies the dma channels
- dma-names: specifies the names of the channels. Use "rxN" for receive
  and "txN" for transmit endpoints. N specifies the endpoint number.

The controller should have an "usb" alias numbered properly in the alias
node.

DMA
~~~
- compatible: ti,am3359-cppi41
- reg: offset and length of the following register spaces: USBSS, USB
  CPPI DMA Controller, USB CPPI DMA Scheduler, USB Queue Manager
- reg-names: glue, controller, scheduler, queuemgr
- #dma-cells: should be set to 2. The first number represents the
  endpoint number (0 … 14 for endpoints 1 … 15 on instance 0 and 15 … 29
  for endpoints 1 … 15 on instance 1). The second number is 0 for RX and
  1 for TX transfers.
- dma-channels: should be set to 30 representing the 15 endpoints for
  each USB instance.
- #dma-channels: deprecated

Example:
~~~~~~~~
The following example contains all the nodes as used on am335x-evm:

aliases {
	usb0 = &usb0;
	usb1 = &usb1;
	phy0 = &usb0_phy;
	phy1 = &usb1_phy;
};

usb: usb@47400000 {
	compatible = "ti,am33xx-usb";
	reg = <0x47400000 0x1000>;
	ranges;
	#address-cells = <1>;
	#size-cells = <1>;
	ti,hwmods = "usb_otg_hs";

	ctrl_mod: control@44e10000 {
		compatible = "ti,am335x-usb-ctrl-module";
		reg = <0x44e10620 0x10
			0x44e10648 0x4>;
		reg-names = "phy_ctrl", "wakeup";
	};

	usb0_phy: usb-phy@47401300 {
		compatible = "ti,am335x-usb-phy";
		reg = <0x47401300 0x100>;
		reg-names = "phy";
		ti,ctrl_mod = <&ctrl_mod>;
		#phy-cells = <0>;
	};

	usb0: usb@47401000 {
		compatible = "ti,musb-am33xx";
		reg = <0x47401400 0x400
			0x47401000 0x200>;
		reg-names = "mc", "control";

		interrupts = <18>;
		interrupt-names = "mc";
		dr_mode = "otg"
		mentor,multipoint = <1>;
		mentor,num-eps = <16>;
		mentor,ram-bits = <12>;
		mentor,power = <500>;
		phys = <&usb0_phy>;

		dmas = <&cppi41dma  0 0 &cppi41dma  1 0
			&cppi41dma  2 0 &cppi41dma  3 0
			&cppi41dma  4 0 &cppi41dma  5 0
			&cppi41dma  6 0 &cppi41dma  7 0
			&cppi41dma  8 0 &cppi41dma  9 0
			&cppi41dma 10 0 &cppi41dma 11 0
			&cppi41dma 12 0 &cppi41dma 13 0
			&cppi41dma 14 0 &cppi41dma  0 1
			&cppi41dma  1 1 &cppi41dma  2 1
			&cppi41dma  3 1 &cppi41dma  4 1
			&cppi41dma  5 1 &cppi41dma  6 1
			&cppi41dma  7 1 &cppi41dma  8 1
			&cppi41dma  9 1 &cppi41dma 10 1
			&cppi41dma 11 1 &cppi41dma 12 1
			&cppi41dma 13 1 &cppi41dma 14 1>;
		dma-names =
			"rx1", "rx2", "rx3", "rx4", "rx5", "rx6", "rx7",
			"rx8", "rx9", "rx10", "rx11", "rx12", "rx13",
			"rx14", "rx15",
			"tx1", "tx2", "tx3", "tx4", "tx5", "tx6", "tx7",
			"tx8", "tx9", "tx10", "tx11", "tx12", "tx13",
			"tx14", "tx15";
	};

	usb1_phy: usb-phy@47401b00 {
		compatible = "ti,am335x-usb-phy";
		reg = <0x47401b00 0x100>;
		reg-names = "phy";
		ti,ctrl_mod = <&ctrl_mod>;
		#phy-cells = <0>;
	};

	usb1: usb@47401800 {
		compatible = "ti,musb-am33xx";
		reg = <0x47401c00 0x400
			0x47401800 0x200>;
		reg-names = "mc", "control";
		interrupts = <19>;
		interrupt-names = "mc";
		dr_mode = "host"
		mentor,multipoint = <1>;
		mentor,num-eps = <16>;
		mentor,ram-bits = <12>;
		mentor,power = <500>;
		phys = <&usb1_phy>;

		dmas = <&cppi41dma 15 0 &cppi41dma 16 0
			&cppi41dma 17 0 &cppi41dma 18 0
			&cppi41dma 19 0 &cppi41dma 20 0
			&cppi41dma 21 0 &cppi41dma 22 0
			&cppi41dma 23 0 &cppi41dma 24 0
			&cppi41dma 25 0 &cppi41dma 26 0
			&cppi41dma 27 0 &cppi41dma 28 0
			&cppi41dma 29 0 &cppi41dma 15 1
			&cppi41dma 16 1 &cppi41dma 17 1
			&cppi41dma 18 1 &cppi41dma 19 1
			&cppi41dma 20 1 &cppi41dma 21 1
			&cppi41dma 22 1 &cppi41dma 23 1
			&cppi41dma 24 1 &cppi41dma 25 1
			&cppi41dma 26 1 &cppi41dma 27 1
			&cppi41dma 28 1 &cppi41dma 29 1>;
		dma-names =
			"rx1", "rx2", "rx3", "rx4", "rx5", "rx6", "rx7",
			"rx8", "rx9", "rx10", "rx11", "rx12", "rx13",
			"rx14", "rx15",
			"tx1", "tx2", "tx3", "tx4", "tx5", "tx6", "tx7",
			"tx8", "tx9", "tx10", "tx11", "tx12", "tx13",
			"tx14", "tx15";
	};

	cppi41dma: dma-controller@7402000 {
		compatible = "ti,am3359-cppi41";
		reg =  <0x47400000 0x1000
			0x47402000 0x1000
			0x47403000 0x1000
			0x47404000 0x4000>;
		reg-names = "glue", "controller", "scheduler", "queuemgr";
		interrupts = <17>;
		interrupt-names = "glue";
		#dma-cells = <2>;
		dma-channels = <30>;
		dma-requests = <256>;
	};
};
```
