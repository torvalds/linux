## Documentation/devicetree/bindings/usb/aspeed,dwc3.yaml
```yaml
# SPDX-License-Identifier: (GPL-2.0-only OR BSD-2-Clause)
%YAML 1.2
---
$id: http://devicetree.org/schemas/usb/aspeed,dwc3.yaml#
$schema: http://devicetree.org/meta-schemas/core.yaml#

title: Aspeed SuperSpeed DWC3 USB SoC controller

maintainers:
  - Ryan Chen <ryan_chen@aspeedtech.com>

description:
  The common content of the node is defined in snps,dwc3.yaml.

select:
  properties:
    compatible:
      contains:
        const: aspeed,ast2700-xhci
  required:
    - compatible

properties:
  compatible:
    items:
      - const: aspeed,ast2700-xhci
      - const: snps,dwc3

  interrupts:
    maxItems: 1

  clocks:
    items:
      - description: Controller bus early clock
      - description: PHY reference clock
      - description: Controller suspend clock

  clock-names:
    items:
      - const: bus_early
      - const: ref
      - const: suspend

  resets:
    maxItems: 1

  phys:
    maxItems: 1

  phy-names:
    const: usb3-phy

required:
  - compatible
  - reg
  - interrupts
  - clocks
  - clock-names
  - resets
  - phys
  - phy-names

allOf:
  - $ref: snps,dwc3.yaml#

unevaluatedProperties: false

examples:
  - |
    #include <dt-bindings/clock/aspeed,ast2700-scu.h>
    #include <dt-bindings/reset/aspeed,ast2700-scu.h>
    #include <dt-bindings/interrupt-controller/arm-gic.h>

    bus {
        #address-cells = <2>;
        #size-cells = <2>;

        usb@12030000 {
            compatible = "aspeed,ast2700-xhci", "snps,dwc3";
            reg = <0x0 0x12030000 0x0 0x10000>;
            interrupts = <GIC_SPI 30 IRQ_TYPE_LEVEL_HIGH>;
            clocks = <&syscon0 SCU0_CLK_GATE_PORTAUSB2CLK>,
                     <&syscon0 SCU0_CLK_U2PHY_REFCLK>,
                     <&syscon0 SCU0_CLK_U2PHY_CLK12M>;
            clock-names = "bus_early", "ref", "suspend";
            resets = <&syscon0 SCU0_RESET_PORTA_XHCI>;
            pinctrl-names = "default";
            pinctrl-0 = <&pinctrl_usb3axh_default &pinctrl_usb2axh_default>;
            phys = <&uphy3a>;
            phy-names = "usb3-phy";
            dr_mode = "host";
        };
    };
```

## Documentation/devicetree/bindings/usb/aspeed,usb-vhub.yaml
```yaml
# SPDX-License-Identifier: (GPL-2.0-only OR BSD-2-Clause)
# Copyright (c) 2020 Facebook Inc.
%YAML 1.2
---
$id: http://devicetree.org/schemas/usb/aspeed,usb-vhub.yaml#
$schema: http://devicetree.org/meta-schemas/core.yaml#

title: ASPEED USB 2.0 Virtual Hub Controller

maintainers:
  - Benjamin Herrenschmidt <benh@kernel.crashing.org>

description: |+
  The ASPEED USB 2.0 Virtual Hub Controller implements 1 set of USB Hub
  register and several sets of Device and Endpoint registers to support
  the Virtual Hub's downstream USB devices.

  Supported number of devices and endpoints vary depending on hardware
  revisions. AST2400 and AST2500 Virtual Hub supports 5 downstream devices
  and 15 generic endpoints, while AST2600 Virtual Hub supports 7 downstream
  devices and 21 generic endpoints.

properties:
  compatible:
    enum:
      - aspeed,ast2400-usb-vhub
      - aspeed,ast2500-usb-vhub
      - aspeed,ast2600-usb-vhub

  reg:
    maxItems: 1

  clocks:
    maxItems: 1

  interrupts:
    maxItems: 1

  aspeed,vhub-downstream-ports:
    description: Number of downstream ports supported by the Virtual Hub
    allOf:
      - $ref: /schemas/types.yaml#/definitions/uint32
      - default: 5
        minimum: 1
        maximum: 7

  aspeed,vhub-generic-endpoints:
    description: Number of generic endpoints supported by the Virtual Hub
    allOf:
      - $ref: /schemas/types.yaml#/definitions/uint32
      - default: 15
        minimum: 1
        maximum: 21

  vhub-vendor-id:
    description: vhub Vendor ID
    allOf:
      - $ref: /schemas/types.yaml#/definitions/uint32
      - maximum: 65535

  vhub-product-id:
    description: vhub Product ID
    allOf:
      - $ref: /schemas/types.yaml#/definitions/uint32
      - maximum: 65535

  vhub-device-revision:
    description: vhub Device Revision in binary-coded decimal
    allOf:
      - $ref: /schemas/types.yaml#/definitions/uint32
      - maximum: 65535

  vhub-strings:
    type: object

    properties:
      '#address-cells':
        const: 1

      '#size-cells':
        const: 0

    patternProperties:
      '^string@[0-9a-f]+$':
        type: object
        description: string descriptors of the specific language

        properties:
          reg:
            maxItems: 1
            description: 16-bit Language Identifier defined by USB-IF

          manufacturer:
            description: vhub manufacturer
            allOf:
              - $ref: /schemas/types.yaml#/definitions/string

          product:
            description: vhub product name
            allOf:
              - $ref: /schemas/types.yaml#/definitions/string

          serial-number:
            description: vhub device serial number
            allOf:
              - $ref: /schemas/types.yaml#/definitions/string

required:
  - compatible
  - reg
  - clocks
  - interrupts
  - aspeed,vhub-downstream-ports
  - aspeed,vhub-generic-endpoints

additionalProperties: false

examples:
  - |
    #include <dt-bindings/clock/aspeed-clock.h>
    vhub: usb-vhub@1e6a0000 {
            compatible = "aspeed,ast2500-usb-vhub";
            reg = <0x1e6a0000 0x300>;
            interrupts = <5>;
            clocks = <&syscon ASPEED_CLK_GATE_USBPORT1CLK>;
            aspeed,vhub-downstream-ports = <5>;
            aspeed,vhub-generic-endpoints = <15>;
            pinctrl-names = "default";
            pinctrl-0 = <&pinctrl_usb2ad_default>;

            vhub-vendor-id = <0x1d6b>;
            vhub-product-id = <0x0107>;
            vhub-device-revision = <0x0100>;
            vhub-strings {
                #address-cells = <1>;
                #size-cells = <0>;

                string@0409 {
                        reg = <0x0409>;
                        manufacturer = "ASPEED";
                        product = "USB Virtual Hub";
                        serial-number = "0000";
                };
            };
    };
```

## Documentation/devicetree/bindings/usb/atmel,at91rm9200-udc.yaml
```yaml
# SPDX-License-Identifier: (GPL-2.0-only OR BSD-2-Clause)
%YAML 1.2
---
$id: http://devicetree.org/schemas/usb/atmel,at91rm9200-udc.yaml#
$schema: http://devicetree.org/meta-schemas/core.yaml#

title: Atmel AT91 USB Device Controller (UDC)

maintainers:
  - Nicolas Ferre <nicolas.ferre@microchip.com>
  - Alexandre Belloni <alexandre.belloni@bootlin.com>

description:
  The Atmel AT91 USB Device Controller provides USB gadget (device-mode)
  functionality on AT91 SoCs. It requires a peripheral clock and an AHB
  clock for operation and may optionally control VBUS power through a GPIO.

properties:
  compatible:
    enum:
      - atmel,at91rm9200-udc
      - atmel,at91sam9260-udc
      - atmel,at91sam9261-udc
      - atmel,at91sam9263-udc

  reg:
    maxItems: 1

  interrupts:
    maxItems: 1

  clocks:
    maxItems: 2

  clock-names:
    items:
      - const: pclk
      - const: hclk

  atmel,vbus-gpio:
    description: GPIO used to enable or control VBUS power for the USB bus.
    maxItems: 1

  atmel,matrix:
    $ref: /schemas/types.yaml#/definitions/phandle
    description: Phandle to the Atmel bus matrix controller.

  atmel,pullup-gpio:
    description:
      GPIO controlling the USB D+ pull-up resistor used to signal device
      connection to the host.
    maxItems: 1

required:
  - compatible
  - reg
  - interrupts
  - clocks
  - clock-names

additionalProperties: false

examples:
  - |
    #include <dt-bindings/interrupt-controller/irq.h>
    #include <dt-bindings/clock/at91.h>
    #include <dt-bindings/gpio/gpio.h>
    gadget@fffa4000 {
        compatible = "atmel,at91rm9200-udc";
        reg = <0xfffa4000 0x4000>;
        interrupts = <11 IRQ_TYPE_LEVEL_HIGH 2>;
        clocks = <&udc_clk>, <&udpck>;
        clock-names = "pclk", "hclk";
        atmel,vbus-gpio = <&pioC 5 GPIO_ACTIVE_HIGH>;
    };
...
```

## Documentation/devicetree/bindings/usb/atmel,at91sam9rl-udc.yaml
```yaml
# SPDX-License-Identifier: (GPL-2.0-only OR BSD-2-Clause)
%YAML 1.2
---
$id: http://devicetree.org/schemas/usb/atmel,at91sam9rl-udc.yaml#
$schema: http://devicetree.org/meta-schemas/core.yaml#

title: Atmel High-Speed USB Device Controller (USBA)

maintainers:
  - Nicolas Ferre <nicolas.ferre@microchip.com>
  - Alexandre Belloni <alexandre.belloni@bootlin.com>

description:
  The Atmel High-Speed USB Device Controller (USBA) provides USB 2.0
  high-speed gadget functionality on several Atmel and Microchip SoCs.
  The controller requires a peripheral clock and a host clock for operation
  and may optionally use a GPIO to detect VBUS presence.

properties:
  compatible:
    oneOf:
      - enum:
          - atmel,at91sam9rl-udc
          - atmel,at91sam9g45-udc
          - atmel,sama5d3-udc
      - items:
          - const: microchip,lan9662-udc
          - const: atmel,sama5d3-udc
      - const: microchip,sam9x60-udc

  reg:
    maxItems: 2

  interrupts:
    maxItems: 1

  clocks:
    maxItems: 2

  clock-names:
    minItems: 2
    maxItems: 2
    items:
      enum: [pclk, hclk]

  atmel,vbus-gpio:
    description: GPIO used to detect the presence of VBUS, indicating that
      the USB cable is connected.
    maxItems: 1

required:
  - compatible
  - reg
  - interrupts
  - clocks
  - clock-names

unevaluatedProperties: false

examples:
  - |
    #include <dt-bindings/interrupt-controller/irq.h>
    #include <dt-bindings/clock/at91.h>
    #include <dt-bindings/gpio/gpio.h>
    gadget@fff78000 {
        compatible = "atmel,at91sam9g45-udc";
        reg = <0x00600000 0x80000
               0xfff78000 0x400>;
        interrupts = <27 IRQ_TYPE_LEVEL_HIGH 0>;
        clocks = <&pmc PMC_TYPE_PERIPHERAL 27>, <&pmc PMC_TYPE_CORE PMC_UTMI>;
        clock-names = "pclk", "hclk";
        atmel,vbus-gpio = <&pioC 15 GPIO_ACTIVE_HIGH>;
    };
...
```

## Documentation/devicetree/bindings/usb/atmel-usb.txt
```
Atmel SOC USB controllers

Atmel High-Speed USB device controller

Required properties:
 - compatible: Should be one of the following
	       "atmel,at91sam9rl-udc"
	       "atmel,at91sam9g45-udc"
	       "atmel,sama5d3-udc"
	       "microchip,sam9x60-udc"
	       "microchip,lan9662-udc"
	       For "microchip,lan9662-udc" the fallback "atmel,sama5d3-udc"
	       is required.
 - reg: Address and length of the register set for the device
 - interrupts: Should contain usba interrupt
 - clocks: Should reference the peripheral and host clocks
 - clock-names: Should contain two strings
		"pclk" for the peripheral clock
		"hclk" for the host clock

Deprecated property:
 - ep childnode: To specify the number of endpoints and their properties.

Optional properties:
 - atmel,vbus-gpio: If present, specifies a gpio that allows to detect whether
   vbus is present (USB is connected).

Deprecated child node properties:
 - name: Name of the endpoint.
 - reg: Num of the endpoint.
 - atmel,fifo-size: Size of the fifo.
 - atmel,nb-banks: Number of banks.
 - atmel,can-dma: Boolean to specify if the endpoint support DMA.
 - atmel,can-isoc: Boolean to specify if the endpoint support ISOC.

usb2: gadget@fff78000 {
	#address-cells = <1>;
	#size-cells = <0>;
	compatible = "atmel,at91sam9rl-udc";
	reg = <0x00600000 0x80000
	       0xfff78000 0x400>;
	interrupts = <27 4 0>;
	clocks = <&utmi>, <&udphs_clk>;
	clock-names = "hclk", "pclk";
	atmel,vbus-gpio = <&pioB 19 0>;
};
```

## Documentation/devicetree/bindings/usb/brcm,bcm3384-usb.txt
```
* Broadcom USB controllers

Required properties:
- compatible: "brcm,bcm3384-ohci", "brcm,bcm3384-ehci"

  These currently use the generic-ohci and generic-ehci drivers.  On some
  systems, special handling may be needed in the following cases:

  - Restoring state after systemwide power save modes
  - Sharing PHYs with the USBD (UDC) hardware
  - Figuring out which controllers are disabled on ASIC bondout variants
```

## Documentation/devicetree/bindings/usb/brcm,bcm7445-ehci.yaml
```yaml
# SPDX-License-Identifier: (GPL-2.0-only OR BSD-2-Clause)
%YAML 1.2
---
$id: http://devicetree.org/schemas/usb/brcm,bcm7445-ehci.yaml#
$schema: http://devicetree.org/meta-schemas/core.yaml#

title: Broadcom STB USB EHCI Controller Device Tree Bindings

allOf:
  - $ref: "usb-hcd.yaml"

maintainers:
  - Al Cooper <alcooperx@gmail.com>

properties:
  compatible:
    const: brcm,bcm7445-ehci

  reg:
    maxItems: 1

  interrupts:
    maxItems: 1

  clocks:
    maxItems: 1
    description: Clock specifier for the EHCI clock

  clock-names:
    const: sw_usb

  phys:
    maxItems: 1

  phy-names:
    const: usbphy

required:
  - compatible
  - reg
  - interrupts
  - phys
  - clocks

additionalProperties: false

examples:
  - |
    usb@f0b00300 {
        compatible = "brcm,bcm7445-ehci";
        reg = <0xf0b00300 0xa8>;
        interrupts = <0x0 0x5a 0x0>;
        phys = <&usbphy_0 0x0>;
        phy-names = "usbphy";
        clocks = <&usb20>;
        clock-names = "sw_usb";
    };

...
```

## Documentation/devicetree/bindings/usb/brcm,bdc.txt
```
Broadcom USB Device Controller (BDC)
====================================

Required properties:

- compatible: must be one of:
                "brcm,bdc-udc-v2"
                "brcm,bdc"
- reg: the base register address and length
- interrupts: the interrupt line for this controller

Optional properties:

On Broadcom STB platforms, these properties are required:

- phys: phandle to one or two USB PHY blocks
        NOTE: Some SoC's have a single phy and some have
        USB 2.0 and USB 3.0 phys
- clocks: phandle to the functional clock of this block

Example:

        bdc@f0b02000 {
                compatible = "brcm,bdc-udc-v2";
                reg = <0xf0b02000 0xfc4>;
                interrupts = <0x0 0x60 0x0>;
                phys = <&usbphy_0 0x0>;
                clocks = <&sw_usbd>;
        };
```
