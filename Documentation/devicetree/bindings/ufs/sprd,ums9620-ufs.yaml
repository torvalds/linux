## Documentation/devicetree/bindings/ufs/sprd,ums9620-ufs.yaml
```yaml
# SPDX-License-Identifier: (GPL-2.0-only OR BSD-2-Clause)
%YAML 1.2
---
$id: http://devicetree.org/schemas/ufs/sprd,ums9620-ufs.yaml#
$schema: http://devicetree.org/meta-schemas/core.yaml#

title: Unisoc Universal Flash Storage (UFS) Controller

maintainers:
  - Zhe Wang <zhe.wang1@unisoc.com>

allOf:
  - $ref: ufs-common.yaml

properties:
  compatible:
    const: sprd,ums9620-ufs

  reg:
    maxItems: 1

  clocks:
    maxItems: 3

  clock-names:
    items:
      - const: controller_eb
      - const: cfg_eb
      - const: core

  resets:
    maxItems: 2

  reset-names:
    items:
      - const: controller
      - const: device

  vdd-mphy-supply:
    description:
      Phandle to vdd-mphy supply regulator node.

  sprd,ufs-anlg-syscon:
    $ref: /schemas/types.yaml#/definitions/phandle
    description: phandle of syscon used to control ufs analog regs.

  sprd,aon-apb-syscon:
    $ref: /schemas/types.yaml#/definitions/phandle
    description: phandle of syscon used to control always-on regs.

required:
  - compatible
  - reg
  - clocks
  - clock-names
  - resets
  - reset-names

unevaluatedProperties: false

examples:
  - |
    #include <dt-bindings/interrupt-controller/arm-gic.h>

    ufs: ufs@22000000 {
        compatible = "sprd,ums9620-ufs";
        reg = <0x22000000 0x3000>;
        interrupts = <GIC_SPI 159 IRQ_TYPE_LEVEL_HIGH>;
        vcc-supply = <&vddemmccore>;
        vdd-mphy-supply = <&vddufs1v2>;
        clocks = <&apahb_gate 5>, <&apahb_gate 22>, <&aonapb_clk 52>;
        clock-names = "controller_eb", "cfg_eb", "core";
        assigned-clocks = <&aonapb_clk 52>;
        assigned-clock-parents = <&g5l_pll 12>;
        resets = <&apahb_gate 4>, <&aonapb_gate 69>;
        reset-names = "controller", "device";
        sprd,ufs-anlg-syscon = <&anlg_phy_g12_regs>;
        sprd,aon-apb-syscon = <&aon_apb_regs>;
    };
```

## Documentation/devicetree/bindings/ufs/tc-dwc-g210-pltfrm.txt
```
* Universal Flash Storage (UFS) DesignWare Host Controller

DWC_UFS nodes are defined to describe on-chip UFS host controllers and MPHY.
Each UFS controller instance should have its own node.

Required properties:
- compatible	: compatible list must contain the PHY type & version:
			"snps,g210-tc-6.00-20bit"
			"snps,g210-tc-6.00-40bit"
		  complemented with the Controller IP version:
			"snps,dwc-ufshcd-1.40a"
		  complemented with the JEDEC version:
			"jedec,ufs-1.1"
			"jedec,ufs-2.0"

- reg		: <registers mapping>
- interrupts	: <interrupt mapping for UFS host controller IRQ>

Example for a setup using a 1.40a DWC Controller with a 6.00 G210 40-bit TC:
	dwc-ufs@d0000000 {
		compatible = "snps,g210-tc-6.00-40bit",
			     "snps,dwc-ufshcd-1.40a",
			     "jedec,ufs-2.0";
		reg = < 0xd0000000 0x10000 >;
		interrupts = < 24 >;
	};
```

## Documentation/devicetree/bindings/ufs/ti,j721e-ufs.yaml
```yaml
# SPDX-License-Identifier: GPL-2.0
%YAML 1.2
---
$id: http://devicetree.org/schemas/ufs/ti,j721e-ufs.yaml#
$schema: http://devicetree.org/meta-schemas/core.yaml#

title: TI J721e UFS Host Controller Glue Driver

maintainers:
  - Vignesh Raghavendra <vigneshr@ti.com>

properties:
  compatible:
    items:
      - const: ti,j721e-ufs

  reg:
    maxItems: 1
    description: address of TI UFS glue registers

  clocks:
    maxItems: 1
    description: phandle to the M-PHY clock

  power-domains:
    maxItems: 1

  assigned-clocks:
    maxItems: 1

  assigned-clock-parents:
    maxItems: 1

  "#address-cells":
    const: 2

  "#size-cells":
    const: 2

  ranges: true

required:
  - compatible
  - reg
  - clocks
  - power-domains

patternProperties:
  "^ufs@[0-9a-f]+$":
    $ref: cdns,ufshc.yaml
    description: |
      Cadence UFS controller node must be the child node.
    unevaluatedProperties: false

additionalProperties: false

examples:
  - |
    #include <dt-bindings/interrupt-controller/irq.h>
    #include <dt-bindings/interrupt-controller/arm-gic.h>

    bus {
        #address-cells = <2>;
        #size-cells = <2>;

        ufs-wrapper@4e80000 {
            compatible = "ti,j721e-ufs";
            reg = <0x0 0x4e80000 0x0 0x100>;
            power-domains = <&k3_pds 277>;
            clocks = <&k3_clks 277 1>;
            assigned-clocks = <&k3_clks 277 1>;
            assigned-clock-parents = <&k3_clks 277 4>;

            ranges = <0x0 0x0 0x0 0x4e80000 0x0 0x14000>;
            #address-cells = <2>;
            #size-cells = <2>;

            ufs@4000 {
                compatible = "cdns,ufshc-m31-16nm", "jedec,ufs-2.0";
                reg = <0x0 0x4000 0x0 0x10000>;
                interrupts = <GIC_SPI 17 IRQ_TYPE_LEVEL_HIGH>;
                freq-table-hz = <19200000 19200000>;
                power-domains = <&k3_pds 277>;
                clocks = <&k3_clks 277 1>;
                assigned-clocks = <&k3_clks 277 1>;
                assigned-clock-parents = <&k3_clks 277 4>;
                clock-names = "core_clk";
            };
        };
    };
```

## Documentation/devicetree/bindings/ufs/ufs-common.yaml
```yaml
# SPDX-License-Identifier: GPL-2.0-only OR BSD-2-Clause
%YAML 1.2
---
$id: http://devicetree.org/schemas/ufs/ufs-common.yaml#
$schema: http://devicetree.org/meta-schemas/core.yaml#

title: Common properties for Universal Flash Storage (UFS) Host Controllers

maintainers:
  - Alim Akhtar <alim.akhtar@samsung.com>
  - Avri Altman <avri.altman@wdc.com>

properties:
  clocks: true

  clock-names: true

  freq-table-hz:
    items:
      items:
        - description: Minimum frequency for given clock in Hz
        - description: Maximum frequency for given clock in Hz
    deprecated: true
    description: |
      Preferred is operating-points-v2.

      Array of <min max> operating frequencies in Hz stored in the same order
      as the clocks property. If either this property or operating-points-v2 is
      not defined or a value in the array is "0" then it is assumed that the
      frequency is set by the parent clock or a fixed rate clock source.

  operating-points-v2:
    description:
      Preferred over freq-table-hz.
      If present, each OPP must contain array of frequencies stored in the same
      order for each clock.  If clock frequency in the array is "0" then it is
      assumed that the frequency is set by the parent clock or a fixed rate
      clock source.

  opp-table:
    type: object

  interrupts:
    maxItems: 1

  lanes-per-direction:
    $ref: /schemas/types.yaml#/definitions/uint32
    enum: [1, 2]
    default: 2
    description:
      Number of lanes available per direction.  Note that it is assume same
      number of lanes is used both directions at once.

  vdd-hba-supply:
    description:
      Phandle to UFS host controller supply regulator node.

  vcc-supply:
    description:
      Phandle to VCC supply regulator node.

  vccq-supply:
    description:
      Phandle to VCCQ supply regulator node.

  vccq2-supply:
    description:
      Phandle to VCCQ2 supply regulator node.

  vcc-supply-1p8:
    type: boolean
    description:
      For embedded UFS devices, valid VCC range is 1.7-1.95V or 2.7-3.6V. This
      boolean property when set, specifies to use low voltage range of
      1.7-1.95V. Note for external UFS cards this property is invalid and valid
      VCC range is always 2.7-3.6V.

  vcc-max-microamp:
    description:
      Specifies max. load that can be drawn from VCC supply.

  vccq-max-microamp:
    description:
      Specifies max. load that can be drawn from VCCQ supply.

  vccq2-max-microamp:
    description:
      Specifies max. load that can be drawn from VCCQ2 supply.

dependencies:
  freq-table-hz: [ clocks ]
  operating-points-v2: [ clocks, clock-names ]

required:
  - interrupts

allOf:
  - if:
      required:
        - freq-table-hz
    then:
      properties:
        operating-points-v2: false
  - if:
      required:
        - operating-points-v2
    then:
      properties:
        freq-table-hz: false

additionalProperties: true
```

## Documentation/devicetree/bindings/ufs/ufs-hisi.txt
```
* Hisilicon Universal Flash Storage (UFS) Host Controller

UFS nodes are defined to describe on-chip UFS hardware macro.
Each UFS Host Controller should have its own node.

Required properties:
- compatible        : compatible list, contains one of the following -
					"hisilicon,hi3660-ufs", "jedec,ufs-1.1" for hisi ufs
					host controller present on Hi3660 chipset.
					"hisilicon,hi3670-ufs", "jedec,ufs-2.1" for hisi ufs
					host controller present on Hi3670 chipset.
- reg               : should contain UFS register address space & UFS SYS CTRL register address,
- interrupts        : interrupt number
- clocks	        : List of phandle and clock specifier pairs
- clock-names       : List of clock input name strings sorted in the same
					order as the clocks property. "ref_clk", "phy_clk" is optional
- freq-table-hz     : Array of <min max> operating frequencies stored in the same
                      order as the clocks property. If this property is not
                      defined or a value in the array is "0" then it is assumed
                      that the frequency is set by the parent clock or a
                      fixed rate clock source.
- resets            : describe reset node register
- reset-names       : reset node register, the "rst" corresponds to reset the whole UFS IP.

Example:

	ufs: ufs@ff3b0000 {
		compatible = "hisilicon,hi3660-ufs", "jedec,ufs-1.1";
		/* 0: HCI standard */
		/* 1: UFS SYS CTRL */
		reg = <0x0 0xff3b0000 0x0 0x1000>,
			<0x0 0xff3b1000 0x0 0x1000>;
		interrupt-parent = <&gic>;
		interrupts = <GIC_SPI 278 IRQ_TYPE_LEVEL_HIGH>;
		clocks = <&crg_ctrl HI3660_CLK_GATE_UFSIO_REF>,
			<&crg_ctrl HI3660_CLK_GATE_UFSPHY_CFG>;
		clock-names = "ref_clk", "phy_clk";
		freq-table-hz = <0 0>, <0 0>;
		/* offset: 0x84; bit: 12  */
		resets = <&crg_rst 0x84 12>;
		reset-names = "rst";
	};
```

## Documentation/devicetree/bindings/ufs/ufs-mediatek.txt
```
* Mediatek Universal Flash Storage (UFS) Host Controller

UFS nodes are defined to describe on-chip UFS hardware macro.
Each UFS Host Controller should have its own node.

To bind UFS PHY with UFS host controller, the controller node should
contain a phandle reference to UFS M-PHY node.

Required properties for UFS nodes:
- compatible         : Compatible list, contains the following controller:
                       "mediatek,mt8183-ufshci" for MediaTek UFS host controller
                       present on MT8183 chipsets.
                       "mediatek,mt8192-ufshci" for MediaTek UFS host controller
                       present on MT8192 chipsets.
- reg                : Address and length of the UFS register set.
- phys               : phandle to m-phy.
- clocks             : List of phandle and clock specifier pairs.
- clock-names        : List of clock input name strings sorted in the same
                       order as the clocks property. "ufs" is mandatory.
                       "ufs": ufshci core control clock.
- freq-table-hz      : Array of <min max> operating frequencies stored in the same
                       order as the clocks property. If this property is not
                       defined or a value in the array is "0" then it is assumed
                       that the frequency is set by the parent clock or a
                       fixed rate clock source.
- vcc-supply         : phandle to VCC supply regulator node.

Example:

	ufsphy: phy@11fa0000 {
		...
	};

	ufshci@11270000 {
		compatible = "mediatek,mt8183-ufshci";
		reg = <0 0x11270000 0 0x2300>;
		interrupts = <GIC_SPI 104 IRQ_TYPE_LEVEL_LOW>;
		phys = <&ufsphy>;

		clocks = <&infracfg_ao INFRACFG_AO_UFS_CG>;
		clock-names = "ufs";
		freq-table-hz = <0 0>;

		vcc-supply = <&mt_pmic_vemc_ldo_reg>;
	};
```

## Documentation/devicetree/bindings/ufs/ufs-qcom.txt
```
* Qualcomm Technologies Inc Universal Flash Storage (UFS) PHY

UFSPHY nodes are defined to describe on-chip UFS PHY hardware macro.
Each UFS PHY node should have its own node.

To bind UFS PHY with UFS host controller, the controller node should
contain a phandle reference to UFS PHY node.

Required properties:
- compatible        : compatible list, contains one of the following -
			"qcom,ufs-phy-qmp-20nm" for 20nm ufs phy,
			"qcom,ufs-phy-qmp-14nm" for legacy 14nm ufs phy,
			"qcom,msm8996-ufs-phy-qmp-14nm" for 14nm ufs phy
			 present on MSM8996 chipset.
- reg               : should contain PHY register address space (mandatory),
- reg-names         : indicates various resources passed to driver (via reg proptery) by name.
                      Required "reg-names" is "phy_mem".
- #phy-cells        : This property shall be set to 0
- vdda-phy-supply   : phandle to main PHY supply for analog domain
- vdda-pll-supply   : phandle to PHY PLL and Power-Gen block power supply
- clocks	    : List of phandle and clock specifier pairs
- clock-names       : List of clock input name strings sorted in the same
		      order as the clocks property. "ref_clk_src", "ref_clk",
		      "tx_iface_clk" & "rx_iface_clk" are mandatory but
		      "ref_clk_parent" is optional

Optional properties:
- vdda-phy-max-microamp : specifies max. load that can be drawn from phy supply
- vdda-pll-max-microamp : specifies max. load that can be drawn from pll supply
- vddp-ref-clk-supply   : phandle to UFS device ref_clk pad power supply
- vddp-ref-clk-max-microamp : specifies max. load that can be drawn from this supply

Example:

	ufsphy1: ufsphy@0xfc597000 {
		compatible = "qcom,ufs-phy-qmp-20nm";
		reg = <0xfc597000 0x800>;
		reg-names = "phy_mem";
		#phy-cells = <0>;
		vdda-phy-supply = <&pma8084_l4>;
		vdda-pll-supply = <&pma8084_l12>;
		vdda-phy-max-microamp = <50000>;
		vdda-pll-max-microamp = <1000>;
		clock-names = "ref_clk_src",
			"ref_clk_parent",
			"ref_clk",
			"tx_iface_clk",
			"rx_iface_clk";
		clocks = <&clock_rpm clk_ln_bb_clk>,
			<&clock_gcc clk_pcie_1_phy_ldo >,
			<&clock_gcc clk_ufs_phy_ldo>,
			<&clock_gcc clk_gcc_ufs_tx_cfg_clk>,
			<&clock_gcc clk_gcc_ufs_rx_cfg_clk>;
	};

	ufshc@0xfc598000 {
		...
		phys = <&ufsphy1>;
		phy-names = "ufsphy";
	};
```
