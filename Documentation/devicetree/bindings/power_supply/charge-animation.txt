## Documentation/devicetree/bindings/power_supply/charge-animation.txt
```
charge-animation
~~~~~~~~~~~~~~~~

Required properties :
 - compatible: "rockchip,uboot-charge"
 - rockchip,uboot-charge-on: enable uboot charge animation
 - rockchip,android-charge-on: enable android charge animation,
	either uboot charge animation or android charge animation
	can be executed, but not both

Optional properties :
 - rockchip,uboot-low-power-voltage: voltage threshold of power off
 - rockchip,screen-on-voltage: voltage threshold of screen on

Example:

	charge-animation {
		compatible = "rockchip,uboot-charge";
		rockchip,uboot-charge-on = <1>;
		rockchip,android-charge-on = <0>;
		rockchip,uboot-low-power-voltage = <3500>;
		rockchip,screen-on-voltage = <3600>;
		status = "okay";
	};
```

## Documentation/devicetree/bindings/power_supply/charger-manager.txt
```
charger-manager bindings
~~~~~~~~~~~~~~~~~~~~~~~~

Required properties :
 - compatible : "charger-manager"
 - <>-supply : for regulator consumer
 - cm-num-chargers : number of chargers
 - cm-chargers : name of chargers
 - cm-fuel-gauge : name of battery fuel gauge
 - subnode <regulator> :
	- cm-regulator-name : name of charger regulator
	- subnode <cable> :
		- cm-cable-name : name of charger cable
		- cm-cable-extcon : name of extcon dev
(optional)	- cm-cable-min : minimum current of cable
(optional)	- cm-cable-max : maximum current of cable

Optional properties :
 - cm-name : charger manager's name (default : "battery")
 - cm-poll-mode : polling mode (enum polling_modes)
 - cm-poll-interval : polling interval
 - cm-battery-stat : battery status (enum data_source)
 - cm-fullbatt-* : data for full battery checking
 - cm-thermal-zone : name of external thermometer's thermal zone
 - cm-battery-* : threshold battery temperature for charging
	-cold : critical cold temperature of battery for charging
	-cold-in-minus : flag that cold temerature is in minus degree
	-hot : critical hot temperature of battery for charging
	-temp-diff : temperature difference to allow recharging
 - cm-dis/charging-max = limits of charging duration

Example :
	charger-manager@0 {
		compatible = "charger-manager";
		chg-reg-supply = <&charger_regulator>;

		cm-name = "battery";
		/* Always polling ON : 30s */
		cm-poll-mode = <1>;
		cm-poll-interval = <30000>;

		cm-fullbatt-vchkdrop-ms = <30000>;
		cm-fullbatt-vchkdrop-volt = <150000>;
		cm-fullbatt-soc = <100>;

		cm-battery-stat = <3>;

		cm-num-chargers = <3>;
		cm-chargers = "charger0", "charger1", "charger2";

		cm-fuel-gauge = "fuelgauge0";

		cm-thermal-zone = "thermal_zone.1"
		/* in deci centigrade */
		cm-battery-cold = <50>;
		cm-battery-cold-in-minus;
		cm-battery-hot = <800>;
		cm-battery-temp-diff = <100>;

		/* Allow charging for 5hr */
		cm-charging-max = <18000000>;
		/* Allow discharging for 2hr */
		cm-discharging-max = <7200000>;

		regulator@0 {
			cm-regulator-name = "chg-reg";
			cable@0 {
				cm-cable-name = "USB";
				cm-cable-extcon = "extcon-dev.0";
				cm-cable-min = <475000>;
				cm-cable-max = <500000>;
			};
			cable@1 {
				cm-cable-name = "TA";
				cm-cable-extcon = "extcon-dev.0";
				cm-cable-min = <650000>;
				cm-cable-max = <675000>;
			};
		};

	};
```

## Documentation/devicetree/bindings/power_supply/max17042_battery.txt
```
max17042_battery
~~~~~~~~~~~~~~~~

Required properties :
 - compatible : "maxim,max17042"

Optional properties :
 - maxim,rsns-microohm : Resistance of rsns resistor in micro Ohms
                         (datasheet-recommended value is 10000).
   Defining this property enables current-sense functionality.

Example:

	battery-charger@36 {
		compatible = "maxim,max17042";
		reg = <0x36>;
		maxim,rsns-microohm = <10000>;
	};
```

## Documentation/devicetree/bindings/power_supply/max8925_batter.txt
```
max8925-battery bindings
~~~~~~~~~~~~~~~~

Optional properties :
 - batt-detect: whether support battery detect
 - topoff-threshold: set charging current in topoff mode
 - fast-charge: set charging current in fast mode
 - no-temp-support: whether support temperature protection detect
 - no-insert-detect: whether support insert detect

Example:
	charger {
		batt-detect = <0>;
		topoff-threshold = <1>;
		fast-charge = <7>;
		no-temp-support = <0>;
		no-insert-detect = <0>;
	};
```

## Documentation/devicetree/bindings/power_supply/msm-poweroff.txt
```
MSM Restart Driver

A power supply hold (ps-hold) bit is set to power the msm chipsets.
Clearing that bit allows us to restart/poweroff. The difference
between poweroff and restart is determined by unique power manager IC
settings.

Required Properties:
-compatible: "qcom,pshold"
-reg: Specifies the physical address of the ps-hold register

Example:

	restart@fc4ab000 {
		compatible = "qcom,pshold";
		reg = <0xfc4ab000 0x4>;
	};
```

## Documentation/devicetree/bindings/power_supply/power_supply.txt
```
Power Supply Core Support

Optional Properties:
 - power-supplies : This property is added to a supply in order to list the
   devices which supply it power, referenced by their phandles.

Example:

	usb-charger: power@e {
		compatible = "some,usb-charger";
		...
	};

	ac-charger: power@c {
		compatible = "some,ac-charger";
		...
	};

	battery@b {
		compatible = "some,battery";
		...
		power-supplies = <&usb-charger>, <&ac-charger>;
	};
```

## Documentation/devicetree/bindings/power_supply/qnap-poweroff.txt
```
* QNAP Power Off

QNAP NAS devices have a microcontroller controlling the main power
supply. This microcontroller is connected to UART1 of the Kirkwood and
Orion5x SoCs. Sending the character 'A', at 19200 baud, tells the
microcontroller to turn the power off. This driver adds a handler to
pm_power_off which is called to turn the power off.

Required Properties:
- compatible: Should be "qnap,power-off"

- reg: Address and length of the register set for UART1
- clocks: tclk clock
```

## Documentation/devicetree/bindings/power_supply/rk816-battery.txt
```
rk816-battery
~~~~~~~~~~

Required properties :
 - compatible: "rk816-battery"
 - ocv_table: ocv voltage and soc relation table
 - design_capacity: real capacity tested by tool
 - design_qmax: nominal capacity * 1.1
 - max_input_current: maximum current from adapter
 - max_chrg_current: maximum current for battery charge
 - max_chrg_voltage: maximum charge voltage for battery

Optional properties :
 - sleep_enter_current: current threshold of enter relax mode
 - sleep_exit_current: current threshold of exit relax mode
 - sleep_filter_current: current threshold of valid relax mode
 - power_off_thresd: vsys voltage threshold of power off
 - zero_algorithm_vol: voltage threshold of discharge zero algorithm
 - fb_temperature: feed back temperature of PMIC
 - max_soc_offset: soc threshold of correct dsoc as rsoc
 - monitor_sec: poll seconds for battery delay work
 - virtual_power: test mode for none battery
 - energy_mode: try to use all power of battery
 - power_dc2otg: dc can provide supply for otg 5v
 - dc_det_adc: dc detect by saradc

Example:

rk816: pmic@1a {
	compatible = "rockchip,rk816";
	reg = <0x1a>;
	interrupt-parent = <&gpio0>;
	interrupts = <2 IRQ_TYPE_LEVEL_LOW>;
	pinctrl-names = "default";
	pinctrl-0 = <&pmic_int_l>;

	......

	battery {
		compatible = "rk816-battery";
		ocv_table = <3400 3654 3686 3710 3744 3775 3803
			     3825 3843 3858 3870 3886 3955 3988
			     4010 4023 4032 4049 4080 4151>;
		design_capacity = <2000>;
		design_qmax = <2200>;
		bat_res = <120>;
		max_input_current = <2000>;
		max_chrg_current = <1000>;
		max_chrg_voltage = <4200>;
		sleep_enter_current = <300>;
		sleep_exit_current = <300>;
		sleep_filter_current = <100>;
		power_off_thresd = <3500>;
		zero_algorithm_vol = <3800>;
		fb_temperature = <105>;
		max_soc_offset = <60>;
		monitor_sec = <5>;
		virtual_power = <0>;
		energy_mode = <0>;
		power_dc2otg = <0>;
		dc_det_adc = <0>;
	};

	......
};
```

## Documentation/devicetree/bindings/power_supply/rk817-battery.txt
```
rk817-battery
~~~~~~~~~~

Required properties :
 - compatible: "rk817,battery"
 - ocv_table: ocv voltage and soc relation table
 - design_capacity: real capacity tested by tool
 - design_qmax: nominal capacity * 1.1

Optional properties :
 - sleep_enter_current: current threshold of enter relax mode
 - sleep_exit_current: current threshold of exit relax mode
 - sleep_filter_current: current threshold of valid relax mode
 - power_off_thresd: vsys voltage threshold of power off
 - zero_algorithm_vol: voltage threshold of discharge zero algorithm
 - max_soc_offset: soc threshold of correct dsoc as rsoc
 - monitor_sec: poll seconds for battery delay work
 - virtual_power: test mode for none battery
 - energy_mode: try to use all power of battery

Example:

rk817: pmic@20 {
	compatible = "rockchip,rk817";
	reg = <0x20>;

	......

	battery {
		compatible = "rk817,battery";
		ocv_table = <3400 3654 3686 3710 3744 3775 3803
			     3825 3843 3858 3870 3886 3955 3988
			     4010 4023 4032 4049 4080 4151>;
		design_capacity = <2000>;
		design_qmax = <2200>;
		bat_res = <120>;
		sleep_enter_current = <300>;
		sleep_exit_current = <300>;
		sleep_filter_current = <100>;
		power_off_thresd = <3500>;
		zero_algorithm_vol = <3800>;
		max_soc_offset = <60>;
		monitor_sec = <5>;
		virtual_power = <0>;
		energy_mode = <0>;
	};

	......
};
```

## Documentation/devicetree/bindings/power_supply/ti,bq24735.txt
```
TI BQ24735 Charge Controller
~~~~~~~~~~

Required properties :
 - compatible : "ti,bq24735"

Optional properties :
 - interrupts : Specify the interrupt to be used to trigger when the AC
   adapter is either plugged in or removed.
 - ti,ac-detect-gpios : This GPIO is optionally used to read the AC adapter
   presence. This is a Host GPIO that is configured as an input and
   connected to the bq24735.
 - ti,charge-current : Used to control and set the charging current. This value
   must be between 128mA and 8.128A with a 64mA step resolution. The POR value
   is 0x0000h. This number is in mA (e.g. 8192), see spec for more information
   about the ChargeCurrent (0x14h) register.
 - ti,charge-voltage : Used to control and set the charging voltage. This value
   must be between 1.024V and 19.2V with a 16mV step resolution. The POR value
   is 0x0000h. This number is in mV (e.g. 19200), see spec for more information
   about the ChargeVoltage (0x15h) register.
 - ti,input-current : Used to control and set the charger input current. This
   value must be between 128mA and 8.064A with a 128mA step resolution. The
   POR value is 0x1000h. This number is in mA (e.g. 8064), see the spec for
   more information about the InputCurrent (0x3fh) register.

Example:

	bq24735@9 {
		compatible = "ti,bq24735";
		reg = <0x9>;
		ti,ac-detect-gpios = <&gpio 72 0x1>;
	}
```

## Documentation/devicetree/bindings/power_supply/ti_bq20z75.txt
```
TI bq20z75
~~~~~~~~~~

Required properties :
 - compatible : "ti,bq20z75"

Optional properties :
 - ti,i2c-retry-count : The number of times to retry i2c transactions on i2c
   IO failure.
 - ti,poll-retry-count : The number of times to try looking for new status
   after an external change notification.
 - ti,battery-detect-gpios : The gpio which signals battery detection and
   a flag specifying its polarity.

Example:

	bq20z75@b {
		compatible = "ti,bq20z75";
		reg = < 0xb >;
		ti,i2c-retry-count = <2>;
		ti,poll-retry-count = <10>;
		ti,battery-detect-gpios = <&gpio-controller 122 1>;
	}
```

## Documentation/devicetree/bindings/power_supply/tps65090.txt
```
TPS65090 Frontend PMU with Switchmode Charger

Required Properties:
-compatible: "ti,tps65090"
-reg: I2C slave address
-interrupts: the interrupt output to which this device connects

Optional Properties:
-ti,enable-low-current-chrg: Enables charging when a low current is detected
 while the default logic is to stop charging.

Example:

	tps65090@48 {
		compatible = "ti,tps65090";
		reg = <0x48>;
		interrupts = <0 88 0x4>;

		ti,enable-low-current-chrg;

		regulators {
			...
		};
```

## Documentation/devicetree/bindings/power_supply/tps65217_charger.txt
```
TPS65217 Charger

Required Properties:
-compatible: "ti,tps65217-charger"

This node is a subnode of the tps65217 PMIC.

Example:

	tps65217-charger {
		compatible = "ti,tps65090-charger";
	};
```

## Documentation/devicetree/bindings/powerpc/4xx/akebono.txt
```
IBM Akeboanal board device tree
=============================

The IBM Akeboanal board is a development board for the PPC476GTR SoC.

0) The root analde

   Required properties:

   - model : "ibm,akeboanal".
   - compatible : "ibm,akeboanal" , "ibm,476gtr".

1.a) The Secure Digital Host Controller Interface (SDHCI) analde

  Represent the Secure Digital Host Controller Interfaces.

  Required properties:

   - compatible : should be "ibm,476gtr-sdhci","generic-sdhci".
   - reg : should contain the SDHCI registers location and length.
   - interrupts : should contain the SDHCI interrupt.

1.b) The Advanced Host Controller Interface (AHCI) SATA analde

  Represents the advanced host controller SATA interface.

  Required properties:

   - compatible : should be "ibm,476gtr-ahci".
   - reg : should contain the AHCI registers location and length.
   - interrupts : should contain the AHCI interrupt.

1.c) The FPGA analde

  The Akeboanal board stores some board information such as the revision
  number in an FPGA which is represented by this analde.

  Required properties:

   - compatible : should be "ibm,akeboanal-fpga".
   - reg : should contain the FPGA registers location and length.

1.d) The AVR analde

  The Akeboanal board has an Atmel AVR microprocessor attached to the I2C
  bus as a power controller for the board.

  Required properties:

   - compatible : should be "ibm,akeboanal-avr".
   - reg : should contain the I2C bus address for the AVR.
```

## Documentation/devicetree/bindings/powerpc/4xx/cpm.txt
```
PPC4xx Clock Power Management (CPM) node

Required properties:
	- compatible		: compatible list, currently only "ibm,cpm"
	- dcr-access-method	: "native"
	- dcr-reg		: < DCR register range >

Optional properties:
	- er-offset		: All 4xx SoCs with a CPM controller have
				  one of two different order for the CPM
				  registers. Some have the CPM registers
				  in the following order (ER,FR,SR). The
				  others have them in the following order
				  (SR,ER,FR). For the second case set
				  er-offset = <1>.
	- unused-units		: specifier consist of one cell. For each
				  bit in the cell, the corresponding bit
				  in CPM will be set to turn off unused
				  devices.
	- idle-doze		: specifier consist of one cell. For each
				  bit in the cell, the corresponding bit
				  in CPM will be set to turn off unused
				  devices. This is usually just CPM[CPU].
	- standby		: specifier consist of one cell. For each
				  bit in the cell, the corresponding bit
				  in CPM will be set on standby and
				  restored on resume.
	- suspend		: specifier consist of one cell. For each
				  bit in the cell, the corresponding bit
				  in CPM will be set on suspend (mem) and
				  restored on resume. Note, for standby
				  and suspend the corresponding bits can
				  be different or the same. Usually for
				  standby only class 2 and 3 units are set.
				  However, the interface does not care.
				  If they are the same, the additional
				  power saving will be seeing if support
				  is available to put the DDR in self
				  refresh mode and any additional power
				  saving techniques for the specific SoC.

Example:
	CPM0: cpm {
		compatible = "ibm,cpm";
		dcr-access-method = "native";
		dcr-reg = <0x160 0x003>;
		er-offset = <0>;
		unused-units = <0x00000100>;
		idle-doze = <0x02000000>;
		standby = <0xfeff0000>;
		suspend = <0xfeff791d>;
};
```
