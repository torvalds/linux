## Documentation/devicetree/bindings/powerpc/fsl/cpm_qe/qe.txt
```
* Freescale QUICC Engine module (QE)
This represents qe module that is installed on PowerQUICC II Pro.

NOTE:  This is an interim binding; it should be updated to fit
in with the CPM binding later in this document.

Basically, it is a bus of devices, that could act more or less
as a complete entity (UCC, USB etc ). All of them should be siblings on
the "root" qe node, using the common properties from there.
The description below applies to the qe of MPC8360 and
more nodes and properties would be extended in the future.

i) Root QE device

Required properties:
- compatible : should be "fsl,qe";
- model : precise model of the QE, Can be "QE", "CPM", or "CPM2"
- reg : offset and length of the device registers.
- bus-frequency : the clock frequency for QUICC Engine.
- fsl,qe-num-riscs: define how many RISC engines the QE has.
- fsl,qe-num-snums: define how many serial number(SNUM) the QE can use for the
  threads.

Optional properties:
- fsl,firmware-phandle:
    Usage: required only if there is no fsl,qe-firmware child node
    Value type: <phandle>
    Definition: Points to a firmware node (see "QE Firmware Node" below)
        that contains the firmware that should be uploaded for this QE.
        The compatible property for the firmware node should say,
        "fsl,qe-firmware".

Recommended properties
- brg-frequency : the internal clock source frequency for baud-rate
  generators in Hz.

Example:
     qe@e0100000 {
	#address-cells = <1>;
	#size-cells = <1>;
	#interrupt-cells = <2>;
	compatible = "fsl,qe";
	ranges = <0 e0100000 00100000>;
	reg = <e0100000 480>;
	brg-frequency = <0>;
	bus-frequency = <179A7B00>;
     }

* Multi-User RAM (MURAM)

Required properties:
- compatible : should be "fsl,qe-muram", "fsl,cpm-muram".
- mode : the could be "host" or "slave".
- ranges : Should be defined as specified in 1) to describe the
   translation of MURAM addresses.
- data-only : sub-node which defines the address area under MURAM
   bus that can be allocated as data/parameter

Example:

     muram@10000 {
	compatible = "fsl,qe-muram", "fsl,cpm-muram";
	ranges = <0 00010000 0000c000>;

	data-only@0{
		compatible = "fsl,qe-muram-data",
			     "fsl,cpm-muram-data";
		reg = <0 c000>;
	};
     };

* Interrupt Controller (IC)

Required properties:
- compatible : should be "fsl,qe-ic".
- reg : Address range of IC register set.
- interrupts : interrupts generated by the device.
- interrupt-controller : this device is a interrupt controller.

Example:

	qeic: interrupt-controller@80 {
		interrupt-controller;
		compatible = "fsl,qe-ic";
		#address-cells = <0>;
		#interrupt-cells = <1>;
		reg = <0x80 0x80>;
		interrupts = <95 2 0 0  94 2 0 0>;
	};

* Serial Interface Block (SI)

The SI manages the routing of eight TDM lines to the QE block serial drivers
, the MCC and the UCCs, for receive and transmit.

Required properties:
- compatible : must be "fsl,<chip>-qe-si". For t1040, must contain
  "fsl,t1040-qe-si".
- reg : Address range of SI register set.

Example:

	si1: si@700 {
		compatible = "fsl,t1040-qe-si";
		reg = <0x700 0x80>;
	};

* Serial Interface Block RAM(SIRAM)

store the routing entries of SI

Required properties:
- compatible : should be "fsl,<chip>-qe-siram". For t1040, must contain
  "fsl,t1040-qe-siram".
- reg : Address range of SI RAM.

Example:

	siram1: siram@1000 {
		compatible = "fsl,t1040-qe-siram";
		reg = <0x1000 0x800>;
	};

* QE Firmware Node

This node defines a firmware binary that is embedded in the device tree, for
the purpose of passing the firmware from bootloader to the kernel, or from
the hypervisor to the guest.

The firmware node itself contains the firmware binary contents, a compatible
property, and any firmware-specific properties.  The node should be placed
inside a QE node that needs it.  Doing so eliminates the need for a
fsl,firmware-phandle property.  Other QE nodes that need the same firmware
should define an fsl,firmware-phandle property that points to the firmware node
in the first QE node.

The fsl,firmware property can be specified in the DTS (possibly using incbin)
or can be inserted by the boot loader at boot time.

Required properties:
  - compatible
      Usage: required
      Value type: <string>
      Definition: A standard property.  Specify a string that indicates what
          kind of firmware it is.  For QE, this should be "fsl,qe-firmware".

   - fsl,firmware
      Usage: required
      Value type: <prop-encoded-array>, encoded as an array of bytes
      Definition: A standard property.  This property contains the firmware
          binary "blob".

Example:
	qe1@e0080000 {
		compatible = "fsl,qe";
		qe_firmware:qe-firmware {
			compatible = "fsl,qe-firmware";
			fsl,firmware = [0x70 0xcd 0x00 0x00 0x01 0x46 0x45 ...];
		};
		...
	};

	qe2@e0090000 {
		compatible = "fsl,qe";
		fsl,firmware-phandle = <&qe_firmware>;
		...
	};
```

## Documentation/devicetree/bindings/powerpc/fsl/cpm_qe/qe/pincfg.txt
```
* Pin configuration nodes

Required properties:
- linux,phandle : phandle of this node; likely referenced by a QE
  device.
- pio-map : array of pin configurations.  Each pin is defined by 6
  integers.  The six numbers are respectively: port, pin, dir,
  open_drain, assignment, has_irq.
  - port : port number of the pin; 0-6 represent port A-G in UM.
  - pin : pin number in the port.
  - dir : direction of the pin, should encode as follows:

     0 = The pin is disabled
     1 = The pin is an output
     2 = The pin is an input
     3 = The pin is I/O

  - open_drain : indicates the pin is normal or wired-OR:

     0 = The pin is actively driven as an output
     1 = The pin is an open-drain driver. As an output, the pin is
         driven active-low, otherwise it is three-stated.

  - assignment : function number of the pin according to the Pin Assignment
    tables in User Manual.  Each pin can have up to 4 possible functions in
    QE and two options for CPM.
  - has_irq : indicates if the pin is used as source of external
    interrupts.

Example:
     ucc_pin@01 {
	linux,phandle = <140001>;
	pio-map = <
	/* port  pin  dir  open_drain  assignment  has_irq */
		0  3  1  0  1  0 	/* TxD0 */
		0  4  1  0  1  0 	/* TxD1 */
		0  5  1  0  1  0 	/* TxD2 */
		0  6  1  0  1  0 	/* TxD3 */
		1  6  1  0  3  0 	/* TxD4 */
		1  7  1  0  1  0 	/* TxD5 */
		1  9  1  0  2  0 	/* TxD6 */
		1  a  1  0  2  0 	/* TxD7 */
		0  9  2  0  1  0 	/* RxD0 */
		0  a  2  0  1  0 	/* RxD1 */
		0  b  2  0  1  0 	/* RxD2 */
		0  c  2  0  1  0 	/* RxD3 */
		0  d  2  0  1  0 	/* RxD4 */
		1  1  2  0  2  0 	/* RxD5 */
		1  0  2  0  2  0 	/* RxD6 */
		1  4  2  0  2  0 	/* RxD7 */
		0  7  1  0  1  0 	/* TX_EN */
		0  8  1  0  1  0 	/* TX_ER */
		0  f  2  0  1  0 	/* RX_DV */
		0  10 2  0  1  0 	/* RX_ER */
		0  0  2  0  1  0 	/* RX_CLK */
		2  9  1  0  3  0 	/* GTX_CLK - CLK10 */
		2  8  2  0  1  0>;	/* GTX125 - CLK9 */
     };
```

## Documentation/devicetree/bindings/powerpc/fsl/cpus.txt
```
===================================================================
Power Architecture CPU Binding
Copyright 2013 Freescale Semiconductor Inc.

Power Architecture CPUs in Freescale SOCs are represented in device trees as
per the definition in the Devicetree Specification.

In addition to the Devicetree Specification definitions, the properties
defined below may be present on CPU nodes.

PROPERTIES

   - fsl,eref-*
        Usage: optional
        Value type: <empty>
        Definition: The EREF (EREF: A Programmer.s Reference Manual for
	Freescale Power Architecture) defines the architecture for Freescale
	Power CPUs.  The EREF defines some architecture categories not defined
	by the Power ISA.  For these EREF-specific categories, the existence of
	a property named fsl,eref-[CAT], where [CAT] is the abbreviated category
	name with all uppercase letters converted to lowercase, indicates that
	the category is supported by the implementation.

    - fsl,portid-mapping
	Usage: optional
	Value type: <u32>
	Definition: The Coherency Subdomain ID Port Mapping Registers and
	Snoop ID Port Mapping registers, which are part of the CoreNet
	Coherency fabric (CCF), provide a CoreNet Coherency Subdomain
	ID/CoreNet Snoop ID to cpu mapping functions.  Certain bits from
	these registers should be set if the coresponding CPU should be
	snooped.  This property defines a bitmask which selects the bit
	that should be set if this cpu should be snooped.
```
