## Documentation/devicetree/bindings/watchdog/atmel-wdt.txt
```
* Atmel Watchdog Timers

** at91sam9-wdt

Required properties:
- compatible: must be "atmel,at91sam9260-wdt".
- reg: physical base address of the controller and length of memory mapped
  region.

Optional properties:
- timeout-sec: contains the watchdog timeout in seconds.
- interrupts : Should contain WDT interrupt.
- atmel,max-heartbeat-sec : Should contain the maximum heartbeat value in
	seconds. This value should be less or equal to 16. It is used to
	compute the WDV field.
- atmel,min-heartbeat-sec : Should contain the minimum heartbeat value in
	seconds. This value must be smaller than the max-heartbeat-sec value.
	It is used to compute the WDD field.
- atmel,watchdog-type : Should be "hardware" or "software". Hardware watchdog
	use the at91 watchdog reset. Software watchdog use the watchdog
	interrupt to trigger a software reset.
- atmel,reset-type : Should be "proc" or "all".
	"all" : assert peripherals and processor reset signals
	"proc" : assert the processor reset signal
	This is valid only when using "hardware" watchdog.
- atmel,disable : Should be present if you want to disable the watchdog.
- atmel,idle-halt : Should be present if you want to stop the watchdog when
	entering idle state.
	CAUTION: This property should be used with care, it actually makes the
	watchdog not counting when the CPU is in idle state, therefore the
	watchdog reset time depends on mean CPU usage and will not reset at all
	if the CPU stop working while it is in idle state, which is probably
	not what you want.
- atmel,dbg-halt : Should be present if you want to stop the watchdog when
	entering debug state.

Example:
	watchdog@fffffd40 {
		compatible = "atmel,at91sam9260-wdt";
		reg = <0xfffffd40 0x10>;
		interrupts = <1 IRQ_TYPE_LEVEL_HIGH 7>;
		timeout-sec = <15>;
		atmel,watchdog-type = "hardware";
		atmel,reset-type = "all";
		atmel,dbg-halt;
		atmel,idle-halt;
		atmel,max-heartbeat-sec = <16>;
		atmel,min-heartbeat-sec = <0>;
		status = "okay";
	};
```

## Documentation/devicetree/bindings/watchdog/brcm,bcm2835-pm-wdog.txt
```
BCM2835 Watchdog timer

Required properties:

- compatible : should be "brcm,bcm2835-pm-wdt"
- reg : Specifies base physical address and size of the registers.

Example:

watchdog {
	compatible = "brcm,bcm2835-pm-wdt";
	reg = <0x7e100000 0x28>;
};
```

## Documentation/devicetree/bindings/watchdog/brcm,bcm7038-wdt.txt
```
BCM7038 Watchdog timer

Required properties:

- compatible : should be "brcm,bcm7038-wdt"
- reg : Specifies base physical address and size of the registers.

Optional properties:

- clocks: The clock running the watchdog. If no clock is found the
	  driver will default to 27000000 Hz.

Example:

watchdog@f040a7e8 {
	compatible = "brcm,bcm7038-wdt";
	clocks = <&upg_fixed>;
	reg = <0xf040a7e8 0x16>;
};
```

## Documentation/devicetree/bindings/watchdog/brcm,bcm7038-wdt.yaml
```yaml
# SPDX-License-Identifier: GPL-2.0-only OR BSD-2-Clause
%YAML 1.2
---
$id: http://devicetree.org/schemas/watchdog/brcm,bcm7038-wdt.yaml#
$schema: http://devicetree.org/meta-schemas/core.yaml#

title: BCM63xx and BCM7038 watchdog timer

allOf:
  - $ref: "watchdog.yaml#"

maintainers:
  - Florian Fainelli <f.fainelli@gmail.com>
  - Justin Chen <justinpopo6@gmail.com>
  - Rafał Miłecki <rafal@milecki.pl>

properties:
  compatible:
    enum:
      - brcm,bcm6345-wdt
      - brcm,bcm7038-wdt

  reg:
    maxItems: 1

  clocks:
    maxItems: 1
    description: >
      The clock running the watchdog. If no clock is found the driver will
      default to 27000000 Hz.

unevaluatedProperties: false

required:
  - reg

examples:
  - |
    watchdog@f040a7e8 {
      compatible = "brcm,bcm7038-wdt";
      reg = <0xf040a7e8 0x16>;
      clocks = <&upg_fixed>;
    };
```

## Documentation/devicetree/bindings/watchdog/brcm,kona-wdt.txt
```
Broadcom Kona Family Watchdog Timer
-----------------------------------

This watchdog timer is used in the following Broadcom SoCs:
  BCM11130, BCM11140, BCM11351, BCM28145, BCM28155

Required properties:
  - compatible = "brcm,bcm11351-wdt", "brcm,kona-wdt";
  - reg: memory address & range

Example:
	watchdog@35002f40 {
		compatible = "brcm,bcm11351-wdt", "brcm,kona-wdt";
		reg = <0x35002f40 0x6c>;
	};
```

## Documentation/devicetree/bindings/watchdog/brcm,kona-wdt.yaml
```yaml
# SPDX-License-Identifier: GPL-2.0-only OR BSD-2-Clause
%YAML 1.2
---
$id: http://devicetree.org/schemas/watchdog/brcm,kona-wdt.yaml#
$schema: http://devicetree.org/meta-schemas/core.yaml#

title: Broadcom Kona Family Watchdog Timer

description: |
  This watchdog timer is used in the following Broadcom SoCs:
  BCM11130, BCM11140, BCM11351, BCM28145, BCM28155

maintainers:
  - Florian Fainelli <f.fainelli@gmail.com>
  - Ray Jui <rjui@broadcom.com>
  - Scott Branden <sbranden@broadcom.com>

allOf:
  - $ref: watchdog.yaml#

properties:
  compatible:
    items:
      - const: brcm,bcm11351-wdt
      - const: brcm,kona-wdt

  reg:
    maxItems: 1

required:
  - compatible
  - reg

unevaluatedProperties: false

examples:
  - |
    watchdog@35002f40 {
        compatible = "brcm,bcm11351-wdt", "brcm,kona-wdt";
        reg = <0x35002f40 0x6c>;
    };
```

## Documentation/devicetree/bindings/watchdog/cadence-wdt.txt
```
Zynq Watchdog Device Tree Bindings
-------------------------------------------

Required properties:
- compatible		: Should be "cdns,wdt-r1p2".
- clocks		: This is pclk (APB clock).
- interrupts		: This is wd_irq - watchdog timeout interrupt.
- interrupt-parent	: Must be core interrupt controller.

Optional properties
- reset-on-timeout	: If this property exists, then a reset is done
			  when watchdog times out.
- timeout-sec		: Watchdog timeout value (in seconds).

Example:
	watchdog@f8005000 {
		compatible = "cdns,wdt-r1p2";
		clocks = <&clkc 45>;
		interrupt-parent = <&intc>;
		interrupts = <0 9 1>;
		reg = <0xf8005000 0x1000>;
		reset-on-timeout;
		timeout-sec = <10>;
	};
```

## Documentation/devicetree/bindings/watchdog/cdns,wdt-r1p2.yaml
```yaml
# SPDX-License-Identifier: (GPL-2.0 OR BSD-2-Clause)
%YAML 1.2
---
$id: http://devicetree.org/schemas/watchdog/cdns,wdt-r1p2.yaml#
$schema: http://devicetree.org/meta-schemas/core.yaml#

title: Cadence watchdog timer controller

maintainers:
  - Neeli Srinivas <srinivas.neeli@amd.com>

description:
  The cadence watchdog timer is used to detect and recover from
  system malfunctions. This watchdog contains 24 bit counter and
  a programmable reset period. The timeout period varies from 1 ms
  to 30 seconds while using a 100Mhz clock.

allOf:
  - $ref: watchdog.yaml#

properties:
  compatible:
    enum:
      - cdns,wdt-r1p2

  reg:
    maxItems: 1

  clocks:
    maxItems: 1

  interrupts:
    maxItems: 1

  reset-on-timeout:
    type: boolean
    description: |
      If this property exists, then a reset is done when watchdog
      times out.

required:
  - compatible
  - reg
  - clocks
  - interrupts

unevaluatedProperties: false

examples:
  - |
    #include <dt-bindings/interrupt-controller/arm-gic.h>

    watchdog@f8005000 {
        compatible = "cdns,wdt-r1p2";
        reg = <0xf8005000 0x1000>;
        clocks = <&clkc 45>;
        interrupt-parent = <&intc>;
        interrupts = <GIC_SPI 9 IRQ_TYPE_EDGE_RISING>;
        reset-on-timeout;
        timeout-sec = <10>;
    };
...
```

## Documentation/devicetree/bindings/watchdog/cirrus,ep9301-wdt.yaml
```yaml
# SPDX-License-Identifier: (GPL-2.0-only OR BSD-2-Clause)
%YAML 1.2
---
$id: http://devicetree.org/schemas/watchdog/cirrus,ep9301-wdt.yaml#
$schema: http://devicetree.org/meta-schemas/core.yaml#

title: Cirrus Logic EP93xx Watchdog Timer

maintainers:
  - Nikita Shubin <nikita.shubin@maquefel.me>
  - Alexander Sverdlin <alexander.sverdlin@gmail.com>

allOf:
  - $ref: watchdog.yaml#

properties:
  compatible:
    oneOf:
      - const: cirrus,ep9301-wdt
      - items:
          - enum:
              - cirrus,ep9302-wdt
              - cirrus,ep9307-wdt
              - cirrus,ep9312-wdt
              - cirrus,ep9315-wdt
          - const: cirrus,ep9301-wdt

  reg:
    maxItems: 1

required:
  - compatible
  - reg

unevaluatedProperties: false

examples:
  - |
    watchdog@80940000 {
        compatible = "cirrus,ep9301-wdt";
        reg = <0x80940000 0x08>;
    };
```

## Documentation/devicetree/bindings/watchdog/cnxt,cx92755-wdt.yaml
```yaml
# SPDX-License-Identifier: GPL-2.0-only OR BSD-2-Clause
%YAML 1.2
---
$id: http://devicetree.org/schemas/watchdog/cnxt,cx92755-wdt.yaml#
$schema: http://devicetree.org/meta-schemas/core.yaml#

title: Conexant Digicolor SoCs Watchdog timer

description: |
  The watchdog functionality in Conexant Digicolor SoCs relies on the so called
  "Agent Communication" block. This block includes the eight programmable system
  timer counters. The first timer (called "Timer A") is the only one that can be
  used as watchdog.

maintainers:
  - Baruch Siach <baruch@tkos.co.il>

allOf:
  - $ref: watchdog.yaml#

properties:
  compatible:
    const: cnxt,cx92755-wdt

  reg:
    maxItems: 1

  clocks:
    maxItems: 1

required:
  - compatible
  - reg
  - clocks

unevaluatedProperties: false

examples:
  - |
    watchdog@f0000fc0 {
        compatible = "cnxt,cx92755-wdt";
        reg = <0xf0000fc0 0x8>;
        clocks = <&main_clk>;
        timeout-sec = <15>;
    };
```

## Documentation/devicetree/bindings/watchdog/cortina,gemin-watchdog.txt
```
Cortina Systems Gemini SoC Watchdog

Required properties:
- compatible : must be "cortina,gemini-watchdog"
- reg : shall contain base register location and length
- interrupts : shall contain the interrupt for the watchdog

Optional properties:
- timeout-sec : the default watchdog timeout in seconds.

Example:

watchdog@41000000 {
	compatible = "cortina,gemini-watchdog";
	reg = <0x41000000 0x1000>;
	interrupts = <3 IRQ_TYPE_LEVEL_HIGH>;
};
```

## Documentation/devicetree/bindings/watchdog/da9062-wdt.txt
```
* Dialog Semiconductor DA9062/61 Watchdog Timer

Required properties:

- compatible: should be one of the following valid compatible string lines:
	"dlg,da9061-watchdog", "dlg,da9062-watchdog"
	"dlg,da9062-watchdog"

Optional properties:
- dlg,use-sw-pm: Add this property to disable the watchdog during suspend.
	Only use this option if you can't use the watchdog automatic suspend
	function during a suspend (see register CONTROL_B).
- dlg,wdt-sd: Set what happens on watchdog timeout. If this bit is set the
	watchdog timeout triggers SHUTDOWN, if cleared the watchdog triggers
	POWERDOWN. Can be 0 or 1. Only use this option if you want to change the
	default chip's OTP setting for WATCHDOG_SD bit. If this property is NOT
	set the WATCHDOG_SD bit and on timeout watchdog behavior will match the
	chip's OTP settings.

Example: DA9062

	pmic0: da9062@58 {
		watchdog {
			compatible = "dlg,da9062-watchdog";
		};
	};

Example: DA9061 using a fall-back compatible for the DA9062 watchdog driver

	pmic0: da9061@58 {
		watchdog {
			compatible = "dlg,da9061-watchdog", "dlg,da9062-watchdog";
		};
	};
```

## Documentation/devicetree/bindings/watchdog/davinci-wdt.txt
```
Texas Instruments DaVinci/Keystone Watchdog Timer (WDT) Controller

Required properties:
- compatible : Should be "ti,davinci-wdt", "ti,keystone-wdt"
- reg : Should contain WDT registers location and length

Optional properties:
- timeout-sec : Contains the watchdog timeout in seconds
- clocks : the clock feeding the watchdog timer.
	   Needed if platform uses clocks.
	   See clock-bindings.txt

Documentation:
Davinci DM646x - https://www.ti.com/lit/ug/spruer5b/spruer5b.pdf
Keystone - https://www.ti.com/lit/ug/sprugv5a/sprugv5a.pdf

Examples:

wdt: wdt@2320000 {
	compatible = "ti,davinci-wdt";
	reg = <0x02320000 0x80>;
	timeout-sec = <30>;
	clocks = <&clkwdtimer0>;
};
```

## Documentation/devicetree/bindings/watchdog/digicolor-wdt.txt
```
Conexant Digicolor SoCs Watchdog timer

The watchdog functionality in Conexant Digicolor SoCs relies on the so called
"Agent Communication" block. This block includes the eight programmable system
timer counters. The first timer (called "Timer A") is the only one that can be
used as watchdog.

Required properties:

- compatible : Should be "cnxt,cx92755-wdt"
- reg : Specifies base physical address and size of the registers
- clocks : phandle; specifies the clock that drives the timer

Optional properties:

- timeout-sec : Contains the watchdog timeout in seconds

Example:

	watchdog@f0000fc0 {
		compatible = "cnxt,cx92755-wdt";
		reg = <0xf0000fc0 0x8>;
		clocks = <&main_clk>;
		timeout-sec = <15>;
	};
```

## Documentation/devicetree/bindings/watchdog/dlg,da9062-watchdog.yaml
```yaml
# SPDX-License-Identifier: (GPL-2.0-only OR BSD-2-Clause)
%YAML 1.2
---
$id: http://devicetree.org/schemas/watchdog/dlg,da9062-watchdog.yaml#
$schema: http://devicetree.org/meta-schemas/core.yaml#

title: Dialog Semiconductor DA9062/61 Watchdog Timer

maintainers:
  - Steve Twiss <stwiss.opensource@diasemi.com>

allOf:
  - $ref: watchdog.yaml#

properties:
  compatible:
    enum: 
      - dlg,da9061-watchdog
      - dlg,da9062-watchdog

  dlg,use-sw-pm:
    type: boolean
    description:
      Add this property to disable the watchdog during suspend.
      Only use this option if you can't use the watchdog automatic suspend
      function during a suspend (see register CONTROL_B).
  
  dlg,wdt-sd:
    $ref: /schemas/types.yaml#/definitions/uint32
    enum: [0, 1]
    description:
      Set what happens on watchdog timeout. If this bit is set the
      watchdog timeout triggers SHUTDOWN, if cleared the watchdog triggers
      POWERDOWN. Can be 0 or 1. Only use this option if you want to change the
      default chip's OTP setting for WATCHDOG_SD bit. If this property is NOT
      set the WATCHDOG_SD bit and on timeout watchdog behavior will match the
      chip's OTP settings.

required:
  - compatible

unevaluatedProperties: false

examples:
  - |
    watchdog {
      compatible = "dlg,da9062-watchdog";
      dlg,use-sw-pm;
      dlg,wdt-sd = <1>;
    };
```

## Documentation/devicetree/bindings/watchdog/dw_wdt.txt
```
Synopsys Designware Watchdog Timer

Required Properties:

- compatible	: Should contain "snps,dw-wdt"
- reg		: Base address and size of the watchdog timer registers.
- clocks	: phandle + clock-specifier for the clock that drives the
		watchdog timer.

Optional Properties:

- interrupts	: The interrupt used for the watchdog timeout warning.

Example:

	watchdog0: wd@ffd02000 {
		compatible = "snps,dw-wdt";
		reg = <0xffd02000 0x1000>;
		interrupts = <0 171 4>;
		clocks = <&per_base_clk>;
	};
```

## Documentation/devicetree/bindings/watchdog/faraday,ftwdt010.txt
```
Faraday Technology FTWDT010 watchdog

This is an IP part from Faraday Technology found in the Gemini
SoCs and others.

Required properties:
- compatible : must be one of
  "faraday,ftwdt010"
  "cortina,gemini-watchdog", "faraday,ftwdt010"
- reg : shall contain base register location and length
- interrupts : shall contain the interrupt for the watchdog

Optional properties:
- timeout-sec : the default watchdog timeout in seconds.

Example:

watchdog@41000000 {
	compatible = "faraday,ftwdt010";
	reg = <0x41000000 0x1000>;
	interrupts = <3 IRQ_TYPE_LEVEL_HIGH>;
};
```
