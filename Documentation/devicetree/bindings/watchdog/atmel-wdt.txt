## Documentation/devicetree/bindings/watchdog/faraday,ftwdt010.yaml
```yaml
# SPDX-License-Identifier: (GPL-2.0-only OR BSD-2-Clause)
%YAML 1.2
---
$id: http://devicetree.org/schemas/watchdog/faraday,ftwdt010.yaml#
$schema: http://devicetree.org/meta-schemas/core.yaml#

title: Faraday Technology FTWDT010 watchdog

maintainers:
  - Linus Walleij <linus.walleij@linaro.org>
  - Corentin Labbe <clabbe@baylibre.com>

description: |
  This is an IP part from Faraday Technology found in the Gemini
  SoCs and others.

allOf:
  - $ref: "watchdog.yaml#"

properties:
  compatible:
    oneOf:
      - const: faraday,ftwdt010
      - items:
          - enum:
              - cortina,gemini-watchdog
              - moxa,moxart-watchdog
          - const: faraday,ftwdt010

  reg:
    maxItems: 1

  resets:
    maxItems: 1

  clocks:
    maxItems: 1

  clock-names:
    const: PCLK

  interrupts:
    maxItems: 1

required:
  - compatible
  - reg

unevaluatedProperties: false

examples:
  - |
    #include <dt-bindings/interrupt-controller/irq.h>
    watchdog@41000000 {
      compatible = "faraday,ftwdt010";
      reg = <0x41000000 0x1000>;
      interrupts = <3 IRQ_TYPE_LEVEL_HIGH>;
      timeout-sec = <5>;
    };
  - |
    watchdog: watchdog@98500000 {
      compatible = "moxa,moxart-watchdog", "faraday,ftwdt010";
      reg = <0x98500000 0x10>;
      clocks = <&clk_apb>;
      clock-names = "PCLK";
    };
...
```

## Documentation/devicetree/bindings/watchdog/fsl,scu-wdt.yaml
```yaml
# SPDX-License-Identifier: (GPL-2.0-only OR BSD-2-Clause)
%YAML 1.2
---
$id: http://devicetree.org/schemas/watchdog/fsl,scu-wdt.yaml#
$schema: http://devicetree.org/meta-schemas/core.yaml#

title: i.MX SCU Client Device Node - Watchdog Based on SCU Message Protocol

maintainers:
  - Dong Aisheng <aisheng.dong@nxp.com>

description: i.MX SCU Client Device Node
  Client nodes are maintained as children of the relevant IMX-SCU device node.

allOf:
  - $ref: watchdog.yaml#

properties:
  compatible:
    items:
      - enum:
          - fsl,imx8dxl-sc-wdt
          - fsl,imx8qm-sc-wdt
          - fsl,imx8qxp-sc-wdt
      - const: fsl,imx-sc-wdt

required:
  - compatible

unevaluatedProperties: false

examples:
  - |
    watchdog {
        compatible = "fsl,imx8qxp-sc-wdt", "fsl,imx-sc-wdt";
        timeout-sec = <60>;
    };
```

## Documentation/devicetree/bindings/watchdog/fsl-imx-sc-wdt.txt
```
* Freescale i.MX System Controller Watchdog

i.MX system controller watchdog is for i.MX SoCs with system controller inside,
the watchdog is managed by system controller, users can ONLY communicate with
system controller from secure mode for watchdog operations, so Linux i.MX system
controller watchdog driver will call ARM SMC API and trap into ARM-Trusted-Firmware
for watchdog operations, ARM-Trusted-Firmware is running at secure EL3 mode and
it will request system controller to execute the watchdog operation passed from
Linux kernel.

Required properties:
- compatible:	Should be :
		"fsl,imx8qxp-sc-wdt"
		followed by "fsl,imx-sc-wdt";

Optional properties:
- timeout-sec : Contains the watchdog timeout in seconds.

Examples:

watchdog {
	compatible = "fsl,imx8qxp-sc-wdt", "fsl,imx-sc-wdt";
	timeout-sec = <60>;
};
```

## Documentation/devicetree/bindings/watchdog/fsl-imx-wdt.txt
```
* Freescale i.MX Watchdog Timer (WDT) Controller

Required properties:
- compatible : Should be "fsl,<soc>-wdt"
- reg : Should contain WDT registers location and length
- interrupts : Should contain WDT interrupt

Optional properties:
- big-endian: If present the watchdog device's registers are implemented
  in big endian mode, otherwise in native mode(same with CPU), for more
  detail please see: Documentation/devicetree/bindings/regmap/regmap.txt.
- fsl,ext-reset-output: If present the watchdog device is configured to
  assert its external reset (WDOG_B) instead of issuing a software reset.
- timeout-sec : Contains the watchdog timeout in seconds

Examples:

wdt@73f98000 {
	compatible = "fsl,imx51-wdt", "fsl,imx21-wdt";
	reg = <0x73f98000 0x4000>;
	interrupts = <58>;
	big-endian;
	timeout-sec = <20>;
};
```

## Documentation/devicetree/bindings/watchdog/fsl-imx-wdt.yaml
```yaml
# SPDX-License-Identifier: (GPL-2.0 OR BSD-2-Clause)
%YAML 1.2
---
$id: http://devicetree.org/schemas/watchdog/fsl-imx-wdt.yaml#
$schema: http://devicetree.org/meta-schemas/core.yaml#

title: Freescale i.MX Watchdog Timer (WDT) Controller

maintainers:
  - Shawn Guo <shawnguo@kernel.org>
  - Sascha Hauer <s.hauer@pengutronix.de>
  - Fabio Estevam <festevam@gmail.com>

properties:
  compatible:
    oneOf:
      - const: fsl,imx21-wdt
      - items:
          - enum:
              - fsl,imx25-wdt
              - fsl,imx27-wdt
              - fsl,imx31-wdt
              - fsl,imx35-wdt
              - fsl,imx50-wdt
              - fsl,imx51-wdt
              - fsl,imx53-wdt
              - fsl,imx6q-wdt
              - fsl,imx6sl-wdt
              - fsl,imx6sll-wdt
              - fsl,imx6sx-wdt
              - fsl,imx6ul-wdt
              - fsl,imx7d-wdt
              - fsl,imx8mm-wdt
              - fsl,imx8mn-wdt
              - fsl,imx8mp-wdt
              - fsl,imx8mq-wdt
              - fsl,ls1012a-wdt
              - fsl,ls1021a-wdt
              - fsl,ls1043a-wdt
              - fsl,ls1046a-wdt
              - fsl,vf610-wdt
          - const: fsl,imx21-wdt

  reg:
    maxItems: 1

  interrupts:
    maxItems: 1

  clocks:
    maxItems: 1

  big-endian: true

  fsl,ext-reset-output:
    $ref: /schemas/types.yaml#/definitions/flag
    description: |
      If present, the watchdog device is configured to assert its
      external reset (WDOG_B) instead of issuing a software reset.

  fsl,suspend-in-wait:
    $ref: /schemas/types.yaml#/definitions/flag
    description: |
      If present, the watchdog device is suspended in WAIT mode
      (Suspend-to-Idle). Only supported on certain devices.

required:
  - compatible
  - interrupts
  - reg

allOf:
  - $ref: watchdog.yaml#
  - if:
      not:
        properties:
          compatible:
            contains:
              enum:
                - fsl,imx25-wdt
                - fsl,imx35-wdt
                - fsl,imx50-wdt
                - fsl,imx51-wdt
                - fsl,imx53-wdt
                - fsl,imx6q-wdt
                - fsl,imx6sl-wdt
                - fsl,imx6sll-wdt
                - fsl,imx6sx-wdt
                - fsl,imx6ul-wdt
                - fsl,imx7d-wdt
                - fsl,imx8mm-wdt
                - fsl,imx8mn-wdt
                - fsl,imx8mp-wdt
                - fsl,imx8mq-wdt
                - fsl,vf610-wdt
    then:
      properties:
        fsl,suspend-in-wait: false

  - if:
      not:
        properties:
          compatible:
            contains:
              enum:
                - fsl,ls1012a-wdt
                - fsl,ls1021a-wdt
                - fsl,ls1043a-wdt
                - fsl,ls1046a-wdt
    then:
      properties:
        big-endian: false

unevaluatedProperties: false

examples:
  - |
    #include <dt-bindings/interrupt-controller/arm-gic.h>
    #include <dt-bindings/clock/imx6qdl-clock.h>

    watchdog@20bc000 {
        compatible = "fsl,imx21-wdt";
        reg = <0x020bc000 0x4000>;
        interrupts = <0 80 IRQ_TYPE_LEVEL_HIGH>;
        clocks = <&clks IMX6QDL_CLK_IPG>;
    };

...
```

## Documentation/devicetree/bindings/watchdog/fsl-imx7ulp-wdt.txt
```
* Freescale i.MX7ULP Watchdog Timer (WDT) Controller

Required properties:
- compatible : Should be "fsl,imx7ulp-wdt"
- reg : Should contain WDT registers location and length
- interrupts : Should contain WDT interrupt
- clocks: Should contain a phandle pointing to the gated peripheral clock.

Optional properties:
- timeout-sec : Contains the watchdog timeout in seconds

Examples:

wdog1: watchdog@403d0000 {
	compatible = "fsl,imx7ulp-wdt";
	reg = <0x403d0000 0x10000>;
	interrupts = <GIC_SPI 55 IRQ_TYPE_LEVEL_HIGH>;
	clocks = <&pcc2 IMX7ULP_CLK_WDG1>;
	assigned-clocks = <&pcc2 IMX7ULP_CLK_WDG1>;
	assigned-clocks-parents = <&scg1 IMX7ULP_CLK_FIRC_BUS_CLK>;
	timeout-sec = <40>;
};
```

## Documentation/devicetree/bindings/watchdog/fsl-imx7ulp-wdt.yaml
```yaml
# SPDX-License-Identifier: (GPL-2.0 OR BSD-2-Clause)
%YAML 1.2
---
$id: http://devicetree.org/schemas/watchdog/fsl-imx7ulp-wdt.yaml#
$schema: http://devicetree.org/meta-schemas/core.yaml#

title: Freescale i.MX7ULP Watchdog Timer (WDT) Controller

maintainers:
  - Anson Huang <Anson.Huang@nxp.com>

allOf:
  - $ref: watchdog.yaml#

properties:
  compatible:
    oneOf:
      - const: fsl,imx7ulp-wdt
      - items:
          - const: fsl,imx8ulp-wdt
          - const: fsl,imx7ulp-wdt
      - const: fsl,imx93-wdt

  reg:
    maxItems: 1

  interrupts:
    maxItems: 1

  clocks:
    maxItems: 1

  fsl,ext-reset-output:
    description:
      When set, wdog can generate external reset from the wdog_any pin.
    type: boolean

required:
  - compatible
  - interrupts
  - reg
  - clocks

unevaluatedProperties: false

examples:
  - |
    #include <dt-bindings/interrupt-controller/arm-gic.h>
    #include <dt-bindings/clock/imx7ulp-clock.h>

    watchdog@403d0000 {
        compatible = "fsl,imx7ulp-wdt";
        reg = <0x403d0000 0x10000>;
        interrupts = <GIC_SPI 55 IRQ_TYPE_LEVEL_HIGH>;
        clocks = <&pcc2 IMX7ULP_CLK_WDG1>;
        assigned-clocks = <&pcc2 IMX7ULP_CLK_WDG1>;
        assigned-clock-parents = <&scg1 IMX7ULP_CLK_FIRC_BUS_CLK>;
        timeout-sec = <40>;
    };

...
```

## Documentation/devicetree/bindings/watchdog/gpio-wdt.txt
```
* GPIO-controlled Watchdog

Required Properties:
- compatible: Should contain "linux,wdt-gpio".
- gpios: From common gpio binding; gpio connection to WDT reset pin.
- hw_algo: The algorithm used by the driver. Should be one of the
  following values:
  - toggle: Either a high-to-low or a low-to-high transition clears
    the WDT counter. The watchdog timer is disabled when GPIO is
    left floating or connected to a three-state buffer.
  - level: Low or high level starts counting WDT timeout,
    the opposite level disables the WDT. Active level is determined
    by the GPIO flags.
- hw_margin_ms: Maximum time to reset watchdog circuit (milliseconds).

Example:
	watchdog: watchdog {
		/* ADM706 */
		compatible = "linux,wdt-gpio";
		gpios = <&gpio3 9 GPIO_ACTIVE_LOW>;
		hw_algo = "toggle";
		hw_margin_ms = <1600>;
	};
```
