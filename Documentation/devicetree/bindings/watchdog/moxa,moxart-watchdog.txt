## Documentation/devicetree/bindings/watchdog/qcom-wdt.txt
```
Qualcomm Krait Processor Sub-system (KPSS) Watchdog
---------------------------------------------------

Required properties :
- compatible : shall contain only one of the following:

			"qcom,kpss-wdt-msm8960"
			"qcom,kpss-wdt-apq8064"
			"qcom,kpss-wdt-ipq8064"
			"qcom,kpss-wdt-ipq4019"
			"qcom,kpss-timer"
			"qcom,scss-timer"
			"qcom,kpss-wdt"

- reg : shall contain base register location and length
- clocks : shall contain the input clock

Optional properties :
- timeout-sec : shall contain the default watchdog timeout in seconds,
                if unset, the default timeout is 30 seconds

Example:
	watchdog@208a038 {
		compatible = "qcom,kpss-wdt-ipq8064";
		reg = <0x0208a038 0x40>;
		clocks = <&sleep_clk>;
		timeout-sec = <10>;
	};
```

## Documentation/devicetree/bindings/watchdog/qcom-wdt.yaml
```yaml
# SPDX-License-Identifier: (GPL-2.0-only OR BSD-2-Clause)
%YAML 1.2
---
$id: http://devicetree.org/schemas/watchdog/qcom-wdt.yaml#
$schema: http://devicetree.org/meta-schemas/core.yaml#

title: Qualcomm Krait Processor Sub-system (KPSS) Watchdog timer

maintainers:
  - Sai Prakash Ranjan <saiprakash.ranjan@codeaurora.org>

properties:
  $nodename:
    pattern: "^(watchdog|timer)@[0-9a-f]+$"

  compatible:
    oneOf:
      - items:
          - enum:
              - qcom,kpss-wdt-ipq4019
              - qcom,apss-wdt-msm8994
              - qcom,apss-wdt-qcs404
              - qcom,apss-wdt-sa8775p
              - qcom,apss-wdt-sc7180
              - qcom,apss-wdt-sc7280
              - qcom,apss-wdt-sc8180x
              - qcom,apss-wdt-sc8280xp
              - qcom,apss-wdt-sdm845
              - qcom,apss-wdt-sdx55
              - qcom,apss-wdt-sdx65
              - qcom,apss-wdt-sm6350
              - qcom,apss-wdt-sm8150
              - qcom,apss-wdt-sm8250
          - const: qcom,kpss-wdt
      - const: qcom,kpss-wdt
        deprecated: true
      - items:
          - const: qcom,scss-timer
          - const: qcom,msm-timer
      - items:
          - enum:
              - qcom,kpss-wdt-apq8064
              - qcom,kpss-wdt-ipq8064
              - qcom,kpss-wdt-mdm9615
              - qcom,kpss-wdt-msm8960
          - const: qcom,kpss-timer
          - const: qcom,msm-timer

  reg:
    maxItems: 1

  clocks:
    maxItems: 1

  clock-names:
    items:
      - const: sleep

  clock-frequency:
    description:
      The frequency of the general purpose timer in Hz.

  cpu-offset:
    $ref: /schemas/types.yaml#/definitions/uint32
    description:
      Per-CPU offset used when the timer is accessed without the CPU remapping
      facilities. The offset is cpu-offset + (0x10000 * cpu-nr).

  interrupts:
    minItems: 1
    maxItems: 5

required:
  - compatible
  - reg
  - clocks

allOf:
  - $ref: watchdog.yaml#

  - if:
      properties:
        compatible:
          contains:
            const: qcom,kpss-wdt
    then:
      properties:
        clock-frequency: false
        cpu-offset: false
        interrupts:
          minItems: 1
          items:
            - description: Bark
            - description: Bite

    else:
      properties:
        interrupts:
          minItems: 3
          items:
            - description: Debug
            - description: First general purpose timer
            - description: Second general purpose timer
            - description: First watchdog
            - description: Second watchdog
      required:
        - clock-frequency

unevaluatedProperties: false

examples:
  - |
    #include <dt-bindings/interrupt-controller/arm-gic.h>

    watchdog@17c10000 {
      compatible = "qcom,apss-wdt-sm8150", "qcom,kpss-wdt";
      reg = <0x17c10000 0x1000>;
      clocks = <&sleep_clk>;
      interrupts = <GIC_SPI 0 IRQ_TYPE_LEVEL_HIGH>;
      timeout-sec = <10>;
    };

  - |
    #include <dt-bindings/interrupt-controller/arm-gic.h>

    watchdog@200a000 {
      compatible = "qcom,kpss-wdt-ipq8064", "qcom,kpss-timer", "qcom,msm-timer";
      interrupts = <GIC_PPI 1 (GIC_CPU_MASK_SIMPLE(2) | IRQ_TYPE_EDGE_RISING)>,
                   <GIC_PPI 2 (GIC_CPU_MASK_SIMPLE(2) | IRQ_TYPE_EDGE_RISING)>,
                   <GIC_PPI 3 (GIC_CPU_MASK_SIMPLE(2) | IRQ_TYPE_EDGE_RISING)>,
                   <GIC_PPI 4 (GIC_CPU_MASK_SIMPLE(2) | IRQ_TYPE_EDGE_RISING)>,
                   <GIC_PPI 5 (GIC_CPU_MASK_SIMPLE(2) | IRQ_TYPE_EDGE_RISING)>;
      reg = <0x0200a000 0x100>;
      clock-frequency = <25000000>;
      clocks = <&sleep_clk>;
      clock-names = "sleep";
      cpu-offset = <0x80000>;
    };
```

## Documentation/devicetree/bindings/watchdog/ralink,rt2880-wdt.yaml
```yaml
# SPDX-License-Identifier: (GPL-2.0-only OR BSD-2-Clause)
%YAML 1.2
---
$id: http://devicetree.org/schemas/watchdog/ralink,rt2880-wdt.yaml#
$schema: http://devicetree.org/meta-schemas/core.yaml#

title: Ralink Watchdog Timers

maintainers:
  - Sergio Paracuellos <sergio.paracuellos@gmail.com>

allOf:
  - $ref: watchdog.yaml#

properties:
  compatible:
    const: ralink,rt2880-wdt

  reg:
    maxItems: 1

  clocks:
    maxItems: 1

  resets:
    maxItems: 1

  interrupts:
    maxItems: 1

required:
  - compatible
  - reg

unevaluatedProperties: false

examples:
  - |
    watchdog@100 {
      compatible = "ralink,rt2880-wdt";
      reg = <0x120 0x10>;
      clocks = <&clkref>;
      resets = <&rstctrl 8>;
      interrupt-parent = <&intc>;
      interrupts = <1>;
    };
```

## Documentation/devicetree/bindings/watchdog/realtek,otto-wdt.yaml
```yaml
# SPDX-License-Identifier: GPL-2.0-only OR BSD-2-Clause
%YAML 1.2
---
$id: http://devicetree.org/schemas/watchdog/realtek,otto-wdt.yaml#
$schema: http://devicetree.org/meta-schemas/core.yaml#

title: Realtek Otto watchdog timer

maintainers:
  - Sander Vanheule <sander@svanheule.net>

description: |
  The timer has two timeout phases. Both phases have a maximum duration of 32
  prescaled clock ticks, which is ca. 43s with a bus clock of 200MHz. The
  minimum duration of each phase is one tick. Each phase can trigger an
  interrupt, although the phase 2 interrupt will occur with the system reset.
  - Phase 1: During this phase, the WDT can be pinged to reset the timeout.
  - Phase 2: Starts after phase 1 has timed out, and only serves to give the
    system some time to clean up, or notify others that it's going to reset.
    During this phase, pinging the WDT has no effect, and a reset is
    unavoidable, unless the WDT is disabled.

allOf:
  - $ref: watchdog.yaml#

properties:
  compatible:
    enum:
      - realtek,rtl8380-wdt
      - realtek,rtl8390-wdt
      - realtek,rtl9300-wdt
      - realtek,rtl9310-wdt

  reg:
    maxItems: 1

  clocks:
    maxItems: 1

  interrupts:
    items:
      - description: interrupt specifier for pretimeout
      - description: interrupt specifier for timeout

  interrupt-names:
    items:
      - const: phase1
      - const: phase2

  realtek,reset-mode:
    $ref: /schemas/types.yaml#/definitions/string
    description: |
      Specify how the system is reset after a timeout. Defaults to "cpu" if
      left unspecified.
    oneOf:
      - description: Reset the entire chip
        const: soc
      - description: |
          Reset the CPU and IPsec engine, but leave other peripherals untouched
        const: cpu
      - description: |
          Reset the execution pointer, but don't actually reset any hardware
        const: software

required:
  - compatible
  - reg
  - clocks
  - interrupts

unevaluatedProperties: false

dependencies:
  interrupts: [ interrupt-names ]

examples:
  - |
    watchdog: watchdog@3150 {
        compatible = "realtek,rtl8380-wdt";
        reg = <0x3150 0xc>;

        realtek,reset-mode = "soc";

        clocks = <&lxbus_clock>;
        timeout-sec = <20>;

        interrupt-parent = <&rtlintc>;
        interrupt-names = "phase1", "phase2";
        interrupts = <19>, <18>;
    };

...
```

## Documentation/devicetree/bindings/watchdog/realtek,rtd119x.txt
```
Realtek RTD1295 Watchdog
========================

Required properties:

- compatible :  Should be "realtek,rtd1295-watchdog"
- reg        :  Specifies the physical base address and size of registers
- clocks     :  Specifies one clock input


Example:

	watchdog@98007680 {
		compatible = "realtek,rtd1295-watchdog";
		reg = <0x98007680 0x100>;
		clocks = <&osc27M>;
	};
```

## Documentation/devicetree/bindings/watchdog/realtek,rtd1295-watchdog.yaml
```yaml
# SPDX-License-Identifier: GPL-2.0-only OR BSD-2-Clause
%YAML 1.2
---
$id: http://devicetree.org/schemas/watchdog/realtek,rtd1295-watchdog.yaml#
$schema: http://devicetree.org/meta-schemas/core.yaml#

title: Realtek RTD1295 Watchdog

maintainers:
  - Andreas Färber <afaerber@suse.de>

allOf:
  - $ref: watchdog.yaml#

properties:
  compatible:
    const: realtek,rtd1295-watchdog

  reg:
    maxItems: 1

  clocks:
    maxItems: 1

required:
  - compatible
  - reg
  - clocks

unevaluatedProperties: false

examples:
  - |
    watchdog@98007680 {
        compatible = "realtek,rtd1295-watchdog";
        reg = <0x98007680 0x100>;
        clocks = <&osc27M>;
    };
```

## Documentation/devicetree/bindings/watchdog/renesas,r9a09g057-wdt.yaml
```yaml
# SPDX-License-Identifier: (GPL-2.0-only OR BSD-2-Clause)
%YAML 1.2
---
$id: http://devicetree.org/schemas/watchdog/renesas,r9a09g057-wdt.yaml#
$schema: http://devicetree.org/meta-schemas/core.yaml#

title: Renesas RZ/V2H(P) Watchdog Timer (WDT) Controller

maintainers:
  - Lad Prabhakar <prabhakar.mahadev-lad.rj@bp.renesas.com>

properties:
  compatible:
    oneOf:
      - items:
          - enum:
              - renesas,r9a09g047-wdt # RZ/G3E
              - renesas,r9a09g056-wdt # RZ/V2N
          - const: renesas,r9a09g057-wdt # RZ/V2H(P)

      - items:
          - const: renesas,r9a09g087-wdt # RZ/N2H
          - const: renesas,r9a09g077-wdt # RZ/T2H

      - enum:
          - renesas,r9a09g057-wdt    # RZ/V2H(P)
          - renesas,r9a09g077-wdt    # RZ/T2H

  reg:
    minItems: 1
    maxItems: 2

  clocks:
    minItems: 1
    items:
      - description: Register access clock
      - description: Main clock

  clock-names:
    minItems: 1
    items:
      - const: pclk
      - const: oscclk

  power-domains:
    maxItems: 1

  resets:
    maxItems: 1

  timeout-sec: true

required:
  - compatible
  - reg
  - clocks
  - clock-names
  - power-domains

allOf:
  - $ref: watchdog.yaml#

  - if:
      properties:
        compatible:
          contains:
            const: renesas,r9a09g057-wdt
    then:
      properties:
        reg:
          maxItems: 1
        clocks:
          minItems: 2
        clock-names:
          minItems: 2
    else:
      properties:
        clocks:
          maxItems: 1
        clock-names:
          maxItems: 1
        reg:
          minItems: 2
        resets: false

additionalProperties: false

examples:
  - |
    #include <dt-bindings/clock/renesas,r9a09g057-cpg.h>

    watchdog@11c00400 {
            compatible = "renesas,r9a09g057-wdt";
            reg = <0x11c00400 0x400>;
            clocks = <&cpg CPG_MOD 0x4b>, <&cpg CPG_MOD 0x4c>;
            clock-names = "pclk", "oscclk";
            resets = <&cpg 0x75>;
            power-domains = <&cpg>;
    };
```
