## Documentation/devicetree/bindings/watchdog/moxa,moxart-watchdog.txt
```
MOXA ART Watchdog timer

Required properties:

- compatible : Must be "moxa,moxart-watchdog"
- reg : Should contain registers location and length
- clocks : Should contain phandle for the clock that drives the counter

Example:

	watchdog: watchdog@98500000 {
		compatible = "moxa,moxart-watchdog";
		reg = <0x98500000 0x10>;
		clocks = <&coreclk>;
	};
```

## Documentation/devicetree/bindings/watchdog/mpc8xxx-wdt.txt
```
* Freescale mpc8xxx watchdog driver (For 83xx, 86xx and 8xx)

Required properties:
- compatible: Shall contain one of the following:
	"mpc83xx_wdt" for an mpc83xx
	"fsl,mpc8610-wdt" for an mpc86xx
	"fsl,mpc823-wdt" for an mpc8xx
- reg: base physical address and length of the area hosting the
       watchdog registers.
		On the 83xx, "Watchdog Timer Registers" area:	<0x200 0x100>
		On the 86xx, "Watchdog Timer Registers" area:	<0xe4000 0x100>
		On the 8xx, "General System Interface Unit" area: <0x0 0x10>

Optional properties:
- reg: additional physical address and length (4) of location of the
       Reset Status Register (called RSTRSCR on the mpc86xx)
		On the 83xx, it is located at offset 0x910
		On the 86xx, it is located at offset 0xe0094
		On the 8xx, it is located at offset 0x288

Example:
		WDT: watchdog@0 {
		    compatible = "fsl,mpc823-wdt";
		    reg = <0x0 0x10 0x288 0x4>;
		};
```

## Documentation/devicetree/bindings/watchdog/mpc8xxx-wdt.yaml
```yaml
# SPDX-License-Identifier: (GPL-2.0-only OR BSD-2-Clause)
%YAML 1.2
---
$id: http://devicetree.org/schemas/watchdog/mpc8xxx-wdt.yaml#
$schema: http://devicetree.org/meta-schemas/core.yaml#

title: Freescale MPC8xxx watchdog timer (For 83xx, 86xx and 8xx)

maintainers:
  - J. Neuschäfer <j.ne@posteo.net>

properties:
  compatible:
    enum:
      - mpc83xx_wdt       # for an mpc83xx
      - fsl,mpc8610-wdt   # for an mpc86xx
      - fsl,mpc823-wdt    # for an mpc8xx

  device_type:
    const: watchdog

  reg:
    minItems: 1
    items:
      - description: |
          Base physical address and length of the area hosting the watchdog
          registers.

          On the 83xx, "Watchdog Timer Registers" area:     <0x200 0x100>
          On the 86xx, "Watchdog Timer Registers" area:     <0xe4000 0x100>
          On the 8xx, "General System Interface Unit" area: <0x0 0x10>

      - description: |
          Additional optional physical address and length (4) of location of
          the Reset Status Register (called RSTRSCR on the mpc86xx)

          On the 83xx, it is located at offset 0x910
          On the 86xx, it is located at offset 0xe0094
          On the 8xx, it is located at offset 0x288

required:
  - compatible
  - reg

allOf:
  - $ref: watchdog.yaml#

additionalProperties: false

examples:
  - |
    watchdog@0 {
        compatible = "fsl,mpc823-wdt";
        reg = <0x0 0x10 0x288 0x4>;
    };

  - |
    watchdog@200 {
        compatible = "mpc83xx_wdt";
        reg = <0x200 0x100>;
        device_type = "watchdog";
    };

...
```

## Documentation/devicetree/bindings/watchdog/mstar,msc313e-wdt.yaml
```yaml
# SPDX-License-Identifier: (GPL-2.0-only OR BSD-2-Clause)
%YAML 1.2
---
$id: http://devicetree.org/schemas/watchdog/mstar,msc313e-wdt.yaml#
$schema: http://devicetree.org/meta-schemas/core.yaml#

title: MStar Watchdog

maintainers:
  - Daniel Palmer <daniel@0x0f.com>
  - Romain Perier <romain.perier@gmail.com>

allOf:
  - $ref: watchdog.yaml#

properties:
  compatible:
    enum:
      - mstar,msc313e-wdt

  reg:
    maxItems: 1

  clocks:
    maxItems: 1

required:
  - compatible
  - clocks
  - reg

unevaluatedProperties: false

examples:
  - |
    watchdog@6000 {
        compatible = "mstar,msc313e-wdt";
        reg = <0x6000 0x1f>;
        clocks = <&xtal_div2>;
    };
```

## Documentation/devicetree/bindings/watchdog/mt7621-wdt.txt
```
Ralink Watchdog Timers

Required properties:
- compatible: must be "mediatek,mt7621-wdt"
- reg: physical base address of the controller and length of the register range

Example:

	watchdog@100 {
		compatible = "mediatek,mt7621-wdt";
		reg = <0x100 0x10>;
	};
```

## Documentation/devicetree/bindings/watchdog/mtk-wdt.txt
```
Mediatek SoCs Watchdog timer

Required properties:

- compatible should contain:
	"mediatek,mt2701-wdt", "mediatek,mt6589-wdt": for MT2701
	"mediatek,mt2712-wdt", "mediatek,mt6589-wdt": for MT2712
	"mediatek,mt6589-wdt": for MT6589
	"mediatek,mt6797-wdt", "mediatek,mt6589-wdt": for MT6797
	"mediatek,mt7622-wdt", "mediatek,mt6589-wdt": for MT7622
	"mediatek,mt7623-wdt", "mediatek,mt6589-wdt": for MT7623
	"mediatek,mt7629-wdt", "mediatek,mt6589-wdt": for MT7629
	"mediatek,mt8183-wdt", "mediatek,mt6589-wdt": for MT8183
	"mediatek,mt8516-wdt", "mediatek,mt6589-wdt": for MT8516

- reg : Specifies base physical address and size of the registers.

Optional properties:
- timeout-sec: contains the watchdog timeout in seconds.
- #reset-cells: Should be 1.

Example:

watchdog: watchdog@10007000 {
	compatible = "mediatek,mt8183-wdt",
		     "mediatek,mt6589-wdt";
	reg = <0 0x10007000 0 0x100>;
	timeout-sec = <10>;
	#reset-cells = <1>;
};
```

## Documentation/devicetree/bindings/watchdog/nuvoton,npcm-wdt.txt
```
Nuvoton NPCM Watchdog

Nuvoton NPCM timer module provides five 24-bit timer counters, and a watchdog.
The watchdog supports a pre-timeout interrupt that fires 10ms before the
expiry.

Required properties:
- compatible      : "nuvoton,npcm750-wdt" for NPCM750 (Poleg).
- reg             : Offset and length of the register set for the device.
- interrupts      : Contain the timer interrupt with flags for
                    falling edge.

Required clocking property, have to be one of:
- clocks          : phandle of timer reference clock.
- clock-frequency : The frequency in Hz of the clock that drives the NPCM7xx
                    timer (usually 25000000).

Optional properties:
- timeout-sec : Contains the watchdog timeout in seconds

Example:

timer@f000801c {
    compatible = "nuvoton,npcm750-wdt";
    interrupts = <GIC_SPI 47 IRQ_TYPE_LEVEL_HIGH>;
    reg = <0xf000801c 0x4>;
    clocks = <&clk NPCM7XX_CLK_TIMER>;
};
```

## Documentation/devicetree/bindings/watchdog/nuvoton,npcm750-wdt.yaml
```yaml
# SPDX-License-Identifier: (GPL-2.0-only OR BSD-2-Clause)
%YAML 1.2
---
$id: http://devicetree.org/schemas/watchdog/nuvoton,npcm750-wdt.yaml#
$schema: http://devicetree.org/meta-schemas/core.yaml#

title: Nuvoton NPCM Watchdog

maintainers:
  - Joel Stanley <joel@jms.id.au>

description:
  Nuvoton NPCM timer module provides five 24-bit timer counters, and a watchdog.
  The watchdog supports a pre-timeout interrupt that fires 10ms before the
  expiry.

allOf:
  - $ref: watchdog.yaml#

properties:
  compatible:
    oneOf:
      - enum:
          - nuvoton,npcm750-wdt
          - nuvoton,wpcm450-wdt
      - items:
          - enum:
              - nuvoton,npcm845-wdt
          - const: nuvoton,npcm750-wdt

  reg:
    maxItems: 1

  interrupts:
    maxItems: 1

  clocks:
    maxItems: 1

  clock-frequency:
    description: Frequency in Hz of the clock that drives the NPCM timer.

required:
  - compatible
  - reg
  - interrupts

unevaluatedProperties: false

examples:
  - |
    #include <dt-bindings/interrupt-controller/arm-gic.h>
    #include <dt-bindings/clock/nuvoton,npcm7xx-clock.h>

    watchdog@f000801c {
        compatible = "nuvoton,npcm750-wdt";
        interrupts = <GIC_SPI 47 IRQ_TYPE_LEVEL_HIGH>;
        reg = <0xf000801c 0x4>;
        clocks = <&clk NPCM7XX_CLK_TIMER>;
    };
```

## Documentation/devicetree/bindings/watchdog/nxp,lpc1850-wwdt.yaml
```yaml
# SPDX-License-Identifier: (GPL-2.0-only OR BSD-2-Clause)
%YAML 1.2
---
$id: http://devicetree.org/schemas/watchdog/nxp,lpc1850-wwdt.yaml#
$schema: http://devicetree.org/meta-schemas/core.yaml#

title: NXP LPC18xx Watchdog Timer (WDT)

maintainers:
  - Animesh Agarwal <animeshagarwal28@gmail.com>

properties:
  compatible:
    const: nxp,lpc1850-wwdt

  reg:
    maxItems: 1

  clocks:
    items:
      - description: Watchdog counter clock
      - description: Register interface clock

  clock-names:
    items:
      - const: wdtclk
      - const: reg

  interrupts:
    maxItems: 1

required:
  - compatible
  - reg
  - clocks
  - clock-names
  - interrupts

additionalProperties: false

examples:
  - |
    #include <dt-bindings/clock/lpc18xx-cgu.h>
    #include <dt-bindings/clock/lpc18xx-ccu.h>

    watchdog@40080000 {
        compatible = "nxp,lpc1850-wwdt";
        reg = <0x40080000 0x24>;
        clocks = <&cgu BASE_SAFE_CLK>, <&ccu1 CLK_CPU_WWDT>;
        clock-names = "wdtclk", "reg";
        interrupts = <49>;
    };
```

## Documentation/devicetree/bindings/watchdog/nxp,pnx4008-wdt.yaml
```yaml
# SPDX-License-Identifier: GPL-2.0-only OR BSD-2-Clause
%YAML 1.2
---
$id: http://devicetree.org/schemas/watchdog/nxp,pnx4008-wdt.yaml#
$schema: http://devicetree.org/meta-schemas/core.yaml#

title: NXP PNX watchdog timer

maintainers:
  - Roland Stigge <stigge@antcom.de>

allOf:
  - $ref: watchdog.yaml#

properties:
  compatible:
    const: nxp,pnx4008-wdt

  reg:
    maxItems: 1

  clocks:
    maxItems: 1

required:
  - compatible
  - reg

unevaluatedProperties: false

examples:
  - |
    watchdog@4003c000 {
        compatible = "nxp,pnx4008-wdt";
        reg = <0x4003c000 0x1000>;
        timeout-sec = <10>;
    };
```

## Documentation/devicetree/bindings/watchdog/nxp,s32g2-swt.yaml
```yaml
# SPDX-License-Identifier: GPL-2.0-only OR BSD-2-Clause
%YAML 1.2
---
$id: http://devicetree.org/schemas/watchdog/nxp,s32g2-swt.yaml#
$schema: http://devicetree.org/meta-schemas/core.yaml#

title: NXP Software Watchdog Timer (SWT)

maintainers:
  - Daniel Lezcano <daniel.lezcano@kernel.org>

allOf:
  - $ref: watchdog.yaml#

properties:
  compatible:
    oneOf:
      - const: nxp,s32g2-swt
      - items:
          - const: nxp,s32g3-swt
          - const: nxp,s32g2-swt

  reg:
    maxItems: 1

  clocks:
    items:
      - description: Counter clock
      - description: Module clock
      - description: Register clock

  clock-names:
    items:
      - const: counter
      - const: module
      - const: register

required:
  - compatible
  - reg
  - clocks
  - clock-names

unevaluatedProperties: false

examples:
  - |
    watchdog@40100000 {
        compatible = "nxp,s32g2-swt";
        reg = <0x40100000 0x1000>;
        clocks = <&clks 0x3a>, <&clks 0x3b>, <&clks 0x3c>;
        clock-names = "counter", "module", "register";
        timeout-sec = <10>;
    };
```

## Documentation/devicetree/bindings/watchdog/of-xilinx-wdt.txt
```
Xilinx AXI/PLB soft-core watchdog Device Tree Bindings
---------------------------------------------------------

Required properties:
- compatible		: Should be "xlnx,xps-timebase-wdt-1.00.a" or
			  "xlnx,xps-timebase-wdt-1.01.a".
- reg			: Physical base address and size

Optional properties:
- clock-frequency	: Frequency of clock in Hz
- xlnx,wdt-enable-once	: 0 - Watchdog can be restarted
			  1 - Watchdog can be enabled just once
- xlnx,wdt-interval	: Watchdog timeout interval in 2^<val> clock cycles,
			  <val> is integer from 8 to 31.

Example:
axi-timebase-wdt@40100000 {
	clock-frequency = <50000000>;
	compatible = "xlnx,xps-timebase-wdt-1.00.a";
	reg = <0x40100000 0x10000>;
	xlnx,wdt-enable-once = <0x0>;
	xlnx,wdt-interval = <0x1b>;
} ;
```

## Documentation/devicetree/bindings/watchdog/omap-wdt.txt
```
TI Watchdog Timer (WDT) Controller for OMAP

Required properties:
- compatible : "ti,omap3-wdt" for OMAP3 or "ti,omap4-wdt" for OMAP4
- ti,hwmods : Name of the hwmod associated to the WDT

Optional properties:
- timeout-sec : default watchdog timeout in seconds

Examples:

wdt2: wdt@4a314000 {
	compatible = "ti,omap4-wdt", "ti,omap3-wdt";
	ti,hwmods = "wd_timer2";
};
```

## Documentation/devicetree/bindings/watchdog/pnx4008-wdt.txt
```
* NXP PNX watchdog timer

Required properties:
- compatible: must be "nxp,pnx4008-wdt"
- reg: physical base address of the controller and length of memory mapped
  region.

Optional properties:
- timeout-sec: contains the watchdog timeout in seconds.

Example:

	watchdog@4003c000 {
		compatible = "nxp,pnx4008-wdt";
		reg = <0x4003C000 0x1000>;
		timeout-sec = <10>;
	};
```

## Documentation/devicetree/bindings/watchdog/qca,ar7130-wdt.yaml
```yaml
# SPDX-License-Identifier: (GPL-2.0-only OR BSD-2-Clause)
%YAML 1.2
---
$id: http://devicetree.org/schemas/watchdog/qca,ar7130-wdt.yaml#
$schema: http://devicetree.org/meta-schemas/core.yaml#

title: Qualcomm Atheros AR7130 Watchdog Timer (WDT) Controller

maintainers:
  - Gabor Juhos <juhosg@openwrt.org>

allOf:
  - $ref: watchdog.yaml#

properties:
  compatible:
    const: qca,ar7130-wdt

  reg:
    maxItems: 1

required:
  - compatible
  - reg

unevaluatedProperties: false

examples:
  - |
    watchdog@18060008 {
        compatible = "qca,ar7130-wdt";
        reg = <0x18060008 0x8>;
    };
```

## Documentation/devicetree/bindings/watchdog/qca-ar7130-wdt.txt
```
* Qualcomm Atheros AR7130 Watchdog Timer (WDT) Controller

Required properties:
- compatible: must be "qca,ar7130-wdt"
- reg: physical base address of the controller and length of memory mapped
  region.

Example:

wdt@18060008 {
	compatible = "qca,ar9330-wdt", "qca,ar7130-wdt";
	reg = <0x18060008 0x8>;
};
```

## Documentation/devicetree/bindings/watchdog/qcom,pm8916-wdt.txt
```
QCOM PM8916 watchdog timer controller

This pm8916 watchdog timer controller must be under pm8916-pon node.

Required properties:
- compatible: should be "qcom,pm8916-wdt"

Optional properties :
- interrupts : Watchdog pre-timeout (bark) interrupt.
- timeout-sec : Watchdog timeout value in seconds.

Example:

	pm8916_0: pm8916@0 {
		compatible = "qcom,pm8916", "qcom,spmi-pmic";
		reg = <0x0 SPMI_USID>;

		pon@800 {
			compatible = "qcom,pm8916-pon";
			reg = <0x800>;

			watchdog {
				compatible = "qcom,pm8916-wdt";
				interrupts = <0x0 0x8 6 IRQ_TYPE_EDGE_RISING>;
				timeout-sec = <10>;
			};
		};
	};
```

## Documentation/devicetree/bindings/watchdog/qcom,pm8916-wdt.yaml
```yaml
# SPDX-License-Identifier: (GPL-2.0-only OR BSD-2-Clause)
%YAML 1.2
---
$id: http://devicetree.org/schemas/watchdog/qcom,pm8916-wdt.yaml#
$schema: http://devicetree.org/meta-schemas/core.yaml#

title: Qualcomm PM8916 watchdog timer controller

maintainers:
  - Krzysztof Kozlowski <krzysztof.kozlowski@linaro.org>

allOf:
  - $ref: watchdog.yaml#

properties:
  compatible:
    const: qcom,pm8916-wdt

  interrupts:
    maxItems: 1

required:
  - compatible
  - interrupts

unevaluatedProperties: false

examples:
  - |
    #include <dt-bindings/interrupt-controller/irq.h>
    #include <dt-bindings/spmi/spmi.h>

    spmi {
        #address-cells = <2>;
        #size-cells = <0>;

        pmic@0 {
            compatible = "qcom,pm8916", "qcom,spmi-pmic";
            reg = <0x0 SPMI_USID>;
            #address-cells = <1>;
            #size-cells = <0>;

            pon@800 {
                compatible = "qcom,pm8916-pon";
                reg = <0x800>;
                mode-bootloader = <0x2>;
                mode-recovery = <0x1>;

                watchdog {
                    compatible = "qcom,pm8916-wdt";
                    interrupts = <0x0 0x8 6 IRQ_TYPE_EDGE_RISING>;
                    timeout-sec = <60>;
                };
            };
        };
    };
```
