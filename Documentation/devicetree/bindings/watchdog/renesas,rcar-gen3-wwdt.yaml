## Documentation/devicetree/bindings/watchdog/st_lpc_wdt.txt
```
STMicroelectronics Low Power Controller (LPC) - Watchdog
========================================================

LPC currently supports Watchdog OR Real Time Clock OR Clocksource
functionality.

[See: ../rtc/rtc-st-lpc.txt for RTC options]
[See: ../timer/st,stih407-lpc for Clocksource options]

Required properties

- compatible 	: Should be: "st,stih407-lpc"
- reg		: LPC registers base address + size
- interrupts    : LPC interrupt line number and associated flags
- clocks	: Clock used by LPC device (See: ../clock/clock-bindings.txt)
- st,lpc-mode	: The LPC can run either one of three modes:
                  ST_LPC_MODE_RTC    [0]
                  ST_LPC_MODE_WDT    [1]
                  ST_LPC_MODE_CLKSRC [2]
		 One (and only one) mode must be selected.

Required properties [watchdog mode]

- st,syscfg	: Phandle to syscfg node used to enable watchdog and configure
		  CPU reset type.
- timeout-sec	: Watchdog timeout in seconds

Optional properties [watchdog mode]

- st,warm-reset	: If present reset type will be 'warm' - if not it will be cold

Example:
	lpc@fde05000 {
		compatible	= "st,stih407-lpc";
		reg		= <0xfde05000 0x1000>;
		clocks 		= <&clk_s_d3_flexgen CLK_LPC_0>;
		st,syscfg	= <&syscfg_core>;
		timeout-sec	= <120>;
		st,lpc-mode	= <ST_LPC_MODE_WDT>;
		st,warm-reset;
	};
```

## Documentation/devicetree/bindings/watchdog/starfive,jh7100-wdt.yaml
```yaml
# SPDX-License-Identifier: (GPL-2.0-only OR BSD-2-Clause)
%YAML 1.2
---
$id: http://devicetree.org/schemas/watchdog/starfive,jh7100-wdt.yaml#
$schema: http://devicetree.org/meta-schemas/core.yaml#

title: StarFive Watchdog for JH7100 and JH7110 SoC

maintainers:
  - Xingyu Wu <xingyu.wu@starfivetech.com>
  - Samin Guo <samin.guo@starfivetech.com>

description:
  The JH7100 and JH7110 watchdog both are 32 bit counters. JH7100 watchdog
  has only one timeout phase and reboots. And JH7110 watchdog has two
  timeout phases. At the first phase, the signal of watchdog interrupt
  output(WDOGINT) will rise when counter is 0. The counter will reload
  the timeout value. And then, if counter decreases to 0 again and WDOGINT
  isn't cleared, the watchdog will reset the system unless the watchdog
  reset is disabled.

allOf:
  - $ref: watchdog.yaml#

properties:
  compatible:
    enum:
      - starfive,jh7100-wdt
      - starfive,jh7110-wdt

  reg:
    maxItems: 1

  interrupts:
    maxItems: 1

  clocks:
    items:
      - description: APB clock
      - description: Core clock

  clock-names:
    items:
      - const: apb
      - const: core

  resets:
    items:
      - description: APB reset
      - description: Core reset

required:
  - compatible
  - reg
  - clocks
  - clock-names
  - resets

unevaluatedProperties: false

examples:
  - |
    watchdog@12480000 {
        compatible = "starfive,jh7100-wdt";
        reg = <0x12480000 0x10000>;
        clocks = <&clk 171>,
                 <&clk 172>;
        clock-names = "apb", "core";
        resets = <&rst 99>,
                 <&rst 100>;
    };
```

## Documentation/devicetree/bindings/watchdog/starfive,wdt.yaml
```yaml
# SPDX-License-Identifier: (GPL-2.0-only OR BSD-2-Clause)
%YAML 1.2
---
$id: http://devicetree.org/schemas/watchdog/maxim,max63xx.yaml#
$schema: http://devicetree.org/meta-schemas/core.yaml#

title: StarFive watchdog

allOf:
  - $ref: "watchdog.yaml#"

maintainers:
  - samin.guo <samin.guo@starfivetech.com>
  - xingyu.wu <xingyu.wu@starfivetech.com>

properties:
  compatible:
    enum:
      - starfive,jh7100-wdt
      - starfive,jh7110-wdt

  reg:
    maxItems: 1

  interrupts:
    maxItems: 1

  clocks:
    items:
      - description: Core clock
      - description: APB clock

  clock-names:
    items:
      - const: core_clk
      - const: apb_clk

  resets:
    items:
      - description: APB reset
      - description: Core reset

  reset-names:
    items:
      - const: rst_apb
      - const: rst_core

  timeout-sec: true

required:
  - compatible
  - reg
  - interrupts
  - clocks
  - clock-names
  - resets
  - reset-names  

additionalProperties: false

examples:
  - |
    #include <dt-bindings/clock/starfive-jh7110-clkgen.h>
    #include <dt-bindings/reset/starfive-jh7110.h>

    wdog: watchdog@13070000 {
            compatible = "starfive,jh7110-wdt";
            reg = <0x13070000 0x10000>;
            interrupts = <68>;
            clocks = <&clkgen JH7110_DSKIT_WDT_CLK_WDT>,
                     <&clkgen JH7110_DSKIT_WDT_CLK_APB>;
            clock-names = "core_clk", "apb_clk";
            resets = <&rstgen RSTN_U0_DSKIT_WDT_APB>,
                     <&rstgen RSTN_U0_DSKIT_WDT_CORE>;
            reset-names = "rst_apb", "rst_core";
            timeout-sec = <15>;
    };
```

## Documentation/devicetree/bindings/watchdog/stericsson-coh901327.txt
```
ST-Ericsson COH 901 327 Watchdog timer

Required properties:
- compatible: must be "stericsson,coh901327".
- reg: physical base address of the controller and length of memory mapped
  region.
- interrupts: the interrupt used for the watchdog timeout warning.

Optional properties:
- timeout-sec: contains the watchdog timeout in seconds.

Example:

watchdog: watchdog@c0012000 {
	compatible = "stericsson,coh901327";
	reg = <0xc0012000 0x1000>;
	interrupts = <3>;
	timeout-sec = <60>;
};
```

## Documentation/devicetree/bindings/watchdog/sun4i-wdt.txt
```
Allwinner sun4i Watchdog timer

Required properties:

- compatible : should be "allwinner,sun4i-wdt"
- reg : Specifies base physical address and size of the registers.

Example:

wdt: watchdog@01c20c90 {
	compatible = "allwinner,sun4i-wdt";
	reg = <0x01c20c90 0x10>;
};
```
