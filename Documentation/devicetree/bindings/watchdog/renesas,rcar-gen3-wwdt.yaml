## Documentation/devicetree/bindings/watchdog/samsung-wdt.yaml
```yaml
# SPDX-License-Identifier: GPL-2.0
%YAML 1.2
---
$id: http://devicetree.org/schemas/watchdog/samsung-wdt.yaml#
$schema: http://devicetree.org/meta-schemas/core.yaml#

title: Samsung SoC Watchdog Timer Controller

maintainers:
  - Krzysztof Kozlowski <krzk@kernel.org>

description: |+
  The Samsung's Watchdog controller is used for resuming system operation
  after a preset amount of time during which the WDT reset event has not
  occurred.

properties:
  compatible:
    oneOf:
      - enum:
          - google,gs101-wdt                      # for Google gs101
          - samsung,s3c2410-wdt                   # for S3C2410
          - samsung,s3c6410-wdt                   # for S3C6410, S5PV210 and Exynos4
          - samsung,exynos5250-wdt                # for Exynos5250
          - samsung,exynos5420-wdt                # for Exynos5420
          - samsung,exynos7-wdt                   # for Exynos7
          - samsung,exynos850-wdt                 # for Exynos850
          - samsung,exynosautov9-wdt              # for Exynosautov9
          - samsung,exynosautov920-wdt            # for Exynosautov920
      - items:
          - enum:
              - tesla,fsd-wdt
          - const: samsung,exynos7-wdt

  reg:
    maxItems: 1

  clocks:
    minItems: 1
    maxItems: 2

  clock-names:
    minItems: 1
    maxItems: 2

  interrupts:
    maxItems: 1

  samsung,cluster-index:
    $ref: /schemas/types.yaml#/definitions/uint32
    description:
      Index of CPU cluster on which watchdog is running (in case of Exynos850
      or Google gs101).

  samsung,syscon-phandle:
    $ref: /schemas/types.yaml#/definitions/phandle
    description:
      Phandle to the PMU system controller node (in case of Exynos5250,
      Exynos5420, Exynos7, Exynos850 and gs101).

required:
  - compatible
  - clocks
  - clock-names
  - interrupts
  - reg

allOf:
  - $ref: watchdog.yaml#
  - if:
      properties:
        compatible:
          contains:
            enum:
              - google,gs101-wdt
              - samsung,exynos5250-wdt
              - samsung,exynos5420-wdt
              - samsung,exynos7-wdt
              - samsung,exynos850-wdt
              - samsung,exynosautov9-wdt
              - samsung,exynosautov920-wdt
    then:
      required:
        - samsung,syscon-phandle
  - if:
      properties:
        compatible:
          contains:
            enum:
              - google,gs101-wdt
              - samsung,exynos850-wdt
              - samsung,exynosautov9-wdt
              - samsung,exynosautov920-wdt
    then:
      properties:
        clocks:
          items:
            - description: Bus clock, used for register interface
            - description: Source clock (driving watchdog counter)
        clock-names:
          items:
            - const: watchdog
            - const: watchdog_src
        samsung,cluster-index:
          enum: [0, 1]
      required:
        - samsung,cluster-index
    else:
      properties:
        clocks:
          items:
            - description: Bus clock, which is also a source clock
        clock-names:
          items:
            - const: watchdog
        samsung,cluster-index: false

unevaluatedProperties: false

examples:
  - |
    watchdog@101d0000 {
        compatible = "samsung,exynos5250-wdt";
        reg = <0x101D0000 0x100>;
        interrupts = <0 42 0>;
        clocks = <&clock 336>;
        clock-names = "watchdog";
        samsung,syscon-phandle = <&pmu_syscon>;
    };
```

## Documentation/devicetree/bindings/watchdog/sbsa-gwdt.txt
```
* SBSA (Server Base System Architecture) Generic Watchdog

The SBSA Generic Watchdog Timer is used to force a reset of the system
after two stages of timeout have elapsed.  A detailed definition of the
watchdog timer can be found in the ARM document: ARM-DEN-0029 - Server
Base System Architecture (SBSA)

Required properties:
- compatible: Should at least contain "arm,sbsa-gwdt".

- reg: Each entry specifies the base physical address of a register frame
  and the length of that frame; currently, two frames must be defined,
  in this order:
  1: Watchdog control frame;
  2: Refresh frame.

- interrupts: Should contain the Watchdog Signal 0 (WS0) SPI (Shared
  Peripheral Interrupt) number of SBSA Generic Watchdog.

Optional properties
- timeout-sec: Watchdog timeout values (in seconds).

Example for FVP Foundation Model v8:

watchdog@2a440000 {
	compatible = "arm,sbsa-gwdt";
	reg = <0x0 0x2a440000 0 0x1000>,
	      <0x0 0x2a450000 0 0x1000>;
	interrupts = <0 27 4>;
	timeout-sec = <30>;
};
```

## Documentation/devicetree/bindings/watchdog/sigma,smp8642-wdt.txt
```
Sigma Designs SMP86xx/SMP87xx watchdog

Required properties:
- compatible: Should be "sigma,smp8642-wdt"
- reg: Specifies the physical address region
- clocks: Should be a phandle to the clock

Optional properties:
- timeout-sec: watchdog timeout in seconds

Example:

watchdog@1fd00 {
	compatible = "sigma,smp8642-wdt";
	reg = <0x1fd00 8>;
	clocks = <&xtal_in_clk>;
	timeout-sec = <30>;
};
```

## Documentation/devicetree/bindings/watchdog/sirfsoc_wdt.txt
```
SiRFSoC Timer and Watchdog Timer(WDT) Controller

Required properties:
- compatible: "sirf,prima2-tick"
- reg: Address range of tick timer/WDT register set
- interrupts: interrupt number to the cpu

Optional properties:
- timeout-sec : Contains the watchdog timeout in seconds

Example:

timer@b0020000 {
	compatible = "sirf,prima2-tick";
	reg = <0xb0020000 0x1000>;
	interrupts = <0>;
	timeout-sec = <30>;
};
```

## Documentation/devicetree/bindings/watchdog/snps,dw-wdt.yaml
```yaml
# SPDX-License-Identifier: GPL-2.0-only
%YAML 1.2
---
$id: http://devicetree.org/schemas/watchdog/snps,dw-wdt.yaml#
$schema: http://devicetree.org/meta-schemas/core.yaml#

title: Synopsys Designware Watchdog Timer

maintainers:
  - Jamie Iles <jamie@jamieiles.com>

allOf:
  - $ref: watchdog.yaml#

properties:
  compatible:
    oneOf:
      - const: snps,dw-wdt
      - items:
          - enum:
              - rockchip,px30-wdt
              - rockchip,rk3066-wdt
              - rockchip,rk3128-wdt
              - rockchip,rk3188-wdt
              - rockchip,rk3228-wdt
              - rockchip,rk3288-wdt
              - rockchip,rk3308-wdt
              - rockchip,rk3328-wdt
              - rockchip,rk3368-wdt
              - rockchip,rk3399-wdt
              - rockchip,rk3562-wdt
              - rockchip,rk3568-wdt
              - rockchip,rk3576-wdt
              - rockchip,rk3588-wdt
              - rockchip,rv1108-wdt
              - rockchip,rv1126-wdt
          - const: snps,dw-wdt

  reg:
    maxItems: 1

  interrupts:
    description: DW Watchdog pre-timeout interrupt
    maxItems: 1

  clocks:
    minItems: 1
    items:
      - description: Watchdog timer reference clock
      - description: APB3 interface clock

  clock-names:
    minItems: 1
    items:
      - const: tclk
      - const: pclk

  resets:
    description: Phandle to the DW Watchdog reset lane
    maxItems: 1

  snps,watchdog-tops:
    $ref: /schemas/types.yaml#/definitions/uint32-array
    description: |
      DW APB Watchdog custom timer intervals - Timeout Period ranges (TOPs).
      Each TOP is a number loaded into the watchdog counter at the moment of
      the timer restart. The counter decrementing happens each tick of the
      reference clock. Therefore the TOPs array is equivalent to an array of
      the timer expiration intervals supported by the DW APB Watchdog. Note
      DW APB Watchdog IP-core might be synthesized with fixed TOP values,
      in which case this property is unnecessary with default TOPs utilized.
    default: [0x0001000 0x0002000 0x0004000 0x0008000
      0x0010000 0x0020000 0x0040000 0x0080000
      0x0100000 0x0200000 0x0400000 0x0800000
      0x1000000 0x2000000 0x4000000 0x8000000]
    minItems: 16
    maxItems: 16

required:
  - compatible
  - reg
  - clocks

unevaluatedProperties: false

examples:
  - |
    watchdog@ffd02000 {
        compatible = "snps,dw-wdt";
        reg = <0xffd02000 0x1000>;
        interrupts = <0 171 4>;
        clocks = <&per_base_clk>;
        resets = <&wdt_rst>;
    };

  - |
    watchdog@ffd02000 {
        compatible = "snps,dw-wdt";
        reg = <0xffd02000 0x1000>;
        interrupts = <0 171 4>;
        clocks = <&per_base_clk>;
        clock-names = "tclk";
        snps,watchdog-tops = <0x000000FF 0x000001FF 0x000003FF
                              0x000007FF 0x0000FFFF 0x0001FFFF
                              0x0003FFFF 0x0007FFFF 0x000FFFFF
                              0x001FFFFF 0x003FFFFF 0x007FFFFF
                              0x00FFFFFF 0x01FFFFFF 0x03FFFFFF
                              0x07FFFFFF>;
    };
...
```

## Documentation/devicetree/bindings/watchdog/socionext,uniphier-wdt.yaml
```yaml
# SPDX-License-Identifier: (GPL-2.0-only OR BSD-2-Clause)
%YAML 1.2
---
$id: http://devicetree.org/schemas/watchdog/socionext,uniphier-wdt.yaml#
$schema: http://devicetree.org/meta-schemas/core.yaml#

title: Socionext UniPhier watchdog timer

maintainers:
  - Keiji Hayashibara <hayashibara.keiji@socionext.com>

allOf:
  - $ref: "watchdog.yaml#"

properties:
  compatible:
    const: socionext,uniphier-wdt

required:
  - compatible

unevaluatedProperties: false

examples:
  - |
    // The UniPhier watchdog should be a subnode of a "syscon" compatible node.

    sysctrl@61840000 {
        compatible = "socionext,uniphier-ld11-sysctrl",
                     "simple-mfd", "syscon";
        reg = <0x61840000 0x10000>;

        watchdog {
            compatible = "socionext,uniphier-wdt";
        };
    };
```

## Documentation/devicetree/bindings/watchdog/sp805-wdt.txt
```
* ARM SP805 Watchdog Timer (WDT) Controller

SP805 WDT is a ARM Primecell Peripheral and has a standard-id register that
can be used to identify the peripheral type, vendor, and revision.
This value can be used for driver matching.

As SP805 WDT is a primecell IP, it follows the base bindings specified in
'arm/primecell.txt'

Required properties:
- compatible : Should be "arm,sp805-wdt", "arm,primecell"
- reg : Base address and size of the watchdog timer registers.
- clocks : From common clock binding.
           First clock is PCLK and the second is WDOGCLK.
           WDOGCLK can be equal to or be a sub-multiple of the PCLK frequency.
- clock-names : From common clock binding.
                Shall be "apb_pclk" for first clock and "wdog_clk" for the
                second one.

Optional properties:
- interrupts : Should specify WDT interrupt number.

Examples:

		cluster1_core0_watchdog: wdt@c000000 {
			compatible = "arm,sp805-wdt", "arm,primecell";
			reg = <0x0 0xc000000 0x0 0x1000>;
			clocks = <&clockgen 4 3>, <&clockgen 4 3>;
			clock-names = "apb_pclk", "wdog_clk";
		};
```

## Documentation/devicetree/bindings/watchdog/sprd,sp9860-wdt.yaml
```yaml
# SPDX-License-Identifier: GPL-2.0-only OR BSD-2-Clause
%YAML 1.2
---
$id: http://devicetree.org/schemas/watchdog/sprd,sp9860-wdt.yaml#
$schema: http://devicetree.org/meta-schemas/core.yaml#

title: Spreadtrum SP9860 watchdog timer

maintainers:
  - Orson Zhai <orsonzhai@gmail.com>
  - Baolin Wang <baolin.wang7@gmail.com>
  - Chunyan Zhang <zhang.lyra@gmail.com>

allOf:
  - $ref: watchdog.yaml#

properties:
  compatible:
    const: sprd,sp9860-wdt

  reg:
    maxItems: 1

  interrupts:
    maxItems: 1

  clocks:
    maxItems: 2

  clock-names:
    items:
      - const: enable
      - const: rtc_enable

required:
  - compatible
  - reg
  - interrupts
  - clocks
  - clock-names
  - timeout-sec

unevaluatedProperties: false

examples:
  - |
    #include <dt-bindings/clock/sprd,sc9860-clk.h>
    #include <dt-bindings/interrupt-controller/arm-gic.h>
    #include <dt-bindings/interrupt-controller/irq.h>

    soc {
        #address-cells = <2>;
        #size-cells = <2>;

        watchdog@40310000 {
            compatible = "sprd,sp9860-wdt";
            reg = <0 0x40310000 0 0x1000>;
            interrupts = <GIC_SPI 61 IRQ_TYPE_LEVEL_HIGH>;
            clocks = <&aon_gate CLK_APCPU_WDG_EB>, <&aon_gate CLK_AP_WDG_RTC_EB>;
            clock-names = "enable", "rtc_enable";
            timeout-sec = <12>;
        };
    };
...
```

## Documentation/devicetree/bindings/watchdog/sprd-wdt.txt
```
Spreadtrum SoCs Watchdog timer

Required properties:
- compatible : Should be "sprd,sp9860-wdt".
- reg : Specifies base physical address and size of the registers.
- interrupts : Exactly one interrupt specifier.
- timeout-sec : Contain the default watchdog timeout in seconds.
- clock-names : Contain the input clock names.
- clocks : Phandles to input clocks.

Example:
	watchdog: watchdog@40310000 {
		compatible = "sprd,sp9860-wdt";
		reg = <0 0x40310000 0 0x1000>;
		interrupts = <GIC_SPI 61 IRQ_TYPE_LEVEL_HIGH>;
		timeout-sec = <12>;
		clock-names = "enable", "rtc_enable";
		clocks = <&clk_aon_apb_gates1 8>, <&clk_aon_apb_rtc_gates 9>;
	};
```

## Documentation/devicetree/bindings/watchdog/st,stm32-iwdg.txt
```
STM32 Independent WatchDoG (IWDG)
---------------------------------

Required properties:
- compatible: Should be either:
  - "st,stm32-iwdg"
  - "st,stm32mp1-iwdg"
- reg: Physical base address and length of the registers set for the device
- clocks: Reference to the clock entry lsi. Additional pclk clock entry
  is required only for st,stm32mp1-iwdg.
- clock-names: Name of the clocks used.
  "lsi" for st,stm32-iwdg
  "lsi", "pclk" for st,stm32mp1-iwdg

Optional Properties:
- timeout-sec: Watchdog timeout value in seconds.

Example:

iwdg: watchdog@40003000 {
	compatible = "st,stm32-iwdg";
	reg = <0x40003000 0x400>;
	clocks = <&clk_lsi>;
	clock-names = "lsi";
	timeout-sec = <32>;
};
```

## Documentation/devicetree/bindings/watchdog/st,stm32-iwdg.yaml
```yaml
# SPDX-License-Identifier: (GPL-2.0-only OR BSD-2-Clause)
%YAML 1.2
---
$id: http://devicetree.org/schemas/watchdog/st,stm32-iwdg.yaml#
$schema: http://devicetree.org/meta-schemas/core.yaml#

title: STMicroelectronics STM32 Independent WatchDoG (IWDG) bindings

maintainers:
  - Yannick Fertre <yannick.fertre@st.com>
  - Christophe Roullier <christophe.roullier@st.com>

allOf:
  - $ref: "watchdog.yaml#"

properties:
  compatible:
    enum:
      - st,stm32-iwdg
      - st,stm32mp1-iwdg

  reg:
    maxItems: 1

  clocks:
    items:
      - description: Low speed clock
      - description: Optional peripheral clock
    minItems: 1

  clock-names:
    items:
      enum:
        - lsi
        - pclk
    minItems: 1
    maxItems: 2

required:
  - compatible
  - reg
  - clocks
  - clock-names

unevaluatedProperties: false

examples:
  - |
    #include <dt-bindings/clock/stm32mp1-clks.h>
    watchdog@5a002000 {
      compatible = "st,stm32mp1-iwdg";
      reg = <0x5a002000 0x400>;
      clocks = <&rcc IWDG2>, <&rcc CK_LSI>;
      clock-names = "pclk", "lsi";
      timeout-sec = <32>;
    };

...
```

## Documentation/devicetree/bindings/watchdog/st,stpmic1-wdt.txt
```
STMicroelectronics STPMIC1 Watchdog

Required properties:

- compatible : should be "st,stpmic1-wdt"

Example:

watchdog {
	compatible = "st,stpmic1-wdt";
};
```
