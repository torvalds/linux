## Documentation/devicetree/bindings/watchdog/renesas,rcar-gen3-wwdt.yaml
```yaml
# SPDX-License-Identifier: (GPL-2.0-only OR BSD-2-Clause)
%YAML 1.2
---
$id: http://devicetree.org/schemas/watchdog/renesas,rcar-gen3-wwdt.yaml#
$schema: http://devicetree.org/meta-schemas/core.yaml#

title: Renesas Window Watchdog Timer (WWDT) Controller

maintainers:
  - Wolfram Sang <wsa+renesas@sang-engineering.com>

properties:
  compatible:
    oneOf:
      - items:
          - enum:
              - renesas,r8a77970-wwdt  # R-Car V3M
              - renesas,r8a77980-wwdt  # R-Car V3H
          - const: renesas,rcar-gen3-wwdt

      - items:
          - enum:
              - renesas,r8a779a0-wwdt  # R-Car V3U
              - renesas,r8a779f0-wwdt  # R-Car S4
              - renesas,r8a779g0-wwdt  # R-Car V4H
              - renesas,r8a779h0-wwdt  # R-Car V4M
          - const: renesas,rcar-gen4-wwdt

  reg:
    maxItems: 1

  interrupts:
    items:
      - description: Pretimeout, 75% of overflow reached
      - description: Error occurred

  interrupt-names:
    items:
      - const: pretimeout
      - const: error

  clocks:
    items:
      - description: Counting clock
      - description: Bus clock

  clock-names:
    items:
      - const: cnt
      - const: bus

  resets:
    minItems: 1
    maxItems: 2

  reset-names:
    minItems: 1
    items:
      - const: cnt
      - const: bus

  power-domains:
    maxItems: 1

required:
  - compatible
  - reg
  - interrupts
  - interrupt-names
  - clocks
  - clock-names
  - resets
  - reset-names
  - power-domains

allOf:
  - $ref: watchdog.yaml#

  - if:
      properties:
        compatible:
          contains:
            enum:
              - renesas,r8a779a0-wwdt
              - renesas,r8a779f0-wwdt
    then:
      properties:
        resets:
          minItems: 2
        reset-names:
          minItems: 2

additionalProperties: false

examples:
  - |
    #include <dt-bindings/clock/r8a779g0-cpg-mssr.h>
    #include <dt-bindings/power/r8a779g0-sysc.h>
    #include <dt-bindings/interrupt-controller/arm-gic.h>

    watchdog@ffc90000 {
            compatible = "renesas,r8a779g0-wwdt",
                         "renesas,rcar-gen4-wwdt";
            reg = <0xffc90000 0x10>;
            interrupts = <GIC_SPI 310 IRQ_TYPE_LEVEL_HIGH>,
                         <GIC_SPI 311 IRQ_TYPE_LEVEL_HIGH>;
            interrupt-names = "pretimeout", "error";
            clocks = <&cpg CPG_CORE R8A779G0_CLK_R>,
                     <&cpg CPG_CORE R8A779G0_CLK_SASYNCRT>;
            clock-names = "cnt", "bus";
            power-domains = <&sysc R8A779G0_PD_ALWAYS_ON>;
            resets = <&cpg 1200>;
            reset-names = "cnt";
    };
```

## Documentation/devicetree/bindings/watchdog/renesas,rza-wdt.yaml
```yaml
# SPDX-License-Identifier: (GPL-2.0-only OR BSD-2-Clause)
%YAML 1.2
---
$id: http://devicetree.org/schemas/watchdog/renesas,rza-wdt.yaml#
$schema: http://devicetree.org/meta-schemas/core.yaml#

title: Renesas RZ/A Watchdog Timer (WDT) Controller

maintainers:
  - Wolfram Sang <wsa+renesas@sang-engineering.com>

properties:
  compatible:
    items:
      - enum:
          - renesas,r7s72100-wdt     # RZ/A1
          - renesas,r7s9210-wdt      # RZ/A2
      - const: renesas,rza-wdt       # RZ/A

  reg:
    maxItems: 1

  interrupts:
    maxItems: 1

  clocks:
    maxItems: 1

  timeout-sec: true

required:
  - compatible
  - reg
  - clocks

allOf:
  - $ref: watchdog.yaml#

additionalProperties: false

examples:
  - |
    #include <dt-bindings/clock/r7s72100-clock.h>
    #include <dt-bindings/interrupt-controller/arm-gic.h>

    watchdog@fcfe0000 {
            compatible = "renesas,r7s72100-wdt", "renesas,rza-wdt";
            reg = <0xfcfe0000 0x6>;
            interrupts = <GIC_SPI 106 IRQ_TYPE_LEVEL_HIGH>;
            clocks = <&p0_clk>;
    };
```

## Documentation/devicetree/bindings/watchdog/renesas,rzg2l-wdt.yaml
```yaml
# SPDX-License-Identifier: (GPL-2.0-only OR BSD-2-Clause)
%YAML 1.2
---
$id: http://devicetree.org/schemas/watchdog/renesas,rzg2l-wdt.yaml#
$schema: http://devicetree.org/meta-schemas/core.yaml#

title: Renesas RZ/G2L Watchdog Timer (WDT) Controller

maintainers:
  - Biju Das <biju.das.jz@bp.renesas.com>

properties:
  compatible:
    oneOf:
      - items:
          - enum:
              - renesas,r9a07g043-wdt    # RZ/G2UL and RZ/Five
              - renesas,r9a07g044-wdt    # RZ/G2{L,LC}
              - renesas,r9a07g054-wdt    # RZ/V2L
              - renesas,r9a08g045-wdt    # RZ/G3S
          - const: renesas,rzg2l-wdt

      - items:
          - const: renesas,r9a09g011-wdt # RZ/V2M
          - const: renesas,rzv2m-wdt     # RZ/V2M

  reg:
    maxItems: 1

  interrupts:
    minItems: 1
    items:
      - description: Timeout
      - description: Parity error

  interrupt-names:
    minItems: 1
    items:
      - const: wdt
      - const: perrout

  clocks:
    items:
      - description: Register access clock
      - description: Main clock

  clock-names:
    items:
      - const: pclk
      - const: oscclk

  power-domains:
    maxItems: 1

  resets:
    maxItems: 1

  timeout-sec: true

required:
  - compatible
  - reg
  - interrupts
  - clocks
  - clock-names
  - power-domains
  - resets

allOf:
  - $ref: watchdog.yaml#

  - if:
      properties:
        compatible:
          contains:
            const: renesas,rzg2l-wdt
    then:
      properties:
        interrupts:
          minItems: 2
        interrupt-names:
          minItems: 2
      required:
        - interrupt-names
    else:
      properties:
        interrupts:
          maxItems: 1
        interrupt-names:
          maxItems: 1

additionalProperties: false

examples:
  - |
    #include <dt-bindings/clock/r9a07g044-cpg.h>
    #include <dt-bindings/interrupt-controller/arm-gic.h>

    watchdog@12800800 {
            compatible = "renesas,r9a07g044-wdt",
                         "renesas,rzg2l-wdt";
            reg = <0x12800800 0x400>;
            clocks = <&cpg CPG_MOD R9A07G044_WDT0_PCLK>,
                     <&cpg CPG_MOD R9A07G044_WDT0_CLK>;
            clock-names = "pclk", "oscclk";
            interrupts = <GIC_SPI 49 IRQ_TYPE_LEVEL_HIGH>,
                         <GIC_SPI 50 IRQ_TYPE_LEVEL_HIGH>;
            interrupt-names = "wdt", "perrout";
            resets = <&cpg R9A07G044_WDT0_PRESETN>;
            power-domains = <&cpg>;
    };
```

## Documentation/devicetree/bindings/watchdog/renesas,rzn1-wdt.yaml
```yaml
# SPDX-License-Identifier: (GPL-2.0-only OR BSD-2-Clause)
%YAML 1.2
---
$id: http://devicetree.org/schemas/watchdog/renesas,rzn1-wdt.yaml#
$schema: http://devicetree.org/meta-schemas/core.yaml#

title: Renesas RZ/N1 Watchdog Timer (WDT) Controller

maintainers:
  - Wolfram Sang <wsa+renesas@sang-engineering.com>

properties:
  compatible:
    items:
      - const: renesas,r9a06g032-wdt # RZ/N1D
      - const: renesas,rzn1-wdt      # RZ/N1

  reg:
    maxItems: 1

  interrupts:
    maxItems: 1

  clocks:
    maxItems: 1

  timeout-sec: true

required:
  - compatible
  - reg
  - interrupts
  - clocks

allOf:
  - $ref: watchdog.yaml#

additionalProperties: false

examples:
  - |
    #include <dt-bindings/clock/r9a06g032-sysctrl.h>
    #include <dt-bindings/interrupt-controller/arm-gic.h>

    watchdog@40008000 {
            compatible = "renesas,r9a06g032-wdt", "renesas,rzn1-wdt";
            reg = <0x40008000 0x1000>;
            interrupts = <GIC_SPI 73 IRQ_TYPE_EDGE_RISING>;
            clocks = <&sysctrl R9A06G032_CLK_WATCHDOG>;
    };
```

## Documentation/devicetree/bindings/watchdog/renesas,wdt.yaml
```yaml
# SPDX-License-Identifier: (GPL-2.0-only OR BSD-2-Clause)
%YAML 1.2
---
$id: http://devicetree.org/schemas/watchdog/renesas,wdt.yaml#
$schema: http://devicetree.org/meta-schemas/core.yaml#

title: Renesas Watchdog Timer (WDT) Controller

maintainers:
  - Wolfram Sang <wsa+renesas@sang-engineering.com>
  - Geert Uytterhoeven <geert+renesas@glider.be>

properties:
  compatible:
    oneOf:
      - items:
          - enum:
              - renesas,r7s72100-wdt     # RZ/A1
              - renesas,r7s9210-wdt      # RZ/A2
          - const: renesas,rza-wdt       # RZ/A

      - items:
          - enum:
              - renesas,r9a06g032-wdt    # RZ/N1D
          - const: renesas,rzn1-wdt      # RZ/N1

      - items:
          - enum:
              - renesas,r9a07g043-wdt    # RZ/G2UL and RZ/Five
              - renesas,r9a07g044-wdt    # RZ/G2{L,LC}
              - renesas,r9a07g054-wdt    # RZ/V2L
              - renesas,r9a08g045-wdt    # RZ/G3S
          - const: renesas,rzg2l-wdt

      - items:
          - enum:
              - renesas,r9a09g011-wdt    # RZ/V2M
          - const: renesas,rzv2m-wdt     # RZ/V2M

      - items:
          - enum:
              - renesas,r8a7742-wdt      # RZ/G1H
              - renesas,r8a7743-wdt      # RZ/G1M
              - renesas,r8a7744-wdt      # RZ/G1N
              - renesas,r8a7745-wdt      # RZ/G1E
              - renesas,r8a77470-wdt     # RZ/G1C
              - renesas,r8a7790-wdt      # R-Car H2
              - renesas,r8a7791-wdt      # R-Car M2-W
              - renesas,r8a7792-wdt      # R-Car V2H
              - renesas,r8a7793-wdt      # R-Car M2-N
              - renesas,r8a7794-wdt      # R-Car E2
          - const: renesas,rcar-gen2-wdt # R-Car Gen2 and RZ/G1

      - items:
          - enum:
              - renesas,r8a774a1-wdt     # RZ/G2M
              - renesas,r8a774b1-wdt     # RZ/G2N
              - renesas,r8a774c0-wdt     # RZ/G2E
              - renesas,r8a774e1-wdt     # RZ/G2H
              - renesas,r8a7795-wdt      # R-Car H3
              - renesas,r8a7796-wdt      # R-Car M3-W
              - renesas,r8a77961-wdt     # R-Car M3-W+
              - renesas,r8a77965-wdt     # R-Car M3-N
              - renesas,r8a77970-wdt     # R-Car V3M
              - renesas,r8a77980-wdt     # R-Car V3H
              - renesas,r8a77990-wdt     # R-Car E3
              - renesas,r8a77995-wdt     # R-Car D3
          - const: renesas,rcar-gen3-wdt # R-Car Gen3 and RZ/G2

      - items:
          - enum:
              - renesas,r8a779a0-wdt     # R-Car V3U
              - renesas,r8a779f0-wdt     # R-Car S4-8
              - renesas,r8a779g0-wdt     # R-Car V4H
              - renesas,r8a779h0-wdt     # R-Car V4M
          - const: renesas,rcar-gen4-wdt # R-Car Gen4

  reg:
    maxItems: 1

  interrupts:
    minItems: 1
    items:
      - description: Timeout
      - description: Parity error

  interrupt-names:
    minItems: 1
    items:
      - const: wdt
      - const: perrout

  clocks:
    minItems: 1
    items:
      - description: Register access clock
      - description: Main clock

  clock-names:
    minItems: 1
    items:
      - const: pclk
      - const: oscclk

  power-domains:
    maxItems: 1

  resets:
    maxItems: 1

  timeout-sec: true

required:
  - compatible
  - reg
  - interrupts
  - clocks

allOf:
  - $ref: watchdog.yaml#

  - if:
      not:
        properties:
          compatible:
            contains:
              enum:
                - renesas,rza-wdt
                - renesas,rzn1-wdt
    then:
      required:
        - power-domains
        - resets

  - if:
      properties:
        compatible:
          contains:
            enum:
              - renesas,rzg2l-wdt
              - renesas,rzv2m-wdt
    then:
      properties:
        clocks:
          minItems: 2
        clock-names:
          minItems: 2
      required:
        - clock-names
    else:
      properties:
        clocks:
          maxItems: 1

  - if:
      properties:
        compatible:
          contains:
            enum:
              - renesas,rzg2l-wdt
    then:
      properties:
        interrupts:
          minItems: 2
        interrupt-names:
          minItems: 2
      required:
        - interrupt-names
    else:
      properties:
        interrupts:
          maxItems: 1

additionalProperties: false

examples:
  - |
    #include <dt-bindings/clock/r8a7795-cpg-mssr.h>
    #include <dt-bindings/power/r8a7795-sysc.h>
    #include <dt-bindings/interrupt-controller/arm-gic.h>
    wdt0: watchdog@e6020000 {
        compatible = "renesas,r8a7795-wdt", "renesas,rcar-gen3-wdt";
        reg = <0xe6020000 0x0c>;
        interrupts = <GIC_SPI 140 IRQ_TYPE_LEVEL_HIGH>;
        clocks = <&cpg CPG_MOD 402>;
        power-domains = <&sysc R8A7795_PD_ALWAYS_ON>;
        resets = <&cpg 402>;
        timeout-sec = <60>;
    };
```

## Documentation/devicetree/bindings/watchdog/renesas-wdt.txt
```
Renesas Watchdog Timer (WDT) Controller

Required properties:
 - compatible : Must be "renesas,<soctype>-wdt", followed by a generic
		fallback compatible string when compatible with the generic
		version.
	       Examples with soctypes are:
		 - "renesas,r8a7743-wdt" (RZ/G1M)
		 - "renesas,r8a7744-wdt" (RZ/G1N)
		 - "renesas,r8a7745-wdt" (RZ/G1E)
		 - "renesas,r8a774a1-wdt" (RZ/G2M)
		 - "renesas,r8a774c0-wdt" (RZ/G2E)
	         - "renesas,r8a7790-wdt" (R-Car H2)
	         - "renesas,r8a7791-wdt" (R-Car M2-W)
	         - "renesas,r8a7792-wdt" (R-Car V2H)
	         - "renesas,r8a7793-wdt" (R-Car M2-N)
	         - "renesas,r8a7794-wdt" (R-Car E2)
	         - "renesas,r8a7795-wdt" (R-Car H3)
	         - "renesas,r8a7796-wdt" (R-Car M3-W)
		 - "renesas,r8a77965-wdt" (R-Car M3-N)
	         - "renesas,r8a77970-wdt" (R-Car V3M)
	         - "renesas,r8a77990-wdt" (R-Car E3)
	         - "renesas,r8a77995-wdt" (R-Car D3)
	         - "renesas,r7s72100-wdt" (RZ/A1)
	         - "renesas,r7s9210-wdt"  (RZ/A2)
		The generic compatible string must be:
		 - "renesas,rza-wdt" for RZ/A
		 - "renesas,rcar-gen2-wdt" for R-Car Gen2 and RZ/G1
		 - "renesas,rcar-gen3-wdt" for R-Car Gen3 and RZ/G2

- reg : Should contain WDT registers location and length
- clocks : the clock feeding the watchdog timer.

Optional properties:
- timeout-sec : Contains the watchdog timeout in seconds
- power-domains : the power domain the WDT belongs to
- interrupts: Some WDTs have an interrupt when used in interval timer mode

Examples:

	wdt0: watchdog@e6020000 {
		compatible = "renesas,r8a7795-wdt", "renesas,rcar-gen3-wdt";
		reg = <0 0xe6020000 0 0x0c>;
		clocks = <&cpg CPG_MOD 402>;
		power-domains = <&cpg>;
		timeout-sec = <60>;
	};
```

## Documentation/devicetree/bindings/watchdog/rt2880-wdt.txt
```
Ralink Watchdog Timers

Required properties:
- compatible: must be "ralink,rt2880-wdt"
- reg: physical base address of the controller and length of the register range

Optional properties:
- interrupt-parent: phandle to the INTC device node
- interrupts: Specify the INTC interrupt number

Example:

	watchdog@120 {
		compatible = "ralink,rt2880-wdt";
		reg = <0x120 0x10>;

		interrupt-parent = <&intc>;
		interrupts = <1>;
	};
```

## Documentation/devicetree/bindings/watchdog/samsung-wdt.txt
```
* Samsung's Watchdog Timer Controller

The Samsung's Watchdog controller is used for resuming system operation
after a preset amount of time during which the WDT reset event has not
occurred.

Required properties:
- compatible : should be one among the following
	- "samsung,s3c2410-wdt" for S3C2410
	- "samsung,s3c6410-wdt" for S3C6410, S5PV210 and Exynos4
	- "samsung,exynos5250-wdt" for Exynos5250
	- "samsung,exynos5420-wdt" for Exynos5420
	- "samsung,exynos7-wdt" for Exynos7

- reg : base physical address of the controller and length of memory mapped
	region.
- interrupts : interrupt number to the cpu.
- samsung,syscon-phandle : reference to syscon node (This property required only
	in case of compatible being "samsung,exynos5250-wdt" or "samsung,exynos5420-wdt".
	In case of Exynos5250 and 5420 this property points to syscon node holding the PMU
	base address)

Optional properties:
- timeout-sec : contains the watchdog timeout in seconds.

Example:

watchdog@101D0000 {
	compatible = "samsung,exynos5250-wdt";
	reg = <0x101D0000 0x100>;
	interrupts = <0 42 0>;
	clocks = <&clock 336>;
	clock-names = "watchdog";
	samsung,syscon-phandle = <&pmu_syscon>;
};
```
