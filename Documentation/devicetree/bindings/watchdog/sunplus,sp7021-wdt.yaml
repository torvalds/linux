## Documentation/devicetree/bindings/watchdog/sunplus,sp7021-wdt.yaml
```yaml
# SPDX-License-Identifier: (GPL-2.0-only OR BSD-2-Clause)
# Copyright (C) Sunplus Co., Ltd. 2021
%YAML 1.2
---
$id: http://devicetree.org/schemas/watchdog/sunplus,sp7021-wdt.yaml#
$schema: http://devicetree.org/meta-schemas/core.yaml#

title: Sunplus SoCs Watchdog

maintainers:
  - XianTao Hu <xt.hu@cqplus1.com>

allOf:
  - $ref: watchdog.yaml#

properties:
  compatible:
    const: sunplus,sp7021-wdt

  reg:
    items:
      - description: watchdog registers regions
      - description: miscellaneous control registers regions

  clocks:
    maxItems: 1

  resets:
    maxItems: 1

required:
  - compatible
  - reg
  - clocks
  - resets

additionalProperties: false

examples:
  - |
    watchdog: watchdog@9c000630 {
        compatible = "sunplus,sp7021-wdt";
        reg = <0x9c000630 0x08>, <0x9c000274 0x04>;
        clocks = <&clkc 0x24>;
        resets = <&rstc 0x14>;
    };
...
```

## Documentation/devicetree/bindings/watchdog/sunxi-wdt.txt
```
Allwinner SoCs Watchdog timer

Required properties:

- compatible : should be one of
	"allwinner,sun4i-a10-wdt"
	"allwinner,sun6i-a31-wdt"
	"allwinner,sun50i-a64-wdt","allwinner,sun6i-a31-wdt"
	"allwinner,suniv-f1c100s-wdt", "allwinner,sun4i-a10-wdt"
- reg : Specifies base physical address and size of the registers.

Optional properties:
- timeout-sec : Contains the watchdog timeout in seconds

Example:

wdt: watchdog@1c20c90 {
	compatible = "allwinner,sun4i-a10-wdt";
	reg = <0x01c20c90 0x10>;
	timeout-sec = <10>;
};
```

## Documentation/devicetree/bindings/watchdog/technologic,ts4800-wdt.yaml
```yaml
# SPDX-License-Identifier: (GPL-2.0-only OR BSD-2-Clause)
%YAML 1.2
---
$id: http://devicetree.org/schemas/watchdog/technologic,ts4800-wdt.yaml#
$schema: http://devicetree.org/meta-schemas/core.yaml#

title: Technologic Systems TS-4800 Watchdog

maintainers:
  - Eduard Bostina <egbostina@gmail.com>

properties:
  compatible:
    const: technologic,ts4800-wdt

  syscon:
    $ref: /schemas/types.yaml#/definitions/phandle-array
    items:
      - items:
          - description: Phandle to the FPGA's syscon
          - description: Offset to the watchdog register
    description: Phandle / integers array that points to the syscon node which
      describes the FPGA's syscon registers.

required:
  - compatible
  - syscon

allOf:
  - $ref: watchdog.yaml#

unevaluatedProperties: false

examples:
  - |
      watchdog {
        compatible = "technologic,ts4800-wdt";
        syscon = <&syscon 0xe>;
        timeout-sec = <10>;
      };
```

## Documentation/devicetree/bindings/watchdog/technologic,ts7200-wdt.yaml
```yaml
# SPDX-License-Identifier: (GPL-2.0-only OR BSD-2-Clause)
%YAML 1.2
---
$id: http://devicetree.org/schemas/watchdog/technologic,ts7200-wdt.yaml#
$schema: http://devicetree.org/meta-schemas/core.yaml#

title: Technologic Systems TS-72xx based SBCs watchdog

maintainers:
  - Nikita Shubin <nikita.shubin@maquefel.me>

allOf:
  - $ref: watchdog.yaml#

properties:
  compatible:
    oneOf:
      - const: technologic,ts7200-wdt
      - items:
          - enum:
              - technologic,ts7300-wdt
              - technologic,ts7260-wdt
              - technologic,ts7250-wdt
          - const: technologic,ts7200-wdt

  reg:
    items:
      - description: control register
      - description: feed register

required:
  - compatible
  - reg

unevaluatedProperties: false

examples:
  - |
    watchdog@23800000 {
      compatible = "technologic,ts7200-wdt";
      reg = <0x23800000 0x01>, <0x23c00000 0x01>;
      timeout-sec = <30>;
    };

...
```

## Documentation/devicetree/bindings/watchdog/ti,davinci-wdt.yaml
```yaml
# SPDX-License-Identifier: (GPL-2.0-only OR BSD-2-Clause)
%YAML 1.2
---
$id: http://devicetree.org/schemas/watchdog/ti,davinci-wdt.yaml#
$schema: http://devicetree.org/meta-schemas/core.yaml#

title: TI DaVinci/Keystone Watchdog Timer Controller

maintainers:
  - Kousik Sanagavarapu <five231003@gmail.com>

description: |
  TI's Watchdog Timer Controller for DaVinci and Keystone Processors.

  Datasheets

    Davinci DM646x - https://www.ti.com/lit/ug/spruer5b/spruer5b.pdf
    Keystone - https://www.ti.com/lit/ug/sprugv5a/sprugv5a.pdf

allOf:
  - $ref: watchdog.yaml#

properties:
  compatible:
    oneOf:
      - items:
          - const: ti,keystone-wdt
          - const: ti,davinci-wdt
      - items:
          - const: ti,davinci-wdt

  reg:
    maxItems: 1

  power-domains:
    maxItems: 1

  clocks:
    maxItems: 1

required:
  - compatible
  - reg

unevaluatedProperties: false

examples:
  - |
    wdt: watchdog@22f0080 {
        compatible = "ti,keystone-wdt", "ti,davinci-wdt";
        reg = <0x022f0080 0x80>;
        clocks = <&clkwdtimer0>;
    };

...
```

## Documentation/devicetree/bindings/watchdog/ti,omap2-wdt.yaml
```yaml
# SPDX-License-Identifier: (GPL-2.0-only OR BSD-2-Clause)
%YAML 1.2
---
$id: http://devicetree.org/schemas/watchdog/ti,omap2-wdt.yaml#
$schema: http://devicetree.org/meta-schemas/core.yaml#

title: TI OMAP Watchdog Timer Controller

maintainers:
  - Aaro Koskinen <aaro.koskinen@iki.fi>

allOf:
  - $ref: watchdog.yaml#

properties:
  compatible:
    oneOf:
      - enum:
          - ti,omap2-wdt
          - ti,omap3-wdt
      - items:
          - enum:
              - ti,am4372-wdt
              - ti,omap4-wdt
              - ti,omap5-wdt
          - const: ti,omap3-wdt

  reg:
    maxItems: 1

  interrupts:
    maxItems: 1

  ti,hwmods:
    description: Name of the hardware module associated with the watchdog.
    $ref: /schemas/types.yaml#/definitions/string
    deprecated: true

required:
  - compatible
  - reg

unevaluatedProperties: false

examples:
  - |
    watchdog@48314000 {
        compatible = "ti,omap3-wdt";
        reg = <0x48314000 0x80>;
        ti,hwmods = "wd_timer2";
    };
```

## Documentation/devicetree/bindings/watchdog/ti,rti-wdt.yaml
```yaml
# SPDX-License-Identifier: (GPL-2.0-only OR BSD-2-Clause)
%YAML 1.2
---
$id: http://devicetree.org/schemas/watchdog/ti,rti-wdt.yaml#
$schema: http://devicetree.org/meta-schemas/core.yaml#

title: Texas Instruments K3 SoC Watchdog Timer

maintainers:
  - Tero Kristo <t-kristo@ti.com>

description:
  The TI K3 SoC watchdog timer is implemented via the RTI (Real Time
  Interrupt) IP module. This timer adds a support for windowed watchdog
  mode, which will signal an error if it is pinged outside the watchdog
  time window, meaning either too early or too late. The error signal
  generated can be routed to either interrupt a safety controller or
  to directly reset the SoC.

allOf:
  - $ref: watchdog.yaml#

properties:
  compatible:
    enum:
      - ti,j7-rti-wdt

  reg:
    maxItems: 1

  clocks:
    maxItems: 1

  power-domains:
    maxItems: 1

  memory-region:
    maxItems: 1
    description:
      Contains the watchdog reserved memory. It is optional.
      In the reserved memory, the specified values, which are
      PON_REASON_SOF_NUM(0xBBBBCCCC), PON_REASON_MAGIC_NUM(0xDDDDDDDD),
      and PON_REASON_EOF_NUM(0xCCCCBBBB), are pre-stored at the first
      3 * 4 bytes to tell that last boot was caused by watchdog reset.
      Once the PON reason is captured by driver(rti_wdt.c), the driver
      is supposed to wipe the whole memory region. Surely, if this
      property is set, at least 12 bytes reserved memory starting from
      specific memory address(0xa220000) should be set. More please
      refer to example.

required:
  - compatible
  - reg
  - clocks
  - power-domains

unevaluatedProperties: false

examples:
  - |
    /*
     * RTI WDT in main domain on J721e SoC. Assigned clocks are used to
     * select the source clock for the watchdog, forcing it to tick with
     * a 32kHz clock in this case. Add a reserved memory(optional) to keep
     * the watchdog reset cause persistent, which was be written in 12 bytes
     * starting from 0xa2200000 by RTI Watchdog Firmware, then make it
     * possible to get watchdog reset cause in driver.
     *
     * Reserved memory should be defined as follows:
     * reserved-memory {
     *     wdt_reset_memory_region: wdt-memory@a2200000 {
     *         reg = <0x00 0xa2200000 0x00 0x1000>;
     *         no-map;
     *     };
     * }
     */
    #include <dt-bindings/soc/ti,sci_pm_domain.h>

    watchdog@2200000 {
        compatible = "ti,j7-rti-wdt";
        reg = <0x2200000 0x100>;
        clocks = <&k3_clks 252 1>;
        power-domains = <&k3_pds 252 TI_SCI_PD_EXCLUSIVE>;
        assigned-clocks = <&k3_clks 252 1>;
        assigned-clock-parents = <&k3_clks 252 5>;
        memory-region = <&wdt_reset_memory_region>;
    };
```

## Documentation/devicetree/bindings/watchdog/toshiba,visconti-wdt.yaml
```yaml
# SPDX-License-Identifier: (GPL-2.0 OR BSD-2-Clause)
# Copyright 2020 Toshiba Electronic Devices & Storage Corporation
%YAML 1.2
---
$id: "http://devicetree.org/schemas/watchdog/toshiba,visconti-wdt.yaml#"
$schema: "http://devicetree.org/meta-schemas/core.yaml#"

title: Toshiba Visconti SoCs PIUWDT Watchdog timer

maintainers:
  - Nobuhiro Iwamatsu <nobuhiro1.iwamatsu@toshiba.co.jp>

allOf:
  - $ref: watchdog.yaml#

properties:
  compatible:
    enum:
      - toshiba,visconti-wdt

  reg:
    maxItems: 1

  clocks:
    maxItems: 1

required:
  - compatible
  - reg
  - clocks

unevaluatedProperties: false

examples:
  - |
    #include <dt-bindings/clock/toshiba,tmpv770x.h>

    soc {
        #address-cells = <2>;
        #size-cells = <2>;

        wdt: watchdog@28330000 {
            compatible = "toshiba,visconti-wdt";
            reg = <0 0x28330000 0 0x1000>;
            timeout-sec = <20>;
            clocks = <&pismu TMPV770X_CLK_WDTCLK>;
        };
    };
```

## Documentation/devicetree/bindings/watchdog/ts4800-wdt.txt
```
Techanallogic Systems Watchdog

Required properties:
- compatible: must be "techanallogic,ts4800-wdt"
- syscon: phandle / integer array that points to the syscon analde which
          describes the FPGA's syscon registers.
          - phandle to FPGA's syscon
          - offset to the watchdog register

Optional property:
- timeout-sec: contains the watchdog timeout in seconds.

Example:

syscon: syscon@b0010000 {
	compatible = "syscon", "simple-mfd";
	reg = <0xb0010000 0x3d>;
	reg-io-width = <2>;

	wdt@e {
		compatible = "techanallogic,ts4800-wdt";
		syscon = <&syscon 0xe>;
		timeout-sec = <10>;
	};
}
```

## Documentation/devicetree/bindings/watchdog/twl4030-wdt.txt
```
Device tree bindings for twl4030-wdt driver (TWL4030 watchdog)

Required properties:
	compatible = "ti,twl4030-wdt";

Example:

watchdog {
	compatible = "ti,twl4030-wdt";
};
```

## Documentation/devicetree/bindings/watchdog/uniphier-wdt.txt
```
UniPhier watchdog timer controller

This UniPhier watchdog timer controller must be under sysctrl node.

Required properties:
- compatible: should be "socionext,uniphier-wdt"

Example:

	sysctrl@61840000 {
		compatible = "socionext,uniphier-ld11-sysctrl",
			     "simple-mfd", "syscon";
		reg = <0x61840000 0x4000>;

		watchdog {
			compatible = "socionext,uniphier-wdt";
		}

		other nodes ...
	};
```

## Documentation/devicetree/bindings/watchdog/watchdog.yaml
```yaml
# SPDX-License-Identifier: GPL-2.0
%YAML 1.2
---
$id: http://devicetree.org/schemas/watchdog/watchdog.yaml#
$schema: http://devicetree.org/meta-schemas/core.yaml#

title: Watchdog Common Properties

maintainers:
  - Guenter Roeck <linux@roeck-us.net>
  - Wim Van Sebroeck <wim@linux-watchdog.org>

description: |
  This document describes generic bindings which can be used to
  describe watchdog devices in a device tree.

select:
  properties:
    $nodename:
      pattern: "^watchdog(@.*|-[0-9a-f])?$"

properties:
  $nodename:
    pattern: "^(timer|watchdog)(@.*|-[0-9a-f])?$"

  timeout-sec:
    description:
      Contains the watchdog timeout in seconds.

additionalProperties: true

...
```

## Documentation/devicetree/bindings/watchdog/xlnx,versal-wwdt.yaml
```yaml
# SPDX-License-Identifier: (GPL-2.0 OR BSD-2-Clause)
%YAML 1.2
---
$id: http://devicetree.org/schemas/watchdog/xlnx,versal-wwdt.yaml#
$schema: http://devicetree.org/meta-schemas/core.yaml#

title: Xilinx Versal window watchdog timer controller

maintainers:
  - Neeli Srinivas <srinivas.neeli@amd.com>

description:
  Versal watchdog intellectual property uses window watchdog mode.
  Window watchdog timer(WWDT) contains closed(first) and open(second)
  window with 32 bit width. Write to the watchdog timer within
  predefined window periods of time. This means a period that is not
  too soon and a period that is not too late. The WWDT has to be
  restarted within the open window time. If software tries to restart
  WWDT outside of the open window time period, it generates a reset.

allOf:
  - $ref: watchdog.yaml#

properties:
  compatible:
    enum:
      - xlnx,versal-wwdt

  reg:
    maxItems: 1

  clocks:
    maxItems: 1

required:
  - compatible
  - reg
  - clocks

unevaluatedProperties: false

examples:
  - |
    watchdog@fd4d0000 {
        compatible = "xlnx,versal-wwdt";
        reg = <0xfd4d0000 0x10000>;
        clocks = <&clock25>;
        timeout-sec = <30>;
    };
...
```

## Documentation/devicetree/bindings/watchdog/xlnx,xps-timebase-wdt.yaml
```yaml
# SPDX-License-Identifier: GPL-2.0-or-later OR BSD-2-Clause
%YAML 1.2
---
$id: http://devicetree.org/schemas/watchdog/xlnx,xps-timebase-wdt.yaml#
$schema: http://devicetree.org/meta-schemas/core.yaml#

title: Xilinx AXI/PLB softcore and window Watchdog Timer

maintainers:
  - Shubhrajyoti Datta <shubhrajyoti.datta@xilinx.com>
  - Srinivas Neeli <srinivas.neeli@xilinx.com>

description:
  The Timebase watchdog timer(WDT) is a free-running 32 bit counter.
  WDT uses a dual-expiration architecture. After one expiration of
  the timeout interval, an interrupt is generated and the WDT state
  bit is set to one in the status register. If the state bit is not
  cleared (by writing a one to the state bit) before the next
  expiration of the timeout interval, a WDT reset is generated.

allOf:
  - $ref: watchdog.yaml#

properties:
  compatible:
    enum:
      - xlnx,xps-timebase-wdt-1.01.a
      - xlnx,xps-timebase-wdt-1.00.a

  reg:
    maxItems: 1

  clocks:
    maxItems: 1

  clock-frequency:
    description: Frequency of clock in Hz

  xlnx,wdt-interval:
    $ref: /schemas/types.yaml#/definitions/uint32
    description: Watchdog timeout interval
    minimum: 8
    maximum: 32

  xlnx,wdt-enable-once:
    $ref: /schemas/types.yaml#/definitions/uint32
    enum: [0, 1]
    description: If watchdog is configured as enable once,
                 then the watchdog cannot be disabled after
                 it has been enabled.

required:
  - compatible
  - reg

unevaluatedProperties: false

examples:
  - |
    watchdog@40100000 {
      compatible = "xlnx,xps-timebase-wdt-1.00.a";
      reg = <0x40100000 0x1000>;
      clock-frequency = <50000000>;
      clocks = <&clkc 15>;
      xlnx,wdt-enable-once = <0x0>;
      xlnx,wdt-interval = <0x1b>;
    };
...
```
