## Documentation/devicetree/bindings/watchdog/zii,rave-sp-wdt.txt
```
Zodiac Inflight Innovations RAVE Supervisory Processor Watchdog Bindings

RAVE SP watchdog device is a "MFD cell" device corresponding to
watchdog functionality of RAVE Supervisory Processor. It is expected
that its Device Tree node is specified as a child of the node
corresponding to the parent RAVE SP device (as documented in
Documentation/devicetree/bindings/mfd/zii,rave-sp.txt)

Required properties:

- compatible: Depending on wire protocol implemented by RAVE SP
  firmware, should be one of:
	- "zii,rave-sp-watchdog"
	- "zii,rave-sp-watchdog-legacy"

Optional properties:

- wdt-timeout:	Two byte nvmem cell specified as per
		Documentation/devicetree/bindings/nvmem/nvmem.txt

Example:

	rave-sp {
		compatible = "zii,rave-sp-rdu1";
		current-speed = <38400>;

		eeprom {
			wdt_timeout: wdt-timeout@8E {
				reg = <0x8E 2>;
			};
		};

		watchdog {
			compatible = "zii,rave-sp-watchdog";
			nvmem-cells = <&wdt_timeout>;
			nvmem-cell-names = "wdt-timeout";
		};
	}
```

## Documentation/devicetree/bindings/watchdog/zii,rave-sp-wdt.yaml
```yaml
# SPDX-License-Identifier: (GPL-2.0-only OR BSD-2-Clause)
%YAML 1.2
---
$id: http://devicetree.org/schemas/watchdog/zii,rave-sp-wdt.yaml#
$schema: http://devicetree.org/meta-schemas/core.yaml#

title: Zodiac Inflight Innovations RAVE Supervisory Processor Watchdog

maintainers:
  - Frank Li <Frank.Li@nxp.com>

description:
  RAVE SP watchdog device is a "MFD cell" device corresponding to
  watchdog functionality of RAVE Supervisory Processor. It is expected
  that its Device Tree node is specified as a child of the node
  corresponding to the parent RAVE SP device (as documented in
  Documentation/devicetree/bindings/mfd/zii,rave-sp.yaml)

properties:
  compatible:
    enum:
      - zii,rave-sp-watchdog
      - zii,rave-sp-watchdog-legacy

  nvmem-cell-names:
    items:
      - const: wdt_timeout

  nvmem-cells:
    maxItems: 1

required:
  - compatible

allOf:
  - $ref: watchdog.yaml#

unevaluatedProperties: false

examples:
  - |
    watchdog {
        compatible = "zii,rave-sp-watchdog";
        nvmem-cells = <&wdt_timeout>;
        nvmem-cell-names = "wdt_timeout";
    };
```

## Documentation/devicetree/bindings/watchdog/zii,rave-wdt.yaml
```yaml
# SPDX-License-Identifier: (GPL-2.0-only OR BSD-2-Clause)
%YAML 1.2
---
$id: http://devicetree.org/schemas/watchdog/zii,rave-wdt.yaml#
$schema: http://devicetree.org/meta-schemas/core.yaml#

title: Zodiac RAVE Watchdog Timer

maintainers:
  - Martyn Welch <martyn.welch@collabora.co.uk>
  - Guenter Roeck <linux@roeck-us.net>
  - Wim Van Sebroeck <wim@iguana.be>

properties:
  compatible:
    const: zii,rave-wdt

  reg:
    maxItems: 1
    description: i2c slave address of device, usually 0x38

  reset-duration-ms:
    description:
      Duration of the pulse generated when the watchdog times
      out.

required:
  - compatible
  - reg

allOf:
  - $ref: watchdog.yaml#

unevaluatedProperties: false

examples:
  - |
    i2c {
        #address-cells = <1>;
        #size-cells = <0>;

        watchdog@38 {
            compatible = "zii,rave-wdt";
            reg = <0x38>;
            timeout-sec = <30>;
            reset-duration-ms = <30>;
        };
    };
```

## Documentation/devicetree/bindings/watchdog/ziirave-wdt.txt
```
Zodiac RAVE Watchdog Timer

Required properties:
- compatible: must be "zii,rave-wdt"
- reg: i2c slave address of device, usually 0x38

Optional Properties:
- timeout-sec: Watchdog timeout value in seconds.
- reset-duration-ms: Duration of the pulse generated when the watchdog times
  out. Value in milliseconds.

Example:

	watchdog@38 {
		compatible = "zii,rave-wdt";
		reg = <0x38>;
		timeout-sec = <30>;
		reset-duration-ms = <30>;
	};
```

## Documentation/devicetree/bindings/watchdog/zte,zx2967-wdt.txt
```
ZTE zx2967 Watchdog timer

Required properties:

- compatible : should be one of the following.
       * zte,zx296718-wdt
- reg : Specifies base physical address and size of the registers.
- clocks : Pairs of phandle and specifier referencing the controller's clocks.
- resets : Reference to the reset controller controlling the watchdog
           controller.

Optional properties:

- timeout-sec : Contains the watchdog timeout in seconds.
- zte,wdt-reset-sysctrl : Directs how to reset system by the watchdog.
	if we don't want to restart system when watchdog been triggered,
	it's not required, vice versa.
	It should include following fields.
	  * phandle of aon-sysctrl.
	  * offset of register that be written, should be 0xb0.
	  * configure value that be written to aon-sysctrl.
	  * bit mask, corresponding bits will be affected.

Example:

wdt: watchdog@1465000 {
	compatible = "zte,zx296718-wdt";
	reg = <0x1465000 0x1000>;
	clocks = <&topcrm WDT_WCLK>;
	resets = <&toprst 35>;
	zte,wdt-reset-sysctrl = <&aon_sysctrl 0xb0 1 0x115>;
};
```

## Documentation/devicetree/bindings/x86/ce4100.txt
```
CE4100 Device Tree Bindings
---------------------------

The CE4100 SoC uses for in core peripherals the following compatible
format: <vendor>,<chip>-<device>.
Many of the "generic" devices like HPET or IO APIC have the ce4100
name in their compatible property because they first appeared in this
SoC.

The CPU analdes
-------------

	cpus {
		#address-cells = <1>;
		#size-cells = <0>;

		cpu@0 {
			device_type = "cpu";
			compatible = "intel,ce4100";
			reg = <0x00>;
		};

		cpu@2 {
			device_type = "cpu";
			compatible = "intel,ce4100";
			reg = <0x02>;
		};
	};

A "cpu" analde describes one logical processor (hardware thread).

Required properties:

- device_type
	Device type, must be "cpu".

- reg
	Local APIC ID, the unique number assigned to each processor by
	system hardware.

The SoC analde
------------

This analde describes the in-core peripherals. Required property:
  compatible = "intel,ce4100-cp";

The PCI analde
------------
This analde describes the PCI bus on the SoC. Its property should be
  compatible = "intel,ce4100-pci", "pci";

If the OS is using the IO-APIC for interrupt routing then the reported
interrupt numbers for devices is anal longer true. In order to obtain the
correct interrupt number, the child analde which represents the device has
to contain the interrupt property. Besides the interrupt property it has
to contain at least the reg property containing the PCI bus address and
compatible property according to "PCI Bus Binding Revision 2.1".
```

## Documentation/devicetree/bindings/x86/timer.txt
```
Timers
------

* High Precision Event Timer (HPET)
  Required property:
     compatible = "intel,ce4100-hpet";
```

## Documentation/devicetree/bindings/xilinx.txt
```
   Bindings for specific devices:

      i) Xilinx ML300 Framebuffer

      Simple framebuffer device from the ML300 reference design (also on the
      ML403 reference design as well as others).

      Optional properties:
       - resolution = <xres yres> : pixel resolution of framebuffer.  Some
                                    implementations use a different resolution.
                                    Default is <d#640 d#480>
       - virt-resolution = <xvirt yvirt> : Size of framebuffer in memory.
                                           Default is <d#1024 d#480>.
       - rotate-display (empty) : rotate display 180 degrees.

      v) Xilinx hwicap

		Xilinx hwicap devices provide access to the configuration logic
		of the FPGA through the Internal Configuration Access Port
		(ICAP).  The ICAP enables partial reconfiguration of the FPGA,
		readback of the configuration information, and some control over
		'warm boots' of the FPGA fabric.

		Required properties:
		- xlnx,family : The family of the FPGA, necessary since the
                      capabilities of the underlying ICAP hardware
                      differ between different families.  May be
                      'virtex2p', 'virtex4', or 'virtex5'.
		- compatible : should contain "xlnx,xps-hwicap-1.00.a" or
				"xlnx,opb-hwicap-1.00.b".

      vii) Xilinx USB Host controller

      The Xilinx USB host controller is EHCI compatible but with a different
      base address for the EHCI registers, and it is always a big-endian
      USB Host controller. The hardware can be configured as high speed only,
      or high speed/full speed hybrid.

      Required properties:
      - xlnx,support-usb-fs: A value 0 means the core is built as high speed
                             only. A value 1 means the core also supports
                             full speed devices.
```

## Documentation/devicetree/bindings/xillybus/xillybus.txt
```
* Xillybus driver for generic FPGA interface

Required properties:
- compatible: Should be "xillybus,xillybus-1.00.a"
- reg: Address and length of the register set for the device
- interrupts: Contains one interrupt node, typically consisting of three cells.
- interrupt-parent: the phandle for the interrupt controller that
                    services interrupts for this device.

Optional properties:
- dma-coherent: Present if DMA operations are coherent

Example:

	xillybus@ff200400 {
		compatible = "xillybus,xillybus-1.00.a";
		reg = < 0xff200400 0x00000080 >;
		interrupts = < 0 40 1 >;
		interrupt-parent = <&intc>;
	} ;
```

## Documentation/kbuild/Kconfig.recursion-issue-01
```kconfig
# Simple Kconfig recursive issue
# ~~~~~~~~~~~~~~~~~~~~~~~~~~~~~~
#
# Test with:
#
# make KBUILD_KCONFIG=Documentation/kbuild/Kconfig.recursion-issue-01 allnoconfig
#
# This Kconfig file has a simple recursive dependency issue. In order to
# understand why this recursive dependency issue occurs lets consider what
# Kconfig needs to address. We iterate over what Kconfig needs to address
# by stepping through the questions it needs to address sequentially.
#
#  * What values are possible for CORE?
#
# CORE_BELL_A_ADVANCED selects CORE, which means that it influences the values
# that are possible for CORE. So for example if CORE_BELL_A_ADVANCED is 'y',
# CORE must be 'y' too.
#
#  * What influences CORE_BELL_A_ADVANCED?
#
# As the name implies CORE_BELL_A_ADVANCED is an advanced feature of
# CORE_BELL_A so naturally it depends on CORE_BELL_A. So if CORE_BELL_A is 'y'
# we know CORE_BELL_A_ADVANCED can be 'y' too.
#
#   * What influences CORE_BELL_A?
#
# CORE_BELL_A depends on CORE, so CORE influences CORE_BELL_A.
#
# But that is a problem, because this means that in order to determine
# what values are possible for CORE we ended up needing to address questions
# regarding possible values of CORE itself again. Answering the original
# question of what are the possible values of CORE would make the kconfig
# tools run in a loop. When this happens Kconfig exits and complains about
# the "recursive dependency detected" error.
#
# Reading the Documentation/kbuild/Kconfig.recursion-issue-01 file it may be
# obvious that an easy solution to this problem should just be the removal
# of the "select CORE" from CORE_BELL_A_ADVANCED as that is implicit already
# since CORE_BELL_A depends on CORE. Recursive dependency issues are not always
# so trivial to resolve, we provide another example below of practical
# implications of this recursive issue where the solution is perhaps not so
# easy to understand. Note that matching semantics on the dependency on
# CORE also consist of a solution to this recursive problem.

mainmenu "Simple example to demo kconfig recursive dependency issue"

config CORE
	tristate

config CORE_BELL_A
	tristate
	depends on CORE

config CORE_BELL_A_ADVANCED
	tristate
	depends on CORE_BELL_A
	select CORE
```

## Documentation/kbuild/Kconfig.recursion-issue-02
```kconfig
# Cumulative Kconfig recursive issue
# ~~~~~~~~~~~~~~~~~~~~~~~~~~~~~~~~~~
#
# Test with:
#
# make KBUILD_KCONFIG=Documentation/kbuild/Kconfig.recursion-issue-02 allnoconfig
#
# The recursive limitations with Kconfig has some non intuitive implications on
# kconfig sematics which are documented here. One known practical implication
# of the recursive limitation is that drivers cannot negate features from other
# drivers if they share a common core requirement and use disjoint semantics to
# annotate those requirements, ie, some drivers use "depends on" while others
# use "select". For instance it means if a driver A and driver B share the same
# core requirement, and one uses "select" while the other uses "depends on" to
# annotate this, all features that driver A selects cannot now be negated by
# driver B.
#
# A perhaps not so obvious implication of this is that, if semantics on these
# core requirements are not carefully synced, as drivers evolve features
# they select or depend on end up becoming shared requirements which cannot be
# negated by other drivers.
#
# The example provided in Documentation/kbuild/Kconfig.recursion-issue-02
# describes a simple driver core layout of example features a kernel might
# have. Let's assume we have some CORE functionality, then the kernel has a
# series of bells and whistles it desires to implement, its not so advanced so
# it only supports bells at this time: CORE_BELL_A and CORE_BELL_B. If
# CORE_BELL_A has some advanced feature CORE_BELL_A_ADVANCED which selects
# CORE_BELL_A then CORE_BELL_A ends up becoming a common BELL feature which
# other bells in the system cannot negate. The reason for this issue is
# due to the disjoint use of semantics on expressing each bell's relationship
# with CORE, one uses "depends on" while the other uses "select". Another
# more important reason is that kconfig does not check for dependencies listed
# under 'select' for a symbol, when such symbols are selected kconfig them
# as mandatory required symbols. For more details on the heavy handed nature
# of select refer to Documentation/kbuild/Kconfig.select-break
#
# To fix this the "depends on CORE" must be changed to "select CORE", or the
# "select CORE" must be changed to "depends on CORE".
#
# For an example real world scenario issue refer to the attempt to remove
# "select FW_LOADER" [0], in the end the simple alternative solution to this
# problem consisted on matching semantics with newly introduced features.
#
# [0] https://lkml.kernel.org/r/1432241149-8762-1-git-send-email-mcgrof@do-not-panic.com

mainmenu "Simple example to demo cumulative kconfig recursive dependency implication"

config CORE
	tristate

config CORE_BELL_A
	tristate
	depends on CORE

config CORE_BELL_A_ADVANCED
	tristate
	select CORE_BELL_A

config CORE_BELL_B
	tristate
	depends on !CORE_BELL_A
	select CORE
```
