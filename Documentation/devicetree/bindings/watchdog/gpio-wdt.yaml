## Documentation/devicetree/bindings/watchdog/marvell,orion-wdt.yaml
```yaml
# SPDX-License-Identifier: (GPL-2.0-only OR BSD-2-Clause)
%YAML 1.2
---
$id: http://devicetree.org/schemas/watchdog/marvell,orion-wdt.yaml#
$schema: http://devicetree.org/meta-schemas/core.yaml#

title: Marvell Orion Watchdog Timer

maintainers:
  - Andrew Lunn <andrew@lunn.ch>
  - Gregory Clement <gregory.clement@bootlin.com>

properties:
  compatible:
    enum:
      - marvell,orion-wdt
      - marvell,armada-370-wdt
      - marvell,armada-xp-wdt
      - marvell,armada-375-wdt
      - marvell,armada-380-wdt

  reg:
    minItems: 2
    items:
      - description: Timer control register address
      - description: RSTOUT enable register address
      - description: Shared mask/unmask RSTOUT register address

  clocks:
    minItems: 1
    items:
      - description: L2/coherency fabric clock input
      - description: Reference 25 MHz fixed-clock supply

  clock-names:
    minItems: 1
    items:
      - const: nbclk
      - const: fixed

  interrupts:
    minItems: 1
    items:
      - description: timeout
      - description: pre-timeout

allOf:
  - $ref: watchdog.yaml#
  - if:
      properties:
        compatible:
          contains:
            enum:
              - marvell,armada-375-wdt
              - marvell,armada-380-wdt
    then:
      properties:
        reg:
          minItems: 3
    else:
      properties:
        reg:
          maxItems: 2

  - if:
      properties:
        compatible:
          contains:
            enum:
              - marvell,armada-xp-wdt
              - marvell,armada-375-wdt
              - marvell,armada-380-wdt
    then:
      properties:
        clocks:
          minItems: 2
        clock-names:
          minItems: 2
        interrupts:
          minItems: 2

      required:
        - clock-names

required:
  - compatible
  - reg
  - clocks

unevaluatedProperties: false

examples:
  - |
    watchdog@20300 {
        compatible = "marvell,orion-wdt";
        reg = <0x20300 0x28>, <0x20108 0x4>;
        interrupts = <3>;
        timeout-sec = <10>;
        clocks = <&gate_clk 7>;
    };
```

## Documentation/devicetree/bindings/watchdog/maxim,max63xx.yaml
```yaml
# SPDX-License-Identifier: (GPL-2.0-only OR BSD-2-Clause)
%YAML 1.2
---
$id: http://devicetree.org/schemas/watchdog/maxim,max63xx.yaml#
$schema: http://devicetree.org/meta-schemas/core.yaml#

title: Maxim 63xx Watchdog Timers

allOf:
  - $ref: "watchdog.yaml#"
  - $ref: /schemas/memory-controllers/mc-peripheral-props.yaml#

maintainers:
  - Marc Zyngier <maz@kernel.org>
  - Linus Walleij <linus.walleij@linaro.org>

properties:
  compatible:
    enum:
      - maxim,max6369
      - maxim,max6370
      - maxim,max6371
      - maxim,max6372
      - maxim,max6373
      - maxim,max6374

  reg:
    description: This is a 1-byte memory-mapped address
    maxItems: 1

required:
  - compatible
  - reg

unevaluatedProperties: false

examples:
  - |
    wdt: watchdog@50000000 {
        compatible = "maxim,max6369";
        reg = <0x50000000 0x1>;
        timeout-sec = <10>;
    };

...
```

## Documentation/devicetree/bindings/watchdog/mediatek,mt7621-wdt.yaml
```yaml
# SPDX-License-Identifier: (GPL-2.0-only OR BSD-2-Clause)
%YAML 1.2
---
$id: http://devicetree.org/schemas/watchdog/mediatek,mt7621-wdt.yaml#
$schema: http://devicetree.org/meta-schemas/core.yaml#

title: Ralink Watchdog Timers

maintainers:
  - Sergio Paracuellos <sergio.paracuellos@gmail.com>

allOf:
  - $ref: watchdog.yaml#

properties:
  compatible:
    const: mediatek,mt7621-wdt

  reg:
    maxItems: 1

required:
  - compatible
  - reg

additionalProperties: false

examples:
  - |
    watchdog@100 {
      compatible = "mediatek,mt7621-wdt";
      reg = <0x100 0x100>;
    };
```

## Documentation/devicetree/bindings/watchdog/mediatek,mtk-wdt.yaml
```yaml
# SPDX-License-Identifier: (GPL-2.0-only OR BSD-2-Clause)
%YAML 1.2
---
$id: http://devicetree.org/schemas/watchdog/mediatek,mtk-wdt.yaml#
$schema: http://devicetree.org/meta-schemas/core.yaml#

title: MediaTek SoCs Watchdog timer

maintainers:
  - Matthias Brugger <matthias.bgg@gmail.com>

description:
  The watchdog supports a pre-timeout interrupt that fires
  timeout-sec/2 before the expiry.

allOf:
  - $ref: watchdog.yaml#

properties:
  compatible:
    oneOf:
      - enum:
          - mediatek,mt2712-wdt
          - mediatek,mt6589-wdt
          - mediatek,mt6795-wdt
          - mediatek,mt7986-wdt
          - mediatek,mt8183-wdt
          - mediatek,mt8186-wdt
          - mediatek,mt8188-wdt
          - mediatek,mt8192-wdt
          - mediatek,mt8195-wdt
      - items:
          - enum:
              - mediatek,mt2701-wdt
              - mediatek,mt6582-wdt
              - mediatek,mt6797-wdt
              - mediatek,mt7622-wdt
              - mediatek,mt7623-wdt
              - mediatek,mt7629-wdt
              - mediatek,mt8173-wdt
              - mediatek,mt8516-wdt
          - const: mediatek,mt6589-wdt

  reg:
    maxItems: 1

  interrupts:
    items:
      - description: Watchdog pre-timeout (bark) interrupt

  mediatek,disable-extrst:
    description: Disable sending output reset signal
    type: boolean

  '#reset-cells':
    const: 1

required:
  - compatible
  - reg

unevaluatedProperties: false

examples:
  - |
    #include <dt-bindings/interrupt-controller/arm-gic.h>

    soc {
        #address-cells = <2>;
        #size-cells = <2>;

        watchdog: watchdog@10007000 {
            compatible = "mediatek,mt8183-wdt";
            reg = <0 0x10007000 0 0x100>;
            interrupts = <GIC_SPI 139 IRQ_TYPE_LEVEL_LOW>;
            mediatek,disable-extrst;
            timeout-sec = <10>;
            #reset-cells = <1>;
        };
    };
```

## Documentation/devicetree/bindings/watchdog/men-a021-wdt.txt
```
Bindings for MEN A21 Watchdog device connected to GPIO lines

Required properties:
- compatible: "men,a021-wdt"
- gpios: Specifies the pins that control the Watchdog, order:
  1: Watchdog enable
  2: Watchdog fast-mode
  3: Watchdog trigger
  4: Watchdog reset cause bit 0
  5: Watchdog reset cause bit 1
  6: Watchdog reset cause bit 2

Optional properties:
- None

Example:
	watchdog {
		compatible ="men,a021-wdt";
		gpios = <&gpio3 9  1	/* WD_EN */
			 &gpio3 10 1	/* WD_FAST */
			 &gpio3 11 1	/* WD_TRIG */
			 &gpio3 6  1	/* RST_CAUSE[0] */
			 &gpio3 7  1	/* RST_CAUSE[1] */
			 &gpio3 8  1>;	/* RST_CAUSE[2] */
	};
```

## Documentation/devicetree/bindings/watchdog/meson-gxbb-wdt.txt
```
Meson GXBB SoCs Watchdog timer

Required properties:

- compatible : should be "amlogic,meson-gxbb-wdt"
- reg : Specifies base physical address and size of the registers.
- clocks : Should be a phandle to the Watchdog clock source, for GXBB the xtal
	   is the default clock source.

Example:

wdt: watchdog@98d0 {
	compatible = "amlogic,meson-gxbb-wdt";
	reg = <0 0x98d0 0x0 0x10>;
	clocks = <&xtal>;
};
```

## Documentation/devicetree/bindings/watchdog/meson-wdt.txt
```
Meson SoCs Watchdog timer

Required properties:

- compatible : depending on the SoC this should be one of:
	"amlogic,meson6-wdt" on Meson6 SoCs
	"amlogic,meson8-wdt" and "amlogic,meson6-wdt" on Meson8 SoCs
	"amlogic,meson8b-wdt" on Meson8b SoCs
	"amlogic,meson8m2-wdt" and "amlogic,meson8b-wdt" on Meson8m2 SoCs
- reg : Specifies base physical address and size of the registers.

Optional properties:
- timeout-sec: contains the watchdog timeout in seconds.

Example:

wdt: watchdog@c1109900 {
	compatible = "amlogic,meson6-wdt";
	reg = <0xc1109900 0x8>;
	timeout-sec = <10>;
};
```

## Documentation/devicetree/bindings/watchdog/microchip,pic32-dmt.txt
```
* Microchip PIC32 Deadman Timer

The deadman timer is used to reset the processor in the event of a software
malfunction. It is a free-running instruction fetch timer, which is clocked
whenever an instruction fetch occurs until a count match occurs.

Required properties:
- compatible: must be "microchip,pic32mzda-dmt".
- reg: physical base address of the controller and length of memory mapped
  region.
- clocks: phandle of source clk. Should be <&rootclk PB7CLK>.

Example:

	watchdog@1f800a00 {
		compatible = "microchip,pic32mzda-dmt";
		reg = <0x1f800a00 0x80>;
		clocks = <&rootclk PB7CLK>;
	};
```

## Documentation/devicetree/bindings/watchdog/microchip,pic32-wdt.txt
```
* Microchip PIC32 Watchdog Timer

When enabled, the watchdog peripheral can be used to reset the device if the
WDT is not cleared periodically in software.

Required properties:
- compatible: must be "microchip,pic32mzda-wdt".
- reg: physical base address of the controller and length of memory mapped
  region.
- clocks: phandle of source clk. should be <&LPRC> clk.

Example:

	watchdog@1f800800 {
		compatible = "microchip,pic32mzda-wdt";
		reg = <0x1f800800 0x200>;
		clocks = <&LPRC>;
	};
```

## Documentation/devicetree/bindings/watchdog/microchip,pic32mzda-dmt.yaml
```yaml
# SPDX-License-Identifier: (GPL-2.0-only OR BSD-2-Clause)
%YAML 1.2
---
$id: http://devicetree.org/schemas/watchdog/microchip,pic32mzda-dmt.yaml#
$schema: http://devicetree.org/meta-schemas/core.yaml#

title: Microchip PIC32MZDA Deadman Timer

maintainers:
  - Thomas Bogendoerfer <tsbogend@alpha.franken.de>

description: |
  The deadman timer is used to reset the processor in the event of a software
  malfunction. It is a free-running instruction fetch timer, which is clocked
  whenever an instruction fetch occurs until a count match occurs.

allOf:
  - $ref: watchdog.yaml#

properties:
  compatible:
    const: microchip,pic32mzda-dmt

  reg:
    maxItems: 1

  clocks:
    maxItems: 1

required:
  - compatible
  - reg
  - clocks

unevaluatedProperties: false

examples:
  - |
    #include <dt-bindings/clock/microchip,pic32-clock.h>

    watchdog@1f800a00 {
        compatible = "microchip,pic32mzda-dmt";
        reg = <0x1f800a00 0x80>;
        clocks = <&rootclk PB7CLK>;
       };
```

## Documentation/devicetree/bindings/watchdog/microchip,pic32mzda-wdt.yaml
```yaml
# SPDX-License-Identifier: (GPL-2.0-only OR BSD-2-Clause)
%YAML 1.2
---
$id: http://devicetree.org/schemas/watchdog/microchip,pic32mzda-wdt.yaml#
$schema: http://devicetree.org/meta-schemas/core.yaml#

title: Microchip PIC32MZDA Watchdog Timer

maintainers:
  - Thomas Bogendoerfer <tsbogend@alpha.franken.de>

description:
  The PIC32 watchdog timer can be used to reset the device if software fails
  to periodically service the watchdog.

allOf:
  - $ref: watchdog.yaml#

properties:
  compatible:
    const: microchip,pic32mzda-wdt

  reg:
    maxItems: 1

  clocks:
    maxItems: 1

required:
  - compatible
  - reg
  - clocks

unevaluatedProperties: false

examples:
  - |
    #include <dt-bindings/clock/microchip,pic32-clock.h>

    watchdog@1f800800 {
        compatible = "microchip,pic32mzda-wdt";
        reg = <0x1f800800 0x200>;
        clocks = <&rootclk LPRCCLK>;
    };
```
