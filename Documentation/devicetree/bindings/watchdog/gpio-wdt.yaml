## Documentation/devicetree/bindings/watchdog/gpio-wdt.yaml
```yaml
# SPDX-License-Identifier: (GPL-2.0-only OR BSD-2-Clause)
%YAML 1.2
---
$id: http://devicetree.org/schemas/watchdog/gpio-wdt.yaml#
$schema: http://devicetree.org/meta-schemas/core.yaml#

title: GPIO controlled watchdog

maintainers:
  - Robert Marko <robert.marko@sartura.hr>

properties:
  compatible:
    const: linux,wdt-gpio

  gpios:
    maxItems: 1
    description: GPIO connected to the WDT reset pin

  hw_algo:
    $ref: /schemas/types.yaml#/definitions/string
    description: Algorithm used by the driver
    oneOf:
      - description:
          Either a high-to-low or a low-to-high transition clears the WDT counter.
          The watchdog timer is disabled when GPIO is left floating or connected
          to a three-state buffer.
        const: toggle
      - description:
          Low or high level starts counting WDT timeout, the opposite level
          disables the WDT.
          Active level is determined by the GPIO flags.
        const: level

  hw_margin_ms:
    $ref: /schemas/types.yaml#/definitions/uint32
    description: Maximum time to reset watchdog circuit (in milliseconds)
    minimum: 2
    maximum: 65535

  always-running:
    type: boolean
    description:
      If the watchdog timer cannot be disabled, add this flag to have the driver
      keep toggling the signal without a client.
      It will only cease to toggle the signal when the device is open and the
      timeout elapsed.

required:
  - compatible
  - gpios
  - hw_algo
  - hw_margin_ms

unevaluatedProperties: false
```

## Documentation/devicetree/bindings/watchdog/img,pdc-wdt.yaml
```yaml
# SPDX-License-Identifier: (GPL-2.0-only OR BSD-2-Clause)
%YAML 1.2
---
$id: http://devicetree.org/schemas/watchdog/img,pdc-wdt.yaml#
$schema: http://devicetree.org/meta-schemas/core.yaml#

title: ImgTec PowerDown Controller (PDC) Watchdog Timer (WDT)

maintainers:
  - Shresth Prasad <shresthprasad7@gmail.com>

allOf:
  - $ref: watchdog.yaml#

properties:
  compatible:
    enum:
      - img,pdc-wdt

  reg:
    maxItems: 1

  clocks:
    items:
      - description: watchdog counter clock
      - description: register interface clock

  clock-names:
    items:
      - const: wdt
      - const: sys

  interrupts:
    maxItems: 1

required:
  - compatible
  - reg
  - clocks
  - clock-names
  - interrupts

unevaluatedProperties: false

examples:
  - |
    #include <dt-bindings/interrupt-controller/irq.h>

    watchdog@18102100 {
      compatible = "img,pdc-wdt";
      reg = <0x18102100 0x100>;
      clocks = <&pdc_wdt_clk>, <&sys_clk>;
      clock-names = "wdt", "sys";
      interrupts = <0 52 IRQ_TYPE_LEVEL_HIGH>;
    };
```

## Documentation/devicetree/bindings/watchdog/imgpdc-wdt.txt
```
*ImgTec PowerDown Controller (PDC) Watchdog Timer (WDT)

Required properties:
- compatible : Should be "img,pdc-wdt"
- reg : Should contain WDT registers location and length
- clocks: Must contain an entry for each entry in clock-names.
- clock-names: Should contain "wdt" and "sys"; the watchdog counter
               clock and register interface clock respectively.
- interrupts : Should contain WDT interrupt

Examples:

watchdog@18102100 {
	compatible = "img,pdc-wdt";
	reg = <0x18102100 0x100>;
	clocks = <&pdc_wdt_clk>, <&sys_clk>;
	clock-names = "wdt", "sys";
	interrupts = <0 52 IRQ_TYPE_LEVEL_HIGH>;
};
```

## Documentation/devicetree/bindings/watchdog/ingenic,jz4740-wdt.txt
```
Ingenic Watchdog Timer (WDT) Controller for JZ4740 & JZ4780

Required properties:
compatible: "ingenic,jz4740-watchdog" or "ingenic,jz4780-watchdog"
reg: Register address and length for watchdog registers
clocks: phandle to the RTC clock
clock-names: should be "rtc"

Example:

watchdog: jz4740-watchdog@10002000 {
	compatible = "ingenic,jz4740-watchdog";
	reg = <0x10002000 0x10>;

	clocks = <&cgu JZ4740_CLK_RTC>;
	clock-names = "rtc";
};
```

## Documentation/devicetree/bindings/watchdog/intel,keembay-wdt.yaml
```yaml
# SPDX-License-Identifier: (GPL-2.0-only OR BSD-2-Clause)
%YAML 1.2
---
$id: http://devicetree.org/schemas/watchdog/intel,keembay-wdt.yaml#
$schema: http://devicetree.org/meta-schemas/core.yaml#

title: Intel Keem Bay SoC non-secure Watchdog Timer

maintainers:
  - Wan Ahmad Zainie <wan.ahmad.zainie.wan.mohamad@intel.com>

properties:
  compatible:
    enum:
      - intel,keembay-wdt

  reg:
    maxItems: 1

  clocks:
    maxItems: 1

  interrupts:
    items:
      - description: interrupt specifier for threshold interrupt line
      - description: interrupt specifier for timeout interrupt line

  interrupt-names:
    items:
      - const: threshold
      - const: timeout

required:
  - compatible
  - reg
  - interrupts
  - interrupt-names
  - clocks

additionalProperties: false

examples:
  - |
    #include <dt-bindings/interrupt-controller/arm-gic.h>
    #include <dt-bindings/interrupt-controller/irq.h>
    #define KEEM_BAY_A53_TIM

    watchdog: watchdog@2033009c {
        compatible = "intel,keembay-wdt";
        reg = <0x2033009c 0x10>;
        interrupts = <GIC_SPI 1 IRQ_TYPE_LEVEL_HIGH>,
                     <GIC_SPI 2 IRQ_TYPE_LEVEL_HIGH>;
        interrupt-names = "threshold", "timeout";
        clocks = <&scmi_clk KEEM_BAY_A53_TIM>;
    };

...
```

## Documentation/devicetree/bindings/watchdog/kontron,sl28cpld-wdt.yaml
```yaml
# SPDX-License-Identifier: (GPL-2.0-only OR BSD-2-Clause)
%YAML 1.2
---
$id: http://devicetree.org/schemas/watchdog/kontron,sl28cpld-wdt.yaml#
$schema: http://devicetree.org/meta-schemas/core.yaml#

title: Watchdog driver for the sl28cpld board management controller

maintainers:
  - Michael Walle <michael@walle.cc>

description: |
  This module is part of the sl28cpld multi-function device. For more
  details see ../embedded-controller/kontron,sl28cpld.yaml.

allOf:
  - $ref: watchdog.yaml#

properties:
  compatible:
    oneOf:
      - items:
          - enum:
              - kontron,sa67mcu-wdt
          - const: kontron,sl28cpld-wdt
      - const: kontron,sl28cpld-wdt

  reg:
    maxItems: 1

  kontron,assert-wdt-timeout-pin:
    description: The SMARC standard defines a WDT_TIME_OUT# pin. If this
      property is set, this output will be pulsed when the watchdog bites
      and the system resets.
    type: boolean

required:
  - compatible

additionalProperties: false
```

## Documentation/devicetree/bindings/watchdog/lantiq,wdt.yaml
```yaml
# SPDX-License-Identifier: (GPL-2.0-only OR BSD-2-Clause)
%YAML 1.2
---
$id: http://devicetree.org/schemas/watchdog/lantiq,wdt.yaml#
$schema: http://devicetree.org/meta-schemas/core.yaml#

title: Lantiq WTD watchdog

maintainers:
  - Hauke Mehrtens <hauke@hauke-m.de>

properties:
  compatible:
    oneOf:
      - enum:
          - lantiq,falcon-wdt
          - lantiq,wdt
          - lantiq,xrx100-wdt
      - items:
          - enum:
              - lantiq,xrx200-wdt
          - const: lantiq,xrx100-wdt

  reg:
    maxItems: 1

  lantiq,rcu:
    $ref: /schemas/types.yaml#/definitions/phandle
    description: Phandle to the RCU syscon node

required:
  - compatible
  - reg

allOf:
  - $ref: watchdog.yaml#
  - if:
      properties:
        compatible:
          contains:
            enum:
              - lantiq,xrx100-wdt
              - lantiq,falcon-wdt
    then:
      required:
        - lantiq,rcu

unevaluatedProperties: false

examples:
  - |
    watchdog@803f0 {
        compatible = "lantiq,xrx200-wdt", "lantiq,xrx100-wdt";
        reg = <0x803f0 0x10>;

        lantiq,rcu = <&rcu0>;
    };
```

## Documentation/devicetree/bindings/watchdog/lantiq-wdt.txt
```
Lantiq WTD watchdog binding
============================

This describes the binding of the Lantiq watchdog driver.

-------------------------------------------------------------------------------
Required properties:
- compatible		: Should be one of
				"lantiq,wdt"
				"lantiq,xrx100-wdt"
				"lantiq,xrx200-wdt", "lantiq,xrx100-wdt"
				"lantiq,falcon-wdt"
- reg			: Address of the watchdog block
- lantiq,rcu		: A phandle to the RCU syscon (required for
			  "lantiq,falcon-wdt" and "lantiq,xrx100-wdt")

-------------------------------------------------------------------------------
Example for the watchdog on the xRX200 SoCs:
		watchdog@803f0 {
			compatible = "lantiq,xrx200-wdt", "lantiq,xrx100-wdt";
			reg = <0x803f0 0x10>;

			lantiq,rcu = <&rcu0>;
		};
```

## Documentation/devicetree/bindings/watchdog/linux,wdt-gpio.yaml
```yaml
# SPDX-License-Identifier: (GPL-2.0-only OR BSD-2-Clause)
%YAML 1.2
---
$id: http://devicetree.org/schemas/watchdog/linux,wdt-gpio.yaml#
$schema: http://devicetree.org/meta-schemas/core.yaml#

title: GPIO-controlled Watchdog

maintainers:
  - Guenter Roeck <linux@roeck-us.net>
  - Robert Marko <robert.marko@sartura.hr>

properties:
  compatible:
    const: linux,wdt-gpio

  gpios:
    description: gpio connection to WDT reset pin
    maxItems: 1

  hw_algo:
    description: The algorithm used by the driver.
    oneOf:
      - description:
          Either a high-to-low or a low-to-high transition clears the WDT counter.
          The watchdog timer is disabled when GPIO is left floating or connected
          to a three-state buffer.
        const: toggle
      - description:
          Low or high level starts counting WDT timeout, the opposite level
          disables the WDT.
          Active level is determined by the GPIO flags.
        const: level

  hw_margin_ms:
    description: Maximum time to reset watchdog circuit (milliseconds).
    $ref: /schemas/types.yaml#/definitions/uint32
    minimum: 2
    maximum: 65535

  always-running:
    type: boolean
    description:
      If the watchdog timer cannot be disabled, add this flag to have the driver
      keep toggling the signal without a client.
      It will only cease to toggle the signal when the device is open and the
      timeout elapsed.

required:
  - compatible
  - gpios
  - hw_algo
  - hw_margin_ms

allOf:
  - $ref: watchdog.yaml#

unevaluatedProperties: false

examples:
  - |
    #include <dt-bindings/gpio/gpio.h>
    watchdog {
        compatible = "linux,wdt-gpio";
        gpios = <&gpio3 9 GPIO_ACTIVE_LOW>;
        hw_algo = "toggle";
        hw_margin_ms = <1600>;
    };
```

## Documentation/devicetree/bindings/watchdog/loongson,ls1x-wdt.yaml
```yaml
# SPDX-License-Identifier: (GPL-2.0-only OR BSD-2-Clause)
%YAML 1.2
---
$id: http://devicetree.org/schemas/watchdog/loongson,ls1x-wdt.yaml#
$schema: http://devicetree.org/meta-schemas/core.yaml#

title: Loongson-1 Watchdog Timer

maintainers:
  - Keguang Zhang <keguang.zhang@gmail.com>

allOf:
  - $ref: watchdog.yaml#

properties:
  compatible:
    enum:
      - loongson,ls1b-wdt
      - loongson,ls1c-wdt

  reg:
    maxItems: 1

  clocks:
    maxItems: 1

required:
  - compatible
  - reg
  - clocks

unevaluatedProperties: false

examples:
  - |
    #include <dt-bindings/clock/loongson,ls1x-clk.h>
    watchdog: watchdog@1fe5c060 {
        compatible = "loongson,ls1b-wdt";
        reg = <0x1fe5c060 0xc>;

        clocks = <&clkc LS1X_CLKID_APB>;
    };
```

## Documentation/devicetree/bindings/watchdog/lpc18xx-wdt.txt
```
* NXP LPC18xx Watchdog Timer (WDT)

Required properties:
- compatible: Should be "nxp,lpc1850-wwdt"
- reg: Should contain WDT registers location and length
- clocks: Must contain an entry for each entry in clock-names.
- clock-names: Should contain "wdtclk" and "reg"; the watchdog counter
               clock and register interface clock respectively.
- interrupts: Should contain WDT interrupt

Examples:

watchdog@40080000 {
	compatible = "nxp,lpc1850-wwdt";
	reg = <0x40080000 0x24>;
	clocks = <&cgu BASE_SAFE_CLK>, <&ccu1 CLK_CPU_WWDT>;
	clock-names = "wdtclk", "reg";
	interrupts = <49>;
};
```

## Documentation/devicetree/bindings/watchdog/marvel.txt
```
* Marvell Orion Watchdog Time

Required Properties:

- Compatibility : "marvell,orion-wdt"
		  "marvell,armada-370-wdt"
		  "marvell,armada-xp-wdt"
		  "marvell,armada-375-wdt"
		  "marvell,armada-380-wdt"

- reg		: Should contain two entries: first one with the
		  timer control address, second one with the
		  rstout enable address.

For "marvell,armada-375-wdt" and "marvell,armada-380-wdt":

- reg		: A third entry is mandatory and should contain the
                  shared mask/unmask RSTOUT address.

Clocks required for compatibles = "marvell,orion-wdt",
				  "marvell,armada-370-wdt":
- clocks : Must contain a single entry describing the clock input

Clocks required for compatibles = "marvell,armada-xp-wdt"
				  "marvell,armada-375-wdt"
				  "marvell,armada-380-wdt":
- clocks : Must contain an entry for each entry in clock-names.
- clock-names : Must include the following entries:
  "nbclk" (L2/coherency fabric clock),
  "fixed" (Reference 25 MHz fixed-clock).

Optional properties:

- interrupts	: Contains the IRQ for watchdog expiration
- timeout-sec	: Contains the watchdog timeout in seconds

Example:

	wdt@20300 {
		compatible = "marvell,orion-wdt";
		reg = <0x20300 0x28>, <0x20108 0x4>;
		interrupts = <3>;
		timeout-sec = <10>;
		status = "okay";
		clocks = <&gate_clk 7>;
	};
```

## Documentation/devicetree/bindings/watchdog/marvell,armada-3700-wdt.yaml
```yaml
# SPDX-License-Identifier: (GPL-2.0-only OR BSD-2-Clause)
%YAML 1.2
---
$id: http://devicetree.org/schemas/watchdog/marvell,armada-3700-wdt.yaml#
$schema: http://devicetree.org/meta-schemas/core.yaml#

title: Armada 37xx CPU Watchdog Timer Controller

maintainers:
  - Marek Behún <kabel@kernel.org>

properties:
  compatible:
    const: marvell,armada-3700-wdt

  reg:
    maxItems: 1

  clocks:
    maxItems: 1

  marvell,system-controller:
    description: Reference to syscon node for the CPU Miscellaneous Registers
    $ref: /schemas/types.yaml#/definitions/phandle

required:
  - compatible
  - reg
  - clocks
  - marvell,system-controller

additionalProperties: false

examples:
  - |
    watchdog@8300 {
        compatible = "marvell,armada-3700-wdt";
        reg = <0x8300 0x40>;
        marvell,system-controller = <&cpu_misc>;
        clocks = <&xtalclk>;
    };
```

## Documentation/devicetree/bindings/watchdog/marvell,cn10624-wdt.yaml
```yaml
# SPDX-License-Identifier: (GPL-2.0-only OR BSD-2-Clause)
%YAML 1.2
---
$id: http://devicetree.org/schemas/watchdog/marvell,cn10624-wdt.yaml#
$schema: http://devicetree.org/meta-schemas/core.yaml#

title: Marvell Global Timer (GTI) system watchdog

maintainers:
  - Bharat Bhushan <bbhushan2@marvell.com>

allOf:
  - $ref: watchdog.yaml#

properties:
  compatible:
    oneOf:
      - enum:
          - marvell,cn9670-wdt
          - marvell,cn10624-wdt

      - items:
          - enum:
              - marvell,cn9880-wdt
              - marvell,cnf9535-wdt
          - const: marvell,cn9670-wdt

      - items:
          - enum:
              - marvell,cn10308-wdt
              - marvell,cnf10518-wdt
          - const: marvell,cn10624-wdt

  reg:
    maxItems: 1

  interrupts:
    maxItems: 1

  clocks:
    maxItems: 1

  clock-names:
    items:
      - const: refclk

  marvell,wdt-timer-index:
    $ref: /schemas/types.yaml#/definitions/uint32
    minimum: 0
    maximum: 63
    description:
      An SoC have many timers (up to 64), firmware can reserve one or more timer
      for some other use case and configures one of the global timer as watchdog
      timer. Firmware will update this field with the timer number configured
      as watchdog timer.

required:
  - compatible
  - reg
  - interrupts
  - clocks
  - clock-names

unevaluatedProperties: false

examples:
  - |
    #include <dt-bindings/interrupt-controller/arm-gic.h>
    soc {
        #address-cells = <2>;
        #size-cells = <2>;

        watchdog@802000040000 {
            compatible = "marvell,cn9670-wdt";
            reg = <0x00008020 0x00040000 0x00000000 0x00020000>;
            interrupts = <GIC_SPI 38 IRQ_TYPE_EDGE_RISING>;
            clocks = <&sclk>;
            clock-names = "refclk";
            marvell,wdt-timer-index = <63>;
        };
    };

...
```
