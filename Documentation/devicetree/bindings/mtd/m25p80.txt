## Documentation/devicetree/bindings/mtd/mtk-nand.txt
```
MTK SoCs NAND FLASH controller (NFC) DT binding

This file documents the device tree bindings for MTK SoCs NAND controllers.
The functional split of the controller requires two drivers to operate:
the nand controller interface driver and the ECC engine driver.

The hardware description for both devices must be captured as device
tree nodes.

1) NFC NAND Controller Interface (NFI):
=======================================

The first part of NFC is NAND Controller Interface (NFI) HW.
Required NFI properties:
- compatible:			Should be one of "mediatek,mt2701-nfc",
				"mediatek,mt2712-nfc".
- reg:				Base physical address and size of NFI.
- interrupts:			Interrupts of NFI.
- clocks:			NFI required clocks.
- clock-names:			NFI clocks internal name.
- status:			Disabled default. Then set "okay" by platform.
- ecc-engine:			Required ECC Engine node.
- #address-cells:		NAND chip index, should be 1.
- #size-cells:			Should be 0.

Example:

	nandc: nfi@1100d000 {
		compatible = "mediatek,mt2701-nfc";
		reg = <0 0x1100d000 0 0x1000>;
		interrupts = <GIC_SPI 56 IRQ_TYPE_LEVEL_LOW>;
		clocks = <&pericfg CLK_PERI_NFI>,
			 <&pericfg CLK_PERI_NFI_PAD>;
		clock-names = "nfi_clk", "pad_clk";
		status = "disabled";
		ecc-engine = <&bch>;
		#address-cells = <1>;
		#size-cells = <0>;
        };

Platform related properties, should be set in {platform_name}.dts:
- children nodes:	NAND chips.

Children nodes properties:
- reg:			Chip Select Signal, default 0.
			Set as reg = <0>, <1> when need 2 CS.
Optional:
- nand-on-flash-bbt:	Store BBT on NAND Flash.
- nand-ecc-mode:	the NAND ecc mode (check driver for supported modes)
- nand-ecc-step-size:	Number of data bytes covered by a single ECC step.
			valid values: 512 and 1024.
			1024 is recommended for large page NANDs.
- nand-ecc-strength:	Number of bits to correct per ECC step.
			The valid values that the controller supports are: 4, 6,
			8, 10, 12, 14, 16, 18, 20, 22, 24, 28, 32, 36, 40, 44,
			48, 52, 56, 60.
			The strength should be calculated as follows:
			E = (S - F) * 8 / 14
			S = O / (P / Q)
				E :	nand-ecc-strength.
				S :	spare size per sector.
				F :	FDM size, should be in the range [1,8].
					It is used to store free oob data.
				O :	oob size.
				P :	page size.
				Q :	nand-ecc-step-size.
			If the result does not match any one of the listed
			choices above, please select the smaller valid value from
			the list.
			(otherwise the driver will do the adjustment at runtime)
- pinctrl-names:	Default NAND pin GPIO setting name.
- pinctrl-0:		GPIO setting node.

Example:
	&pio {
		nand_pins_default: nanddefault {
			pins_dat {
				pinmux = <MT2701_PIN_111_MSDC0_DAT7__FUNC_NLD7>,
					 <MT2701_PIN_112_MSDC0_DAT6__FUNC_NLD6>,
					 <MT2701_PIN_114_MSDC0_DAT4__FUNC_NLD4>,
					 <MT2701_PIN_118_MSDC0_DAT3__FUNC_NLD3>,
					 <MT2701_PIN_121_MSDC0_DAT0__FUNC_NLD0>,
					 <MT2701_PIN_120_MSDC0_DAT1__FUNC_NLD1>,
					 <MT2701_PIN_113_MSDC0_DAT5__FUNC_NLD5>,
					 <MT2701_PIN_115_MSDC0_RSTB__FUNC_NLD8>,
					 <MT2701_PIN_119_MSDC0_DAT2__FUNC_NLD2>;
				input-enable;
				drive-strength = <MTK_DRIVE_8mA>;
				bias-pull-up;
			};

			pins_we {
				pinmux = <MT2701_PIN_117_MSDC0_CLK__FUNC_NWEB>;
				drive-strength = <MTK_DRIVE_8mA>;
				bias-pull-up = <MTK_PUPD_SET_R1R0_10>;
			};

			pins_ale {
				pinmux = <MT2701_PIN_116_MSDC0_CMD__FUNC_NALE>;
				drive-strength = <MTK_DRIVE_8mA>;
				bias-pull-down = <MTK_PUPD_SET_R1R0_10>;
			};
		};
	};

	&nandc {
		status = "okay";
		pinctrl-names = "default";
		pinctrl-0 = <&nand_pins_default>;
		nand@0 {
			reg = <0>;
			nand-on-flash-bbt;
			nand-ecc-mode = "hw";
			nand-ecc-strength = <24>;
			nand-ecc-step-size = <1024>;
		};
	};

NAND chip optional subnodes:
- Partitions, see Documentation/devicetree/bindings/mtd/partition.txt

Example:
	nand@0 {
		partitions {
			compatible = "fixed-partitions";
			#address-cells = <1>;
			#size-cells = <1>;

			preloader@0 {
				label = "pl";
				read-only;
				reg = <0x00000000 0x00400000>;
			};
			android@00400000 {
				label = "android";
				reg = <0x00400000 0x12c00000>;
			};
		};
	};

2) ECC Engine:
==============

Required BCH properties:
- compatible:	Should be one of "mediatek,mt2701-ecc", "mediatek,mt2712-ecc".
- reg:		Base physical address and size of ECC.
- interrupts:	Interrupts of ECC.
- clocks:	ECC required clocks.
- clock-names:	ECC clocks internal name.
- status:	Disabled default. Then set "okay" by platform.

Example:

	bch: ecc@1100e000 {
		compatible = "mediatek,mt2701-ecc";
		reg = <0 0x1100e000 0 0x1000>;
		interrupts = <GIC_SPI 55 IRQ_TYPE_LEVEL_LOW>;
		clocks = <&pericfg CLK_PERI_NFI_ECC>;
		clock-names = "nfiecc_clk";
		status = "disabled";
	};
```

## Documentation/devicetree/bindings/mtd/mtk-quadspi.txt
```
* Serial NOR flash controller for MediaTek SoCs

Required properties:
- compatible: 	  For mt8173, compatible should be "mediatek,mt8173-yesr",
		  and it's the fallback compatible for other Soc.
		  For every other SoC, should contain both the SoC-specific compatible
		  string and "mediatek,mt8173-yesr".
		  The possible values are:
		  "mediatek,mt2701-yesr", "mediatek,mt8173-yesr"
		  "mediatek,mt2712-yesr", "mediatek,mt8173-yesr"
		  "mediatek,mt7622-yesr", "mediatek,mt8173-yesr"
		  "mediatek,mt7623-yesr", "mediatek,mt8173-yesr"
		  "mediatek,mt7629-yesr", "mediatek,mt8173-yesr"
		  "mediatek,mt8173-yesr"
- reg: 		  physical base address and length of the controller's register
- clocks: 	  the phandle of the clocks needed by the yesr controller
- clock-names: 	  the names of the clocks
		  the clocks should be named "spi" and "sf". "spi" is used for spi bus,
		  and "sf" is used for controller, these are the clocks witch
		  hardware needs to enabling yesr flash and yesr flash controller.
		  See Documentation/devicetree/bindings/clock/clock-bindings.txt for details.
- #address-cells: should be <1>
- #size-cells:	  should be <0>

The SPI flash must be a child of the yesr_flash yesde and must have a
compatible property. Also see jedec,spi-yesr.txt.

Required properties:
- compatible:	  May include a device-specific string consisting of the manufacturer
		  and name of the chip. Must also include "jedec,spi-yesr" for any
		  SPI NOR flash that can be identified by the JEDEC READ ID opcode (0x9F).
- reg :		  Chip-Select number

Example:

yesr_flash: spi@1100d000 {
	compatible = "mediatek,mt8173-yesr";
	reg = <0 0x1100d000 0 0xe0>;
	clocks = <&pericfg CLK_PERI_SPI>,
		 <&topckgen CLK_TOP_SPINFI_IFR_SEL>;
	clock-names = "spi", "sf";
	#address-cells = <1>;
	#size-cells = <0>;

	flash@0 {
		compatible = "jedec,spi-yesr";
		reg = <0>;
	};
};
```

## Documentation/devicetree/bindings/mtd/mxc-nand.txt
```
* Freescale's mxc_nand

Required properties:
- compatible: "fsl,imxXX-nand"
- reg: address range of the nfc block
- interrupts: irq to be used
- nand-bus-width: see nand-controller.yaml
- nand-ecc-mode: see nand-controller.yaml
- nand-on-flash-bbt: see nand-controller.yaml

Example:

	nand@d8000000 {
		compatible = "fsl,imx27-nand";
		reg = <0xd8000000 0x1000>;
		interrupts = <29>;
		nand-bus-width = <8>;
		nand-ecc-mode = "hw";
	};
```

## Documentation/devicetree/bindings/mtd/mxc-nand.yaml
```yaml
# SPDX-License-Identifier: (GPL-2.0-only OR BSD-2-Clause)
%YAML 1.2
---
$id: http://devicetree.org/schemas/mtd/mxc-nand.yaml#
$schema: http://devicetree.org/meta-schemas/core.yaml#

title: Freescale's mxc_nand

maintainers:
  - Uwe Kleine-König <u.kleine-koenig@pengutronix.de>

allOf:
  - $ref: nand-controller-legacy.yaml

properties:
  compatible:
    oneOf:
      - enum:
          - fsl,imx25-nand
          - fsl,imx27-nand
          - fsl,imx51-nand
          - fsl,imx53-nand
      - items:
          - enum:
              - fsl,imx35-nand
          - const: fsl,imx25-nand
      - items:
          - enum:
              - fsl,imx31-nand
          - const: fsl,imx27-nand
  reg:
    minItems: 1
    items:
      - description: IP register space
      - description: Nand flash internal buffer space

  interrupts:
    maxItems: 1

  clocks:
    maxItems: 1

  dmas:
    maxItems: 1

  dma-names:
    items:
      - const: rx-tx

required:
  - compatible
  - reg
  - interrupts

unevaluatedProperties: false

examples:
  - |
    nand-controller@d8000000 {
        #address-cells = <1>;
        #size-cells = <0>;
        compatible = "fsl,imx27-nand";
        reg = <0xd8000000 0x1000>;
        interrupts = <29>;
    };
```

## Documentation/devicetree/bindings/mtd/mxic,multi-itfc-v009-nand-controller.yaml
```yaml
# SPDX-License-Identifier: GPL-2.0-only OR BSD-2-Clause

%YAML 1.2
---
$id: http://devicetree.org/schemas/mtd/mxic,multi-itfc-v009-nand-controller.yaml#
$schema: http://devicetree.org/meta-schemas/core.yaml#

title: Macronix Raw NAND Controller

maintainers:
  - Mason Yang <masonccyang@mxic.com.tw>

description:
  The Macronix Multi-Interface Raw NAND Controller is a versatile flash
  memory controller for embedding in SoCs, capable of interfacing with
  various NAND devices. It requires dedicated clock inputs for core, data
  transmit, and delayed transmit paths along with register space and an
  interrupt line for operation.

allOf:
  - $ref: nand-controller.yaml#

properties:
  compatible:
    const: mxic,multi-itfc-v009-nand-controller

  reg:
    maxItems: 1

  interrupts:
    maxItems: 1

  "#address-cells":
    const: 1

  "#size-cells":
    const: 0

  clocks:
    minItems: 3
    maxItems: 3

  clock-names:
    items:
      - const: ps
      - const: send
      - const: send_dly

required:
  - compatible
  - reg
  - interrupts
  - "#address-cells"
  - "#size-cells"
  - clocks
  - clock-names

unevaluatedProperties: false

examples:
  - |
    #include <dt-bindings/interrupt-controller/arm-gic.h>
    nand-controller@43c30000 {
        compatible = "mxic,multi-itfc-v009-nand-controller";
        reg = <0x43c30000 0x10000>;
        #address-cells = <1>;
        #size-cells = <0>;
        interrupts = <GIC_SPI 0x1d IRQ_TYPE_EDGE_RISING>;
        clocks = <&clkwizard 0>, <&clkwizard 1>, <&clkc 15>;
        clock-names = "ps", "send", "send_dly";

        nand@0 {
            reg = <0>;
            nand-ecc-mode = "soft";
            nand-ecc-algo = "bch";
        };
    };
...
```

## Documentation/devicetree/bindings/mtd/mxic-nand.txt
```
Macronix Raw NAND Controller Device Tree Bindings
-------------------------------------------------

Required properties:
- compatible: should be "mxic,multi-itfc-v009-nand-controller"
- reg: should contain 1 entry for the registers
- #address-cells: should be set to 1
- #size-cells: should be set to 0
- interrupts: interrupt line connected to this raw NAND controller
- clock-names: should contain "ps", "send" and "send_dly"
- clocks: should contain 3 phandles for the "ps", "send" and
	 "send_dly" clocks

Children nodes:
- children nodes represent the available NAND chips.

See Documentation/devicetree/bindings/mtd/nand-controller.yaml
for more details on generic bindings.

Example:

	nand: nand-controller@43c30000 {
		compatible = "mxic,multi-itfc-v009-nand-controller";
		reg = <0x43c30000 0x10000>;
		#address-cells = <1>;
		#size-cells = <0>;
		interrupts = <GIC_SPI 0x1d IRQ_TYPE_EDGE_RISING>;
		clocks = <&clkwizard 0>, <&clkwizard 1>, <&clkc 15>;
		clock-names = "send", "send_dly", "ps";

		nand@0 {
			reg = <0>;
			nand-ecc-mode = "soft";
			nand-ecc-algo = "bch";
		};
	};
```

## Documentation/devicetree/bindings/mtd/mxicy,nand-ecc-engine.yaml
```yaml
# SPDX-License-Identifier: (GPL-2.0-only OR BSD-2-Clause)
%YAML 1.2
---
$id: http://devicetree.org/schemas/mtd/mxicy,nand-ecc-engine.yaml#
$schema: http://devicetree.org/meta-schemas/core.yaml#

title: Macronix NAND ECC engine

maintainers:
  - Miquel Raynal <miquel.raynal@bootlin.com>

properties:
  compatible:
    const: mxicy,nand-ecc-engine-rev3

  reg:
    maxItems: 1

  clocks:
    maxItems: 1

  interrupts:
    maxItems: 1

required:
  - compatible
  - reg

additionalProperties: false

examples:
  - |
    /* External configuration */
    spi_controller0: spi@43c30000 {
        compatible = "mxicy,mx25f0a-spi";
        reg = <0x43c30000 0x10000>, <0xa0000000 0x4000000>;
        reg-names = "regs", "dirmap";
        clocks = <&clkwizard 0>, <&clkwizard 1>, <&clkc 15>;
        clock-names = "send_clk", "send_dly_clk", "ps_clk";
        #address-cells = <1>;
        #size-cells = <0>;

        flash@0 {
            compatible = "spi-nand";
            reg = <0>;
            nand-ecc-engine = <&ecc_engine0>;
        };
    };

    ecc_engine0: ecc@43c40000 {
        compatible = "mxicy,nand-ecc-engine-rev3";
        reg = <0x43c40000 0x10000>;
    };

  - |
    /* Pipelined configuration */
    spi_controller1: spi@43c30000 {
        compatible = "mxicy,mx25f0a-spi";
        reg = <0x43c30000 0x10000>, <0xa0000000 0x4000000>;
        reg-names = "regs", "dirmap";
        clocks = <&clkwizard 0>, <&clkwizard 1>, <&clkc 15>;
        clock-names = "send_clk", "send_dly_clk", "ps_clk";
        #address-cells = <1>;
        #size-cells = <0>;
        nand-ecc-engine = <&ecc_engine1>;

        flash@0 {
            compatible = "spi-nand";
            reg = <0>;
            nand-ecc-engine = <&spi_controller1>;
        };
    };

    ecc_engine1: ecc@43c40000 {
        compatible = "mxicy,nand-ecc-engine-rev3";
        reg = <0x43c40000 0x10000>;
    };
```

## Documentation/devicetree/bindings/mtd/nand-chip.yaml
```yaml
# SPDX-License-Identifier: (GPL-2.0-only OR BSD-2-Clause)
%YAML 1.2
---
$id: http://devicetree.org/schemas/mtd/nand-chip.yaml#
$schema: http://devicetree.org/meta-schemas/core.yaml#

title: NAND Chip Common Properties

maintainers:
  - Miquel Raynal <miquel.raynal@bootlin.com>

allOf:
  - $ref: mtd.yaml#
  - $ref: nand-property.yaml

description: |
  This file covers the generic description of a NAND chip. It implies that the
  bus interface should not be taken into account: both raw NAND devices and
  SPI-NAND devices are concerned by this description.

properties:
  reg:
    description:
      Contains the chip-select IDs.

  nand-randomizer:
    description: |
      Control the data randomizer feature.
      0: Disable randomizer.
      1: Enable randomizer.
      If absent, the current hardware state is left unchanged.
    $ref: /schemas/types.yaml#/definitions/uint32
    enum: [0, 1]

required:
  - reg

# This file can be referenced by more specific devices (like spi-nands)
additionalProperties: true
```
