## Documentation/devicetree/bindings/mtd/m25p80.txt
```
* MTD SPI driver for ST M25Pxx (and similar) serial flash chips

Required properties:
- #address-cells, #size-cells : Must be present if the device has sub-nodes
  representing partitions.
- compatible : Should be the manufacturer and the name of the chip. Bear in mind
               the DT binding is not Linux-only, but in case of Linux, see the
               "spi_nor_ids" table in drivers/mtd/spi-nor/spi-nor.c for the list
               of supported chips.
- reg : Chip-Select number
- spi-max-frequency : Maximum frequency of the SPI bus the chip can operate at

Optional properties:
- m25p,fast-read : Use the "fast read" opcode to read data from the chip instead
                   of the usual "read" opcode. This opcode is not supported by
                   all chips and support for it can not be detected at runtime.
                   Refer to your chips' datasheet to check if this is supported
                   by your chip.

Example:

	flash: m25p80@0 {
		#address-cells = <1>;
		#size-cells = <1>;
		compatible = "spansion,m25p80";
		reg = <0>;
		spi-max-frequency = <40000000>;
		m25p,fast-read;
	};
```

## Documentation/devicetree/bindings/mtd/marvell,nand-controller.yaml
```yaml
# SPDX-License-Identifier: (GPL-2.0-only OR BSD-2-Clause)
%YAML 1.2
---
$id: http://devicetree.org/schemas/mtd/marvell,nand-controller.yaml#
$schema: http://devicetree.org/meta-schemas/core.yaml#

title: Marvell NAND Flash Controller (NFC)

maintainers:
  - Miquel Raynal <miquel.raynal@bootlin.com>

properties:
  compatible:
    oneOf:
      - items:
          - const: marvell,armada-8k-nand-controller
          - const: marvell,armada370-nand-controller
      - enum:
          - marvell,armada370-nand-controller
          - marvell,pxa3xx-nand-controller
      - description: legacy bindings
        deprecated: true
        enum:
          - marvell,armada-8k-nand
          - marvell,armada370-nand
          - marvell,pxa3xx-nand

  reg:
    maxItems: 1

  interrupts:
    maxItems: 1

  clocks:
    description:
      Shall reference the NAND controller clocks, the second one is
      is only needed for the Armada 7K/8K SoCs
    minItems: 1
    maxItems: 2

  clock-names:
    minItems: 1
    items:
      - const: core
      - const: reg

  dmas:
    maxItems: 1

  dma-names:
    items:
      - const: data

  marvell,system-controller:
    $ref: /schemas/types.yaml#/definitions/phandle
    description: Syscon node that handles NAND controller related registers

patternProperties:
  "^nand@[a-f0-9]$":
    type: object
    $ref: raw-nand-chip.yaml

    properties:
      reg:
        minimum: 0
        maximum: 3

      nand-rb:
        items:
          - minimum: 0
            maximum: 1

      nand-ecc-step-size:
        const: 512

      nand-ecc-strength:
        enum: [1, 4, 8, 12, 16]

      nand-ecc-mode:
        const: hw

      marvell,nand-keep-config:
        $ref: /schemas/types.yaml#/definitions/flag
        description:
          Orders the driver not to take the timings from the core and
          leaving them completely untouched. Bootloader timings will then
          be used.

      marvell,nand-enable-arbiter:
        $ref: /schemas/types.yaml#/definitions/flag
        description:
          To enable the arbiter, all boards blindly used it,
          this bit was set by the bootloader for many boards and even if
          it is marked reserved in several datasheets, it might be needed to set
          it (otherwise it is harmless).
        deprecated: true

    required:
      - reg
      - nand-rb

    unevaluatedProperties: false

required:
  - compatible
  - reg
  - interrupts
  - clocks

allOf:
  - $ref: nand-controller.yaml#

  - if:
      properties:
        compatible:
          contains:
            const: marvell,pxa3xx-nand-controller
    then:
      required:
        - dmas
        - dma-names

  - if:
      properties:
        compatible:
          contains:
            const: marvell,armada-8k-nand-controller
    then:
      properties:
        clocks:
          minItems: 2

        clock-names:
          minItems: 2

      required:
        - marvell,system-controller

    else:
      properties:
        clocks:
          minItems: 1

        clock-names:
          minItems: 1


unevaluatedProperties: false

examples:
  - |
    #include <dt-bindings/interrupt-controller/arm-gic.h>
    nand_controller: nand-controller@d0000 {
        compatible = "marvell,armada370-nand-controller";
        reg = <0xd0000 0x54>;
        #address-cells = <1>;
        #size-cells = <0>;
        interrupts = <GIC_SPI 84 IRQ_TYPE_LEVEL_HIGH>;
        clocks = <&coredivclk 0>;

        nand@0 {
            reg = <0>;
            label = "main-storage";
            nand-rb = <0>;
            nand-ecc-mode = "hw";
            marvell,nand-keep-config;
            nand-on-flash-bbt;
            nand-ecc-strength = <4>;
            nand-ecc-step-size = <512>;

            partitions {
                compatible = "fixed-partitions";
                #address-cells = <1>;
                #size-cells = <1>;

                partition@0 {
                    label = "Rootfs";
                    reg = <0x00000000 0x40000000>;
                };
            };
        };
    };

  - |
    cp0_nand_controller: nand-controller@720000 {
        compatible = "marvell,armada-8k-nand-controller",
                "marvell,armada370-nand-controller";
        reg = <0x720000 0x54>;
        #address-cells = <1>;
        #size-cells = <0>;
        interrupts = <115 IRQ_TYPE_LEVEL_HIGH>;
        clock-names = "core", "reg";
        clocks = <&cp0_clk 1 2>,
                 <&cp0_clk 1 17>;
        marvell,system-controller = <&cp0_syscon0>;

        nand@0 {
            reg = <0>;
            label = "main-storage";
            nand-rb = <0>;
            nand-ecc-mode = "hw";
            nand-ecc-strength = <8>;
            nand-ecc-step-size = <512>;
        };
    };

  - |
    nand-controller@43100000 {
        compatible = "marvell,pxa3xx-nand-controller";
        reg = <0x43100000 90>;
        interrupts = <45>;
        clocks = <&clks 1>;
        clock-names = "core";
        dmas = <&pdma 97 3>;
        dma-names = "data";
        #address-cells = <1>;
        #size-cells = <0>;
        nand@0 {
            reg = <0>;
            nand-rb = <0>;
            nand-ecc-mode = "hw";
            marvell,nand-keep-config;
        };
    };

...
```

## Documentation/devicetree/bindings/mtd/marvell-nand.txt
```
Marvell NAND Flash Controller (NFC)

Required properties:
- compatible: can be one of the following:
    * "marvell,armada-8k-nand-controller"
    * "marvell,armada370-nand-controller"
    * "marvell,pxa3xx-nand-controller"
    * "marvell,armada-8k-nand" (deprecated)
    * "marvell,armada370-nand" (deprecated)
    * "marvell,pxa3xx-nand" (deprecated)
  Compatibles marked deprecated support only the old bindings described
  at the bottom.
- reg: NAND flash controller memory area.
- #address-cells: shall be set to 1. Encode the NAND CS.
- #size-cells: shall be set to 0.
- interrupts: shall define the NAND controller interrupt.
- clocks: shall reference the NAND controller clocks, the second one is
  is only needed for the Armada 7K/8K SoCs
- clock-names: mandatory if there is a second clock, in this case there
  should be one clock named "core" and another one named "reg"
- marvell,system-controller: Set to retrieve the syscon node that handles
  NAND controller related registers (only required with the
  "marvell,armada-8k-nand[-controller]" compatibles).

Optional properties:
- label: see partition.txt. New platforms shall omit this property.
- dmas: shall reference DMA channel associated to the NAND controller.
  This property is only used with "marvell,pxa3xx-nand[-controller]"
  compatible strings.
- dma-names: shall be "rxtx".
  This property is only used with "marvell,pxa3xx-nand[-controller]"
  compatible strings.

Optional children nodes:
Children nodes represent the available NAND chips.

Required properties:
- reg: shall contain the native Chip Select ids (0-3).
- nand-rb: see nand.txt (0-1).

Optional properties:
- marvell,nand-keep-config: orders the driver not to take the timings
  from the core and leaving them completely untouched. Bootloader
  timings will then be used.
- label: MTD name.
- nand-on-flash-bbt: see nand.txt.
- nand-ecc-mode: see nand.txt. Will use hardware ECC if not specified.
- nand-ecc-algo: see nand.txt. This property is essentially useful when
  not using hardware ECC. Howerver, it may be added when using hardware
  ECC for clarification but will be ignored by the driver because ECC
  mode is chosen depending on the page size and the strength required by
  the NAND chip. This value may be overwritten with nand-ecc-strength
  property.
- nand-ecc-strength: see nand.txt.
- nand-ecc-step-size: see nand.txt. Marvell's NAND flash controller does
  use fixed strength (1-bit for Hamming, 16-bit for BCH), so the actual
  step size will shrink or grow in order to fit the required strength.
  Step sizes are not completely random for all and follow certain
  patterns described in AN-379, "Marvell SoC NFC ECC".

See Documentation/devicetree/bindings/mtd/nand.txt for more details on
generic bindings.


Example:
nand_controller: nand-controller@d0000 {
	compatible = "marvell,armada370-nand-controller";
	reg = <0xd0000 0x54>;
	#address-cells = <1>;
	#size-cells = <0>;
	interrupts = <GIC_SPI 84 IRQ_TYPE_LEVEL_HIGH>;
	clocks = <&coredivclk 0>;

	nand@0 {
		reg = <0>;
		label = "main-storage";
		nand-rb = <0>;
		nand-ecc-mode = "hw";
		marvell,nand-keep-config;
		nand-on-flash-bbt;
		nand-ecc-strength = <4>;
		nand-ecc-step-size = <512>;

		partitions {
			compatible = "fixed-partitions";
			#address-cells = <1>;
			#size-cells = <1>;

			partition@0 {
				label = "Rootfs";
				reg = <0x00000000 0x40000000>;
			};
		};
	};
};


Note on legacy bindings: One can find, in not-updated device trees,
bindings slightly different than described above with other properties
described below as well as the partitions node at the root of a so
called "nand" node (without clear controller/chip separation).

Legacy properties:
- marvell,nand-enable-arbiter: To enable the arbiter, all boards blindly
  used it, this bit was set by the bootloader for many boards and even if
  it is marked reserved in several datasheets, it might be needed to set
  it (otherwise it is harmless) so whether or not this property is set,
  the bit is selected by the driver.
- num-cs: Number of chip-select lines to use, all boards blindly set 1
  to this and for a reason, other values would have failed. The value of
  this property is ignored.

Example:

	nand0: nand@43100000 {
		compatible = "marvell,pxa3xx-nand";
		reg = <0x43100000 90>;
		interrupts = <45>;
		dmas = <&pdma 97 0>;
		dma-names = "rxtx";
		#address-cells = <1>;
		marvell,nand-keep-config;
		marvell,nand-enable-arbiter;
		num-cs = <1>;
		/* Partitions (optional) */
       };
```

## Documentation/devicetree/bindings/mtd/mediatek,mtk-nfc.yaml
```yaml
# SPDX-License-Identifier: (GPL-2.0-only OR BSD-2-Clause)
%YAML 1.2
---
$id: http://devicetree.org/schemas/mtd/mediatek,mtk-nfc.yaml#
$schema: http://devicetree.org/meta-schemas/core.yaml#

title: MediaTek(MTK) SoCs raw NAND FLASH controller (NFC)

maintainers:
  - Xiangsheng Hou <xiangsheng.hou@mediatek.com>

properties:
  compatible:
    enum:
      - mediatek,mt2701-nfc
      - mediatek,mt2712-nfc
      - mediatek,mt7622-nfc

  reg:
    items:
      - description: Base physical address and size of NFI.

  interrupts:
    items:
      - description: NFI interrupt

  clocks:
    items:
      - description: clock used for the controller
      - description: clock used for the pad

  clock-names:
    items:
      - const: nfi_clk
      - const: pad_clk

  ecc-engine:
    description: device-tree node of the required ECC engine.
    $ref: /schemas/types.yaml#/definitions/phandle

patternProperties:
  "^nand@[a-f0-9]$":
    $ref: raw-nand-chip.yaml#
    unevaluatedProperties: false
    properties:
      reg:
        maximum: 1
      nand-on-flash-bbt: true
      nand-ecc-mode:
        const: hw

allOf:
  - $ref: nand-controller.yaml#

  - if:
      properties:
        compatible:
          contains:
            const: mediatek,mt2701-nfc
    then:
      patternProperties:
        "^nand@[a-f0-9]$":
          properties:
            nand-ecc-step-size:
              enum: [ 512, 1024 ]
            nand-ecc-strength:
              enum: [4, 6, 8, 10, 12, 14, 16, 18, 20, 22, 24, 28, 32, 36,
                     40, 44, 48, 52, 56, 60]

  - if:
      properties:
        compatible:
          contains:
            const: mediatek,mt2712-nfc
    then:
      patternProperties:
        "^nand@[a-f0-9]$":
          properties:
            nand-ecc-step-size:
              enum: [ 512, 1024 ]
            nand-ecc-strength:
              enum: [4, 6, 8, 10, 12, 14, 16, 18, 20, 22, 24, 28, 32, 36,
                     40, 44, 48, 52, 56, 60, 68, 72, 80]

  - if:
      properties:
        compatible:
          contains:
            const: mediatek,mt7622-nfc
    then:
      patternProperties:
        "^nand@[a-f0-9]$":
          properties:
            nand-ecc-step-size:
              const: 512
            nand-ecc-strength:
              enum: [4, 6, 8, 10, 12]

required:
  - compatible
  - reg
  - interrupts
  - clocks
  - clock-names
  - ecc-engine

unevaluatedProperties: false

examples:
  - |
    #include <dt-bindings/clock/mt2701-clk.h>
    #include <dt-bindings/interrupt-controller/arm-gic.h>
    #include <dt-bindings/interrupt-controller/irq.h>

    soc {
        #address-cells = <2>;
        #size-cells = <2>;

        nand-controller@1100d000 {
            compatible = "mediatek,mt2701-nfc";
            reg = <0 0x1100d000 0 0x1000>;
            interrupts = <GIC_SPI 56 IRQ_TYPE_LEVEL_LOW>;
            clocks = <&pericfg CLK_PERI_NFI>,
                     <&pericfg CLK_PERI_NFI_PAD>;
            clock-names = "nfi_clk", "pad_clk";
            ecc-engine = <&bch>;
            #address-cells = <1>;
            #size-cells = <0>;

            nand@0 {
                reg = <0>;

                nand-on-flash-bbt;
                nand-ecc-mode = "hw";
                nand-ecc-step-size = <1024>;
                nand-ecc-strength = <24>;

                partitions {
                    compatible = "fixed-partitions";
                    #address-cells = <1>;
                    #size-cells = <1>;

                    preloader@0 {
                        label = "pl";
                        read-only;
                        reg = <0x0 0x400000>;
                    };
                    android@400000 {
                        label = "android";
                        reg = <0x400000 0x12c00000>;
                    };
                };
            };
        };
    };
```
