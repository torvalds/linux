## Documentation/devicetree/bindings/mtd/vf610-nfc.txt
```
Freescale's NAND flash controller (NFC)

This variant of the Freescale NAND flash controller (NFC) can be found on
Vybrid (vf610), MPC5125, MCF54418 and Kinetis K70.

Required properties:
- compatible: Should be set to "fsl,vf610-nfc".
- reg: address range of the NFC.
- interrupts: interrupt of the NFC.
- #address-cells: shall be set to 1. Encode the nand CS.
- #size-cells : shall be set to 0.
- assigned-clocks: main clock from the SoC, for Vybrid <&clks VF610_CLK_NFC>;
- assigned-clock-rates: The NAND bus timing is derived from this clock
    rate and should not exceed maximum timing for any NAND memory chip
    in a board stuffing. Typical NAND memory timings derived from this
    clock are found in the SoC hardware reference manual. Furthermore,
    there might be restrictions on maximum rates when using hardware ECC.

- #address-cells, #size-cells : Must be present if the device has sub-nodes
  representing partitions.

Required children nodes:
Children nodes represent the available nand chips. Currently the driver can
only handle one NAND chip.

Required properties:
- compatible: Should be set to "fsl,vf610-nfc-cs".
- nand-bus-width: see nand-controller.yaml
- nand-ecc-mode: see nand-controller.yaml

Required properties for hardware ECC:
- nand-ecc-strength: supported strengths are 24 and 32 bit (see nand-controller.yaml)
- nand-ecc-step-size: step size equals page size, currently only 2k pages are
    supported
- nand-on-flash-bbt: see nand-controller.yaml

Example:

	nfc: nand@400e0000 {
		compatible = "fsl,vf610-nfc";
		#address-cells = <1>;
		#size-cells = <0>;
		reg = <0x400e0000 0x4000>;
		interrupts = <GIC_SPI 83 IRQ_TYPE_LEVEL_HIGH>;
		clocks = <&clks VF610_CLK_NFC>;
		clock-names = "nfc";
		assigned-clocks = <&clks VF610_CLK_NFC>;
		assigned-clock-rates = <33000000>;

		nand@0 {
			compatible = "fsl,vf610-nfc-nandcs";
			reg = <0>;
			nand-bus-width = <8>;
			nand-ecc-mode = "hw";
			nand-ecc-strength = <32>;
			nand-ecc-step-size = <2048>;
			nand-on-flash-bbt;
		};
	};
```

## Documentation/devicetree/bindings/mux/adi,adg792a.txt
```
Bindings for Analog Devices ADG792A/G Triple 4:1 Multiplexers

Required properties:
- compatible : "adi,adg792a" or "adi,adg792g"
- #mux-control-cells : <0> if parallel (the three muxes are bound together
  with a single mux controller controlling all three muxes), or <1> if
  not (one mux controller for each mux).
* Standard mux-controller bindings as described in mux-controller.txt

Optional properties for ADG792G:
- gpio-controller : if present, #gpio-cells below is required.
- #gpio-cells : should be <2>
			  - First cell is the GPO line number, i.e. 0 or 1
			  - Second cell is used to specify active high (0)
			    or active low (1)

Optional properties:
- idle-state : if present, array of states that the mux controllers will have
  when idle. The special state MUX_IDLE_AS_IS is the default and
  MUX_IDLE_DISCONNECT is also supported.

States 0 through 3 correspond to signals A through D in the datasheet.

Example:

	/*
	 * Three independent mux controllers (of which one is used).
	 * Mux 0 is disconnected when idle, mux 1 idles in the previously
	 * selected state and mux 2 idles with signal B.
	 */
	&i2c0 {
		mux: mux-controller@50 {
			compatible = "adi,adg792a";
			reg = <0x50>;
			#mux-control-cells = <1>;

			idle-state = <MUX_IDLE_DISCONNECT MUX_IDLE_AS_IS 1>;
		};
	};

	adc-mux {
		compatible = "io-channel-mux";
		io-channels = <&adc 0>;
		io-channel-names = "parent";

		mux-controls = <&mux 2>;

		channels = "sync-1", "", "out";
	};


	/*
	 * Three parallel muxes with one mux controller, useful e.g. if
	 * the adc is differential, thus needing two signals to be muxed
	 * simultaneously for correct operation.
	 */
	&i2c0 {
		pmux: mux-controller@50 {
			compatible = "adi,adg792a";
			reg = <0x50>;
			#mux-control-cells = <0>;

			idle-state = <1>;
		};
	};

	diff-adc-mux {
		compatible = "io-channel-mux";
		io-channels = <&adc 0>;
		io-channel-names = "parent";

		mux-controls = <&pmux>;

		channels = "sync-1", "", "out";
	};
```

## Documentation/devicetree/bindings/mux/adi,adgs1408.txt
```
Bindings for Analog Devices ADGS1408/1409 8:1/Dual 4:1 Mux

Required properties:
- compatible : Should be one of
	* "adi,adgs1408"
	* "adi,adgs1409"
* Standard mux-controller bindings as described in mux-controller.txt

Optional properties for ADGS1408/1409:
- gpio-controller : if present, #gpio-cells is required.
- #gpio-cells : should be <2>
			- First cell is the GPO line number, i.e. 0 to 3
			for ADGS1408 and 0 to 4 for ADGS1409
			- Second cell is used to specify active high (0)
			or active low (1)

Optional properties:
- idle-state : if present, the state that the mux controller will have
  when idle. The special state MUX_IDLE_AS_IS is the default and
  MUX_IDLE_DISCONNECT is also supported.

States 0 through 7 correspond to signals S1 through S8 in the datasheet.
For ADGS1409 only states 0 to 3 are available.

Example:

	/*
	 * One mux controller.
	 * Mux state set to idle as is (no idle-state declared)
	 */
	&spi0 {
		mux: mux-controller@0 {
			compatible = "adi,adgs1408";
			reg = <0>;
			spi-max-frequency = <1000000>;
			#mux-control-cells = <0>;
		};
	}

	adc-mux {
		compatible = "io-channel-mux";
		io-channels = <&adc 1>;
		io-channel-names = "parent";
		mux-controls = <&mux>;

		channels = "out_a0", "out_a1", "test0", "test1",
			"out_b0", "out_b1", "testb0", "testb1";
	};
```

## Documentation/devicetree/bindings/mux/gpio-mux.yaml
```yaml
# SPDX-License-Identifier: GPL-2.0
%YAML 1.2
---
$id: http://devicetree.org/schemas/mux/gpio-mux.yaml#
$schema: http://devicetree.org/meta-schemas/core.yaml#

title: GPIO-based multiplexer controller

maintainers:
  - Peter Rosin <peda@axentia.se>

description: |+
  Define what GPIO pins are used to control a multiplexer. Or several
  multiplexers, if the same pins control more than one multiplexer.

  The multiplexer state is defined as the number represented by the
  multiplexer GPIO pins, where the first pin is the least significant
  bit. An active pin is a binary 1, an inactive pin is a binary 0.

properties:
  compatible:
    const: gpio-mux

  mux-gpios:
    description:
      List of gpios used to control the multiplexer, least significant bit first.

  '#mux-control-cells':
    enum: [ 0, 1 ]

  '#mux-state-cells':
    enum: [ 1, 2 ]

  idle-state:
    default: -1

required:
  - compatible
  - mux-gpios
anyOf:
  - required:
      - "#mux-control-cells"
  - required:
      - "#mux-state-cells"

additionalProperties: false

examples:
  - |
    #include <dt-bindings/gpio/gpio.h>

    mux: mux-controller {
        compatible = "gpio-mux";
        #mux-control-cells = <0>;

        mux-gpios = <&pioA 0 GPIO_ACTIVE_HIGH>,
              <&pioA 1 GPIO_ACTIVE_HIGH>;
    };

    adc-mux {
        compatible = "io-channel-mux";
        io-channels = <&adc 0>;
        io-channel-names = "parent";

        mux-controls = <&mux>;

        channels = "sync-1", "in", "out", "sync-2";
    };

    i2c-mux {
        compatible = "i2c-mux";
        i2c-parent = <&i2c1>;

        mux-controls = <&mux>;

        #address-cells = <1>;
        #size-cells = <0>;

        i2c@0 {
            reg = <0>;
            #address-cells = <1>;
            #size-cells = <0>;

            ssd1307: oled@3c {
                reg = <0x3c>;
            };
        };

        i2c@3 {
            reg = <3>;
            #address-cells = <1>;
            #size-cells = <0>;

            pca9555: pca9555@20 {
                reg = <0x20>;
            };
        };
    };
...
```

## Documentation/devicetree/bindings/mux/mmio-mux.txt
```
MMIO register bitfield-based multiplexer controller bindings

Define register bitfields to be used to control multiplexers. The parent
device tree node must be a syscon node to provide register access.

Required properties:
- compatible : "mmio-mux"
- #mux-control-cells : <1>
- mux-reg-masks : an array of register offset and pre-shifted bitfield mask
                  pairs, each describing a single mux control.
* Standard mux-controller bindings as decribed in mux-controller.txt

Optional properties:
- idle-states : if present, the state the muxes will have when idle. The
		special state MUX_IDLE_AS_IS is the default.

The multiplexer state of each multiplexer is defined as the value of the
bitfield described by the corresponding register offset and bitfield mask pair
in the mux-reg-masks array, accessed through the parent syscon.

Example:

	syscon {
		compatible = "syscon";

		mux: mux-controller {
			compatible = "mmio-mux";
			#mux-control-cells = <1>;

			mux-reg-masks = <0x3 0x30>, /* 0: reg 0x3, bits 5:4 */
					<0x3 0x40>, /* 1: reg 0x3, bit 6 */
			idle-states = <MUX_IDLE_AS_IS>, <0>;
		};
	};

	video-mux {
		compatible = "video-mux";
		mux-controls = <&mux 0>;

		ports {
			/* inputs 0..3 */
			port@0 {
				reg = <0>;
			};
			port@1 {
				reg = <1>;
			};
			port@2 {
				reg = <2>;
			};
			port@3 {
				reg = <3>;
			};

			/* output */
			port@4 {
				reg = <4>;
			};
		};
	};
```

## Documentation/devicetree/bindings/mux/mux-consumer.yaml
```yaml
# SPDX-License-Identifier: GPL-2.0
%YAML 1.2
---
$id: http://devicetree.org/schemas/mux/mux-consumer.yaml#
$schema: http://devicetree.org/meta-schemas/core.yaml#

title: Common multiplexer controller consumer

maintainers:
  - Peter Rosin <peda@axentia.se>

description: |
  Mux controller consumers should specify a list of mux controllers that they
  want to use with a property containing a 'mux-ctrl-list':

    mux-ctrl-list ::= <single-mux-ctrl> [mux-ctrl-list]
    single-mux-ctrl ::= <mux-ctrl-phandle> [mux-ctrl-specifier]
    mux-ctrl-phandle : phandle to mux controller node
    mux-ctrl-specifier : array of #mux-control-cells specifying the
                         given mux controller (controller specific)

  Mux controller properties should be named "mux-controls". The exact meaning of
  each mux controller property must be documented in the device tree binding for
  each consumer. An optional property "mux-control-names" may contain a list of
  strings to label each of the mux controllers listed in the "mux-controls"
  property.

  If it is required to provide the state that the mux controller needs to
  be set to, the property "mux-states" must be used. An optional property
  "mux-state-names" can be used to provide a list of strings, to label
  each of the multiplixer states listed in the "mux-states" property.

  Properties "mux-controls" and "mux-states" can be used depending on how
  the consumers want to control the mux controller. If the consumer needs
  needs to set multiple states in a mux controller, then property
  "mux-controls" can be used. If the consumer needs to set the mux
  controller to a given state then property "mux-states" can be used.

  mux-ctrl-specifier typically encodes the chip-relative mux controller number.
  If the mux controller chip only provides a single mux controller, the
  mux-ctrl-specifier can typically be left out.

select: true

properties:
  mux-controls:
    $ref: /schemas/types.yaml#/definitions/phandle-array

  mux-states:
    $ref: /schemas/types.yaml#/definitions/phandle-array

  mux-control-names:
    description:
      Devices that use more than a single mux controller can use the
      "mux-control-names" property to map the name of the requested mux
      controller to an index into the list given by the "mux-controls" property.

  mux-state-names:
    description:
      Devices that use more than a single multiplexer state can use the
      "mux-state-names" property to map the name of the requested mux
      controller to an index into the list given by the "mux-states"
      property.

additionalProperties: true

...
```
