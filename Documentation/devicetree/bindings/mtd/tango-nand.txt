## Documentation/devicetree/bindings/mux/reg-mux.yaml
```yaml
# SPDX-License-Identifier: GPL-2.0
%YAML 1.2
---
$id: http://devicetree.org/schemas/mux/reg-mux.yaml#
$schema: http://devicetree.org/meta-schemas/core.yaml#

title: Generic register bitfield-based multiplexer controller bindings

maintainers:
  - Peter Rosin <peda@axentia.se>

description: |+
  Define register bitfields to be used to control multiplexers. The parent
  device tree node must be a device node to provide register r/w access.

properties:
  compatible:
    enum:
      - reg-mux   # parent device of mux controller is not syscon device
      - mmio-mux  # parent device of mux controller is syscon device

  reg: true

  '#mux-control-cells':
    const: 1

  mux-reg-masks:
    description: an array of register offset and pre-shifted bitfield mask
      pairs, each describing a single mux control.

  idle-states: true

required:
  - compatible
  - mux-reg-masks
  - '#mux-control-cells'

additionalProperties: false

examples:
  - |
    /* The parent device of mux controller is not a syscon device. */

    #include <dt-bindings/mux/mux.h>

    mux-controller {
        compatible = "reg-mux";
        #mux-control-cells = <1>;
        mux-reg-masks =
            <0x54 0xf8>, /* 0: reg 0x54, bits 7:3 */
            <0x54 0x07>; /* 1: reg 0x54, bits 2:0 */
    };

    mdio-mux-1 {
        compatible = "mdio-mux-multiplexer";
        mux-controls = <&mux1 0>;
        mdio-parent-bus = <&emdio1>;
        #address-cells = <1>;
        #size-cells = <0>;

        mdio@0 {
            reg = <0x0>;
            #address-cells = <1>;
            #size-cells = <0>;
        };

        mdio@8 {
            reg = <0x8>;
            #address-cells = <1>;
            #size-cells = <0>;
        };
    };

    mdio-mux-2 {
        compatible = "mdio-mux-multiplexer";
        mux-controls = <&mux1 1>;
        mdio-parent-bus = <&emdio2>;
        #address-cells = <1>;
        #size-cells = <0>;

        mdio@0 {
            reg = <0x0>;
            #address-cells = <1>;
            #size-cells = <0>;
        };

        mdio@1 {
            reg = <0x1>;
            #address-cells = <1>;
            #size-cells = <0>;
        };
    };

  - |
    /* The parent device of mux controller is syscon device. */

    #include <dt-bindings/mux/mux.h>
    syscon@1000 {
        compatible = "fsl,imx7d-iomuxc-gpr", "fsl,imx6q-iomuxc-gpr", "syscon", "simple-mfd";
        reg = <0x1000 0x100>;

        mux2: mux-controller {
            compatible = "mmio-mux";
            #mux-control-cells = <1>;

            mux-reg-masks =
                <0x3 0x30>, /* 0: reg 0x3, bits 5:4 */
                <0x3 0x40>; /* 1: reg 0x3, bit 6 */
            idle-states = <MUX_IDLE_AS_IS>, <0>;
        };
    };

    video-mux {
        compatible = "video-mux";
        mux-controls = <&mux2 0>;
        #address-cells = <1>;
        #size-cells = <0>;

        ports {
            #address-cells = <1>;
            #size-cells = <0>;

            /* inputs 0..3 */
            port@0 {
                reg = <0>;
            };
            port@1 {
                reg = <1>;
            };
            port@2 {
                reg = <2>;
            };
            port@3 {
                reg = <3>;
            };

            /* output */
            port@4 {
                reg = <4>;
            };
        };
    };
...
```

## Documentation/devicetree/bindings/nds32/atl2c.txt
```
* Andestech L2 cache Controller

The level-2 cache controller plays an important role in reducing memory latency
for high performance systems, such as thoese designs with AndesCore processors.
Level-2 cache controller in general enhances overall system performance
signigicantly and the system power consumption might be reduced as well by
reducing DRAM accesses.

This binding specifies what properties must be available in the device tree
representation of an Andestech L2 cache controller.

Required properties:
	- compatible:
		Usage: required
		Value type: <string>
		Definition: "andestech,atl2c"
	- reg : Physical base address and size of cache controller's memory mapped
	- cache-unified : Specifies the cache is a unified cache.
	- cache-level : Should be set to 2 for a level 2 cache.

* Example

	cache-controller@e0500000 {
		compatible = "andestech,atl2c";
		reg = <0xe0500000 0x1000>;
		cache-unified;
		cache-level = <2>;
	};
```

## Documentation/devicetree/bindings/nds32/cpus.txt
```
* Andestech Processor Binding

This binding specifies what properties must be available in the device tree
representation of a Andestech Processor Core, which is the root node in the
tree.

Required properties:

	- compatible:
		Usage: required
		Value type: <string>
		Definition: Should be "andestech,<core_name>", "andestech,nds32v3" as fallback.
		Must contain "andestech,nds32v3" as the most generic value, in addition to
		one of the following identifiers for a particular CPU core:
		"andestech,n13"
		"andestech,n15"
		"andestech,d15"
		"andestech,n10"
		"andestech,d10"
	- device_type
		Usage: required
		Value type: <string>
		Definition: must be "cpu"
	- reg: Contains CPU index.
	- clock-frequency: Contains the clock frequency for CPU, in Hz.

* Examples

/ {
	cpus {
		cpu@0 {
			device_type = "cpu";
			compatible = "andestech,n13", "andestech,nds32v3";
			reg = <0x0>;
			clock-frequency = <60000000>
		};
	};
};
```

## Documentation/devicetree/bindings/net/4g-modem-platdata.txt
```
* Rockchip 4g modem device tree bindings

Required properties:
- compatible : "4g-modem-platdata"

Optional properties:
- 4G,vbat-gpio : 4g modem vbat gpio
- 4G,power-gpio : 4g modem power enable/disable gpio
- 4G,reset-gpio : 4g modem reset gpio

Example:

	4G-Modem {
		compatible="4g-modem-platdata";
		4G,vbat-gpio = <&gpio0 RK_PA4 GPIO_ACTIVE_HIGH>;
		4G,power-gpio = <&gpio0 RK_PC0 GPIO_ACTIVE_LOW>;
		4G,reset-gpio = <&gpio0 RK_PB7 GPIO_ACTIVE_LOW>;
	}
```

## Documentation/devicetree/bindings/net/actions,owl-emac.yaml
```yaml
# SPDX-License-Identifier: (GPL-2.0-only OR BSD-2-Clause)
%YAML 1.2
---
$id: http://devicetree.org/schemas/net/actions,owl-emac.yaml#
$schema: http://devicetree.org/meta-schemas/core.yaml#

title: Actions Semi Owl SoCs Ethernet MAC Controller

maintainers:
  - Cristian Ciocaltea <cristian.ciocaltea@gmail.com>

description: |
  This Ethernet MAC is used on the Owl family of SoCs from Actions Semi.
  It provides the RMII and SMII interfaces and is compliant with the
  IEEE 802.3 CSMA/CD standard, supporting both half-duplex and full-duplex
  operation modes at 10/100 Mb/s data transfer rates.

allOf:
  - $ref: "ethernet-controller.yaml#"

properties:
  compatible:
    oneOf:
      - const: actions,owl-emac
      - items:
          - enum:
              - actions,s500-emac
          - const: actions,owl-emac

  reg:
    maxItems: 1

  interrupts:
    maxItems: 1

  clocks:
    minItems: 2
    maxItems: 2

  clock-names:
    additionalItems: false
    items:
      - const: eth
      - const: rmii

  resets:
    maxItems: 1

  actions,ethcfg:
    $ref: /schemas/types.yaml#/definitions/phandle
    description:
      Phandle to the device containing custom config.

  mdio:
    $ref: mdio.yaml#
    unevaluatedProperties: false

required:
  - compatible
  - reg
  - interrupts
  - clocks
  - clock-names
  - resets
  - phy-mode
  - phy-handle

unevaluatedProperties: false

examples:
  - |
    #include <dt-bindings/clock/actions,s500-cmu.h>
    #include <dt-bindings/interrupt-controller/arm-gic.h>
    #include <dt-bindings/reset/actions,s500-reset.h>

    ethernet@b0310000 {
        compatible = "actions,s500-emac", "actions,owl-emac";
        reg = <0xb0310000 0x10000>;
        interrupts = <GIC_SPI 0 IRQ_TYPE_LEVEL_HIGH>;
        clocks = <&cmu 59 /*CLK_ETHERNET*/>, <&cmu CLK_RMII_REF>;
        clock-names = "eth", "rmii";
        resets = <&cmu RESET_ETHERNET>;
        phy-mode = "rmii";
        phy-handle = <&eth_phy>;

        mdio {
            #address-cells = <1>;
            #size-cells = <0>;

            eth_phy: ethernet-phy@3 {
                reg = <0x3>;
                interrupt-parent = <&sirq>;
                interrupts = <0 IRQ_TYPE_LEVEL_LOW>;
            };
        };
    };
```

## Documentation/devicetree/bindings/net/adi,ad3306.yaml
```yaml
# SPDX-License-Identifier: (GPL-2.0-only OR BSD-2-Clause)
%YAML 1.2
---
$id: http://devicetree.org/schemas/net/adi,ad3306.yaml#
$schema: http://devicetree.org/meta-schemas/core.yaml#

title: ADI ADIN1140 10BASE-T1S MAC-PHY

maintainers:
  - Ciprian Regus <ciprian.regus@analog.com>

description: |
  The ADIN1140 (also called AD3306) is a low power single port
  10BASE-T1S MAC-PHY. It integrates an Ethernet PHY with a MAC
  and all the associated analog circuitry.
  The device tries to implement the Open Alliance TC6 10BASE-T1x MAC-PHY
  Serial Interface specification and is compliant with the
  IEEE 802.3cg-2019 Ethernet standard for 10 Mbps single pair
  Ethernet (SPE). The device has a 4-wire SPI interface for
  communication between the MAC and host processor.

allOf:
  - $ref: /schemas/net/ethernet-controller.yaml#
  - $ref: /schemas/spi/spi-peripheral-props.yaml#

properties:
  compatible:
    oneOf:
      - items:
          - const: adi,adin1140
          - const: adi,ad3306
      - const: adi,ad3306

  reg:
    maxItems: 1

  spi-max-frequency:
    maximum: 25000000

  interrupts:
    maxItems: 1
    description: Interrupt from the MAC-PHY for receive data available
      and error conditions

required:
  - compatible
  - reg
  - interrupts
  - spi-max-frequency

unevaluatedProperties: false

examples:
  - |
    #include <dt-bindings/interrupt-controller/irq.h>

    spi {
        #address-cells = <1>;
        #size-cells = <0>;

        ethernet@0 {
            compatible = "adi,ad3306";
            reg = <0>;
            spi-max-frequency = <23000000>;

            interrupt-parent = <&gpio>;
            interrupts = <6 IRQ_TYPE_LEVEL_LOW>;

            local-mac-address = [ 00 11 22 33 44 55 ];
        };
    };
```

## Documentation/devicetree/bindings/net/adi,adin.yaml
```yaml
# SPDX-License-Identifier: GPL-2.0+
%YAML 1.2
---
$id: http://devicetree.org/schemas/net/adi,adin.yaml#
$schema: http://devicetree.org/meta-schemas/core.yaml#

title: Analog Devices ADIN1200/ADIN1300 PHY

maintainers:
  - Marcelo Schmitt <marcelo.schmitt@analog.com>

description: |
  Bindings for Analog Devices Industrial Ethernet PHYs

allOf:
  - $ref: ethernet-phy.yaml#

properties:
  adi,rx-internal-delay-ps:
    description: |
      RGMII RX Clock Delay used only when PHY operates in RGMII mode with
      internal delay (phy-mode is 'rgmii-id' or 'rgmii-rxid') in pico-seconds.
    enum: [ 1600, 1800, 2000, 2200, 2400 ]
    default: 2000

  adi,tx-internal-delay-ps:
    description: |
      RGMII TX Clock Delay used only when PHY operates in RGMII mode with
      internal delay (phy-mode is 'rgmii-id' or 'rgmii-txid') in pico-seconds.
    enum: [ 1600, 1800, 2000, 2200, 2400 ]
    default: 2000

  adi,fifo-depth-bits:
    description: |
      When operating in RMII mode, this option configures the FIFO depth.
    enum: [ 4, 8, 12, 16, 20, 24 ]
    default: 8

  adi,phy-output-clock:
    description: |
      Select clock output on GP_CLK pin. Two clocks are available:
      A 25MHz reference and a free-running 125MHz.
      The phy can alternatively automatically switch between the reference and
      the 125MHz clocks based on its internal state.
    $ref: /schemas/types.yaml#/definitions/string
    enum:
      - 25mhz-reference
      - 125mhz-free-running
      - adaptive-free-running

  adi,phy-output-reference-clock:
    description: Enable 25MHz reference clock output on CLK25_REF pin.
    type: boolean

unevaluatedProperties: false

examples:
  - |
    ethernet {
        #address-cells = <1>;
        #size-cells = <0>;

        phy-mode = "rgmii-id";

        ethernet-phy@0 {
            reg = <0>;

            adi,rx-internal-delay-ps = <1800>;
            adi,tx-internal-delay-ps = <2200>;
        };
    };
  - |
    ethernet {
        #address-cells = <1>;
        #size-cells = <0>;

        phy-mode = "rmii";

        ethernet-phy@1 {
            reg = <1>;

            adi,fifo-depth-bits = <16>;
        };
    };
```

## Documentation/devicetree/bindings/net/adi,adin1110.yaml
```yaml
# SPDX-License-Identifier: (GPL-2.0 OR BSD-2-Clause)
%YAML 1.2
---
$id: http://devicetree.org/schemas/net/adi,adin1110.yaml#
$schema: http://devicetree.org/meta-schemas/core.yaml#

title: ADI ADIN1110 MAC-PHY

maintainers:
  - Alexandru Tachici <alexandru.tachici@analog.com>

description: |
  The ADIN1110 is a low power single port 10BASE-T1L MAC-
  PHY designed for industrial Ethernet applications. It integrates
  an Ethernet PHY core with a MAC and all the associated analog
  circuitry, input and output clock buffering.

  The ADIN2111 is a low power, low complexity, two-Ethernet ports
  switch with integrated 10BASE-T1L PHYs and one serial peripheral
  interface (SPI) port. The device is designed for industrial Ethernet
  applications using low power constrained nodes and is compliant
  with the IEEE 802.3cg-2019 Ethernet standard for long reach
  10 Mbps single pair Ethernet (SPE).

  The device has a 4-wire SPI interface for communication
  between the MAC and host processor.

allOf:
  - $ref: ethernet-controller.yaml#
  - $ref: /schemas/spi/spi-peripheral-props.yaml#

properties:
  compatible:
    enum:
      - adi,adin1110
      - adi,adin2111

  reg:
    maxItems: 1

  adi,spi-crc:
    description: |
      Enable CRC8 checks on SPI read/writes.
    type: boolean

  interrupts:
    maxItems: 1

required:
  - compatible
  - reg
  - interrupts

unevaluatedProperties: false

examples:
  - |
    #include <dt-bindings/interrupt-controller/irq.h>

    spi {

        #address-cells = <1>;
        #size-cells = <0>;

        ethernet@0 {
            compatible = "adi,adin2111";
            reg = <0>;
            spi-max-frequency = <24500000>;

            adi,spi-crc;

            interrupt-parent = <&gpio>;
            interrupts = <25 IRQ_TYPE_LEVEL_LOW>;

            local-mac-address = [ 00 11 22 33 44 55 ];
        };
    };
```
