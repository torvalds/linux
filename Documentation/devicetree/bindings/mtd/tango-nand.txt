## Documentation/devicetree/bindings/mtd/tango-nand.txt
```
Sigma Designs Tango4 NAND Flash Controller (NFC)

Required properties:

- compatible: "sigma,smp8758-nand"
- reg: address/size of nfc_reg, nfc_mem, and pbus_reg
- dmas: reference to the DMA channel used by the controller
- dma-names: "nfc_sbox"
- clocks: reference to the system clock
- #address-cells: <1>
- #size-cells: <0>

Children nodes represent the available NAND chips.
See Documentation/devicetree/bindings/mtd/nand.txt for generic bindings.

Example:

	nandc: nand-controller@2c000 {
		compatible = "sigma,smp8758-nand";
		reg = <0x2c000 0x30 0x2d000 0x800 0x20000 0x1000>;
		dmas = <&dma0 3>;
		dma-names = "nfc_sbox";
		clocks = <&clkgen SYS_CLK>;
		#address-cells = <1>;
		#size-cells = <0>;

		nand@0 {
			reg = <0>; /* CS0 */
			nand-ecc-strength = <14>;
			nand-ecc-step-size = <1024>;
		};

		nand@1 {
			reg = <1>; /* CS1 */
			nand-ecc-strength = <14>;
			nand-ecc-step-size = <1024>;
		};
	};
```

## Documentation/devicetree/bindings/mtd/technologic,nand.yaml
```yaml
# SPDX-License-Identifier: GPL-2.0-only OR BSD-2-Clause
%YAML 1.2
---
$id: http://devicetree.org/schemas/mtd/technologic,nand.yaml#
$schema: http://devicetree.org/meta-schemas/core.yaml#

title: Technologic Systems NAND controller

maintainers:
  - Nikita Shubin <nikita.shubin@maquefel.me>

allOf:
  - $ref: nand-controller.yaml

properties:
  compatible:
    oneOf:
      - const: technologic,ts7200-nand
      - items:
          - enum:
              - technologic,ts7300-nand
              - technologic,ts7260-nand
              - technologic,ts7250-nand
          - const: technologic,ts7200-nand

  reg:
    maxItems: 1

required:
  - compatible
  - reg

unevaluatedProperties: false

examples:
  - |
    nand-controller@60000000 {
        compatible = "technologic,ts7200-nand";
        reg = <0x60000000 0x8000000>;
        #address-cells = <1>;
        #size-cells = <0>;
        nand@0 {
           reg = <0>;
        };
    };
```

## Documentation/devicetree/bindings/mtd/ti,am654-hbmc.txt
```
Bindings for HyperBus Memory Controller (HBMC) on TI's K3 family of SoCs

Required properties:
- compatible : "ti,am654-hbmc" for AM654 SoC
- reg : Two entries:
	First entry pointed to the register space of HBMC controller
	Second entry pointing to the memory map region dedicated for
	MMIO access to attached flash devices
- ranges : Address translation from offset within CS to allocated MMIO
	   space in SoC

Optional properties:
- mux-controls : phandle to the multiplexer that controls selection of
		 HBMC vs OSPI inside Flash SubSystem (FSS). Default is OSPI,
		 if property is absent.
		 See Documentation/devicetree/bindings/mux/reg-mux.yaml
		 for mmio-mux binding details

Example:

	system-controller@47000000 {
		compatible = "syscon", "simple-mfd";
		reg = <0x0 0x47000000 0x0 0x100>;
		#address-cells = <2>;
		#size-cells = <2>;
		ranges;

		hbmc_mux: multiplexer {
			compatible = "mmio-mux";
			#mux-control-cells = <1>;
			mux-reg-masks = <0x4 0x2>; /* 0: reg 0x4, bit 1 */
		};
	};

	hbmc: hyperbus@47034000 {
		compatible = "ti,am654-hbmc";
		reg = <0x0 0x47034000 0x0 0x100>,
			<0x5 0x00000000 0x1 0x0000000>;
		power-domains = <&k3_pds 55>;
		#address-cells = <2>;
		#size-cells = <1>;
		ranges = <0x0 0x0 0x5 0x00000000 0x4000000>, /* CS0 - 64MB */
			 <0x1 0x0 0x5 0x04000000 0x4000000>; /* CS1 - 64MB */
		mux-controls = <&hbmc_mux 0>;

		/* Slave flash node */
		flash@0,0 {
			compatible = "cypress,hyperflash", "cfi-flash";
			reg = <0x0 0x0 0x4000000>;
		};
	};
```

## Documentation/devicetree/bindings/mtd/ti,am654-hbmc.yaml
```yaml
# SPDX-License-Identifier: (GPL-2.0-only OR BSD-2-Clause)
%YAML 1.2
---
$id: http://devicetree.org/schemas/mtd/ti,am654-hbmc.yaml#
$schema: http://devicetree.org/meta-schemas/core.yaml#

title: HyperBus Memory Controller (HBMC) on TI's K3 family of SoCs

maintainers:
  - Vignesh Raghavendra <vigneshr@ti.com>

properties:
  compatible:
    const: ti,am654-hbmc

  reg:
    maxItems: 2

  power-domains: true
  '#address-cells': true
  '#size-cells': true
  ranges: true

  mux-controls:
    description: MMIO mux controller node to select b/w OSPI and HBMC.

  clocks:
    maxItems: 1

patternProperties:
  "^flash@[0-1],[0-9a-f]+$":
    type: object

required:
  - compatible
  - reg
  - ranges
  - clocks
  - '#address-cells'
  - '#size-cells'

additionalProperties: false

examples:
  - |
    bus {
        #address-cells = <2>;
        #size-cells = <2>;

        hbmc: memory-controller@47034000 {
            compatible = "ti,am654-hbmc";
            reg = <0x0 0x47034000 0x0 0x100>,
                  <0x5 0x00000000 0x1 0x0000000>;
            ranges = <0x0 0x0 0x5 0x00000000 0x4000000>, /* CS0 - 64MB */
                     <0x1 0x0 0x5 0x04000000 0x4000000>; /* CS1 - 64MB */
            clocks = <&k3_clks 102 0>;
            #address-cells = <2>;
            #size-cells = <1>;
            power-domains = <&k3_pds 55>;
            mux-controls = <&hbmc_mux 0>;

            flash@0,0 {
                compatible = "cypress,hyperflash", "cfi-flash";
                reg = <0x0 0x0 0x4000000>;
                #address-cells = <1>;
                #size-cells = <1>;
            };
        };
    };
```

## Documentation/devicetree/bindings/mtd/ti,davinci-nand.yaml
```yaml
# SPDX-License-Identifier: (GPL-2.0-only OR BSD-2-Clause)
%YAML 1.2
---
$id: http://devicetree.org/schemas/mtd/ti,davinci-nand.yaml#
$schema: http://devicetree.org/meta-schemas/core.yaml#

title: TI DaVinci NAND controller

maintainers:
  - Marcus Folkesson <marcus.folkesson@gmail.com>

allOf:
  - $ref: nand-controller.yaml

properties:
  compatible:
    enum:
      - ti,davinci-nand
      - ti,keystone-nand

  reg:
    items:
      - description: Access window.
      - description: AEMIF control registers.

  partitions:
    $ref: /schemas/mtd/partitions/partitions.yaml

  ti,davinci-chipselect:
    description:
      Number of chipselect. Indicate on the davinci_nand driver which
      chipselect is used for accessing the nand.
    $ref: /schemas/types.yaml#/definitions/uint32
    enum: [0, 1, 2, 3]

  ti,davinci-mask-ale:
    description:
      Mask for ALE. Needed for executing address phase. These offset will be
      added to the base address for the chip select space the NAND Flash
      device is connected to.
    $ref: /schemas/types.yaml#/definitions/uint32
    default: 0x08

  ti,davinci-mask-cle:
    description:
      Mask for CLE. Needed for executing command phase. These offset will be
      added to the base address for the chip select space the NAND Flash device
      is connected to.
    $ref: /schemas/types.yaml#/definitions/uint32
    default: 0x10

  ti,davinci-mask-chipsel:
    description:
      Mask for chipselect address. Needed to mask addresses for given
      chipselect.
    $ref: /schemas/types.yaml#/definitions/uint32
    default: 0

  ti,davinci-ecc-bits:
    description: Used ECC bits.
    enum: [1, 4]

  ti,davinci-ecc-mode:
    description: Operation mode of the NAND ECC mode.
    $ref: /schemas/types.yaml#/definitions/string
    enum: [none, soft, hw, on-die]
    deprecated: true

  ti,davinci-nand-buswidth:
    description: Bus width to the NAND chip.
    $ref: /schemas/types.yaml#/definitions/uint32
    enum: [8, 16]
    default: 8
    deprecated: true

  ti,davinci-nand-use-bbt:
    type: boolean
    description:
      Use flash based bad block table support. OOB identifier is saved in OOB
      area.
    deprecated: true

required:
  - compatible
  - reg
  - ti,davinci-chipselect

unevaluatedProperties: false

examples:
  - |
    bus {
      #address-cells = <2>;
      #size-cells = <1>;

      nand-controller@2000000,0 {
        compatible = "ti,davinci-nand";
        #address-cells = <1>;
        #size-cells = <0>;
        reg = <0 0x02000000 0x02000000>,
              <1 0x00000000 0x00008000>;

        ti,davinci-chipselect = <1>;
        ti,davinci-mask-ale = <0>;
        ti,davinci-mask-cle = <0>;
        ti,davinci-mask-chipsel = <0>;

        ti,davinci-nand-buswidth = <16>;
        ti,davinci-ecc-mode = "hw";
        ti,davinci-ecc-bits = <4>;
        ti,davinci-nand-use-bbt;

        partitions {
          compatible = "fixed-partitions";
          #address-cells = <1>;
          #size-cells = <1>;

          partition@0 {
            label = "u-boot env";
            reg = <0 0x020000>;
          };
        };
      };
    };
```

## Documentation/devicetree/bindings/mtd/ti,elm.yaml
```yaml
# SPDX-License-Identifier: (GPL-2.0-only OR BSD-2-Clause)
%YAML 1.2
---
$id: http://devicetree.org/schemas/mtd/ti,elm.yaml#
$schema: http://devicetree.org/meta-schemas/core.yaml#

title: Texas Instruments Error Location Module (ELM).

maintainers:
  - Roger Quadros <rogerq@kernel.org>

description:
  ELM module is used together with GPMC and NAND Flash to detect
  errors and the location of the error based on BCH algorithms
  so they can be corrected if possible.

properties:
  compatible:
    enum:
      - ti,am3352-elm
      - ti,am64-elm

  reg:
    maxItems: 1

  interrupts:
    maxItems: 1

  clocks:
    maxItems: 1
    description: Functional clock.

  clock-names:
    items:
      - const: fck

  power-domains:
    maxItems: 1

  ti,hwmods:
    description:
      Name of the HWMOD associated with ELM. This is for legacy
      platforms only.
    $ref: /schemas/types.yaml#/definitions/string
    deprecated: true

required:
  - compatible
  - reg
  - interrupts

allOf:
  - if:
      properties:
        compatible:
          contains:
            const: ti,am64-elm
    then:
      required:
        - clocks
        - clock-names
        - power-domains

additionalProperties: false

examples:
  - |
    elm: ecc@0 {
        compatible = "ti,am3352-elm";
        reg = <0x0 0x2000>;
        interrupts = <4>;
    };
```

## Documentation/devicetree/bindings/mtd/ti,gpmc-nand.yaml
```yaml
# SPDX-License-Identifier: (GPL-2.0-only OR BSD-2-Clause)
%YAML 1.2
---
$id: http://devicetree.org/schemas/mtd/ti,gpmc-nand.yaml#
$schema: http://devicetree.org/meta-schemas/core.yaml#

title: Texas Instruments GPMC NAND Flash controller.

maintainers:
  - Tony Lindgren <tony@atomide.com>
  - Roger Quadros <rogerq@kernel.org>

description:
  GPMC NAND controller/Flash is represented as a child of the
  GPMC controller node.

properties:
  compatible:
    items:
      - enum:
          - ti,am64-nand
          - ti,omap2-nand

  reg:
    maxItems: 1

  interrupts:
    items:
      - description: Interrupt for fifoevent
      - description: Interrupt for termcount

  "#address-cells": true

  "#size-cells": true

  ti,nand-ecc-opt:
    description: Desired ECC algorithm
    $ref: /schemas/types.yaml#/definitions/string
    enum: [sw, ham1, bch4, bch8, bch16]

  ti,nand-xfer-type:
    description: Data transfer method between controller and chip.
    $ref: /schemas/types.yaml#/definitions/string
    enum: [prefetch-polled, polled, prefetch-dma, prefetch-irq]
    default: prefetch-polled

  ti,elm-id:
    description:
      phandle to the ELM (Error Location Module).
    $ref: /schemas/types.yaml#/definitions/phandle

  nand-bus-width:
    description:
      Bus width to the NAND chip
    $ref: /schemas/types.yaml#/definitions/uint32
    enum: [8, 16]
    default: 8

  rb-gpios:
    description:
      GPIO connection to R/B signal from NAND chip
    maxItems: 1

patternProperties:
  "@[0-9a-f]+$":
    $ref: "/schemas/mtd/partitions/partition.yaml"

allOf:
  - $ref: "/schemas/memory-controllers/ti,gpmc-child.yaml"

required:
  - compatible
  - reg
  - ti,nand-ecc-opt

unevaluatedProperties: false

examples:
  - |
    #include <dt-bindings/interrupt-controller/arm-gic.h>
    #include <dt-bindings/gpio/gpio.h>

    gpmc: memory-controller@50000000 {
      compatible = "ti,am3352-gpmc";
      dmas = <&edma 52 0>;
      dma-names = "rxtx";
      clocks = <&l3s_gclk>;
      clock-names = "fck";
      reg = <0x50000000 0x2000>;
      interrupts = <GIC_SPI 100 IRQ_TYPE_LEVEL_HIGH>;
      gpmc,num-cs = <7>;
      gpmc,num-waitpins = <2>;
      #address-cells = <2>;
      #size-cells = <1>;
      interrupt-controller;
      #interrupt-cells = <2>;
      gpio-controller;
      #gpio-cells = <2>;

      ranges = <0 0 0x08000000 0x01000000>;   /* CS0 space. Min partition = 16MB */
      nand@0,0 {
        compatible = "ti,omap2-nand";
        reg = <0 0 4>;          /* device IO registers */
        interrupt-parent = <&gpmc>;
        interrupts = <0 IRQ_TYPE_NONE>, /* fifoevent */
                     <1 IRQ_TYPE_NONE>; /* termcount */
        ti,nand-xfer-type = "prefetch-dma";
        ti,nand-ecc-opt = "bch16";
        ti,elm-id = <&elm>;
        #address-cells = <1>;
        #size-cells = <1>;

        /* NAND generic properties */
        nand-bus-width = <8>;
        rb-gpios = <&gpmc 0 GPIO_ACTIVE_HIGH>;  /* gpmc_wait0 */

        /* GPMC properties*/
        gpmc,device-width = <1>;

        partition@0 {
          label = "NAND.SPL";
          reg = <0x00000000 0x00040000>;
        };
        partition@1 {
          label = "NAND.SPL.backup1";
          reg = <0x00040000 0x00040000>;
        };
      };
    };
```

## Documentation/devicetree/bindings/mtd/ti,gpmc-onenand.yaml
```yaml
# SPDX-License-Identifier: (GPL-2.0-only OR BSD-2-Clause)
%YAML 1.2
---
$id: http://devicetree.org/schemas/mtd/ti,gpmc-onenand.yaml#
$schema: http://devicetree.org/meta-schemas/core.yaml#

title: OneNAND over Texas Instruments GPMC bus.

maintainers:
  - Tony Lindgren <tony@atomide.com>
  - Roger Quadros <rogerq@kernel.org>

description:
  GPMC connected OneNAND (found on OMAP boards) are represented
  as child nodes of the GPMC controller.

properties:
  compatible:
    const: ti,omap2-onenand

  reg:
    items:
      - description: |
          Chip Select number, register offset and size of
          OneNAND register window.

  "#address-cells": true

  "#size-cells": true

  int-gpios:
    description: GPIO specifier for the INT pin.

patternProperties:
  "@[0-9a-f]+$":
    $ref: "/schemas/mtd/partitions/partition.yaml"

allOf:
  - $ref: "/schemas/memory-controllers/ti,gpmc-child.yaml"

required:
  - compatible
  - reg
  - "#address-cells"
  - "#size-cells"

unevaluatedProperties: false

examples:
  - |
    gpmc: memory-controller@6e000000 {
      compatible = "ti,omap3430-gpmc";
      reg = <0x6e000000 0x02d0>;
      interrupts = <20>;
      gpmc,num-cs = <8>;
      gpmc,num-waitpins = <4>;
      clocks = <&l3s_clkctrl>;
      clock-names = "fck";
      #address-cells = <2>;
      #size-cells = <1>;

      ranges = <0 0 0x01000000 0x01000000>,   /* 16 MB for OneNAND */
               <1 0 0x02000000 0x01000000>;   /* 16 MB for smc91c96 */

      onenand@0,0 {
        compatible = "ti,omap2-onenand";
        reg = <0 0 0x20000>;    /* CS0, offset 0, IO size 128K */
        #address-cells = <1>;
        #size-cells = <1>;

        partition@0 {
          label = "bootloader";
          reg = <0x00000000 0x00100000>;
        };

        partition@100000 {
          label = "config";
          reg = <0x00100000 0x002c0000>;
        };
      };
    };
```
