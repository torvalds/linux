## Documentation/devicetree/bindings/mtd/nvidia-tegra20-nand.txt
```
NVIDIA Tegra NAND Flash controller

Required properties:
- compatible: Must be one of:
  - "nvidia,tegra20-nand"
- reg: MMIO address range
- interrupts: interrupt output of the NFC controller
- clocks: Must contain an entry for each entry in clock-names.
  See ../clocks/clock-bindings.txt for details.
- clock-names: Must include the following entries:
  - nand
- resets: Must contain an entry for each entry in reset-names.
  See ../reset/reset.txt for details.
- reset-names: Must include the following entries:
  - nand

Optional children nodes:
Individual NAND chips are children of the NAND controller node. Currently
only one NAND chip supported.

Required children node properties:
- reg: An integer ranging from 1 to 6 representing the CS line to use.

Optional children node properties:
- nand-ecc-mode: String, operation mode of the NAND ecc mode. Currently only
		 "hw" is supported.
- nand-ecc-algo: string, algorithm of NAND ECC.
		 Supported values with "hw" ECC mode are: "rs", "bch".
- nand-bus-width : See nand-controller.yaml
- nand-on-flash-bbt: See nand-controller.yaml
- nand-ecc-strength: integer representing the number of bits to correct
		     per ECC step (always 512). Supported strength using HW ECC
		     modes are:
		     - RS: 4, 6, 8
		     - BCH: 4, 8, 14, 16
- nand-ecc-maximize: See nand-controller.yaml
- nand-is-boot-medium: Makes sure only ECC strengths supported by the boot ROM
		       are chosen.
- wp-gpios: GPIO specifier for the write protect pin.

Optional child node of NAND chip nodes:
Partitions: see mtd.yaml

  Example:
	nand-controller@70008000 {
		compatible = "nvidia,tegra20-nand";
		reg = <0x70008000 0x100>;
		interrupts = <GIC_SPI 24 IRQ_TYPE_LEVEL_HIGH>;
		clocks = <&tegra_car TEGRA20_CLK_NDFLASH>;
		clock-names = "nand";
		resets = <&tegra_car 13>;
		reset-names = "nand";

		nand@0 {
			reg = <0>;
			#address-cells = <1>;
			#size-cells = <1>;
			nand-bus-width = <8>;
			nand-on-flash-bbt;
			nand-ecc-algo = "bch";
			nand-ecc-strength = <8>;
			wp-gpios = <&gpio TEGRA_GPIO(S, 0) GPIO_ACTIVE_LOW>;
		};
	};
```

## Documentation/devicetree/bindings/mtd/nxp,lpc1773-spifi.yaml
```yaml
# SPDX-License-Identifier: (GPL-2.0-only OR BSD-2-Clause)
%YAML 1.2
---
$id: http://devicetree.org/schemas/mtd/nxp,lpc1773-spifi.yaml#
$schema: http://devicetree.org/meta-schemas/core.yaml#

title: NXP SPI Flash Interface (SPIFI)

description:
  NXP SPIFI is a specialized SPI interface for serial Flash devices.
  It supports one Flash device with 1-, 2- and 4-bits width in SPI
  mode 0 or 3. The controller operates in either command or memory
  mode. In memory mode the Flash is accessible from the CPU as
  normal memory.

maintainers:
  - Frank Li <Frank.Li@nxp.com>

properties:
  compatible:
    const: nxp,lpc1773-spifi

  reg:
    maxItems: 2

  reg-names:
    items:
      - const: spifi
      - const: flash

  interrupts:
    maxItems: 1

  clocks:
    maxItems: 2

  clock-names:
    items:
      - const: spifi
      - const: reg

  resets:
    maxItems: 1

  spi-cpol:
    enum: [0, 3]

required:
  - compatible
  - reg
  - reg-names
  - interrupts
  - clocks
  - clock-names

allOf:
  - $ref: /schemas/spi/spi-controller.yaml#

unevaluatedProperties: false

examples:
  - |
    #include <dt-bindings/clock/lpc18xx-ccu.h>

    spi@40003000 {
        compatible = "nxp,lpc1773-spifi";
        reg = <0x40003000 0x1000>, <0x14000000 0x4000000>;
        reg-names = "spifi", "flash";
        interrupts = <30>;
        clocks = <&ccu1 CLK_SPIFI>, <&ccu1 CLK_CPU_SPIFI>;
        clock-names = "spifi", "reg";
        resets = <&rgu 53>;
    };
```

## Documentation/devicetree/bindings/mtd/nxp-spifi.txt
```
* NXP SPI Flash Interface (SPIFI)

NXP SPIFI is a specialized SPI interface for serial Flash devices.
It supports one Flash device with 1-, 2- and 4-bits width in SPI
mode 0 or 3. The controller operates in either command or memory
mode. In memory mode the Flash is accessible from the CPU as
normal memory.

Required properties:
  - compatible : Should be "nxp,lpc1773-spifi"
  - reg : the first contains the register location and length,
          the second contains the memory mapping address and length
  - reg-names: Should contain the reg names "spifi" and "flash"
  - interrupts : Should contain the interrupt for the device
  - clocks : The clocks needed by the SPIFI controller
  - clock-names : Should contain the clock names "spifi" and "reg"

Optional properties:
 - resets : phandle + reset specifier

The SPI Flash must be a child of the SPIFI node and must have a
compatible property as specified in bindings/mtd/jedec,spi-nor.txt

Optionally it can also contain the following properties.
 - spi-cpol : Controller only supports mode 0 and 3 so either
              both spi-cpol and spi-cpha should be present or
              none of them
 - spi-cpha : See above
 - spi-rx-bus-width : Used to select how many pins that are used
                      for input on the controller

See bindings/spi/spi-bus.txt for more information.

Example:
spifi: spifi@40003000 {
	compatible = "nxp,lpc1773-spifi";
	reg = <0x40003000 0x1000>, <0x14000000 0x4000000>;
	reg-names = "spifi", "flash";
	interrupts = <30>;
	clocks = <&ccu1 CLK_SPIFI>, <&ccu1 CLK_CPU_SPIFI>;
	clock-names = "spifi", "reg";
	resets = <&rgu 53>;

	flash@0 {
		compatible = "jedec,spi-nor";
		spi-cpol;
		spi-cpha;
		spi-rx-bus-width = <4>;
		#address-cells = <1>;
		#size-cells = <1>;

		partition@0 {
			label = "data";
			reg = <0 0x200000>;
		};
	};
};
```

## Documentation/devicetree/bindings/mtd/orion-nand.txt
```
NAND support for Marvell Orion SoC platforms

Required properties:
- compatible : "marvell,orion-nand".
- reg : Base physical address of the NAND and length of memory mapped
	region

Optional properties:
- cle : Address line number connected to CLE. Default is 0
- ale : Address line number connected to ALE. Default is 1
- bank-width : Width in bytes of the device. Default is 1
- chip-delay : Chip dependent delay for transferring data from array to read
               registers in usecs

The device tree may optionally contain sub-nodes describing partitions of the
address space. See mtd.yaml for more detail.

Example:

nand@f4000000 {
	#address-cells = <1>;
	#size-cells = <1>;
	cle = <0>;
	ale = <1>;
	bank-width = <1>;
	chip-delay = <25>;
	compatible = "marvell,orion-nand";
	reg = <0xf4000000 0x400>;

	partition@0 {
		label = "u-boot";
		reg = <0x0000000 0x100000>;
		read-only;
	};

	partition@100000 {
		label = "uImage";
		reg = <0x0100000 0x200000>;
	};

	partition@300000 {
		label = "dtb";
		reg = <0x0300000 0x100000>;
	};

	partition@400000 {
		label = "root";
		reg = <0x0400000 0x7d00000>;
	};
};
```

## Documentation/devicetree/bindings/mtd/oxnas-nand.txt
```
* Oxford Semiconductor OXNAS NAND Controller

Please refer to nand.txt for generic information regarding MTD NAND bindings.

Required properties:
 - compatible: "oxsemi,ox820-nand"
 - reg: Base address and length for NAND mapped memory.

Optional Properties:
 - clocks: phandle to the NAND gate clock if needed.
 - resets: phandle to the NAND reset control if needed.

Example:

nandc: nand-controller@41000000 {
	compatible = "oxsemi,ox820-nand";
	reg = <0x41000000 0x100000>;
	clocks = <&stdclk CLK_820_NAND>;
	resets = <&reset RESET_NAND>;
	#address-cells = <1>;
	#size-cells = <0>;

	nand@0 {
		reg = <0>;
		#address-cells = <1>;
		#size-cells = <1>;
		nand-ecc-mode = "soft";
		nand-ecc-algo = "hamming";

		partition@0 {
			label = "boot";
			reg = <0x00000000 0x00e00000>;
			read-only;
		};

		partition@e00000 {
			label = "ubi";
			reg = <0x00e00000 0x07200000>;
		};
	};
};
```

## Documentation/devicetree/bindings/mtd/partition.txt
```
Flash partitions in device tree
===============================

Flash devices can be partitioned into one or more functional ranges (e.g. "boot
code", "nvram", "kernel").

Different devices may be partitioned in a different ways. Some may use a fixed
flash layout set at production time. Some may use on-flash table that describes
the geometry and naming/purpose of each functional region. It is also possible
to see these methods mixed.

To assist system software in locating partitions, we allow describing which
method is used for a given flash device. To describe the method there should be
a subnode of the flash device that is named 'partitions'. It must have a
'compatible' property, which is used to identify the method to use.

When a single partition is represented with a DT node (it depends on a used
format) it may also be described using above rules ('compatible' and optionally
some extra properties / subnodes). It allows describing more complex,
hierarchical (multi-level) layouts and should be used if there is some
significant relation between partitions or some partition internally uses
another partitioning method.

Available bindings are listed in the "partitions" subdirectory.


Deprecated: partitions defined in flash node
============================================

For backwards compatibility partitions as direct subnodes of the flash device are
supported. This use is discouraged.
NOTE: also for backwards compatibility, direct subnodes that have a compatible
string are not considered partitions, as they may be used for other bindings.
```

## Documentation/devicetree/bindings/mtd/partitions/arm,arm-firmware-suite.txt
```
ARM AFS - ARM Firmware Suite Partitions
=======================================

The ARM Firmware Suite is a flash partitioning system found on the
ARM reference designs: Integrator AP, Integrator CP, Versatile AB,
Versatile PB, the RealView family, Versatile Express and Juno.

Required properties:
- compatible : (required) must be "arm,arm-firmware-suite"

Example:

flash@0 {
	partitions {
		compatible = "arm,arm-firmware-suite";
	};
};
```

## Documentation/devicetree/bindings/mtd/partitions/arm,arm-firmware-suite.yaml
```yaml
# SPDX-License-Identifier: GPL-2.0-only OR BSD-2-Clause
%YAML 1.2
---
$id: http://devicetree.org/schemas/mtd/partitions/arm,arm-firmware-suite.yaml#
$schema: http://devicetree.org/meta-schemas/core.yaml#

title: ARM Firmware Suite (AFS) Partitions

maintainers:
  - Linus Walleij <linus.walleij@linaro.org>

select: false

description: |
  The ARM Firmware Suite is a flash partitioning system found on the
  ARM reference designs: Integrator AP, Integrator CP, Versatile AB,
  Versatile PB, the RealView family, Versatile Express and Juno.

properties:
  compatible:
    const: arm,arm-firmware-suite

additionalProperties: false

examples:
  - |
    partitions {
        compatible = "arm,arm-firmware-suite";
    };
...
```

## Documentation/devicetree/bindings/mtd/partitions/binman.yaml
```yaml
# SPDX-License-Identifier: GPL-2.0-only OR BSD-2-Clause
%YAML 1.2
---
$id: http://devicetree.org/schemas/mtd/partitions/binman.yaml#
$schema: http://devicetree.org/meta-schemas/core.yaml#

title: Binman entries

description: |
  This corresponds to a binman 'entry'. It is a single partition which holds
  data of a defined type.

  Binman uses the type to indicate what data file / type to place in the
  partition. There are quite a number of binman-specific entry types, such as
  section, fill and files, to be added later.

maintainers:
  - Simon Glass <sjg@chromium.org>

allOf:
  - $ref: /schemas/mtd/partitions/partition.yaml#

properties:
  compatible:
    enum:
      - u-boot       # u-boot.bin from U-Boot project
      - tfa-bl31     # bl31.bin or bl31.elf from TF-A project

required:
  - compatible

unevaluatedProperties: false

examples:
  - |
    partitions {
        compatible = "fixed-partitions";
        #address-cells = <1>;
        #size-cells = <1>;

        partition@100000 {
            compatible = "u-boot";
            reg = <0x100000 0xf00000>;
            align-size = <0x1000>;
            align-end = <0x10000>;
        };

        partition@200000 {
            compatible = "tfa-bl31";
            reg = <0x200000 0x100000>;
            align = <0x4000>;
        };
    };
```

## Documentation/devicetree/bindings/mtd/partitions/brcm,bcm4908-partitions.yaml
```yaml
# SPDX-License-Identifier: GPL-2.0-only OR BSD-2-Clause
%YAML 1.2
---
$id: http://devicetree.org/schemas/mtd/partitions/brcm,bcm4908-partitions.yaml#
$schema: http://devicetree.org/meta-schemas/core.yaml#

title: Broadcom BCM4908 partitioning

description: |
  Broadcom BCM4908 CFE bootloader supports two firmware partitions. One is used
  for regular booting, the other is treated as fallback.

  This binding allows defining all fixed partitions and marking those containing
  firmware. System can use that information e.g. for booting or flashing
  purposes.

maintainers:
  - Rafał Miłecki <rafal@milecki.pl>

select: false

properties:
  compatible:
    const: brcm,bcm4908-partitions

  "#address-cells":
    enum: [ 1, 2 ]

  "#size-cells":
    enum: [ 1, 2 ]

patternProperties:
  "^partition@[0-9a-f]+$":
    $ref: partition.yaml#
    properties:
      compatible:
        const: brcm,bcm4908-firmware
    unevaluatedProperties: false

required:
  - "#address-cells"
  - "#size-cells"

additionalProperties: false

examples:
  - |
    partitions {
        compatible = "brcm,bcm4908-partitions";
        #address-cells = <1>;
        #size-cells = <1>;

        partition@0 {
            label = "cferom";
            reg = <0x0 0x100000>;
        };

        partition@100000 {
            compatible = "brcm,bcm4908-firmware";
            reg = <0x100000 0xf00000>;
        };

        partition@1000000 {
            compatible = "brcm,bcm4908-firmware";
            reg = <0x1000000 0xf00000>;
        };

        partition@1f00000 {
            label = "calibration";
            reg = <0x1f00000 0x100000>;
        };
    };
```

## Documentation/devicetree/bindings/mtd/partitions/brcm,bcm947xx-cfe-partitions.yaml
```yaml
# SPDX-License-Identifier: GPL-2.0-only OR BSD-2-Clause
%YAML 1.2
---
$id: http://devicetree.org/schemas/mtd/partitions/brcm,bcm947xx-cfe-partitions.yaml#
$schema: http://devicetree.org/meta-schemas/core.yaml#

title: Broadcom BCM47xx Partitions

description: |
  Broadcom is one of hardware manufacturers providing SoCs (BCM47xx) used in
  home routers. Their BCM947xx boards using CFE bootloader have several
  partitions without any on-flash partition table. On some devices their sizes
  and/or meanings can also vary so fixed partitioning can't be used.

  Discovering partitions on these devices is possible thanks to having a special
  header and/or magic signature at the beginning of each of them. They are also
  block aligned which is important for determinig a size.

  Most of partitions use ASCII text based magic for determining a type. More
  complex partitions (like TRX with its HDR0 magic) may include extra header
  containing some details, including a length.

  A list of supported partitions includes:
  1) Bootloader with Broadcom's CFE (Common Firmware Environment)
  2) NVRAM with configuration/calibration data
  3) Device manufacturer's data with some default values (e.g. SSIDs)
  4) TRX firmware container which can hold up to 4 subpartitions
  5) Backup TRX firmware used after failed upgrade

  As mentioned earlier, role of some partitions may depend on extra
  configuration. For example both: main firmware and backup firmware use the
  same TRX format with the same header. To distinguish currently used firmware a
  CFE's environment variable "bootpartition" is used.

maintainers:
  - Rafał Miłecki <rafal@milecki.pl>

select: false

properties:
  compatible:
    const: brcm,bcm947xx-cfe-partitions

additionalProperties: false

examples:
  - |
    partitions {
        compatible = "brcm,bcm947xx-cfe-partitions";
    };
```
