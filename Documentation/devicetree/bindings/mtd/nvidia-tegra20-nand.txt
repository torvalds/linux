## Documentation/devicetree/bindings/mtd/partitions/partition.yaml
```yaml
# SPDX-License-Identifier: GPL-2.0-only OR BSD-2-Clause
%YAML 1.2
---
$id: http://devicetree.org/schemas/mtd/partitions/partition.yaml#
$schema: http://devicetree.org/meta-schemas/core.yaml#

title: Partition

description: |
  This binding describes a single flash partition. Each partition must have its
  relative offset and size specified. Depending on partition function extra
  properties can be used.

  A partition may be dynamically allocated by a specific parser at runtime.
  In this specific case, a specific suffix is required to the node name.
  Everything after 'partition-' will be used as the partition name to compare
  with the one dynamically allocated by the specific parser.
  If the partition contains invalid char a label can be provided that will
  be used instead of the node name to make the comparison.
  This is used to assign an OF node to the dynamiccally allocated partition
  so that subsystem like NVMEM can provide an OF node and declare NVMEM cells.
  The OF node will be assigned only if the partition label declared match the
  one assigned by the parser at runtime.

maintainers:
  - Rafał Miłecki <rafal@milecki.pl>

properties:
  reg:
    description: partition's offset and size within the flash
    maxItems: 1

  label:
    description: The label / name for this partition. If omitted, the label
      is taken from the node name (excluding the unit address).

  read-only:
    description: This parameter, if present, is a hint that this partition
      should only be mounted read-only. This is usually used for flash
      partitions containing early-boot firmware images or data which should
      not be clobbered.
    type: boolean

  lock:
    description: Do not unlock the partition at initialization time (not
      supported on all devices)
    type: boolean

  slc-mode:
    description: This parameter, if present, allows one to emulate SLC mode
      on a partition attached to an MLC NAND thus making this partition
      immune to paired-pages corruptions
    type: boolean

  linux,rootfs:
    description: Marks partition that contains root filesystem to mount and boot
      user space from
    type: boolean

  align:
    $ref: /schemas/types.yaml#/definitions/uint32
    minimum: 2
    maximum: 0x80000000
    multipleOf: 2
    description:
      This sets the alignment of the entry in bytes.

      The entry offset is adjusted so that the entry starts on an aligned
      boundary within the containing section or image. For example ‘align =
      <16>’ means that the entry will start on a 16-byte boundary. This may
      mean that padding is added before the entry. The padding is part of
      the containing section but is not included in the entry, meaning that
      an empty space may be created before the entry starts. Alignment
      must be a power of 2. If ‘align’ is not provided, no alignment is
      performed.

  align-size:
    $ref: /schemas/types.yaml#/definitions/uint32
    minimum: 2
    maximum: 0x80000000
    multipleOf: 2
    description:
      This sets the alignment of the entry size in bytes. It must be a power
      of 2.

      For example, to ensure that the size of an entry is a multiple of 64
      bytes, set this to 64. While this does not affect the content of the
      entry itself (the padding is performed only when its parent section is
      assembled), the end result is that the entry ends with the padding
      bytes, so may grow. If ‘align-size’ is not provided, no alignment is
      performed.

  align-end:
    $ref: /schemas/types.yaml#/definitions/uint32
    minimum: 2
    maximum: 0x80000000
    multipleOf: 2
    description:
      This sets the alignment (in bytes) of the end of an entry with respect
      to the containing section. It must be a power of 2.

      Some entries require that they end on an alignment boundary,
      regardless of where they start. This does not move the start of the
      entry, so the content of the entry will still start at the beginning.
      But there may be padding at the end. While this does not affect the
      content of the entry itself (the padding is performed only when its
      parent section is assembled), the end result is that the entry ends
      with the padding bytes, so may grow. If ‘align-end’ is not provided,
      no alignment is performed.

if:
  not:
    required: [ reg ]
then:
  properties:
    $nodename:
      pattern: '^partition-.*$'

# This is a generic file other binding inherit from and extend
additionalProperties: true

examples:
  - |
    partitions {
        compatible = "fixed-partitions";
        #address-cells = <1>;
        #size-cells = <1>;

        partition@100000 {
            compatible = "u-boot";
            reg = <0x100000 0xf00000>;
            align-size = <0x1000>;
            align-end = <0x10000>;
        };

        partition@200000 {
            compatible = "tfa-bl31";
            reg = <0x200000 0x100000>;
            align = <0x4000>;
        };
    };
```

## Documentation/devicetree/bindings/mtd/partitions/partitions.yaml
```yaml
# SPDX-License-Identifier: GPL-2.0-only OR BSD-2-Clause
%YAML 1.2
---
$id: http://devicetree.org/schemas/mtd/partitions/partitions.yaml#
$schema: http://devicetree.org/meta-schemas/core.yaml#

title: Partitions

description: |
  This binding is generic and describes the content of the partitions container
  node. All partition parsers must be referenced here.

maintainers:
  - Miquel Raynal <miquel.raynal@bootlin.com>

oneOf:
  - $ref: arm,arm-firmware-suite.yaml
  - $ref: brcm,bcm4908-partitions.yaml
  - $ref: brcm,bcm947xx-cfe-partitions.yaml
  - $ref: fixed-partitions.yaml
  - $ref: linksys,ns-partitions.yaml
  - $ref: qcom,smem-part.yaml
  - $ref: redboot-fis.yaml
  - $ref: tplink,safeloader-partitions.yaml

properties:
  compatible: true

  '#address-cells':
    enum: [1, 2]

  '#size-cells':
    enum: [1, 2]

patternProperties:
  "^partition(-.+|@[0-9a-f]+)$":
    $ref: partition.yaml

required:
  - compatible

unevaluatedProperties: false
```

## Documentation/devicetree/bindings/mtd/partitions/qcom,smem-part.yaml
```yaml
# SPDX-License-Identifier: (GPL-2.0-only OR BSD-2-Clause)
%YAML 1.2
---
$id: http://devicetree.org/schemas/mtd/partitions/qcom,smem-part.yaml#
$schema: http://devicetree.org/meta-schemas/core.yaml#

title: Qualcomm SMEM NAND flash partition parser

maintainers:
  - Manivannan Sadhasivam <manivannan.sadhasivam@linaro.org>

description: |
  The Qualcomm SoCs supporting the NAND controller interface features a Shared
  Memory (SMEM) based partition table scheme. The maximum partitions supported
  varies between partition table revisions. V3 supports maximum 16 partitions
  and V4 supports 48 partitions.

select: false

properties:
  compatible:
    const: qcom,smem-part

patternProperties:
  "^partition-[0-9a-z]+$":
    $ref: nvmem-cells.yaml

required:
  - compatible

additionalProperties: false

examples:
  - |
    flash {
        partitions {
            compatible = "qcom,smem-part";
        };
    };

  - |
    /* Example declaring dynamic partition */
    flash {
        partitions {
            compatible = "qcom,smem-part";

            partition-art {
                compatible = "nvmem-cells";
                #address-cells = <1>;
                #size-cells = <1>;
                label = "0:art";

                macaddr_art_0: macaddr@0 {
                    reg = <0x0 0x6>;
                };

                macaddr_art_6: macaddr@6 {
                    reg = <0x6 0x6>;
                };
            };
        };
    };
```

## Documentation/devicetree/bindings/mtd/partitions/redboot-fis.txt
```
RedBoot FLASH Image System (FIS) Partitions
===========================================

The FLASH Image System (FIS) directory is a flash description
format closely associated with the RedBoot boot loader.

It uses one single flash eraseblock in the flash to store an index of
all images in the flash.

This block size will vary depending on flash but is typically
32 KB in size.

Required properties:
- compatible : (required) must be "redboot-fis"
- fis-index-block : (required) a index to the eraseblock containing
  the FIS directory on this device. On a flash memory with 32KB
  eraseblocks, 0 means the first eraseblock at 0x00000000, 1 means the
  second eraseblock at 0x00008000 and so on.

Example:

flash@0 {
	partitions {
		compatible = "redboot-fis";
		fis-index-block = <0>;
	};
};
```

## Documentation/devicetree/bindings/mtd/partitions/redboot-fis.yaml
```yaml
# SPDX-License-Identifier: (GPL-2.0-only OR BSD-2-Clause)
%YAML 1.2
---
$id: http://devicetree.org/schemas/mtd/partitions/redboot-fis.yaml#
$schema: http://devicetree.org/meta-schemas/core.yaml#

title: RedBoot FLASH Image System (FIS) Partitions

description: The FLASH Image System (FIS) directory is a flash description
    format closely associated with the RedBoot boot loader.
    It uses one single flash eraseblock in the flash to store an index of
    all images in the flash.
    This block size will vary depending on flash but is typically
    32 KB in size.

maintainers:
  - Linus Walleij <linus.walleij@linaro.org>

properties:
  compatible:
    const: redboot-fis

  fis-index-block:
    $ref: /schemas/types.yaml#/definitions/uint32
    description: a index to the eraseblock containing the FIS directory on this
      device. On a flash memory with 32KB eraseblocks, 0 means the first
      eraseblock at 0x00000000, 1 means the second eraseblock at 0x00008000 and so on.

required:
  - compatible
  - fis-index-block

additionalProperties: false

examples:
  - |
    flash {
      partitions {
        compatible = "redboot-fis";
        fis-index-block = <0>;
      };
    };
```

## Documentation/devicetree/bindings/mtd/partitions/seama.yaml
```yaml
# SPDX-License-Identifier: (GPL-2.0-only OR BSD-2-Clause)
%YAML 1.2
---
$id: http://devicetree.org/schemas/mtd/partitions/seama.yaml#
$schema: http://devicetree.org/meta-schemas/core.yaml#

title: Seattle Image Partitions

description: The SEAttle iMAge (SEAMA) partition is a type of partition
  used for NAND flash devices. This type of flash image is found in some
  D-Link routers such as DIR-645, DIR-842, DIR-859, DIR-860L, DIR-885L,
  DIR890L and DCH-M225, as well as in WD and NEC routers on the ath79
  (MIPS), Broadcom BCM53xx, and RAMIPS platforms. This partition type
  does not have children defined in the device tree, they need to be
  detected by software.

allOf:
  - $ref: partition.yaml#

maintainers:
  - Linus Walleij <linus.walleij@linaro.org>

properties:
  compatible:
    const: seama

required:
  - compatible

unevaluatedProperties: false

examples:
  - |
    partitions {
        compatible = "fixed-partitions";
        #address-cells = <1>;
        #size-cells = <1>;

        partition@0 {
            compatible = "seama";
            reg = <0x0 0x800000>;
            label = "firmware";
        };
    };
```

## Documentation/devicetree/bindings/mtd/partitions/simple-partition.yaml
```yaml
# SPDX-License-Identifier: GPL-2.0-only OR BSD-2-Clause
%YAML 1.2
---
$id: http://devicetree.org/schemas/mtd/partitions/simple-partition.yaml#
$schema: http://devicetree.org/meta-schemas/core.yaml#

title: Simple partition types

description:
  Simple partition types which only define a "compatible" value and no custom
  properties.

maintainers:
  - Rafał Miłecki <rafal@milecki.pl>
  - Simon Glass <sjg@chromium.org>

allOf:
  - $ref: partition.yaml#

properties:
  compatible:
    oneOf:
      - const: brcm,bcm4908-firmware
        description:
          Broadcom BCM4908 CFE bootloader firmware partition

      - const: brcm,bcm963xx-imagetag
        description:
          The BCM963XX ImageTag is a simple firmware header describing the
          offsets and sizes of the rootfs and kernel parts contained in the
          firmware.

      - const: seama
        description:
          The SEAttle iMAge (SEAMA) partition is a type of partition used for
          NAND flash devices. This type of flash image is found in some D-Link
          routers such as DIR-645, DIR-842, DIR-859, DIR-860L, DIR-885L, DIR890L
          and DCH-M225, as well as in WD and NEC routers on the ath79 (MIPS),
          Broadcom BCM53xx, and RAMIPS platforms. This partition type does not
          have children defined in the device tree, they need to be detected by
          software.

      - const: u-boot
        description: >
          u-boot.bin from U-Boot project.

          This corresponds to a binman 'entry'. It is a single partition which holds
          data of a defined type.

          Binman uses the type to indicate what data file / type to place in the
          partition. There are quite a number of binman-specific entry types, such as
          section, fill and files, to be added later.

      - const: tfa-bl31
        description: >
          bl31.bin or bl31.elf from TF-A project

          This corresponds to a binman 'entry'. It is a single partition which holds
          data of a defined type.

unevaluatedProperties: false
```
