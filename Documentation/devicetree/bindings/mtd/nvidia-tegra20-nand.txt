## Documentation/devicetree/bindings/mtd/partitions/brcm,bcm963xx-cfe-nor-partitions.txt
```
Broadcom BCM963XX CFE Loader NOR Flash Partitions
=================================================

Most Broadcom BCM63XX SoC based devices follow the Broadcom reference layout for
NOR. The first erase block used for the CFE bootloader, the last for an
NVRAM partition, and the remainder in-between for one to two firmware partitions
at fixed offsets. A valid firmware partition is identified by the ImageTag
header found at beginning of the second erase block, containing the rootfs and
kernel offsets and sizes within the firmware partition.

Required properties:
- compatible : must be "brcm,bcm963xx-cfe-nor-partitions"

Example:

flash@1fc00000 {
	compatible = "cfi-flash";
	reg = <0x1fc00000 0x400000>;
	bank-width = <2>;

	partitions {
		compatible = "brcm,bcm963xx-cfe-nor-partitions";
	};
};
```

## Documentation/devicetree/bindings/mtd/partitions/brcm,bcm963xx-imagetag.txt
```
Broadcom BCM963XX ImageTag Partition Container
==============================================

Some Broadcom BCM63XX SoC based devices contain additional, non discoverable
partitions or non standard bootloader partition sizes. For these a mixed layout
needs to be used with an explicit firmware partition.

The BCM963XX ImageTag is a simple firmware header describing the offsets and
sizes of the rootfs and kernel parts contained in the firmware.

Required properties:
- compatible : must be "brcm,bcm963xx-imagetag"

Example:

flash@1e000000 {
	compatible = "cfi-flash";
	reg = <0x1e000000 0x2000000>;
	bank-width = <2>;

	partitions {
		compatible = "fixed-partitions";
		#address-cells = <1>;
		#size-cells = <1>;

		cfe@0 {
			reg = <0x0 0x10000>;
			read-only;
		};

		firmware@10000 {
			reg = <0x10000 0x7d0000>;
			compatible = "brcm,bcm963xx-imagetag";
		};

		caldata@7e0000 {
			reg = <0x7e0000 0x10000>;
			read-only;
		};

		nvram@7f0000 {
			reg = <0x7f0000 0x10000>;
		};
	};
};
```

## Documentation/devicetree/bindings/mtd/partitions/brcm,trx.txt
```
Broadcom TRX Container Partition
================================

TRX is Broadcom's official firmware format for the BCM947xx boards. It's used by
most of the vendors building devices based on Broadcom's BCM47xx SoCs and is
supported by the CFE bootloader.

Design of the TRX format is very minimalistic. Its header contains
identification fields, CRC32 checksum and the locations of embedded partitions.
Its purpose is to store a few partitions in a format that can be distributed as
a standalone file and written in a flash memory.

Container can hold up to 4 partitions. The first partition has to contain a
device executable binary (e.g. a kernel) as it's what the CFE bootloader starts
executing. Other partitions can be used for operating system purposes. This is
useful for systems that keep kernel and rootfs separated.

TRX doesn't enforce any strict partition boundaries or size limits. All
partitions have to be less than the 4GiB max size limit.

There are two existing/known TRX variants:
1) v1 which contains 3 partitions
2) v2 which contains 4 partitions

There aren't separated compatible bindings for them as version can be trivialy
detected by a software parsing TRX header.

Required properties:
- compatible : (required) must be "brcm,trx"

Optional properties:

- brcm,trx-magic: TRX magic, if it is different from the default magic
		  0x30524448 as a u32.

Example:

flash@0 {
	partitions {
		compatible = "brcm,trx";
	};
};
```

## Documentation/devicetree/bindings/mtd/partitions/fixed-partitions.yaml
```yaml
# SPDX-License-Identifier: GPL-2.0-only OR BSD-2-Clause
%YAML 1.2
---
$id: http://devicetree.org/schemas/mtd/partitions/fixed-partitions.yaml#
$schema: http://devicetree.org/meta-schemas/core.yaml#

title: Fixed partitions

description: |
  This binding can be used on platforms which have strong conventions about
  which portions of a flash are used for what purposes, but which don't use an
  on-flash partition table such as RedBoot.

  The partition table should be a node named "partitions". Partitions are then
  defined as subnodes.

maintainers:
  - Rafał Miłecki <rafal@milecki.pl>

properties:
  compatible:
    oneOf:
      - const: fixed-partitions
      - items:
          - const: sercomm,sc-partitions
          - const: fixed-partitions

  "#address-cells": true

  "#size-cells": true

patternProperties:
  "@[0-9a-f]+$":
    $ref: partition.yaml#

    properties:
      sercomm,scpart-id:
        description: Partition id in Sercomm partition map. Mtd parser
          uses this id to find a record in the partition map containing
          offset and size of the current partition. The values from
          partition map overrides partition offset and size defined in
          reg property of the dts. Frequently these values are the same,
          but may differ if device has bad eraseblocks on a flash.
        $ref: /schemas/types.yaml#/definitions/uint32

required:
  - "#address-cells"
  - "#size-cells"

additionalProperties: true

examples:
  - |
    partitions {
        compatible = "fixed-partitions";
        #address-cells = <1>;
        #size-cells = <1>;

        partition@0 {
            label = "u-boot";
            reg = <0x0000000 0x100000>;
            read-only;
        };

        uimage@100000 {
            reg = <0x0100000 0x200000>;
        };
    };

  - |
    partitions {
        compatible = "fixed-partitions";
        #address-cells = <1>;
        #size-cells = <2>;

        /* a 4 GiB partition */
        partition@0 {
            label = "filesystem";
            reg = <0x00000000 0x1 0x00000000>;
            linux,rootfs;
        };
    };

  - |
    partitions {
        compatible = "fixed-partitions";
        #address-cells = <2>;
        #size-cells = <2>;

        /* an 8 GiB partition */
        partition@0 {
            label = "filesystem #1";
            reg = <0x0 0x00000000 0x2 0x00000000>;
        };

        /* a 4 GiB partition */
        partition@200000000 {
            label = "filesystem #2";
            reg = <0x2 0x00000000 0x1 0x00000000>;
        };
    };

  - |
    partitions {
        compatible = "fixed-partitions";
        #address-cells = <1>;
        #size-cells = <1>;

        partition@0 {
            label = "bootloader";
            reg = <0x000000 0x100000>;
            read-only;
        };

        firmware@100000 {
            compatible = "brcm,trx";
            label = "firmware";
            reg = <0x100000 0xe00000>;
        };

        calibration@f00000 {
            compatible = "fixed-partitions";
            label = "calibration";
            reg = <0xf00000 0x100000>;
            ranges = <0 0xf00000 0x100000>;
            #address-cells = <1>;
            #size-cells = <1>;

            partition@0 {
                label = "wifi0";
                reg = <0x000000 0x080000>;
            };

            partition@80000 {
                label = "wifi1";
                reg = <0x080000 0x080000>;
            };
        };
    };

  - |
    partitions {
        compatible = "sercomm,sc-partitions", "fixed-partitions";
        #address-cells = <1>;
        #size-cells = <1>;

        partition@0 {
            label = "u-boot";
            reg = <0x0 0x100000>;
            sercomm,scpart-id = <0>;
            read-only;
        };

        partition@100000 {
            label = "dynamic partition map";
            reg = <0x100000 0x100000>;
            sercomm,scpart-id = <1>;
        };

        partition@200000 {
            label = "Factory";
            reg = <0x200000 0x100000>;
            sercomm,scpart-id = <2>;
            read-only;
        };
    };
```

## Documentation/devicetree/bindings/mtd/partitions/linksys,ns-partitions.yaml
```yaml
# SPDX-License-Identifier: GPL-2.0-only OR BSD-2-Clause
%YAML 1.2
---
$id: http://devicetree.org/schemas/mtd/partitions/linksys,ns-partitions.yaml#
$schema: http://devicetree.org/meta-schemas/core.yaml#

title: Linksys Northstar partitioning

description: |
  Linksys devices based on Broadcom Northstar architecture often use two
  firmware partitions. One is used for regular booting, the other is treated as
  fallback.

  This binding allows defining all fixed partitions and marking those containing
  firmware. System can use that information e.g. for booting or flashing
  purposes.

maintainers:
  - Rafał Miłecki <rafal@milecki.pl>

properties:
  compatible:
    const: linksys,ns-partitions

  "#address-cells":
    enum: [ 1, 2 ]

  "#size-cells":
    enum: [ 1, 2 ]

patternProperties:
  "^partition@[0-9a-f]+$":
    $ref: "partition.yaml#"
    properties:
      compatible:
        items:
          - const: linksys,ns-firmware
          - const: brcm,trx
    unevaluatedProperties: false

required:
  - "#address-cells"
  - "#size-cells"

additionalProperties: false

examples:
  - |
    partitions {
        compatible = "linksys,ns-partitions";
        #address-cells = <1>;
        #size-cells = <1>;

        partition@0 {
            label = "boot";
            reg = <0x0 0x100000>;
            read-only;
        };

        partition@100000 {
            label = "nvram";
            reg = <0x100000 0x100000>;
        };

        partition@200000 {
            compatible = "linksys,ns-firmware", "brcm,trx";
            reg = <0x200000 0xf00000>;
        };

        partition@1100000 {
            compatible = "linksys,ns-firmware", "brcm,trx";
            reg = <0x1100000 0xf00000>;
        };
    };
```

## Documentation/devicetree/bindings/mtd/partitions/linux,ubi.yaml
```yaml
# SPDX-License-Identifier: GPL-2.0-only OR BSD-2-Clause
%YAML 1.2
---
$id: http://devicetree.org/schemas/mtd/partitions/linux,ubi.yaml#
$schema: http://devicetree.org/meta-schemas/core.yaml#

title: Unsorted Block Images

description: |
  UBI ("Unsorted Block Images") is a volume management system for raw
  flash devices which manages multiple logical volumes on a single
  physical flash device and spreads the I/O load (i.e wear-leveling)
  across the whole flash chip.

maintainers:
  - Daniel Golle <daniel@makrotopia.org>

allOf:
  - $ref: partition.yaml#

properties:
  compatible:
    const: linux,ubi

  volumes:
    type: object
    description: UBI Volumes

    patternProperties:
      "^ubi-volume-.*$":
        $ref: /schemas/mtd/partitions/ubi-volume.yaml#

    unevaluatedProperties: false

required:
  - compatible

unevaluatedProperties: false

examples:
  - |
    partitions {
        compatible = "fixed-partitions";
        #address-cells = <1>;
        #size-cells = <1>;

        partition@0 {
            reg = <0x0 0x100000>;
            label = "bootloader";
            read-only;
        };

        partition@100000 {
            reg = <0x100000 0x1ff00000>;
            label = "ubi";
            compatible = "linux,ubi";

            volumes {
                ubi-volume-caldata {
                    volid = <2>;
                    volname = "rf";

                    nvmem-layout {
                        compatible = "fixed-layout";
                        #address-cells = <1>;
                        #size-cells = <1>;

                        eeprom@0 {
                            reg = <0x0 0x1000>;
                        };
                    };
                };
            };
        };
    };
```

## Documentation/devicetree/bindings/mtd/partitions/nvmem-cells.yaml
```yaml
# SPDX-License-Identifier: GPL-2.0-only OR BSD-2-Clause
%YAML 1.2
---
$id: http://devicetree.org/schemas/mtd/partitions/nvmem-cells.yaml#
$schema: http://devicetree.org/meta-schemas/core.yaml#

title: Nvmem cells

description: |
  Any partition containing the compatible "nvmem-cells" will register as a
  nvmem provider.
  Each direct subnodes represents a nvmem cell following the nvmem binding.
  Nvmem binding to declare nvmem-cells can be found in:
  Documentation/devicetree/bindings/nvmem/nvmem.yaml

maintainers:
  - Ansuel Smith <ansuelsmth@gmail.com>

allOf:
  - $ref: /schemas/mtd/partitions/partition.yaml#
  - $ref: /schemas/nvmem/nvmem.yaml#
  - $ref: /schemas/nvmem/nvmem-deprecated-cells.yaml#

properties:
  compatible:
    const: nvmem-cells

required:
  - compatible

unevaluatedProperties: false

examples:
  - |
    partitions {
      compatible = "fixed-partitions";
      #address-cells = <1>;
      #size-cells = <1>;

      /* ... */

      };
      art: art@1200000 {
        compatible = "nvmem-cells";
        reg = <0x1200000 0x0140000>;
        label = "art";
        read-only;
        #address-cells = <1>;
        #size-cells = <1>;

        macaddr_gmac1: macaddr_gmac1@0 {
          reg = <0x0 0x6>;
        };

        macaddr_gmac2: macaddr_gmac2@6 {
          reg = <0x6 0x6>;
        };

        pre_cal_24g: pre_cal_24g@1000 {
          reg = <0x1000 0x2f20>;
        };

        pre_cal_5g: pre_cal_5g@5000{
          reg = <0x5000 0x2f20>;
        };
      };
  - |
    partitions {
        compatible = "fixed-partitions";
        #address-cells = <1>;
        #size-cells = <1>;

        partition@0 {
            label = "bootloader";
            reg = <0x000000 0x100000>;
            read-only;
        };

        firmware@100000 {
            compatible = "brcm,trx";
            label = "firmware";
            reg = <0x100000 0xe00000>;
        };

        calibration@f00000 {
            compatible = "nvmem-cells";
            label = "calibration";
            reg = <0xf00000 0x100000>;
            #address-cells = <1>;
            #size-cells = <1>;

            wifi0@0 {
                reg = <0x000000 0x080000>;
            };

            wifi1@80000 {
                reg = <0x080000 0x080000>;
            };
        };
    };
```
