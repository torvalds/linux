## Documentation/devicetree/bindings/mtd/intel,lgm-ebunand.yaml
```yaml
# SPDX-License-Identifier: (GPL-2.0 OR BSD-2-Clause)
%YAML 1.2
---
$id: http://devicetree.org/schemas/mtd/intel,lgm-ebunand.yaml#
$schema: http://devicetree.org/meta-schemas/core.yaml#

title: Intel LGM SoC NAND Controller

allOf:
  - $ref: "nand-controller.yaml"

maintainers:
  - Ramuthevar Vadivel Murugan <vadivel.muruganx.ramuthevar@linux.intel.com>

properties:
  compatible:
    const: intel,lgm-ebunand

  reg:
    maxItems: 6

  reg-names:
    items:
      - const: ebunand
      - const: hsnand
      - const: nand_cs0
      - const: nand_cs1
      - const: addr_sel0
      - const: addr_sel1

  clocks:
    maxItems: 1

  dmas:
    maxItems: 2

  dma-names:
    items:
      - const: tx
      - const: rx

patternProperties:
  "^nand@[a-f0-9]$":
    type: object
    properties:
      reg:
        minimum: 0
        maximum: 1

      nand-ecc-mode: true

      nand-ecc-algo:
        const: hw

    additionalProperties: false

required:
  - compatible
  - reg
  - reg-names
  - clocks
  - dmas
  - dma-names

unevaluatedProperties: false

examples:
  - |
    nand-controller@e0f00000 {
        compatible = "intel,lgm-ebunand";
        reg = <0xe0f00000 0x100>,
              <0xe1000000 0x300>,
              <0xe1400000 0x8000>,
              <0xe1c00000 0x1000>,
              <0x17400000 0x4>,
              <0x17c00000 0x4>;
        reg-names = "ebunand", "hsnand", "nand_cs0", "nand_cs1",
                    "addr_sel0", "addr_sel1";
        clocks = <&cgu0 125>;
        dmas = <&dma0 8>, <&dma0 9>;
        dma-names = "tx", "rx";
        #address-cells = <1>;
        #size-cells = <0>;

        nand@0 {
            reg = <0>;
            nand-ecc-mode = "hw";
        };
    };

...
```

## Documentation/devicetree/bindings/mtd/jedec,spi-nor.txt
```
* SPI NOR flash: ST M25Pxx (and similar) serial flash chips

Required properties:
- #address-cells, #size-cells : Must be present if the device has sub-nodes
  representing partitions.
- compatible : May include a device-specific string consisting of the
               manufacturer and name of the chip. A list of supported chip
               names follows.
               Must also include "jedec,spi-nor" for any SPI NOR flash that can
               be identified by the JEDEC READ ID opcode (0x9F).

               Supported chip names:
                 at25df321a
                 at25df641
                 at26df081a
                 en25s64
                 mr25h128
                 mr25h256
                 mr25h10
                 mr25h40
                 mx25l4005a
                 mx25l1606e
                 mx25l6405d
                 mx25l12805d
                 mx25l25635e
                 n25q064
                 n25q128a11
                 n25q128a13
                 n25q512a
                 s25fl256s1
                 s25fl512s
                 s25sl12801
                 s25fl008k
                 s25fl064k
                 sst25vf040b
                 sst25wf040b
                 m25p40
                 m25p80
                 m25p16
                 m25p32
                 m25p64
                 m25p128
                 w25x80
                 w25x32
                 w25q32
                 w25q64
                 w25q32dw
                 w25q80bl
                 w25q128
                 w25q256

               The following chip names have been used historically to
               designate quirky versions of flash chips that do not support the
               JEDEC READ ID opcode (0x9F):
                 m25p05-nonjedec
                 m25p10-nonjedec
                 m25p20-nonjedec
                 m25p40-nonjedec
                 m25p80-nonjedec
                 m25p16-nonjedec
                 m25p32-nonjedec
                 m25p64-nonjedec
                 m25p128-nonjedec

- reg : Chip-Select number
- spi-max-frequency : Maximum frequency of the SPI bus the chip can operate at

Optional properties:
- m25p,fast-read : Use the "fast read" opcode to read data from the chip instead
                   of the usual "read" opcode. This opcode is not supported by
                   all chips and support for it can not be detected at runtime.
                   Refer to your chips' datasheet to check if this is supported
                   by your chip.

Example:

	flash: m25p80@0 {
		#address-cells = <1>;
		#size-cells = <1>;
		compatible = "spansion,m25p80", "jedec,spi-nor";
		reg = <0>;
		spi-max-frequency = <40000000>;
		m25p,fast-read;
	};
```

## Documentation/devicetree/bindings/mtd/jedec,spi-nor.yaml
```yaml
# SPDX-License-Identifier: GPL-2.0-only
%YAML 1.2
---
$id: http://devicetree.org/schemas/mtd/jedec,spi-nor.yaml#
$schema: http://devicetree.org/meta-schemas/core.yaml#

title: SPI NOR flash ST M25Pxx (and similar) serial flash chips

maintainers:
  - Rob Herring <robh@kernel.org>

allOf:
  - $ref: mtd.yaml#
  - $ref: /schemas/spi/spi-peripheral-props.yaml#

properties:
  compatible:
    oneOf:
      - items:
          - pattern: "^((((micron|spansion|st),)?\
              (m25p(40|80|16|32|64|128)|\
              n25q(32b|064|128a11|128a13|256a|512a|164k)))|\
              atmel,at25df(321a|641|081a)|\
              everspin,mr25h(10|40|128|256)|\
              (mxicy|macronix),mx25l(4005a|1606e|6405d|8005|12805d|25635e)|\
              (mxicy|macronix),mx25u(4033|4035)|\
              (spansion,)?s25fl(128s|256s1|512s|008k|064k|164k)|\
              (sst|microchip),sst25vf(016b|032b|040b)|\
              (sst,)?sst26wf016b|\
              (sst,)?sst25wf(040b|080)|\
              winbond,w25x(80|32)|\
              (winbond,)?w25q(16|32(w|dw)?|64(dw)?|80bl|128(fw)?|256))$"
          - const: jedec,spi-nor
      - items:
          - enum:
              - issi,is25lp016d
              - micron,mt25qu02g
              - mxicy,mx25r1635f
              - mxicy,mx25u6435f
              - mxicy,mx25v8035f
              - spansion,s25sl12801
              - spansion,s25fs512s
          - const: jedec,spi-nor
      - const: jedec,spi-nor
    description:
      SPI NOR flashes compatible with the JEDEC SFDP standard or which may be
      identified with the READ ID opcode (0x9F) do not deserve a specific
      compatible. They should instead only be matched against the generic
      "jedec,spi-nor" compatible.

  reg:
    minItems: 1
    maxItems: 2

  interrupts:
    maxItems: 1

  m25p,fast-read:
    type: boolean
    description:
      Use the "fast read" opcode to read data from the chip instead of the usual
      "read" opcode. This opcode is not supported by all chips and support for
      it can not be detected at runtime. Refer to your chips' datasheet to check
      if this is supported by your chip.

  broken-flash-reset:
    type: boolean
    description:
      Some flash devices utilize stateful addressing modes (e.g., for 32-bit
      addressing) which need to be managed carefully by a system. Because these
      sorts of flash don't have a standardized software reset command, and
      because some systems don't toggle the flash RESET# pin upon system reset
      (if the pin even exists at all), there are systems which cannot reboot
      properly if the flash is left in the "wrong" state. This boolean flag can
      be used on such systems, to denote the absence of a reliable reset
      mechanism.

  no-wp:
    type: boolean
    description:
      The status register write disable (SRWD) bit in status register, combined
      with the WP# signal, provides hardware data protection for the device. When
      the SRWD bit is set to 1, and the WP# signal is either driven LOW or hard
      strapped to LOW, the status register nonvolatile bits become read-only and
      the WRITE STATUS REGISTER operation will not execute. The only way to exit
      this hardware-protected mode is to drive WP# HIGH. If the WP# signal of the
      flash device is not connected or is wrongly tied to GND (that includes internal
      pull-downs) then status register permanently becomes read-only as the SRWD bit
      cannot be reset. This boolean flag can be used on such systems to avoid setting
      the SRWD bit while writing the status register. WP# signal hard strapped to GND
      can be a valid use case.

  reset-gpios:
    description:
      A GPIO line connected to the RESET (active low) signal of the device.
      If "broken-flash-reset" is present then having this property does not
      make any difference.

  spi-cpol: true
  spi-cpha: true

dependencies:
  spi-cpol: [ spi-cpha ]
  spi-cpha: [ spi-cpol ]

unevaluatedProperties: false

examples:
  - |
    #include <dt-bindings/gpio/gpio.h>
    spi {
        #address-cells = <1>;
        #size-cells = <0>;

        flash@0 {
            compatible = "spansion,m25p80", "jedec,spi-nor";
            reg = <0>;
            spi-max-frequency = <40000000>;
            m25p,fast-read;
            reset-gpios = <&gpio 12 GPIO_ACTIVE_LOW>;
        };
    };
...
```

## Documentation/devicetree/bindings/mtd/loongson,ls1b-nand-controller.yaml
```yaml
# SPDX-License-Identifier: (GPL-2.0-only OR BSD-2-Clause)
%YAML 1.2
---
$id: http://devicetree.org/schemas/mtd/loongson,ls1b-nand-controller.yaml#
$schema: http://devicetree.org/meta-schemas/core.yaml#

title: Loongson NAND Controller

maintainers:
  - Keguang Zhang <keguang.zhang@gmail.com>
  - Binbin Zhou <zhoubinbin@loongson.cn>

description:
  The Loongson NAND controller abstracts all supported operations,
  meaning it does not support low-level access to raw NAND flash chips.
  Moreover, the controller is paired with the DMA engine to perform
  READ and PROGRAM functions.

allOf:
  - $ref: nand-controller.yaml

properties:
  compatible:
    oneOf:
      - enum:
          - loongson,ls1b-nand-controller
          - loongson,ls1c-nand-controller
          - loongson,ls2k0500-nand-controller
          - loongson,ls2k1000-nand-controller
      - items:
          - enum:
              - loongson,ls1a-nand-controller
          - const: loongson,ls1b-nand-controller

  reg:
    minItems: 2
    maxItems: 3

  reg-names:
    minItems: 2
    items:
      - const: nand
      - const: nand-dma
      - const: dma-config

  dmas:
    maxItems: 1

  dma-names:
    const: rxtx

required:
  - compatible
  - reg
  - reg-names
  - dmas
  - dma-names

unevaluatedProperties: false

if:
  properties:
    compatible:
      contains:
        enum:
          - loongson,ls2k1000-nand-controller

then:
  properties:
    reg:
      minItems: 3
    reg-names:
      minItems: 3

else:
  properties:
    reg:
      maxItems: 2
    reg-names:
      maxItems: 2

examples:
  - |
    nand-controller@1fe78000 {
        compatible = "loongson,ls1b-nand-controller";
        reg = <0x1fe78000 0x24>, <0x1fe78040 0x4>;
        reg-names = "nand", "nand-dma";
        dmas = <&dma 0>;
        dma-names = "rxtx";
        #address-cells = <1>;
        #size-cells = <0>;

        nand@0 {
            reg = <0>;
            label = "ls1x-nand";
            nand-use-soft-ecc-engine;
            nand-ecc-algo = "hamming";
        };
    };

  - |
    nand-controller@1fe26000 {
        compatible = "loongson,ls2k1000-nand-controller";
        reg = <0x1fe26000 0x24>,
              <0x1fe26040 0x4>,
              <0x1fe00438 0x8>;
        reg-names = "nand", "nand-dma", "dma-config";
        dmas = <&apbdma0 0>;
        dma-names = "rxtx";

        #address-cells = <1>;
        #size-cells = <0>;

        nand@0 {
            reg = <0>;
            label = "ls2k1000-nand";
            nand-use-soft-ecc-engine;
            nand-ecc-algo = "bch";
            nand-ecc-strength = <8>;
            nand-ecc-step-size = <512>;
        };
    };
```

## Documentation/devicetree/bindings/mtd/lpc32xx-mlc.txt
```
NXP LPC32xx SoC NAND MLC controller

Required properties:
- compatible: "nxp,lpc3220-mlc"
- reg: Address and size of the controller
- interrupts: The NAND interrupt specification
- gpios: GPIO specification for NAND write protect

The following required properties are very controller specific. See the LPC32xx
User Manual 7.5.14 MLC NAND Timing Register (the values here are specified in
Hz, to make them independent of actual clock speed and to provide for good
accuracy:)
- nxp,tcea_delay: TCEA_DELAY
- nxp,busy_delay: BUSY_DELAY
- nxp,nand_ta: NAND_TA
- nxp,rd_high: RD_HIGH
- nxp,rd_low: RD_LOW
- nxp,wr_high: WR_HIGH
- nxp,wr_low: WR_LOW

Optional subnodes:
- Partitions, see Documentation/devicetree/bindings/mtd/mtd.yaml

Example:

	mlc: flash@200a8000 {
		compatible = "nxp,lpc3220-mlc";
		reg = <0x200A8000 0x11000>;
		interrupts = <11 0>;
		#address-cells = <1>;
		#size-cells = <1>;

		nxp,tcea-delay = <333333333>;
		nxp,busy-delay = <10000000>;
		nxp,nand-ta = <18181818>;
		nxp,rd-high = <31250000>;
		nxp,rd-low = <45454545>;
		nxp,wr-high = <40000000>;
		nxp,wr-low = <83333333>;
		gpios = <&gpio 5 19 1>; /* GPO_P3 19, active low */

		mtd0@00000000 {
			label = "boot";
			reg = <0x00000000 0x00064000>;
			read-only;
		};

		...

	};
```

## Documentation/devicetree/bindings/mtd/lpc32xx-slc.txt
```
NXP LPC32xx SoC NAND SLC controller

Required properties:
- compatible: "nxp,lpc3220-slc"
- reg: Address and size of the controller
- nand-on-flash-bbt: Use bad block table on flash
- gpios: GPIO specification for NAND write protect

The following required properties are very controller specific. See the LPC32xx
User Manual:
- nxp,wdr-clks: Delay before Ready signal is tested on write (W_RDY)
- nxp,rdr-clks: Delay before Ready signal is tested on read (R_RDY)
(The following values are specified in Hz, to make them independent of actual
clock speed:)
- nxp,wwidth: Write pulse width (W_WIDTH)
- nxp,whold: Write hold time (W_HOLD)
- nxp,wsetup: Write setup time (W_SETUP)
- nxp,rwidth: Read pulse width (R_WIDTH)
- nxp,rhold: Read hold time (R_HOLD)
- nxp,rsetup: Read setup time (R_SETUP)

Optional subnodes:
- Partitions, see Documentation/devicetree/bindings/mtd/mtd.yaml

Example:

	slc: flash@20020000 {
		compatible = "nxp,lpc3220-slc";
		reg = <0x20020000 0x1000>;
		#address-cells = <1>;
		#size-cells = <1>;

		nxp,wdr-clks = <14>;
		nxp,wwidth = <40000000>;
		nxp,whold = <100000000>;
		nxp,wsetup = <100000000>;
		nxp,rdr-clks = <14>;
		nxp,rwidth = <40000000>;
		nxp,rhold = <66666666>;
		nxp,rsetup = <100000000>;
		nand-on-flash-bbt;
		gpios = <&gpio 5 19 1>; /* GPO_P3 19, active low */

		mtd0@00000000 {
			label = "phy3250-boot";
			reg = <0x00000000 0x00064000>;
			read-only;
		};

		...

	};
```
