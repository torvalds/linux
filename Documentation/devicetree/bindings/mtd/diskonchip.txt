## Documentation/devicetree/bindings/mtd/gpmi-nand.yaml
```yaml
# SPDX-License-Identifier: (GPL-2.0-only OR BSD-2-Clause)
%YAML 1.2
---
$id: http://devicetree.org/schemas/mtd/gpmi-nand.yaml#
$schema: http://devicetree.org/meta-schemas/core.yaml#

title: Freescale General-Purpose Media Interface (GPMI)

maintainers:
  - Han Xu <han.xu@nxp.com>

description: |
  The GPMI nand controller provides an interface to control the NAND
  flash chips. The device tree may optionally contain sub-nodes
  describing partitions of the address space. See partition.txt for
  more detail.

properties:
  compatible:
    oneOf:
      - enum:
          - fsl,imx23-gpmi-nand
          - fsl,imx28-gpmi-nand
          - fsl,imx6q-gpmi-nand
          - fsl,imx6sx-gpmi-nand
          - fsl,imx7d-gpmi-nand
      - items:
          - enum:
              - fsl,imx8mm-gpmi-nand
              - fsl,imx8mn-gpmi-nand
          - const: fsl,imx7d-gpmi-nand

  reg:
    items:
      - description: Address and length of gpmi block.
      - description: Address and length of bch block.

  reg-names:
    items:
      - const: gpmi-nand
      - const: bch

  interrupts:
    maxItems: 1

  interrupt-names:
    const: bch

  dmas:
    maxItems: 1

  dma-names:
    const: rx-tx

  clocks:
    minItems: 1
    maxItems: 5

  clock-names:
    minItems: 1
    maxItems: 5

  fsl,use-minimum-ecc:
    type: boolean
    description: |
      Protect this NAND flash with the minimum ECC strength required.
      The required ECC strength is automatically discoverable for some
      flash (e.g., according to the ONFI standard). However, note that
      if this strength is not discoverable or this property is not enabled,
      the software may chooses an implementation-defined ECC scheme.

  fsl,no-blockmark-swap:
    type: boolean
    description: |
      Don't swap the bad block marker from the OOB area with the byte in
      the data area but rely on the flash based BBT for identifying bad blocks.
      NOTE: this is only valid in conjunction with 'nand-on-flash-bbt'.
      WARNING: on i.MX28 blockmark swapping cannot be disabled for the BootROM
      in the FCB. Thus, partitions written from Linux with this feature turned
      on may not be accessible by the BootROM code.

required:
  - compatible
  - reg
  - reg-names
  - interrupts
  - interrupt-names
  - clocks
  - clock-names
  - dmas
  - dma-names

unevaluatedProperties: false

allOf:
  - $ref: nand-controller.yaml

  - if:
      properties:
        compatible:
          contains:
            enum:
              - fsl,imx23-gpmi-nand
              - fsl,imx28-gpmi-nand
    then:
      properties:
        clocks:
          items:
            - description: SoC gpmi io clock
        clock-names:
          items:
            - const: gpmi_io

  - if:
      properties:
        compatible:
          contains:
            enum:
              - fsl,imx6q-gpmi-nand
              - fsl,imx6sx-gpmi-nand
    then:
      properties:
        clocks:
          items:
            - description: SoC gpmi io clock
            - description: SoC gpmi apb clock
            - description: SoC gpmi bch clock
            - description: SoC gpmi bch apb clock
            - description: SoC per1 bch clock
        clock-names:
          items:
            - const: gpmi_io
            - const: gpmi_apb
            - const: gpmi_bch
            - const: gpmi_bch_apb
            - const: per1_bch

  - if:
      properties:
        compatible:
          contains:
            const: fsl,imx7d-gpmi-nand
    then:
      properties:
        clocks:
          items:
            - description: SoC gpmi io clock
            - description: SoC gpmi bch apb clock
        clock-names:
          items:
            - const: gpmi_io
            - const: gpmi_bch_apb

examples:
  - |
    nand-controller@8000c000 {
        #address-cells = <1>;
        #size-cells = <0>;
        compatible = "fsl,imx28-gpmi-nand";
        reg = <0x8000c000 0x2000>, <0x8000a000 0x2000>;
        reg-names = "gpmi-nand", "bch";
        interrupts = <41>;
        interrupt-names = "bch";
        clocks = <&clks 50>;
        clock-names = "gpmi_io";
        dmas = <&dma_apbh 4>;
        dma-names = "rx-tx";
    };
```

## Documentation/devicetree/bindings/mtd/hisi504-nand.txt
```
Hisilicon Hip04 Soc NAND controller DT binding

Required properties:

- compatible:          Should be "hisilicon,504-nfc".
- reg:                 The first contains base physical address and size of
                       NAND controller's registers. The second contains base
                       physical address and size of NAND controller's buffer.
- interrupts:          Interrupt number for nfc.
- nand-bus-width:      See nand-controller.yaml.
- nand-ecc-mode:       Support none and hw ecc mode.
- #address-cells:      Partition address, should be set 1.
- #size-cells:         Partition size, should be set 1.

Optional properties:

- nand-ecc-strength:   Number of bits to correct per ECC step.
- nand-ecc-step-size:  Number of data bytes covered by a single ECC step.

The following ECC strength and step size are currently supported:

 - nand-ecc-strength = <16>, nand-ecc-step-size = <1024>

Flash chip may optionally contain additional sub-nodes describing partitions of
the address space. See mtd.yaml for more detail.

Example:

	nand: nand@4020000 {
		compatible = "hisilicon,504-nfc";
		reg = <0x4020000 0x10000>, <0x5000000 0x1000>;
		interrupts = <0 379 4>;
		nand-bus-width = <8>;
		nand-ecc-mode = "hw";
		nand-ecc-strength = <16>;
		nand-ecc-step-size = <1024>;
		#address-cells = <1>;
		#size-cells = <1>;

		partition@0 {
			label = "nand_text";
			reg = <0x00000000 0x00400000>;
		};

		...

	};
```

## Documentation/devicetree/bindings/mtd/hisilicon,fmc-spi-nor.txt
```
HiSilicon SPI-ANALR Flash Controller

Required properties:
- compatible : Should be "hisilicon,fmc-spi-analr" and one of the following strings:
		"hisilicon,hi3519-spi-analr"
- address-cells : Should be 1.
- size-cells : Should be 0.
- reg : Offset and length of the register set for the controller device.
- reg-names : Must include the following two entries: "control", "memory".
- clocks : handle to spi-analr flash controller clock.

Example:
spi-analr-controller@10000000 {
	compatible = "hisilicon,hi3519-spi-analr", "hisilicon,fmc-spi-analr";
	#address-cells = <1>;
	#size-cells = <0>;
	reg = <0x10000000 0x1000>, <0x14000000 0x1000000>;
	reg-names = "control", "memory";
	clocks = <&clock HI3519_FMC_CLK>;
	flash@0 {
		compatible = "jedec,spi-analr";
		reg = <0>;
	};
};
```

## Documentation/devicetree/bindings/mtd/ibm,ndfc.txt
```
AMCC NDFC (NanD Flash Controller)

Required properties:
- compatible : "ibm,ndfc".
- reg : should specify chip select and size used for the chip (0x2000).

Optional properties:
- ccr : NDFC config and control register value (default 0).
- bank-settings : NDFC bank configuration register value (default 0).

Notes:
- partition(s) - follows the OF MTD standard for partitions

Example:

ndfc@1,0 {
	compatible = "ibm,ndfc";
	reg = <0x00000001 0x00000000 0x00002000>;
	ccr = <0x00001000>;
	bank-settings = <0x80002222>;
	#address-cells = <1>;
	#size-cells = <1>;

	nand {
		#address-cells = <1>;
		#size-cells = <1>;

		partition@0 {
			label = "kernel";
			reg = <0x00000000 0x00200000>;
		};
		partition@200000 {
			label = "root";
			reg = <0x00200000 0x03E00000>;
		};
	};
};
```

## Documentation/devicetree/bindings/mtd/ingenic,jz4780-nand.txt
```
* Ingenic JZ4780 NAND/ECC

This file documents the device tree bindings for NAND flash devices on the
JZ4780. NAND devices are connected to the NEMC controller (described in
memory-controllers/ingenic,jz4780-nemc.txt), and thus NAND device nodes must
be children of the NEMC node.

Required NAND controller device properties:
- compatible: Should be one of:
  * ingenic,jz4740-nand
  * ingenic,jz4725b-nand
  * ingenic,jz4780-nand
- reg: For each bank with a NAND chip attached, should specify a bank number,
  an offset of 0 and a size of 0x1000000 (i.e. the whole NEMC bank).

Optional NAND controller device properties:
- ecc-engine: To make use of the hardware ECC controller, this
  property must contain a phandle for the ECC controller node. The required
  properties for this node are described below. If this is not specified,
  software ECC will be used instead.

Optional children nodes:
- Individual NAND chips are children of the NAND controller node.

Required children node properties:
- reg: An integer ranging from 1 to 6 representing the CS line to use.

Optional children node properties:
- nand-ecc-step-size: ECC block size in bytes.
- nand-ecc-strength: ECC strength (max number of correctable bits).
- nand-ecc-mode: String, operation mode of the NAND ecc mode. "hw" by default
- nand-on-flash-bbt: boolean to enable on flash bbt option, if not present false
- rb-gpios: GPIO specifier for the busy pin.
- wp-gpios: GPIO specifier for the write protect pin.

Optional child node of NAND chip nodes:
- partitions: see Documentation/devicetree/bindings/mtd/partition.txt

Example:

nemc: nemc@13410000 {
	...

	nandc: nand-controller@1 {
		compatible = "ingenic,jz4780-nand";
		reg = <1 0 0x1000000>;	/* Bank 1 */

		#address-cells = <1>;
		#size-cells = <0>;

		ecc-engine = <&bch>;

		nand@1 {
			reg = <1>;

			nand-ecc-step-size = <1024>;
			nand-ecc-strength = <24>;
			nand-ecc-mode = "hw";
			nand-on-flash-bbt;

			rb-gpios = <&gpa 20 GPIO_ACTIVE_LOW>;
			wp-gpios = <&gpf 22 GPIO_ACTIVE_LOW>;

			partitions {
				#address-cells = <2>;
				#size-cells = <2>;
				...
			}
		};
	};
};

The ECC controller is a separate SoC component used for error correction on
NAND devices. The following is a description of the device properties for a
ECC controller.

Required ECC properties:
- compatible: Should be one of:
  * ingenic,jz4740-ecc
  * ingenic,jz4725b-bch
  * ingenic,jz4780-bch
- reg: Should specify the ECC controller registers location and length.
- clocks: Clock for the ECC controller.

Example:

bch: bch@134d0000 {
	compatible = "ingenic,jz4780-bch";
	reg = <0x134d0000 0x10000>;

	clocks = <&cgu JZ4780_CLK_BCH>;
};
```

## Documentation/devicetree/bindings/mtd/ingenic,nand.yaml
```yaml
# SPDX-License-Identifier: (GPL-2.0-only OR BSD-2-Clause)
%YAML 1.2
---
$id: http://devicetree.org/schemas/mtd/ingenic,nand.yaml#
$schema: http://devicetree.org/meta-schemas/core.yaml#

title: Ingenic SoCs NAND controller devicetree bindings

maintainers:
  - Paul Cercueil <paul@crapouillou.net>

allOf:
  - $ref: nand-controller.yaml#

properties:
  compatible:
    enum:
      - ingenic,jz4740-nand
      - ingenic,jz4725b-nand
      - ingenic,jz4780-nand

  reg:
    items:
      - description: Bank number, offset and size of first attached NAND chip
      - description: Bank number, offset and size of second attached NAND chip
      - description: Bank number, offset and size of third attached NAND chip
      - description: Bank number, offset and size of fourth attached NAND chip
    minItems: 1

  ecc-engine: true

  partitions:
    type: object
    description:
      Node containing description of fixed partitions.
      See Documentation/devicetree/bindings/mtd/partition.txt

patternProperties:
  "^nand@[a-f0-9]$":
    type: object
    properties:
      rb-gpios:
        description: GPIO specifier for the busy pin.
        maxItems: 1

      wp-gpios:
        description: GPIO specifier for the write-protect pin.
        maxItems: 1

required:
  - compatible
  - reg

unevaluatedProperties: false

examples:
  - |
    #include <dt-bindings/clock/jz4780-cgu.h>
    memory-controller@13410000 {
      compatible = "ingenic,jz4780-nemc";
      reg = <0x13410000 0x10000>;
      #address-cells = <2>;
      #size-cells = <1>;
      ranges = <1 0 0x1b000000 0x1000000>,
         <2 0 0x1a000000 0x1000000>,
         <3 0 0x19000000 0x1000000>,
         <4 0 0x18000000 0x1000000>,
         <5 0 0x17000000 0x1000000>,
         <6 0 0x16000000 0x1000000>;

      clocks = <&cgu JZ4780_CLK_NEMC>;

      nand-controller@1 {
        compatible = "ingenic,jz4780-nand";
        reg = <1 0 0x1000000>;

        #address-cells = <1>;
        #size-cells = <0>;

        ecc-engine = <&bch>;

        ingenic,nemc-tAS = <10>;
        ingenic,nemc-tAH = <5>;
        ingenic,nemc-tBP = <10>;
        ingenic,nemc-tAW = <15>;
        ingenic,nemc-tSTRV = <100>;

        pinctrl-names = "default";
        pinctrl-0 = <&pins_nemc>;

        nand@1 {
          reg = <1>;

          nand-ecc-step-size = <1024>;
          nand-ecc-strength = <24>;
          nand-ecc-mode = "hw";
          nand-on-flash-bbt;

          pinctrl-names = "default";
          pinctrl-0 = <&pins_nemc_cs1>;

          partitions {
            compatible = "fixed-partitions";
            #address-cells = <2>;
            #size-cells = <2>;

            partition@0 {
              label = "u-boot-spl";
              reg = <0x0 0x0 0x0 0x800000>;
            };

            partition@800000 {
              label = "u-boot";
              reg = <0x0 0x800000 0x0 0x200000>;
            };

            partition@a00000 {
              label = "u-boot-env";
              reg = <0x0 0xa00000 0x0 0x200000>;
            };

            partition@c00000 {
              label = "boot";
              reg = <0x0 0xc00000 0x0 0x4000000>;
            };

            partition@4c00000 {
              label = "system";
              reg = <0x0 0x4c00000 0x1 0xfb400000>;
            };
          };
        };
      };
    };
```

## Documentation/devicetree/bindings/mtd/intel,ixp4xx-flash.txt
```
Flash device on Intel IXP4xx SoC

This flash is regular CFI compatible (Intel or AMD extended) flash chips with
specific big-endian or mixed-endian memory access pattern.

Required properties:
- compatible : must be "intel,ixp4xx-flash", "cfi-flash";
- reg : memory address for the flash chip
- bank-width : width in bytes of flash interface, should be <2>

For the rest of the properties, see mtd-physmap.txt.

The device tree may optionally contain sub-nodes describing partitions of the
address space. See partition.txt for more detail.

Example:

flash@50000000 {
	compatible = "intel,ixp4xx-flash", "cfi-flash";
	reg = <0x50000000 0x01000000>;
	bank-width = <2>;
};
```
