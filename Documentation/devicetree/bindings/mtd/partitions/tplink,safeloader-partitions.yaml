## Documentation/devicetree/bindings/mtd/partitions/tplink,safeloader-partitions.yaml
```yaml
# SPDX-License-Identifier: GPL-2.0-only OR BSD-2-Clause
%YAML 1.2
---
$id: http://devicetree.org/schemas/mtd/partitions/tplink,safeloader-partitions.yaml#
$schema: http://devicetree.org/meta-schemas/core.yaml#

title: TP-Link SafeLoader partitions

description: |
  TP-Link home routers store various data on flash (e.g. bootloader,
  flash layout, firmware, product info, configuration, calibration
  data). That requires flash partitioning.

  Flash space layout of TP-Link devices is stored on flash itself using
  a custom ASCII-based format. That format was first found in TP-Link
  devices with a custom SafeLoader bootloader. Later it was adapted to
  CFE and U-Boot bootloaders.

  Partitions specified in partitions table cover whole flash space. Some
  contain static data that shouldn't get modified (device's MAC or WiFi
  calibration data). Others are semi-static (like kernel). Finally some
  partitions contain fully changeable content (like rootfs).

  This binding describes partitioning method and defines offset of ASCII
  based partitions table. That offset is picked at manufacturing process
  and doesn't change.

maintainers:
  - Rafał Miłecki <rafal@milecki.pl>

properties:
  compatible:
    const: tplink,safeloader-partitions

  partitions-table-offset:
    description: Flash offset of partitions table
    $ref: /schemas/types.yaml#/definitions/uint32

patternProperties:
  "^partition-.*$":
    $ref: partition.yaml#

required:
  - partitions-table-offset

additionalProperties: false

examples:
  - |
    partitions {
        compatible = "tplink,safeloader-partitions";
        partitions-table-offset = <0x100000>;

        partition-file-system {
                linux,rootfs;
        };
    };
```

## Documentation/devicetree/bindings/mtd/partitions/u-boot.yaml
```yaml
# SPDX-License-Identifier: GPL-2.0-only OR BSD-2-Clause
%YAML 1.2
---
$id: http://devicetree.org/schemas/mtd/partitions/u-boot.yaml#
$schema: http://devicetree.org/meta-schemas/core.yaml#

title: U-Boot bootloader partition

description: |
  U-Boot is a bootlodaer commonly used in embedded devices. It's almost always
  located on some kind of flash device.

  Device configuration is stored as a set of environment variables that are
  located in a (usually standalone) block of data.

maintainers:
  - Rafał Miłecki <rafal@milecki.pl>

allOf:
  - $ref: partition.yaml#

properties:
  compatible:
    oneOf:
      - const: brcm,u-boot
        description: |
          Broadcom stores environment variables inside a U-Boot partition. They
          can be identified by a custom header with magic value.

patternProperties:
  "^partition-.*$":
    $ref: partition.yaml#

unevaluatedProperties: false

examples:
  - |
    partitions {
        compatible = "fixed-partitions";
        #address-cells = <1>;
        #size-cells = <1>;

        partition@0 {
            compatible = "brcm,u-boot";
            reg = <0x0 0x100000>;
            label = "u-boot";

            partition-u-boot-env {
            };
        };

        partition@100000 {
            reg = <0x100000 0x1ff00000>;
            label = "firmware";
        };
    };
```

## Documentation/devicetree/bindings/mtd/partitions/ubi-volume.yaml
```yaml
# SPDX-License-Identifier: GPL-2.0-only OR BSD-2-Clause
%YAML 1.2
---
$id: http://devicetree.org/schemas/mtd/partitions/ubi-volume.yaml#
$schema: http://devicetree.org/meta-schemas/core.yaml#

title: UBI volume

description: |
  This binding describes a single UBI volume. Volumes can be matches either
  by their ID or their name, or both.

maintainers:
  - Daniel Golle <daniel@makrotopia.org>

properties:
  volid:
    $ref: /schemas/types.yaml#/definitions/uint32
    description:
      Match UBI volume ID

  volname:
    $ref: /schemas/types.yaml#/definitions/string
    description:
      Match UBI volume ID

  nvmem-layout:
    $ref: /schemas/nvmem/layouts/nvmem-layout.yaml#
    description:
      This container may reference an NVMEM layout parser.

anyOf:
  - required:
      - volid

  - required:
      - volname

# This is a generic file other binding inherit from and extend
additionalProperties: true
```

## Documentation/devicetree/bindings/mtd/pxa3xx-nand.txt
```
PXA3xx NAND DT bindings

Required properties:

 - compatible:		Should be set to one of the following:
			marvell,pxa3xx-nand
			marvell,armada370-nand
 - reg: 		The register base for the controller
 - interrupts:		The interrupt to map
 - #address-cells:	Set to <1> if the node includes partitions

Optional properties:

 - marvell,nand-enable-arbiter:	Set to enable the bus arbiter
 - marvell,nand-keep-config:	Set to keep the NAND controller config as set
				by the bootloader
 - num-cs:			Number of chipselect lines to usw
 - nand-on-flash-bbt: 		boolean to enable on flash bbt option if
				not present false
 - nand-ecc-strength:           number of bits to correct per ECC step
 - nand-ecc-step-size:          number of data bytes covered by a single ECC step

The following ECC strength and step size are currently supported:

 - nand-ecc-strength = <1>, nand-ecc-step-size = <512>
 - nand-ecc-strength = <4>, nand-ecc-step-size = <512>
 - nand-ecc-strength = <8>, nand-ecc-step-size = <512>

Example:

	nand0: nand@43100000 {
		compatible = "marvell,pxa3xx-nand";
		reg = <0x43100000 90>;
		interrupts = <45>;
		#address-cells = <1>;

		marvell,nand-enable-arbiter;
		marvell,nand-keep-config;
		num-cs = <1>;

		/* partitions (optional) */
	};
```

## Documentation/devicetree/bindings/mtd/qcom,nandc.yaml
```yaml
# SPDX-License-Identifier: (GPL-2.0-only OR BSD-2-Clause)
%YAML 1.2
---
$id: http://devicetree.org/schemas/mtd/qcom,nandc.yaml#
$schema: http://devicetree.org/meta-schemas/core.yaml#

title: Qualcomm NAND controller

maintainers:
  - Manivannan Sadhasivam <manivannan.sadhasivam@linaro.org>

properties:
  compatible:
    oneOf:
      - items:
          - enum:
              - qcom,sdx75-nand
          - const: qcom,sdx55-nand
      - items:
          - enum:
              - qcom,ipq806x-nand
              - qcom,ipq4019-nand
              - qcom,ipq6018-nand
              - qcom,ipq8074-nand
              - qcom,sdx55-nand

  reg:
    maxItems: 1

  clocks:
    items:
      - description: Core Clock
      - description: Always ON Clock

  clock-names:
    items:
      - const: core
      - const: aon

  qcom,cmd-crci:
    $ref: /schemas/types.yaml#/definitions/uint32
    description:
      Must contain the ADM command type CRCI block instance number specified for
      the NAND controller on the given platform

  qcom,data-crci:
    $ref: /schemas/types.yaml#/definitions/uint32
    description:
      Must contain the ADM data type CRCI block instance number specified for
      the NAND controller on the given platform

patternProperties:
  "^nand@[a-f0-9]$":
    type: object
    $ref: raw-nand-chip.yaml
    properties:

      nand-bus-width:
        const: 8

      nand-ecc-strength:
        enum: [1, 4, 8]

      nand-ecc-step-size:
        enum:
          - 512

      qcom,boot-partitions:
        $ref: /schemas/types.yaml#/definitions/uint32-matrix
        items:
          items:
            - description: offset
            - description: size
        description:
          Boot partition use a different layout where the 4 bytes of spare
          data are not protected by ECC. Use this to declare these special
          partitions by defining first the offset and then the size.

          It's in the form of <offset1 size1 offset2 size2 offset3 ...>
          and should be declared in ascending order.

          Refer to the ipq8064 example on how to use this special binding.

    unevaluatedProperties: false

allOf:
  - $ref: nand-controller.yaml#

  - if:
      properties:
        compatible:
          contains:
            const: qcom,ipq806x-nand
    then:
      properties:
        dmas:
          items:
            - description: rxtx DMA channel

        dma-names:
          items:
            - const: rxtx

  - if:
      properties:
        compatible:
          contains:
            enum:
              - qcom,sdx75-nand

    then:
      properties:
        iommus:
          maxItems: 1

  - if:
      properties:
        compatible:
          contains:
            enum:
              - qcom,ipq4019-nand
              - qcom,ipq6018-nand
              - qcom,ipq8074-nand
              - qcom,sdx55-nand

    then:
      properties:
        dmas:
          items:
            - description: tx DMA channel
            - description: rx DMA channel
            - description: cmd DMA channel

        dma-names:
          items:
            - const: tx
            - const: rx
            - const: cmd

        qcom,cmd-crci: false
        qcom,data-crci: false

      patternProperties:
        "^nand@[a-f0-9]$":
          properties:
            qcom,boot-partitions: false

required:
  - compatible
  - reg
  - clocks
  - clock-names

unevaluatedProperties: false

examples:
  - |
    #include <dt-bindings/clock/qcom,gcc-ipq806x.h>
    nand-controller@1ac00000 {
        compatible = "qcom,ipq806x-nand";
        reg = <0x1ac00000 0x800>;

        clocks = <&gcc EBI2_CLK>,
                 <&gcc EBI2_AON_CLK>;
        clock-names = "core", "aon";

        dmas = <&adm_dma 3>;
        dma-names = "rxtx";
        qcom,cmd-crci = <15>;
        qcom,data-crci = <3>;

        #address-cells = <1>;
        #size-cells = <0>;

        nand@0 {
            reg = <0>;

            nand-ecc-strength = <4>;
            nand-bus-width = <8>;

            qcom,boot-partitions = <0x0 0x58a0000>;

            partitions {
                compatible = "fixed-partitions";
                #address-cells = <1>;
                #size-cells = <1>;

                partition@0 {
                    label = "boot-nand";
                    reg = <0 0x58a0000>;
                };

                partition@58a0000 {
                    label = "fs-nand";
                    reg = <0x58a0000 0x4000000>;
                };
            };
        };
    };

    #include <dt-bindings/clock/qcom,gcc-ipq4019.h>
    nand-controller@79b0000 {
        compatible = "qcom,ipq4019-nand";
        reg = <0x79b0000 0x1000>;

        clocks = <&gcc GCC_QPIC_CLK>,
                 <&gcc GCC_QPIC_AHB_CLK>;
        clock-names = "core", "aon";

        dmas = <&qpicbam 0>,
               <&qpicbam 1>,
               <&qpicbam 2>;
        dma-names = "tx", "rx", "cmd";

        #address-cells = <1>;
        #size-cells = <0>;

        nand@0 {
            reg = <0>;
            nand-ecc-strength = <4>;
            nand-bus-width = <8>;

            partitions {
                compatible = "fixed-partitions";
                #address-cells = <1>;
                #size-cells = <1>;

                partition@0 {
                    label = "boot-nand";
                    reg = <0 0x58a0000>;
                };

                partition@58a0000 {
                    label = "fs-nand";
                    reg = <0x58a0000 0x4000000>;
                };
            };
        };
    };

...
```

## Documentation/devicetree/bindings/mtd/qcom_nandc.txt
```
* Qualcomm NAND controller

Required properties:
- compatible:		must be one of the following:
    * "qcom,ipq806x-nand" - for EBI2 NAND controller being used in IPQ806x
			    SoC and it uses ADM DMA
    * "qcom,ipq4019-nand" - for QPIC NAND controller v1.4.0 being used in
                            IPQ4019 SoC and it uses BAM DMA
    * "qcom,ipq8074-nand" - for QPIC NAND controller v1.5.0 being used in
                            IPQ8074 SoC and it uses BAM DMA

- reg:			MMIO address range
- clocks:		must contain core clock and always on clock
- clock-names:		must contain "core" for the core clock and "aon" for the
			always on clock

EBI2 specific properties:
- dmas:			DMA specifier, consisting of a phandle to the ADM DMA
			controller node and the channel number to be used for
			NAND. Refer to dma.txt and qcom_adm.txt for more details
- dma-names:		must be "rxtx"
- qcom,cmd-crci:	must contain the ADM command type CRCI block instance
			number specified for the NAND controller on the given
			platform
- qcom,data-crci:	must contain the ADM data type CRCI block instance
			number specified for the NAND controller on the given
			platform

QPIC specific properties:
- dmas:			DMA specifier, consisting of a phandle to the BAM DMA
			and the channel number to be used for NAND. Refer to
			dma.txt, qcom_bam_dma.txt for more details
- dma-names:		must contain all 3 channel names : "tx", "rx", "cmd"
- #address-cells:	<1> - subnodes give the chip-select number
- #size-cells:		<0>

* NAND chip-select

Each controller may contain one or more subnodes to represent enabled
chip-selects which (may) contain NAND flash chips. Their properties are as
follows.

Required properties:
- reg:			a single integer representing the chip-select
			number (e.g., 0, 1, 2, etc.)
- #address-cells:	see partition.txt
- #size-cells:		see partition.txt

Optional properties:
- nand-bus-width:	see nand-controller.yaml
- nand-ecc-strength:	see nand-controller.yaml. If not specified, then ECC strength will
			be used according to chip requirement and available
			OOB size.

Each nandcs device node may optionally contain a 'partitions' sub-node, which
further contains sub-nodes describing the flash partition mapping. See
partition.txt for more detail.

Example:

nand-controller@1ac00000 {
	compatible = "qcom,ipq806x-nand";
	reg = <0x1ac00000 0x800>;

	clocks = <&gcc EBI2_CLK>,
		 <&gcc EBI2_AON_CLK>;
	clock-names = "core", "aon";

	dmas = <&adm_dma 3>;
	dma-names = "rxtx";
	qcom,cmd-crci = <15>;
	qcom,data-crci = <3>;

	#address-cells = <1>;
	#size-cells = <0>;

	nand@0 {
		reg = <0>;

		nand-ecc-strength = <4>;
		nand-bus-width = <8>;

		partitions {
			compatible = "fixed-partitions";
			#address-cells = <1>;
			#size-cells = <1>;

			partition@0 {
				label = "boot-nand";
				reg = <0 0x58a0000>;
			};

			partition@58a0000 {
				label = "fs-nand";
				reg = <0x58a0000 0x4000000>;
			};
		};
	};
};

nand-controller@79b0000 {
	compatible = "qcom,ipq4019-nand";
	reg = <0x79b0000 0x1000>;

	clocks = <&gcc GCC_QPIC_CLK>,
		<&gcc GCC_QPIC_AHB_CLK>;
	clock-names = "core", "aon";

	dmas = <&qpicbam 0>,
		<&qpicbam 1>,
		<&qpicbam 2>;
	dma-names = "tx", "rx", "cmd";

	#address-cells = <1>;
	#size-cells = <0>;

	nand@0 {
		reg = <0>;
		nand-ecc-strength = <4>;
		nand-bus-width = <8>;

		partitions {
			compatible = "fixed-partitions";
			#address-cells = <1>;
			#size-cells = <1>;

			partition@0 {
				label = "boot-nand";
				reg = <0 0x58a0000>;
			};

			partition@58a0000 {
				label = "fs-nand";
				reg = <0x58a0000 0x4000000>;
			};
		};
	};
};
```

## Documentation/devicetree/bindings/mtd/raw-nand-chip.yaml
```yaml
# SPDX-License-Identifier: (GPL-2.0-only OR BSD-2-Clause)
%YAML 1.2
---
$id: http://devicetree.org/schemas/mtd/raw-nand-chip.yaml#
$schema: http://devicetree.org/meta-schemas/core.yaml#

title: Raw NAND Chip Common Properties

maintainers:
  - Miquel Raynal <miquel.raynal@bootlin.com>

allOf:
  - $ref: nand-chip.yaml#
  - $ref: raw-nand-property.yaml#

description: |
  The ECC strength and ECC step size properties define the user
  desires in terms of correction capability of a controller. Together,
  they request the ECC engine to correct {strength} bit errors per
  {size} bytes for a particular raw NAND chip.

  The interpretation of these parameters is implementation-defined, so
  not all implementations must support all possible
  combinations. However, implementations are encouraged to further
  specify the value(s) they support.

properties:
  $nodename:
    pattern: "^nand@[a-f0-9]$"

  reg:
    description:
      Contains the chip-select IDs.

required:
  - reg

# This is a generic file other binding inherit from and extend
additionalProperties: true
```
