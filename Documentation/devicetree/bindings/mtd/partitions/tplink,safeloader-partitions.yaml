## Documentation/devicetree/bindings/mtd/st,spi-fsm.yaml
```yaml
# SPDX-License-Identifier: (GPL-2.0 OR BSD-2-Clause)
%YAML 1.2
---
$id: http://devicetree.org/schemas/mtd/st,spi-fsm.yaml#
$schema: http://devicetree.org/meta-schemas/core.yaml#

title: STMicroelectronics SPI FSM Serial NOR Flash Controller

maintainers:
  - Angus Clark <angus.clark@st.com>

description:
  The STMicroelectronics Fast Sequence Mode (FSM) controller is a dedicated
  hardware accelerator integrated in older STiH4xx/STiDxxx set-top box SoCs
  (such as STiH407, STiH416, STiD127). It connects directly to a single
  external serial flash device used as the primary boot device. The FSM
  executes hard-coded or configurable instruction sequences in hardware,
  providing low-latency reads suitable for execute-in-place (XIP) boot
  and high read bandwidth.

properties:
  compatible:
    const: st,spi-fsm

  reg:
    maxItems: 1

  reg-names:
    const: spi-fsm

  interrupts:
    maxItems: 1

  st,syscfg:
    $ref: /schemas/types.yaml#/definitions/phandle
    description: Phandle to the system configuration registers used for boot-device selection.

  st,boot-device-reg:
    $ref: /schemas/types.yaml#/definitions/uint32
    description: Offset of the boot-device register within the st,syscfg node.

  st,boot-device-spi:
    $ref: /schemas/types.yaml#/definitions/uint32
    description: Expected boot-device value when booting from this SPI controller.

required:
  - compatible
  - reg
  - reg-names
  - interrupts
  - pinctrl-0

unevaluatedProperties: false

examples:
  - |
    #include <dt-bindings/interrupt-controller/arm-gic.h>
    spifsm@fe902000 {
        compatible = "st,spi-fsm";
        reg = <0xfe902000 0x1000>;
        reg-names = "spi-fsm";
        interrupts = <GIC_SPI 64 IRQ_TYPE_LEVEL_HIGH>;
        pinctrl-0 = <&pinctrl_fsm>;
        st,syscfg = <&syscfg_rear>;
        st,boot-device-reg = <0x958>;
        st,boot-device-spi = <0x1a>;
    };
...
```

## Documentation/devicetree/bindings/mtd/st,stm32-fmc2-nand.yaml
```yaml
# SPDX-License-Identifier: (GPL-2.0-only OR BSD-2-Clause)
%YAML 1.2
---
$id: http://devicetree.org/schemas/mtd/st,stm32-fmc2-nand.yaml#
$schema: http://devicetree.org/meta-schemas/core.yaml#

title: STMicroelectronics Flexible Memory Controller 2 (FMC2) Bindings

maintainers:
  - Christophe Kerello <christophe.kerello@foss.st.com>

properties:
  compatible:
    enum:
      - st,stm32mp15-fmc2
      - st,stm32mp1-fmc2-nfc

  reg:
    minItems: 6
    maxItems: 7

  interrupts:
    maxItems: 1

  dmas:
    items:
      - description: tx DMA channel
      - description: rx DMA channel
      - description: ecc DMA channel

  dma-names:
    items:
      - const: tx
      - const: rx
      - const: ecc

patternProperties:
  "^nand@[a-f0-9]$":
    type: object
    properties:
      nand-ecc-step-size:
        const: 512

      nand-ecc-strength:
        enum: [1, 4, 8]

allOf:
  - $ref: "nand-controller.yaml#"

  - if:
      properties:
        compatible:
          contains:
            const: st,stm32mp15-fmc2
    then:
      properties:
        reg:
          items:
            - description: Registers
            - description: Chip select 0 data
            - description: Chip select 0 command
            - description: Chip select 0 address space
            - description: Chip select 1 data
            - description: Chip select 1 command
            - description: Chip select 1 address space

        clocks:
          maxItems: 1

        resets:
          maxItems: 1

      required:
        - clocks

  - if:
      properties:
        compatible:
          contains:
            const: st,stm32mp1-fmc2-nfc
    then:
      properties:
        reg:
          items:
            - description: Chip select 0 data
            - description: Chip select 0 command
            - description: Chip select 0 address space
            - description: Chip select 1 data
            - description: Chip select 1 command
            - description: Chip select 1 address space

required:
  - compatible
  - reg
  - interrupts

unevaluatedProperties: false

examples:
  - |
    #include <dt-bindings/interrupt-controller/arm-gic.h>
    #include <dt-bindings/clock/stm32mp1-clks.h>
    #include <dt-bindings/reset/stm32mp1-resets.h>
    nand-controller@58002000 {
      compatible = "st,stm32mp15-fmc2";
      reg = <0x58002000 0x1000>,
            <0x80000000 0x1000>,
            <0x88010000 0x1000>,
            <0x88020000 0x1000>,
            <0x81000000 0x1000>,
            <0x89010000 0x1000>,
            <0x89020000 0x1000>;
      interrupts = <GIC_SPI 48 IRQ_TYPE_LEVEL_HIGH>;
      dmas = <&mdma1 20 0x2 0x12000a02 0x0 0x0>,
             <&mdma1 20 0x2 0x12000a08 0x0 0x0>,
             <&mdma1 21 0x2 0x12000a0a 0x0 0x0>;
      dma-names = "tx", "rx", "ecc";
      clocks = <&rcc FMC_K>;
      resets = <&rcc FMC_R>;
      #address-cells = <1>;
      #size-cells = <0>;

      nand@0 {
        reg = <0>;
        nand-on-flash-bbt;
        #address-cells = <1>;
        #size-cells = <1>;
      };
    };

...
```

## Documentation/devicetree/bindings/mtd/st-fsm.txt
```
* ST-Microelectronics SPI FSM Serial (NOR) Flash Controller

Required properties:
  - compatible : Should be "st,spi-fsm"
  - reg        : Contains register's location and length.
  - reg-names  : Should contain the reg names "spi-fsm"
  - interrupts : The interrupt number
  - pinctrl-0  : Standard Pinctrl phandle (see: pinctrl/pinctrl-bindings.txt)

Optional properties:
  - st,syscfg          : Phandle to boot-device system configuration registers
  - st,boot-device-reg : Address of the aforementioned boot-device register(s)
  - st,boot-device-spi : Expected boot-device value if booted via this device

Example:
	spifsm: spifsm@fe902000{
	        compatible         = "st,spi-fsm";
	        reg                =  <0xfe902000 0x1000>;
	        reg-names          = "spi-fsm";
	        pinctrl-0          = <&pinctrl_fsm>;
		st,syscfg	   = <&syscfg_rear>;
	        st,boot-device-reg = <0x958>;
	        st,boot-device-spi = <0x1a>;
	};
```

## Documentation/devicetree/bindings/mtd/stm32-fmc2-nand.txt
```
STMicroelectronics Flexible Memory Controller 2 (FMC2)
NAND Interface

Required properties:
- compatible: Should be one of:
              * st,stm32mp15-fmc2
- reg: NAND flash controller memory areas.
       First region contains the register location.
       Regions 2 to 4 respectively contain the data, command,
       and address space for CS0.
       Regions 5 to 7 contain the same areas for CS1.
- interrupts: The interrupt number
- pinctrl-0: Standard Pinctrl phandle (see: pinctrl/pinctrl-bindings.txt)
- clocks: The clock needed by the NAND flash controller

Optional properties:
- resets: Reference to a reset controller asserting the FMC controller
- dmas: DMA specifiers (see: dma/stm32-mdma.txt)
- dma-names: Must be "tx", "rx" and "ecc"

* NAND device bindings:

Required properties:
- reg: describes the CS lines assigned to the NAND device.

Optional properties:
- nand-on-flash-bbt: see nand-controller.yaml
- nand-ecc-strength: see nand-controller.yaml
- nand-ecc-step-size: see nand-controller.yaml

The following ECC strength and step size are currently supported:
 - nand-ecc-strength = <1>, nand-ecc-step-size = <512> (Hamming)
 - nand-ecc-strength = <4>, nand-ecc-step-size = <512> (BCH4)
 - nand-ecc-strength = <8>, nand-ecc-step-size = <512> (BCH8) (default)

Example:

	fmc: nand-controller@58002000 {
		compatible = "st,stm32mp15-fmc2";
		reg = <0x58002000 0x1000>,
		      <0x80000000 0x1000>,
		      <0x88010000 0x1000>,
		      <0x88020000 0x1000>,
		      <0x81000000 0x1000>,
		      <0x89010000 0x1000>,
		      <0x89020000 0x1000>;
		interrupts = <GIC_SPI 48 IRQ_TYPE_LEVEL_HIGH>;
		clocks = <&rcc FMC_K>;
		resets = <&rcc FMC_R>;
		pinctrl-names = "default";
		pinctrl-0 = <&fmc_pins_a>;
		#address-cells = <1>;
		#size-cells = <0>;

		nand@0 {
			reg = <0>;
			nand-on-flash-bbt;
			#address-cells = <1>;
			#size-cells = <1>;
		};
	};
```

## Documentation/devicetree/bindings/mtd/stm32-quadspi.txt
```
* STMicroelectronics Quad Serial Peripheral Interface(QuadSPI)

Required properties:
- compatible: should be "st,stm32f469-qspi"
- reg: the first contains the register location and length.
       the second contains the memory mapping address and length
- reg-names: should contain the reg names "qspi" "qspi_mm"
- interrupts: should contain the interrupt for the device
- clocks: the phandle of the clock needed by the QSPI controller
- A pinctrl must be defined to set pins in mode of operation for QSPI transfer

Optional properties:
- resets: must contain the phandle to the reset controller.

A spi flash must be a child of the nor_flash node and could have some
properties. Also see jedec,spi-nor.txt.

Required properties:
- reg: chip-Select number (QSPI controller may connect 2 nor flashes)
- spi-max-frequency: max frequency of spi bus

Optional property:
- spi-rx-bus-width: see ../spi/spi-bus.txt for the description

Example:

qspi: spi@a0001000 {
	compatible = "st,stm32f469-qspi";
	reg = <0xa0001000 0x1000>, <0x90000000 0x10000000>;
	reg-names = "qspi", "qspi_mm";
	interrupts = <91>;
	resets = <&rcc STM32F4_AHB3_RESET(QSPI)>;
	clocks = <&rcc 0 STM32F4_AHB3_CLOCK(QSPI)>;
	pinctrl-names = "default";
	pinctrl-0 = <&pinctrl_qspi0>;

	flash@0 {
		reg = <0>;
		spi-rx-bus-width = <4>;
		spi-max-frequency = <108000000>;
		...
	};
};
```

## Documentation/devicetree/bindings/mtd/sunxi-nand.txt
```
Allwinner NAND Flash Controller (NFC)

Required properties:
- compatible : "allwinner,sun4i-a10-nand".
- reg : shall contain registers location and length for data and reg.
- interrupts : shall define the nand controller interrupt.
- #address-cells: shall be set to 1. Encode the nand CS.
- #size-cells : shall be set to 0.
- clocks : shall reference nand controller clocks.
- clock-names : nand controller internal clock names. Shall contain :
    * "ahb" : AHB gating clock
    * "mod" : nand controller clock

Optional properties:
- dmas : shall reference DMA channel associated to the NAND controller.
- dma-names : shall be "rxtx".

Optional children nodes:
Children nodes represent the available nand chips.

Optional properties:
- reset : phandle + reset specifier pair
- reset-names : must contain "ahb"
- allwinner,rb : shall contain the native Ready/Busy ids.
 or
- rb-gpios : shall contain the gpios used as R/B pins.
- nand-ecc-mode : one of the supported ECC modes ("hw", "hw_syndrome", "soft",
  "soft_bch" or "none")

see Documentation/devicetree/bindings/mtd/nand.txt for generic bindings.


Examples:
nfc: nand@01c03000 {
	compatible = "allwinner,sun4i-a10-nand";
	reg = <0x01c03000 0x1000>;
	interrupts = <0 37 1>;
	clocks = <&ahb_gates 13>, <&nand_clk>;
	clock-names = "ahb", "mod";
	#address-cells = <1>;
	#size-cells = <0>;
	pinctrl-names = "default";
	pinctrl-0 = <&nand_pins_a &nand_cs0_pins_a &nand_rb0_pins_a>;

	nand@0 {
		reg = <0>;
		allwinner,rb = <0>;
		nand-ecc-mode = "soft_bch";
	};
};
```
