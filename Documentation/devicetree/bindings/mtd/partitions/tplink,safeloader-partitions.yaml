## Documentation/devicetree/bindings/mtd/realtek,rtl9301-ecc.yaml
```yaml
# SPDX-License-Identifier: (GPL-2.0-only OR BSD-2-Clause)
%YAML 1.2
---
$id: http://devicetree.org/schemas/mtd/realtek,rtl9301-ecc.yaml#
$schema: http://devicetree.org/meta-schemas/core.yaml#

title: Realtek SoCs NAND ECC engine

maintainers:
  - Markus Stockhausen <markus.stockhausen@gmx.de>

properties:
  compatible:
    const: realtek,rtl9301-ecc

  reg:
    maxItems: 1

  clocks:
    maxItems: 1

  interrupts:
    maxItems: 1

required:
  - compatible
  - reg

additionalProperties: false

examples:
  - |
    soc {
        #address-cells = <1>;
        #size-cells = <1>;

        ecc0: ecc@1a600 {
            compatible = "realtek,rtl9301-ecc";
            reg = <0x1a600 0x54>;
        };
    };
```

## Documentation/devicetree/bindings/mtd/renesas-nandc.yaml
```yaml
# SPDX-License-Identifier: (GPL-2.0-only OR BSD-2-Clause)
%YAML 1.2
---
$id: http://devicetree.org/schemas/mtd/renesas-nandc.yaml#
$schema: http://devicetree.org/meta-schemas/core.yaml#

title: Renesas R-Car Gen3 & RZ/N1x NAND flash controller

maintainers:
  - Miquel Raynal <miquel.raynal@bootlin.com>

allOf:
  - $ref: nand-controller.yaml

properties:
  compatible:
    oneOf:
      - items:
          - enum:
              - renesas,r9a06g032-nandc
          - const: renesas,rzn1-nandc

  reg:
    maxItems: 1

  interrupts:
    maxItems: 1

  clocks:
    items:
      - description: APB host controller clock
      - description: External NAND bus clock

  clock-names:
    items:
      - const: hclk
      - const: eclk

  power-domains:
    maxItems: 1

required:
  - compatible
  - reg
  - clocks
  - clock-names
  - power-domains
  - interrupts

unevaluatedProperties: false

examples:
  - |
    #include <dt-bindings/interrupt-controller/arm-gic.h>
    #include <dt-bindings/clock/r9a06g032-sysctrl.h>

    nand-controller@40102000 {
        compatible = "renesas,r9a06g032-nandc", "renesas,rzn1-nandc";
        reg = <0x40102000 0x2000>;
        interrupts = <GIC_SPI 58 IRQ_TYPE_LEVEL_HIGH>;
        clocks = <&sysctrl R9A06G032_HCLK_NAND>, <&sysctrl R9A06G032_CLK_NAND>;
        clock-names = "hclk", "eclk";
        power-domains = <&sysctrl>;
        #address-cells = <1>;
        #size-cells = <0>;
    };
```

## Documentation/devicetree/bindings/mtd/rockchip,nand-controller.yaml
```yaml
# SPDX-License-Identifier: (GPL-2.0-only OR BSD-2-Clause)
%YAML 1.2
---
$id: http://devicetree.org/schemas/mtd/rockchip,nand-controller.yaml#
$schema: http://devicetree.org/meta-schemas/core.yaml#

title: Rockchip SoCs NAND FLASH Controller (NFC)

allOf:
  - $ref: "nand-controller.yaml#"

maintainers:
  - Heiko Stuebner <heiko@sntech.de>

properties:
  compatible:
    oneOf:
      - const: rockchip,px30-nfc
      - const: rockchip,rk2928-nfc
      - const: rockchip,rv1108-nfc
      - items:
          - const: rockchip,rk3036-nfc
          - const: rockchip,rk2928-nfc
      - items:
          - const: rockchip,rk3308-nfc
          - const: rockchip,rv1108-nfc

  reg:
    maxItems: 1

  interrupts:
    maxItems: 1

  clocks:
    minItems: 1
    items:
      - description: Bus Clock
      - description: Module Clock

  clock-names:
    minItems: 1
    items:
      - const: ahb
      - const: nfc

  assigned-clocks:
    maxItems: 1

  assigned-clock-rates:
    maxItems: 1

  power-domains:
    maxItems: 1

patternProperties:
  "^nand@[0-7]$":
    type: object
    properties:
      reg:
        minimum: 0
        maximum: 7

      nand-ecc-mode:
        const: hw

      nand-ecc-step-size:
        const: 1024

      nand-ecc-strength:
        enum: [16, 24, 40, 60, 70]
        description: |
          The ECC configurations that can be supported are as follows.
            NFC v600 ECC 16, 24, 40, 60
              RK2928, RK3066, RK3188

            NFC v622 ECC 16, 24, 40, 60
              RK3036, RK3128

            NFC v800 ECC 16
              RK3308, RV1108

            NFC v900 ECC 16, 40, 60, 70
              RK3326, PX30

      nand-bus-width:
        const: 8

      rockchip,boot-blks:
        $ref: /schemas/types.yaml#/definitions/uint32
        minimum: 2
        default: 16
        description:
          The NFC driver need this information to select ECC
          algorithms supported by the boot ROM.
          Only used in combination with 'nand-is-boot-medium'.

      rockchip,boot-ecc-strength:
        enum: [16, 24, 40, 60, 70]
        $ref: /schemas/types.yaml#/definitions/uint32
        description: |
          If specified it indicates that a different BCH/ECC setting is
          supported by the boot ROM.
            NFC v600 ECC 16, 24
              RK2928, RK3066, RK3188

            NFC v622 ECC 16, 24, 40, 60
              RK3036, RK3128

            NFC v800 ECC 16
              RK3308, RV1108

            NFC v900 ECC 16, 70
              RK3326, PX30

          Only used in combination with 'nand-is-boot-medium'.

required:
  - compatible
  - reg
  - interrupts
  - clocks
  - clock-names

unevaluatedProperties: false

examples:
  - |
    #include <dt-bindings/clock/rk3308-cru.h>
    #include <dt-bindings/interrupt-controller/arm-gic.h>
    nfc: nand-controller@ff4b0000 {
      compatible = "rockchip,rk3308-nfc",
                   "rockchip,rv1108-nfc";
      reg = <0xff4b0000 0x4000>;
      interrupts = <GIC_SPI 81 IRQ_TYPE_LEVEL_HIGH>;
      clocks = <&cru HCLK_NANDC>, <&cru SCLK_NANDC>;
      clock-names = "ahb", "nfc";
      assigned-clocks = <&clks SCLK_NANDC>;
      assigned-clock-rates = <150000000>;

      pinctrl-0 = <&flash_ale &flash_bus8 &flash_cle &flash_csn0
                   &flash_rdn &flash_rdy &flash_wrn>;
      pinctrl-names = "default";

      #address-cells = <1>;
      #size-cells = <0>;

      nand@0 {
        reg = <0>;
        label = "rk-nand";
        nand-bus-width = <8>;
        nand-ecc-mode = "hw";
        nand-ecc-step-size = <1024>;
        nand-ecc-strength = <16>;
        nand-is-boot-medium;
        rockchip,boot-blks = <8>;
        rockchip,boot-ecc-strength = <16>;
      };
    };

...
```

## Documentation/devicetree/bindings/mtd/rockchip-nand-v6.txt
```
Rockchip NAND Flash Controller DT binding

Required properties:

- compatible : "rockchip,rk-nand".
- reg : shall contain registers location and length for data and reg.
- interrupts : shall define the nand controller interrupt.
- clocks : shall reference nand controller clocks.
- clock-names : nand controller internal clock names. Shall contain :
    * "hclk_nandc" : AHB gating clock
    * "clk_nandc" : nand controller clock

Example for rk322x:
	nandc: nandc@10500000 {
		compatible = "rockchip,rk-nand";
		reg = <0x10500000 0x4000>;
		interrupts = <GIC_SPI 18 IRQ_TYPE_LEVEL_HIGH>;
		clocks = <&clk_nandc>, <&clk_gates10 15>;
		clock-names = "clk_nandc", "hclk_nandc";
		clock-frequency = <150000000>;
		status = "okay";

		#address-cells = <1>;
		#size-cells = <1>;
		nand@0 {
			reg = <0>;
			nand-ecc-mode = "hw";
			nand-ecc-strength = <16>;
			nand-ecc-step-size = <1024>;
		};
	};
```

## Documentation/devicetree/bindings/mtd/rockchip-nand-v9.txt
```
Rockchip NAND Flash Controller DT binding

Required properties:

- compatible : "rockchip,rk-nand-v9".
- reg : shall contain registers location and length for data and reg.
- interrupts : shall define the nand controller interrupt.
- clocks : shall reference nand controller clocks.
- clock-names : nand controller internal clock names. Shall contain :
    * "hclk_nandc" : AHB gating clock
    * "clk_nandc" : nand controller clock

Example for rk3326 / rkpx30:
	nandc0: nandc@ff3b0000 {
		compatible = "rockchip,rk-nandc-v9";
		reg = <0x0 0xff3b0000 0x0 0x4000>;
		interrupts = <GIC_SPI 57 IRQ_TYPE_LEVEL_HIGH>;
		nandc_id = <0>;
		clocks = <&cru SCLK_NANDC>, <&cru HCLK_NANDC>;
		clock-names = "clk_nandc", "hclk_nandc";
		assigned-clocks = <&cru SCLK_NANDC>;
		assigned-clock-parents = <&cru SCLK_NANDC_DIV50>;
		clock-frequency = <150000000>;
		status = "okay";

		#address-cells = <1>;
		#size-cells = <1>;
		nand@0 {
			reg = <0>;
			nand-ecc-mode = "hw";
			nand-ecc-strength = <16>;
			nand-ecc-step-size = <1024>;
		};
	};
```

## Documentation/devicetree/bindings/mtd/samsung,s5pv210-onenand.yaml
```yaml
# SPDX-License-Identifier: GPL-2.0-only OR BSD-2-Clause
%YAML 1.2
---
$id: http://devicetree.org/schemas/mtd/samsung,s5pv210-onenand.yaml#
$schema: http://devicetree.org/meta-schemas/core.yaml#

title: Samsung S5Pv210 SoC OneNAND Controller

maintainers:
  - Krzysztof Kozlowski <krzk@kernel.org>

properties:
  compatible:
    enum:
      - samsung,s5pv210-onenand

  reg:
    items:
      - description: Control registers
      - description: OneNAND interface nCE[0]
      - description: OneNAND interface nCE[1]

  clocks:
    maxItems: 2

  clock-names:
    items:
      - const: bus
      - const: onenand

  interrupts:
    maxItems: 1

required:
  - compatible
  - reg
  - clocks
  - clock-names
  - interrupts

allOf:
  - $ref: nand-controller.yaml

unevaluatedProperties: false

examples:
  - |
    #include <dt-bindings/clock/s5pv210.h>

    nand-controller@b0600000 {
        compatible = "samsung,s5pv210-onenand";
        reg = <0xb0600000 0x2000>,
              <0xb0000000 0x20000>,
              <0xb0040000 0x20000>;
        clocks = <&clocks CLK_NANDXL>, <&clocks DOUT_FLASH>;
        clock-names = "bus", "onenand";
        interrupt-parent = <&vic1>;
        interrupts = <31>;
        #address-cells = <1>;
        #size-cells = <0>;

        nand@0 {
            reg = <0>;
        };
    };
```

## Documentation/devicetree/bindings/mtd/samsung-s3c2410.txt
```
* Samsung S3C2410 and compatible NAND flash controller

Required properties:
- compatible : The possible values are:
	"samsung,s3c2410-nand"
	"samsung,s3c2412-nand"
	"samsung,s3c2440-nand"
- reg : register's location and length.
- #address-cells, #size-cells : see nand-controller.yaml
- clocks : phandle to the nand controller clock
- clock-names : must contain "nand"

Optional child analdes:
Child analdes representing the available nand chips.

Optional child properties:
- nand-ecc-mode : see nand-controller.yaml
- nand-on-flash-bbt : see nand-controller.yaml

Each child device analde may optionally contain a 'partitions' sub-analde,
which further contains sub-analdes describing the flash partition mapping.
See partition.txt for more detail.

Example:

nand-controller@4e000000 {
	compatible = "samsung,s3c2440-nand";
	reg = <0x4e000000 0x40>;

	#address-cells = <1>;
        #size-cells = <0>;

	clocks = <&clocks HCLK_NAND>;
	clock-names = "nand";

	nand {
		nand-ecc-mode = "soft";
		nand-on-flash-bbt;

		partitions {
			compatible = "fixed-partitions";
			#address-cells = <1>;
			#size-cells = <1>;

			partition@0 {
				label = "u-boot";
				reg = <0 0x040000>;
			};

			partition@40000 {
				label = "kernel";
				reg = <0x040000 0x500000>;
			};
		};
	};
};
```

## Documentation/devicetree/bindings/mtd/spear_smi.txt
```
* SPEAr SMI

Required properties:
- compatible : "st,spear600-smi"
- reg : Address range of the mtd chip
- #address-cells, #size-cells : Must be present if the device has sub-nodes
  representing partitions.
- interrupts: Should contain the STMMAC interrupts
- clock-rate : Functional clock rate of SMI in Hz

Optional properties:
- st,smi-fast-mode : Flash supports read in fast mode

Example:

	smi: flash@fc000000 {
		compatible = "st,spear600-smi";
		#address-cells = <1>;
		#size-cells = <1>;
		reg = <0xfc000000 0x1000>;
		interrupt-parent = <&vic1>;
		interrupts = <12>;
		clock-rate = <50000000>;	/* 50MHz */

		flash@f8000000 {
			st,smi-fast-mode;
			...
		};
	};
```

## Documentation/devicetree/bindings/mtd/spi-nand.txt
```
SPI NAND flash

Required properties:
- compatible: should be "spi-nand"
- reg: should encode the chip-select line used to access the NAND chip
```

## Documentation/devicetree/bindings/mtd/spi-nand.yaml
```yaml
# SPDX-License-Identifier: (GPL-2.0-only OR BSD-2-Clause)
%YAML 1.2
---
$id: http://devicetree.org/schemas/mtd/spi-nand.yaml#
$schema: http://devicetree.org/meta-schemas/core.yaml#

title: SPI-NAND flash

maintainers:
  - Miquel Raynal <miquel.raynal@bootlin.com>

allOf:
  - $ref: "nand-chip.yaml#"
  - $ref: /schemas/spi/spi-peripheral-props.yaml#

properties:
  compatible:
    const: spi-nand

  reg:
    description: Encode the chip-select line on the SPI bus
    maxItems: 1

required:
  - compatible
  - reg

unevaluatedProperties: false
```

## Documentation/devicetree/bindings/mtd/spi-nor-flash.txt
```
This file defines some DT properties for specific SPI NOR flash features.
The SPI NOR controller drivers may refer to this file, such as fsl-quadspi.txt

Optional properties:
  - spi-nor,ddr-quad-read-dummy: The dummy cycles used by the DDR Quad read.
                                 Please refer to the chip's datasheet. This
                                 property can be 4 or 6 which is less then 8.
```

## Documentation/devicetree/bindings/mtd/st,spear600-smi.yaml
```yaml
# SPDX-License-Identifier: (GPL-2.0 OR BSD-2-Clause)
%YAML 1.2
---
$id: http://devicetree.org/schemas/mtd/st,spear600-smi.yaml#
$schema: http://devicetree.org/meta-schemas/core.yaml#

title: STMicroelectronics SPEAr600 Serial Memory Interface (SMI) Controller

maintainers:
  - Richard Weinberger <richard@nod.at>

description:
  The SPEAr600 Serial Memory Interface (SMI) is a dedicated serial flash
  controller supporting up to four chip selects for serial NOR flashes
  connected in parallel. The controller is memory-mapped and the attached
  flash devices appear in the CPU address space.The driver
  (drivers/mtd/devices/spear_smi.c) probes the attached flashes
  dynamically by sending commands (e.g., RDID) to each bank.
  Flash sub nodes describe the memory range and optional per-flash
  properties.

allOf:
  - $ref: mtd.yaml#

properties:
  compatible:
    const: st,spear600-smi

  reg:
    maxItems: 1

  interrupts:
    maxItems: 1

  "#address-cells":
    const: 1

  "#size-cells":
    const: 1

  clock-rate:
    $ref: /schemas/types.yaml#/definitions/uint32
    description: Functional clock rate of the SMI controller in Hz.

  st,smi-fast-mode:
    type: boolean
    description: Indicates that the attached flash supports fast read mode.

required:
  - compatible
  - reg
  - clock-rate

unevaluatedProperties: false

examples:
  - |
    flash@fc000000 {
        compatible = "st,spear600-smi";
        #address-cells = <1>;
        #size-cells = <1>;
        reg = <0xfc000000 0x1000>;
        interrupt-parent = <&vic1>;
        interrupts = <12>;
        clock-rate = <50000000>;  /* 50 MHz */

        flash@f8000000 {
            reg = <0xfc000000 0x1000>;
            st,smi-fast-mode;
        };
    };
...
```
