## Documentation/devicetree/bindings/serial/rs485.yaml
```yaml
# SPDX-License-Identifier: GPL-2.0
%YAML 1.2
---
$id: http://devicetree.org/schemas/serial/rs485.yaml#
$schema: http://devicetree.org/meta-schemas/core.yaml#

title: RS485 serial communications Bindings

description: The RTS signal is capable of automatically controlling line
  direction for the built-in half-duplex mode. The properties described
  hereafter shall be given to a half-duplex capable UART node.

maintainers:
  - Rob Herring <robh@kernel.org>

properties:
  rs485-rts-delay:
    description: prop-encoded-array <a b>
    $ref: /schemas/types.yaml#/definitions/uint32-array
    items:
      items:
        - description: Delay between rts signal and beginning of data sent in
            milliseconds. It corresponds to the delay before sending data.
          default: 0
          maximum: 100
        - description: Delay between end of data sent and rts signal in milliseconds.
            It corresponds to the delay after sending data and actual release
            of the line.
          default: 0
          maximum: 100

  rs485-rts-active-low:
    description: drive RTS low when sending (default is high).
    $ref: /schemas/types.yaml#/definitions/flag

  rs485-rx-active-high:
    description: Polarity of receiver enable signal (when separate from RTS).
      True indicates active high (default is low).
    $ref: /schemas/types.yaml#/definitions/flag

  linux,rs485-enabled-at-boot-time:
    description: enables the rs485 feature at boot time. It can be disabled
      later with proper ioctl.
    $ref: /schemas/types.yaml#/definitions/flag

  rs485-rx-during-tx:
    description: enables the receiving of data even while sending data.
    $ref: /schemas/types.yaml#/definitions/flag

  rs485-term-gpios:
    description: GPIO pin to enable RS485 bus termination.
    maxItems: 1

additionalProperties: true

...
```

## Documentation/devicetree/bindings/serial/samsung_uart.txt
```
* Samsung's UART Controller

The Samsung's UART controller is used for interfacing SoC with serial
communicaion devices.

Required properties:
- compatible: should be one of following:
  - "samsung,exynos4210-uart" -  Exynos4210 SoC,
  - "samsung,s3c2410-uart" - compatible with ports present on S3C2410 SoC,
  - "samsung,s3c2412-uart" - compatible with ports present on S3C2412 SoC,
  - "samsung,s3c2440-uart" - compatible with ports present on S3C2440 SoC,
  - "samsung,s3c6400-uart" - compatible with ports present on S3C6400 SoC,
  - "samsung,s5pv210-uart" - compatible with ports present on S5PV210 SoC.

- reg: base physical address of the controller and length of memory mapped
  region.

- interrupts: a single interrupt signal to SoC interrupt controller,
  according to interrupt bindings documentation [1].

- clock-names: input names of clocks used by the controller:
  - "uart" - controller bus clock,
  - "clk_uart_baudN" - Nth baud base clock input (N = 0, 1, ...),
    according to SoC User's Manual (only N = 0 is allowedfor SoCs without
    internal baud clock mux).
- clocks: phandles and specifiers for all clocks specified in "clock-names"
  property, in the same order, according to clock bindings documentation [2].

[1] Documentation/devicetree/bindings/interrupt-controller/interrupts.txt
[2] Documentation/devicetree/bindings/clock/clock-bindings.txt

Note: Each Samsung UART should have an alias correctly numbered in the
"aliases" node, according to serialN format, where N is the port number
(non-negative decimal integer) as specified by User's Manual of respective
SoC.

Example:
	aliases {
		serial0 = &uart0;
		serial1 = &uart1;
		serial2 = &uart2;
	};

Example:
	uart1: serial@7f005400 {
		compatible = "samsung,s3c6400-uart";
		reg = <0x7f005400 0x100>;
		interrupt-parent = <&vic1>;
		interrupts = <6>;
		clock-names = "uart", "clk_uart_baud2",
				"clk_uart_baud3";
		clocks = <&clocks PCLK_UART1>, <&clocks PCLK_UART1>,
				<&clocks SCLK_UART>;
	};
```

## Documentation/devicetree/bindings/serial/samsung_uart.yaml
```yaml
# SPDX-License-Identifier: GPL-2.0
%YAML 1.2
---
$id: http://devicetree.org/schemas/serial/samsung_uart.yaml#
$schema: http://devicetree.org/meta-schemas/core.yaml#

title: Samsung S3C, S5P, Exynos, and S5L (Apple SoC) SoC UART Controller

maintainers:
  - Krzysztof Kozlowski <krzk@kernel.org>
  - Greg Kroah-Hartman <gregkh@linuxfoundation.org>

description: |+
  Each Samsung UART should have an alias correctly numbered in the "aliases"
  node, according to serialN format, where N is the port number (non-negative
  decimal integer) as specified by User's Manual of respective SoC.

properties:
  compatible:
    oneOf:
      - enum:
          - apple,s5l-uart
          - axis,artpec8-uart
          - google,gs101-uart
          - samsung,s3c6400-uart
          - samsung,s5pv210-uart
          - samsung,exynos4210-uart
          - samsung,exynos5433-uart
          - samsung,exynos850-uart
          - samsung,exynos8895-uart
      - items:
          - enum:
              - samsung,exynos7-uart
              - tesla,fsd-uart
          - const: samsung,exynos4210-uart
      - items:
          - enum:
              - samsung,exynos7885-uart
          - const: samsung,exynos5433-uart
      - items:
          - enum:
              - samsung,exynosautov9-uart
              - samsung,exynosautov920-uart
          - const: samsung,exynos850-uart
      - items:
          - enum:
              - samsung,exynos7870-uart
          - const: samsung,exynos8895-uart

  reg:
    maxItems: 1

  reg-io-width:
    description: |
      The size (in bytes) of the IO accesses that should be performed
      on the device.
    enum: [ 1, 4 ]

  clocks:
    minItems: 2
    maxItems: 5

  clock-names:
    minItems: 2
    maxItems: 5

  dmas:
    items:
      - description: DMA controller phandle and request line for RX
      - description: DMA controller phandle and request line for TX

  dma-names:
    items:
      - const: rx
      - const: tx

  interrupts:
    description: RX interrupt and optionally TX interrupt.
    minItems: 1
    maxItems: 2

  power-domains:
    maxItems: 1

  samsung,uart-fifosize:
    description: The fifo size supported by the UART channel.
    $ref: /schemas/types.yaml#/definitions/uint32
    enum: [16, 64, 256]

required:
  - compatible
  - clocks
  - clock-names
  - interrupts
  - reg

allOf:
  - $ref: serial.yaml#

  - if:
      properties:
        compatible:
          contains:
            enum:
              - samsung,s3c6400-uart
    then:
      properties:
        clocks:
          minItems: 3
          maxItems: 3

        clock-names:
          items:
            - const: uart
            - const: clk_uart_baud2
            - const: clk_uart_baud3

    else:
      properties:
        clock-names:
          minItems: 2
          items:
            - const: uart
            - const: clk_uart_baud0
            - const: clk_uart_baud1
            - const: clk_uart_baud2
            - const: clk_uart_baud3

  - if:
      properties:
        compatible:
          contains:
            enum:
              - samsung,s5pv210-uart
    then:
      properties:
        clocks:
          minItems: 3
          maxItems: 3

        clock-names:
          minItems: 3
          maxItems: 3

  - if:
      properties:
        compatible:
          contains:
            enum:
              - apple,s5l-uart
              - axis,artpec8-uart
              - samsung,exynos4210-uart
              - samsung,exynos5433-uart
    then:
      properties:
        clocks:
          maxItems: 2

        clock-names:
          maxItems: 2

  - if:
      properties:
        compatible:
          contains:
            enum:
              - google,gs101-uart
              - samsung,exynos8895-uart
    then:
      required:
        - samsung,uart-fifosize
      properties:
        clocks:
          maxItems: 2

        clock-names:
          maxItems: 2

  - if:
      properties:
        compatible:
          contains:
            enum:
              - google,gs101-uart
    then:
      properties:
        reg-io-width: false

unevaluatedProperties: false

examples:
  - |
    #include <dt-bindings/clock/samsung,s3c64xx-clock.h>

    uart0: serial@7f005000 {
        compatible = "samsung,s3c6400-uart";
        reg = <0x7f005000 0x100>;
        interrupt-parent = <&vic1>;
        interrupts = <5>;
        clock-names = "uart", "clk_uart_baud2",
                      "clk_uart_baud3";
        clocks = <&clocks PCLK_UART0>, <&clocks PCLK_UART0>,
                 <&clocks SCLK_UART>;
        samsung,uart-fifosize = <16>;
    };
  - |
    #include <dt-bindings/clock/google,gs101.h>
    #include <dt-bindings/interrupt-controller/arm-gic.h>
    #include <dt-bindings/interrupt-controller/irq.h>

    serial_0: serial@10a00000 {
      compatible = "google,gs101-uart";
      reg = <0x10a00000 0xc0>;
      clocks = <&cmu_peric0 CLK_GOUT_PERIC0_PERIC0_TOP1_PCLK_0>,
               <&cmu_peric0 CLK_GOUT_PERIC0_PERIC0_TOP1_IPCLK_0>;
      clock-names = "uart", "clk_uart_baud0";
      interrupts = <GIC_SPI 634 IRQ_TYPE_LEVEL_HIGH 0>;
      pinctrl-0 = <&uart0_bus>;
      pinctrl-names = "default";
      samsung,uart-fifosize = <256>;
    };
```

## Documentation/devicetree/bindings/serial/serial-peripheral-props.yaml
```yaml
# SPDX-License-Identifier: GPL-2.0-only OR BSD-2-Clause
%YAML 1.2
---
$id: http://devicetree.org/schemas/serial/serial-peripheral-props.yaml#
$schema: http://devicetree.org/meta-schemas/core.yaml#

title: Common Properties for Serial-attached Devices

maintainers:
  - Rob Herring <robh@kernel.org>
  - Greg Kroah-Hartman <gregkh@linuxfoundation.org>

description:
  Devices connected over serial/UART, expressed as children of a serial
  controller, might need similar properties, e.g. for configuring the baud
  rate.

properties:
  max-speed:
    $ref: /schemas/types.yaml#/definitions/uint32
    description:
      The maximum baud rate the device operates at.
      This should only be present if the maximum is less than the slave
      device can support.  For example, a particular board has some
      signal quality issue or the host processor can't support higher
      baud rates.

  current-speed:
    $ref: /schemas/types.yaml#/definitions/uint32
    description: |
      The current baud rate the device operates at.
      This should only be present in case a driver has no chance to know
      the baud rate of the slave device.
      Examples:
        * device supports auto-baud
        * the rate is setup by a bootloader and there is no way to reset
          the device
        * device baud rate is configured by its firmware but there is no
          way to request the actual settings

additionalProperties: true
```

## Documentation/devicetree/bindings/serial/serial.txt
```
Generic Serial DT Bindings

This document lists a set of generic properties for describing UARTs in a
device tree.  Whether these properties apply to a particular device depends on
the DT bindings for the actual device.

Optional properties:
  - cts-gpios: Must contain a GPIO specifier, referring to the GPIO pin to be
    used as the UART's CTS line.
  - dcd-gpios: Must contain a GPIO specifier, referring to the GPIO pin to be
    used as the UART's DCD line.
  - dsr-gpios: Must contain a GPIO specifier, referring to the GPIO pin to be
    used as the UART's DSR line.
  - dtr-gpios: Must contain a GPIO specifier, referring to the GPIO pin to be
    used as the UART's DTR line.
  - rng-gpios: Must contain a GPIO specifier, referring to the GPIO pin to be
    used as the UART's RNG line.
  - rts-gpios: Must contain a GPIO specifier, referring to the GPIO pin to be
    used as the UART's RTS line.

  - uart-has-rtscts: The presence of this property indicates that the
    UART has dedicated lines for RTS/CTS hardware flow control, and that
    they are available for use (wired and enabled by pinmux configuration).
    This depends on both the UART hardware and the board wiring.
    Note that this property is mutually-exclusive with "cts-gpios" and
    "rts-gpios" above, unless support is provided to switch between modes
    dynamically.


Examples:

	uart1: serial@48022000 {
		compatible = "ti,am3352-uart", "ti,omap3-uart";
		ti,hwmods = "uart2";
		clock-frequency = <48000000>;
		reg = <0x48022000 0x2000>;
		interrupts = <73>;
		dmas = <&edma 28 0>, <&edma 29 0>;
		dma-names = "tx", "rx";
		dtr-gpios = <&gpio2 22 GPIO_ACTIVE_LOW>;
		dsr-gpios = <&gpio2 23 GPIO_ACTIVE_LOW>;
		dcd-gpios = <&gpio2 24 GPIO_ACTIVE_LOW>;
		rng-gpios = <&gpio2 25 GPIO_ACTIVE_LOW>;
		cts-gpios = <&gpio0 12 GPIO_ACTIVE_LOW>;
		rts-gpios = <&gpio0 13 GPIO_ACTIVE_LOW>;
		status = "okay";
	};

	scifa4: serial@e6c80000 {
		compatible = "renesas,scifa-sh73a0", "renesas,scifa";
		reg = <0xe6c80000 0x100>;
		interrupts = <GIC_SPI 78 IRQ_TYPE_LEVEL_HIGH>;
		clocks = <&mstp2_clks SH73A0_CLK_SCIFA4>;
		clock-names = "fck";
		power-domains = <&pd_a3sp>;
		uart-has-rtscts;
		status = "okay";
	};
```
