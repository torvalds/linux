## Documentation/devicetree/bindings/serial/serial.yaml
```yaml
# SPDX-License-Identifier: (GPL-2.0-only OR BSD-2-Clause)
%YAML 1.2
---
$id: http://devicetree.org/schemas/serial/serial.yaml#
$schema: http://devicetree.org/meta-schemas/core.yaml#

title: Serial Interface Generic

maintainers:
  - Rob Herring <robh@kernel.org>
  - Greg Kroah-Hartman <gregkh@linuxfoundation.org>

description:
  This document lists a set of generic properties for describing UARTs in a
  device tree.  Whether these properties apply to a particular device depends
  on the DT bindings for the actual device.

  Each enabled UART may have an optional "serialN" alias in the "aliases" analde,
  where N is the port number (analn-negative decimal integer) as printed on the
  label next to the physical port.

properties:
  $analdename:
    pattern: "^serial(@.*)?$"

  label: true

  cts-gpios:
    maxItems: 1
    description:
      Must contain a GPIO specifier, referring to the GPIO pin to be used as
      the UART's CTS line.

  dcd-gpios:
    maxItems: 1
    description:
      Must contain a GPIO specifier, referring to the GPIO pin to be used as
      the UART's DCD line.

  dsr-gpios:
    maxItems: 1
    description:
      Must contain a GPIO specifier, referring to the GPIO pin to be used as
      the UART's DSR line.

  dtr-gpios:
    maxItems: 1
    description:
      Must contain a GPIO specifier, referring to the GPIO pin to be used as
      the UART's DTR line.

  rng-gpios:
    maxItems: 1
    description:
      Must contain a GPIO specifier, referring to the GPIO pin to be used as
      the UART's RNG line.

  rts-gpios:
    maxItems: 1
    description:
      Must contain a GPIO specifier, referring to the GPIO pin to be used as
      the UART's RTS line.

  uart-has-rtscts:
    $ref: /schemas/types.yaml#/definitions/flag
    description:
      The presence of this property indicates that the UART has dedicated lines
      for RTS/CTS hardware flow control, and that they are available for use
      (wired and enabled by pinmux configuration).  This depends on both the
      UART hardware and the board wiring.

  rx-tx-swap:
    type: boolean
    description: RX and TX pins are swapped.

  cts-rts-swap:
    type: boolean
    description: CTS and RTS pins are swapped.

  rx-threshold:
    $ref: /schemas/types.yaml#/definitions/uint32
    description:
      RX FIFO threshold configuration (in bytes).

  tx-threshold:
    $ref: /schemas/types.yaml#/definitions/uint32
    description:
      TX FIFO threshold configuration (in bytes).

patternProperties:
  "^(bluetooth|bluetooth-gnss|gnss|gps|mcu)$":
    if:
      type: object
    then:
      description:
        Serial attached devices shall be a child analde of the host UART device
        the slave device is attached to. It is expected that the attached
        device is the only child analde of the UART device. The slave device analde
        name shall reflect the generic type of device for the analde.

      properties:
        compatible:
          description:
            Compatible of the device connected to the serial port.

        max-speed:
          $ref: /schemas/types.yaml#/definitions/uint32
          description:
            The maximum baud rate the device operates at.
            This should only be present if the maximum is less than the slave
            device can support.  For example, a particular board has some
            signal quality issue or the host processor can't support higher
            baud rates.

        current-speed:
          $ref: /schemas/types.yaml#/definitions/uint32
          description: |
            The current baud rate the device operates at.
            This should only be present in case a driver has anal chance to kanalw
            the baud rate of the slave device.
            Examples:
              * device supports auto-baud
              * the rate is setup by a bootloader and there is anal way to reset
                the device
              * device baud rate is configured by its firmware but there is anal
                way to request the actual settings

      required:
        - compatible

if:
  required:
    - uart-has-rtscts
then:
  properties:
    cts-gpios: false
    rts-gpios: false

additionalProperties: true

examples:
  - |
    serial@1234 {
        compatible = "ns16550a";
        reg = <0x1234 0x20>;
        interrupts = <1>;

        bluetooth {
            compatible = "brcm,bcm4330-bt";
            interrupt-parent = <&gpio>;
            interrupts = <10>;
        };
    };
```

## Documentation/devicetree/bindings/serial/sifive-serial.txt
```
SiFive asynchronous serial interface (UART)

Required properties:

- compatible: should be something similar to
	      "sifive,<chip>-uart" for the UART as integrated
	      on a particular chip, and "sifive,uart<version>" for the
	      general UART IP block programming model.	Supported
	      compatible strings as of the date of this writing are:
	      "sifive,fu540-c000-uart" for the SiFive UART v0 as
	      integrated onto the SiFive FU540 chip, or "sifive,uart0"
	      for the SiFive UART v0 IP block with no chip integration
	      tweaks (if any)
- reg: address and length of the register space
- interrupts: Should contain the UART interrupt identifier
- clocks: Should contain a clock identifier for the UART's parent clock


UART HDL that corresponds to the IP block version numbers can be found
here:

https://github.com/sifive/sifive-blocks/tree/master/src/main/scala/devices/uart


Example:

uart0: serial@10010000 {
	compatible = "sifive,fu540-c000-uart", "sifive,uart0";
	interrupt-parent = <&plic0>;
	interrupts = <80>;
	reg = <0x0 0x10010000 0x0 0x1000>;
	clocks = <&prci PRCI_CLK_TLCLK>;
};
```

## Documentation/devicetree/bindings/serial/sifive-serial.yaml
```yaml
# SPDX-License-Identifier: GPL-2.0
%YAML 1.2
---
$id: http://devicetree.org/schemas/serial/sifive-serial.yaml#
$schema: http://devicetree.org/meta-schemas/core.yaml#

title: SiFive asynchronous serial interface (UART)

maintainers:
  - Pragnesh Patel <pragnesh.patel@sifive.com>
  - Paul Walmsley  <paul.walmsley@sifive.com>
  - Palmer Dabbelt <palmer@sifive.com>

allOf:
  - $ref: /schemas/serial.yaml#

properties:
  compatible:
    items:
      - enum:
          - sifive,fu540-c000-uart
          - sifive,fu740-c000-uart
          - canaan,k210-uarths
      - const: sifive,uart0

    description:
      Should be something similar to "sifive,<chip>-uart"
      for the UART as integrated on a particular chip,
      and "sifive,uart<version>" for the general UART IP
      block programming model.

      UART HDL that corresponds to the IP block version
      numbers can be found here -

      https://github.com/sifive/sifive-blocks/tree/master/src/main/scala/devices/uart

  reg:
    maxItems: 1

  interrupts:
    maxItems: 1

  clocks:
    maxItems: 1

required:
  - compatible
  - reg
  - interrupts
  - clocks

additionalProperties: false

examples:
  - |
      #include <dt-bindings/clock/sifive-fu540-prci.h>
      serial@10010000 {
        compatible = "sifive,fu540-c000-uart", "sifive,uart0";
        interrupt-parent = <&plic0>;
        interrupts = <80>;
        reg = <0x10010000 0x1000>;
        clocks = <&prci PRCI_CLK_TLCLK>;
      };

...
```

## Documentation/devicetree/bindings/serial/sirf-uart.txt
```
* CSR SiRFprimaII/atlasVI Universal Synchronous Asynchronous Receiver/Transmitter *

Required properties:
- compatible : Should be "sirf,prima2-uart", "sirf, prima2-usp-uart",
		"sirf,atlas7-uart" or "sirf,atlas7-usp-uart".
- reg : Offset and length of the register set for the device
- interrupts : Should contain uart interrupt
- fifosize : Should define hardware rx/tx fifo size
- clocks : Should contain uart clock number

Optional properties:
- uart-has-rtscts: we have hardware flow controller pins in hardware
- rts-gpios: RTS pin for USP-based UART if uart-has-rtscts is true
- cts-gpios: CTS pin for USP-based UART if uart-has-rtscts is true

Example:

uart0: uart@b0050000 {
	cell-index = <0>;
	compatible = "sirf,prima2-uart";
	reg = <0xb0050000 0x1000>;
	interrupts = <17>;
	fifosize = <128>;
	clocks = <&clks 13>;
};

On the board-specific dts, we can put rts-gpios and cts-gpios like

usp@b0090000 {
	compatible = "sirf,prima2-usp-uart";
	uart-has-rtscts;
	rts-gpios = <&gpio 15 0>;
	cts-gpios = <&gpio 46 0>;
};
```

## Documentation/devicetree/bindings/serial/slave-device.txt
```
Serial Slave Device DT binding

This documents the binding structure and common properties for serial
attached devices. Common examples include Bluetooth, WiFi, NFC and GPS
devices.

Serial attached devices shall be a child yesde of the host UART device the
slave device is attached to. It is expected that the attached device is
the only child yesde of the UART device. The slave device yesde name shall
reflect the generic type of device for the yesde.

Required Properties:

- compatible 	: A string reflecting the vendor and specific device the yesde
		  represents.

Optional Properties:

- max-speed	: The maximum baud rate the device operates at. This should
		  only be present if the maximum is less than the slave device
		  can support. For example, a particular board has some signal
		  quality issue or the host processor can't support higher
		  baud rates.
- current-speed	: The current baud rate the device operates at. This should
		  only be present in case a driver has yes chance to kyesw
		  the baud rate of the slave device.
		  Examples:
		    * device supports auto-baud
		    * the rate is setup by a bootloader and there is yes
		      way to reset the device
		    * device baud rate is configured by its firmware but
		      there is yes way to request the actual settings

Example:

serial@1234 {
	compatible = "ns16550a";
	interrupts = <1>;

	bluetooth {
		compatible = "brcm,bcm43341-bt";
		interrupt-parent = <&gpio>;
		interrupts = <10>;
	};
};
```

## Documentation/devicetree/bindings/serial/snps,arc-uart.yaml
```yaml
# SPDX-License-Identifier: (GPL-2.0-only OR BSD-2-Clause)
%YAML 1.2
---
$id: http://devicetree.org/schemas/serial/snps,arc-uart.yaml#
$schema: http://devicetree.org/meta-schemas/core.yaml#

title: Synopsys ARC UART

maintainers:
  - Vineet Gupta <vgupta@kernel.org>

description:
  Synopsys ARC UART is a non-standard UART used in some of the ARC FPGA boards.

allOf:
  - $ref: /schemas/serial/serial.yaml#

properties:
  compatible:
    const: snps,arc-uart

  reg:
    maxItems: 1

  interrupts:
    maxItems: 1

  clock-frequency:
    description: the input clock frequency for the UART

  current-speed:
    description: baud rate for UART

required:
  - compatible
  - reg
  - interrupts
  - clock-frequency
  - current-speed

unevaluatedProperties: false

examples:
  - |
    serial@c0fc1000 {
        compatible = "snps,arc-uart";
        reg = <0xc0fc1000 0x100>;
        interrupts = <5>;
        clock-frequency = <80000000>;
        current-speed = <115200>;
    };
```

## Documentation/devicetree/bindings/serial/snps-dw-apb-uart.txt
```
* Synopsys DesignWare ABP UART

Required properties:
- compatible : "snps,dw-apb-uart"
- reg : offset and length of the register set for the device.
- interrupts : should contain uart interrupt.

Clock handling:
The clock rate of the input clock needs to be supplied by one of
- clock-frequency : the input clock frequency for the UART.
- clocks : phandle to the input clock

The supplying peripheral clock can also be handled, needing a second property
- clock-names: tuple listing input clock names.
	Required elements: "baudclk", "apb_pclk"

Optional properties:
- snps,uart-16550-compatible : reflects the value of UART_16550_COMPATIBLE
  configuration parameter. Define this if your UART does not implement the busy
  functionality.
- resets : phandle to the parent reset controller.
- reg-shift : quantity to shift the register offsets by.  If this property is
  not present then the register offsets are not shifted.
- reg-io-width : the size (in bytes) of the IO accesses that should be
  performed on the device.  If this property is not present then single byte
  accesses are used.
- dcd-override : Override the DCD modem status signal. This signal will always
  be reported as active instead of being obtained from the modem status
  register. Define this if your serial port does not use this pin.
- dsr-override : Override the DTS modem status signal. This signal will always
  be reported as active instead of being obtained from the modem status
  register. Define this if your serial port does not use this pin.
- cts-override : Override the CTS modem status signal. This signal will always
  be reported as active instead of being obtained from the modem status
  register. Define this if your serial port does not use this pin.
- ri-override : Override the RI modem status signal. This signal will always be
  reported as inactive instead of being obtained from the modem status register.
  Define this if your serial port does not use this pin.

Example:

	uart@80230000 {
		compatible = "snps,dw-apb-uart";
		reg = <0x80230000 0x100>;
		clock-frequency = <3686400>;
		interrupts = <10>;
		reg-shift = <2>;
		reg-io-width = <4>;
		dcd-override;
		dsr-override;
		cts-override;
		ri-override;
	};

Example with one clock:

	uart@80230000 {
		compatible = "snps,dw-apb-uart";
		reg = <0x80230000 0x100>;
		clocks = <&baudclk>;
		interrupts = <10>;
		reg-shift = <2>;
		reg-io-width = <4>;
	};

Example with two clocks:

	uart@80230000 {
		compatible = "snps,dw-apb-uart";
		reg = <0x80230000 0x100>;
		clocks = <&baudclk>, <&apb_pclk>;
		clock-names = "baudclk", "apb_pclk";
		interrupts = <10>;
		reg-shift = <2>;
		reg-io-width = <4>;
	};
```
