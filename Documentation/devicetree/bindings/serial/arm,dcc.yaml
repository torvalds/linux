## Documentation/devicetree/bindings/serial/arm,dcc.yaml
```yaml
# SPDX-License-Identifier: (GPL-2.0-only OR BSD-2-Clause)
%YAML 1.2
---
$id: http://devicetree.org/schemas/serial/arm,dcc.yaml#
$schema: http://devicetree.org/meta-schemas/core.yaml#

title: ARM DCC (Data communication channel) serial emulation

maintainers:
  - Michal Simek <michal.simek@amd.com>

description: |
  ARM DCC (Data communication channel) serial emulation interface available
  via JTAG can be also used as one of serial line tightly coupled with every
  ARM CPU available in the system.

properties:
  compatible:
    const: arm,dcc

required:
  - compatible

additionalProperties: false

examples:
  - |
    serial {
      compatible = "arm,dcc";
    };
```

## Documentation/devicetree/bindings/serial/arm,mps2-uart.txt
```
ARM MPS2 UART

Required properties:
- compatible	: Should be "arm,mps2-uart"
- reg		: Address and length of the register set
- interrupts	: Reference to the UART RX, TX and overrun interrupts

Required clocking property:
- clocks	  : The input clock of the UART


Examples:

uart0: serial@40004000 {
	compatible = "arm,mps2-uart";
	reg = <0x40004000 0x1000>;
	interrupts = <0 1 12>;
	clocks = <&sysclk>;
};
```

## Documentation/devicetree/bindings/serial/arm,mps2-uart.yaml
```yaml
# SPDX-License-Identifier: (GPL-2.0-only OR BSD-2-Clause)
%YAML 1.2
---
$id: http://devicetree.org/schemas/serial/arm,mps2-uart.yaml#
$schema: http://devicetree.org/meta-schemas/core.yaml#

title: Arm MPS2 UART

maintainers:
  - Vladimir Murzin <vladimir.murzin@arm.com>

allOf:
  - $ref: /schemas/serial/serial.yaml#

properties:
  compatible:
    const: arm,mps2-uart

  reg:
    maxItems: 1

  interrupts:
    items:
      - description: RX interrupt
      - description: TX interrupt
      - description: Overrun interrupt

  clocks:
    maxItems: 1

required:
  - compatible
  - reg
  - interrupts
  - clocks

unevaluatedProperties: false

examples:
  - |
    serial@40004000 {
        compatible = "arm,mps2-uart";
        reg = <0x40004000 0x1000>;
        interrupts = <0>, <1>, <12>;
        clocks = <&sysclk>;
    };
```

## Documentation/devicetree/bindings/serial/arm,sbsa-uart.yaml
```yaml
# SPDX-License-Identifier: (GPL-2.0-only OR BSD-2-Clause)
---
$id: http://devicetree.org/schemas/serial/arm,sbsa-uart.yaml#
$schema: http://devicetree.org/meta-schemas/core.yaml#

title: ARM SBSA UART

maintainers:
  - Andre Przywara <andre.przywara@arm.com>

description:
  This UART uses a subset of the PL011 registers and consequently lives in the
  PL011 driver. It's baudrate and other communication parameters cannot be
  adjusted at runtime, so it lacks a clock specifier here.

allOf:
  - $ref: /schemas/serial/serial.yaml#

properties:
  compatible:
    const: arm,sbsa-uart

  reg:
    maxItems: 1

  interrupts:
    maxItems: 1

  current-speed:
    description: fixed baud rate set by the firmware

required:
  - compatible
  - reg
  - interrupts
  - current-speed

unevaluatedProperties: false
```

## Documentation/devicetree/bindings/serial/arm_sbsa_uart.txt
```
* ARM SBSA defined generic UART
This UART uses a subset of the PL011 registers and consequently lives
in the PL011 driver. It's baudrate and other communication parameters
cannot be adjusted at runtime, so it lacks a clock specifier here.

Required properties:
- compatible: must be "arm,sbsa-uart"
- reg: exactly one register range
- interrupts: exactly one interrupt specifier
- current-speed: the (fixed) baud rate set by the firmware
```

## Documentation/devicetree/bindings/serial/atmel,at91-usart.yaml
```yaml
# SPDX-License-Identifier: (GPL-2.0-only OR BSD-2-Clause)
# Copyright (C) 2022 Microchip Technology, Inc. and its subsidiaries
%YAML 1.2
---
$id: http://devicetree.org/schemas/serial/atmel,at91-usart.yaml#
$schema: http://devicetree.org/meta-schemas/core.yaml#

title: Atmel Universal Synchronous Asynchronous Receiver/Transmitter (USART)

maintainers:
  - Richard Genoud <richard.genoud@gmail.com>

properties:
  compatible:
    oneOf:
      - enum:
          - atmel,at91rm9200-usart
          - atmel,at91sam9260-usart
      - items:
          - const: atmel,at91rm9200-dbgu
          - const: atmel,at91rm9200-usart
      - items:
          - const: atmel,at91sam9260-dbgu
          - const: atmel,at91sam9260-usart
      - items:
          - const: microchip,sam9x60-usart
          - const: atmel,at91sam9260-usart
      - items:
          - const: microchip,sam9x60-dbgu
          - const: microchip,sam9x60-usart
          - const: atmel,at91sam9260-dbgu
          - const: atmel,at91sam9260-usart

  reg:
    maxItems: 1

  interrupts:
    maxItems: 1

  clock-names:
    minItems: 1
    items:
      - const: usart
      - const: gclk

  clocks:
    minItems: 1
    items:
      - description: USART Peripheral Clock
      - description: USART Generic Clock

  dmas:
    items:
      - description: TX DMA Channel
      - description: RX DMA Channel

  dma-names:
    items:
      - const: tx
      - const: rx

  atmel,usart-mode:
    $ref: /schemas/types.yaml#/definitions/uint32
    description:
      Must be either <AT91_USART_MODE_SPI> for SPI or
      <AT91_USART_MODE_SERIAL> for USART (found in dt-bindings/mfd/at91-usart.h).
    enum: [ 0, 1 ]

  atmel,use-dma-rx:
    type: boolean
    description: use of PDC or DMA for receiving data

  atmel,use-dma-tx:
    type: boolean
    description: use of PDC or DMA for transmitting data

  atmel,fifo-size:
    $ref: /schemas/types.yaml#/definitions/uint32
    description:
      Maximum number of data the RX and TX FIFOs can store for FIFO
      capable USARTS.
    enum: [ 16, 32 ]

required:
  - compatible
  - reg
  - interrupts
  - clock-names
  - clocks
  - atmel,usart-mode

allOf:
  - if:
      properties:
        atmel,usart-mode:
          const: 1
    then:
      allOf:
        - $ref: /schemas/spi/spi-controller.yaml#

      properties:
        atmel,use-dma-rx: false

        atmel,use-dma-tx: false

        atmel,fifo-size: false

        "#size-cells":
          const: 0

        "#address-cells":
          const: 1

      required:
        - "#size-cells"
        - "#address-cells"

    else:
      allOf:
        - $ref: /schemas/serial/serial.yaml#
        - $ref: /schemas/serial/rs485.yaml#

unevaluatedProperties: false

examples:
  - |
    #include <dt-bindings/gpio/gpio.h>
    #include <dt-bindings/interrupt-controller/irq.h>
    #include <dt-bindings/mfd/at91-usart.h>
    #include <dt-bindings/dma/at91.h>

    /* use PDC */
    usart0: serial@fff8c000 {
        compatible = "atmel,at91sam9260-usart";
        reg = <0xfff8c000 0x4000>;
        atmel,usart-mode = <AT91_USART_MODE_SERIAL>;
        interrupts = <7>;
        clocks = <&usart0_clk>;
        clock-names = "usart";
        atmel,use-dma-rx;
        atmel,use-dma-tx;
        rts-gpios = <&pioD 15 GPIO_ACTIVE_LOW>;
        cts-gpios = <&pioD 16 GPIO_ACTIVE_LOW>;
        dtr-gpios = <&pioD 17 GPIO_ACTIVE_LOW>;
        dsr-gpios = <&pioD 18 GPIO_ACTIVE_LOW>;
        dcd-gpios = <&pioD 20 GPIO_ACTIVE_LOW>;
        rng-gpios = <&pioD 19 GPIO_ACTIVE_LOW>;
    };

  - |
    #include <dt-bindings/gpio/gpio.h>
    #include <dt-bindings/interrupt-controller/irq.h>
    #include <dt-bindings/mfd/at91-usart.h>
    #include <dt-bindings/dma/at91.h>

    /* use DMA */
    usart1: serial@f001c000 {
        compatible = "atmel,at91sam9260-usart";
        reg = <0xf001c000 0x100>;
        atmel,usart-mode = <AT91_USART_MODE_SERIAL>;
        interrupts = <12 IRQ_TYPE_LEVEL_HIGH 5>;
        clocks = <&usart0_clk>;
        clock-names = "usart";
        atmel,use-dma-rx;
        atmel,use-dma-tx;
        dmas = <&dma0 2 AT91_DMA_CFG_PER_ID(3)>,
               <&dma0 2 (AT91_DMA_CFG_PER_ID(4) | AT91_DMA_CFG_FIFOCFG_ASAP)>;
        dma-names = "tx", "rx";
        atmel,fifo-size = <32>;
    };

  - |
    #include <dt-bindings/gpio/gpio.h>
    #include <dt-bindings/interrupt-controller/irq.h>
    #include <dt-bindings/mfd/at91-usart.h>
    #include <dt-bindings/dma/at91.h>

    /* SPI mode */
    spi0: spi@f001c000 {
        compatible = "atmel,at91sam9260-usart";
        reg = <0xf001c000 0x100>;
        #address-cells = <1>;
        #size-cells = <0>;
        atmel,usart-mode = <AT91_USART_MODE_SPI>;
        interrupts = <12 IRQ_TYPE_LEVEL_HIGH 5>;
        clocks = <&usart0_clk>;
        clock-names = "usart";
        dmas = <&dma0 2 AT91_DMA_CFG_PER_ID(3)>,
               <&dma0 2 (AT91_DMA_CFG_PER_ID(4) | AT91_DMA_CFG_FIFOCFG_ASAP)>;
        dma-names = "tx", "rx";
        cs-gpios = <&pioB 3 GPIO_ACTIVE_HIGH>;
    };
```

## Documentation/devicetree/bindings/serial/atmel-usart.txt
```
* Atmel Universal Synchronous Asynchronous Receiver/Transmitter (USART)

Required properties:
- compatible: Should be "atmel,<chip>-usart" or "atmel,<chip>-dbgu"
  The compatible <chip> indicated will be the first SoC to support an
  additional mode or an USART new feature.
  For the dbgu UART, use "atmel,<chip>-dbgu", "atmel,<chip>-usart"
- reg: Should contain registers location and length
- interrupts: Should contain interrupt
- clock-names: tuple listing input clock names.
	Required elements: "usart"
- clocks: phandles to input clocks.

Optional properties:
- atmel,use-dma-rx: use of PDC or DMA for receiving data
- atmel,use-dma-tx: use of PDC or DMA for transmitting data
- {rts,cts,dtr,dsr,rng,dcd}-gpios: specify a GPIO for RTS/CTS/DTR/DSR/RI/DCD line respectively.
  It will use specified PIO instead of the peripheral function pin for the USART feature.
  If unsure, don't specify this property.
- add dma bindings for dma transfer:
	- dmas: DMA specifier, consisting of a phandle to DMA controller node,
		memory peripheral interface and USART DMA channel ID, FIFO configuration.
		Refer to dma.txt and atmel-dma.txt for details.
	- dma-names: "rx" for RX channel, "tx" for TX channel.

<chip> compatible description:
- at91rm9200:  legacy USART support
- at91sam9260: generic USART implementation for SAM9 SoCs

Example:
- use PDC:
	usart0: serial@fff8c000 {
		compatible = "atmel,at91sam9260-usart";
		reg = <0xfff8c000 0x4000>;
		interrupts = <7>;
		clocks = <&usart0_clk>;
		clock-names = "usart";
		atmel,use-dma-rx;
		atmel,use-dma-tx;
		rts-gpios = <&pioD 15 GPIO_ACTIVE_LOW>;
		cts-gpios = <&pioD 16 GPIO_ACTIVE_LOW>;
		dtr-gpios = <&pioD 17 GPIO_ACTIVE_LOW>;
		dsr-gpios = <&pioD 18 GPIO_ACTIVE_LOW>;
		dcd-gpios = <&pioD 20 GPIO_ACTIVE_LOW>;
		rng-gpios = <&pioD 19 GPIO_ACTIVE_LOW>;
	};

- use DMA:
	usart0: serial@f001c000 {
		compatible = "atmel,at91sam9260-usart";
		reg = <0xf001c000 0x100>;
		interrupts = <12 4 5>;
		clocks = <&usart0_clk>;
		clock-names = "usart";
		atmel,use-dma-rx;
		atmel,use-dma-tx;
		dmas = <&dma0 2 0x3>,
		       <&dma0 2 0x204>;
		dma-names = "tx", "rx";
	};
```

## Documentation/devicetree/bindings/serial/axis,etraxfs-uart.txt
```
ETRAX FS UART

Required properties:
- compatible : "axis,etraxfs-uart"
- reg: offset and length of the register set for the device.
- interrupts: device interrupt

Optional properties:
- {dtr,dsr,rng,dcd}-gpios: specify a GPIO for DTR/DSR/RI/DCD
  line respectively.

Example:

serial@b00260000 {
	compatible = "axis,etraxfs-uart";
	reg = <0xb0026000 0x1000>;
	interrupts = <68>;
	dtr-gpios = <&sysgpio 0 GPIO_ACTIVE_LOW>;
	dsr-gpios = <&sysgpio 1 GPIO_ACTIVE_LOW>;
	rng-gpios = <&sysgpio 2 GPIO_ACTIVE_LOW>;
	dcd-gpios = <&sysgpio 3 GPIO_ACTIVE_LOW>;
};
```

## Documentation/devicetree/bindings/serial/brcm,bcm2835-aux-uart.txt
```
* BCM2835 AUXILIAR UART

Required properties:

- compatible: "brcm,bcm2835-aux-uart"
- reg: The base address of the UART register bank.
- interrupts: A single interrupt specifier.
- clocks: Clock driving the hardware; used to figure out the baud rate
  divisor.

Example:

	uart1: serial@7e215040 {
		compatible = "brcm,bcm2835-aux-uart";
		reg = <0x7e215040 0x40>;
		interrupts = <1 29>;
		clocks = <&aux BCM2835_AUX_CLOCK_UART>;
	};
```

## Documentation/devicetree/bindings/serial/brcm,bcm2835-aux-uart.yaml
```yaml
# SPDX-License-Identifier: (GPL-2.0-only OR BSD-2-Clause)
%YAML 1.2
---
$id: http://devicetree.org/schemas/serial/brcm,bcm2835-aux-uart.yaml#
$schema: http://devicetree.org/meta-schemas/core.yaml#

title: BCM2835 AUXILIARY UART

maintainers:
  - Pratik Farkase <pratikfarkase94@gmail.com>
  - Florian Fainelli <florian.fainelli@broadcom.com>
  - Stefan Wahren <wahrenst@gmx.net>

allOf:
  - $ref: serial.yaml

properties:
  compatible:
    const: brcm,bcm2835-aux-uart

  reg:
    maxItems: 1

  interrupts:
    maxItems: 1

  clocks:
    maxItems: 1

required:
  - compatible
  - reg
  - interrupts
  - clocks

unevaluatedProperties: false

examples:
  - |
    #include <dt-bindings/clock/bcm2835-aux.h>
    serial@7e215040 {
        compatible = "brcm,bcm2835-aux-uart";
        reg = <0x7e215040 0x40>;
        interrupts = <1 29>;
        clocks = <&aux BCM2835_AUX_CLOCK_UART>;
    };
```

## Documentation/devicetree/bindings/serial/brcm,bcm6345-uart.txt
```
* BCM63xx UART

Required properties:

- compatible: "brcm,bcm6345-uart"

- reg: The base address of the UART register bank.

- interrupts: A single interrupt specifier.

- clocks: Clock driving the hardware; used to figure out the baud rate
  divisor.

Example:

	uart0: serial@14e00520 {
		compatible = "brcm,bcm6345-uart";
		reg = <0x14e00520 0x18>;
		interrupt-parent = <&periph_intc>;
		interrupts = <2>;
		clocks = <&periph_clk>;
	};

	clocks {
		periph_clk: periph_clk@0 {
			compatible = "fixed-clock";
			#clock-cells = <0>;
			clock-frequency = <54000000>;
		};
	};
```

## Documentation/devicetree/bindings/serial/brcm,bcm6345-uart.yaml
```yaml
# SPDX-License-Identifier: GPL-2.0-only OR BSD-2-Clause
%YAML 1.2
---
$id: http://devicetree.org/schemas/serial/brcm,bcm6345-uart.yaml#
$schema: http://devicetree.org/meta-schemas/core.yaml#

title: BCM63xx UART

maintainers:
  - Rafał Miłecki <rafal@milecki.pl>

allOf:
  - $ref: serial.yaml#

properties:
  compatible:
    const: brcm,bcm6345-uart

  reg:
    maxItems: 1

  interrupts:
    maxItems: 1

  clocks:
    maxItems: 1

  clock-names:
    const: refclk

unevaluatedProperties: false

required:
  - reg
  - interrupts
  - clocks

examples:
  - |
    serial@14e00520 {
        compatible = "brcm,bcm6345-uart";
        reg = <0x14e00520 0x18>;
        interrupt-parent = <&periph_intc>;
        interrupts = <2>;
        clocks = <&periph_clk>;
        clock-names = "refclk";
    };
```
