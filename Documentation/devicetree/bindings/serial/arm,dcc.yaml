## Documentation/devicetree/bindings/serial/brcm,bcm7271-uart.yaml
```yaml
# SPDX-License-Identifier: (GPL-2.0-only OR BSD-2-Clause)
%YAML 1.2
---
$id: http://devicetree.org/schemas/serial/brcm,bcm7271-uart.yaml#
$schema: http://devicetree.org/meta-schemas/core.yaml#

title: Broadcom 8250 based serial port

maintainers:
  - Al Cooper <alcooperx@gmail.com>

allOf:
  - $ref: serial.yaml#

description: |+
  The Broadcom UART is based on the basic 8250 UART but with
  enhancements for more accurate high speed baud rates and support
  for DMA.

properties:
  compatible:
    items:
      - enum:
          - brcm,bcm7271-uart
          - brcm,bcm7278-uart

  reg:
    minItems: 1
    maxItems: 5

  reg-names:
    description: The UART register block and optionally the DMA register blocks.
    oneOf:
      - items:
          - const: uart
      - items:
          - const: uart
          - const: dma_arb
          - const: dma_rx
          - const: dma_tx
          - const: dma_intr2

  clocks:
    minItems: 1

  clock-names:
    const: sw_baud

  interrupts:
    minItems: 1
    maxItems: 2

  interrupt-names:
    description: The UART interrupt and optionally the DMA interrupt.
    minItems: 1
    items:
      - const: uart
      - const: dma

required:
  - compatible
  - reg
  - reg-names
  - clocks
  - clock-names
  - interrupts
  - interrupt-names

unevaluatedProperties: false

examples:
  - |
    serial@840d000 {
        compatible = "brcm,bcm7271-uart";
        reg = <0x840d000 0x20>;
        reg-names = "uart";
        interrupts = <0x0 0x62 0x4>;
        interrupt-names = "uart";
        clocks = <&scmi_clk 190>;
        clock-names = "sw_baud";
    };

    serial@840e000 {
        compatible = "brcm,bcm7271-uart";
        reg = <0x840e000 0x20>,
              <0x840e080 0x8>,
              <0x840e100 0xa8>,
              <0x840e200 0x4c>,
              <0x840e300 0x30>;
        reg-names = "uart", "dma_arb", "dma_rx", "dma_tx", "dma_intr2";
        interrupts = <0x0 0x62 0x4>, <0x0 0x75 0x4>;
        interrupt-names = "uart", "dma";
        clocks = <&scmi_clk 190>;
        clock-names = "sw_baud";
    };
```

## Documentation/devicetree/bindings/serial/cavium-uart.txt
```
* Universal Asynchronous Receiver/Transmitter (UART)

- compatible: "cavium,octeon-3860-uart"

  Compatibility with all cn3XXX, cn5XXX and cn6XXX SOCs.

- reg: The base address of the UART register bank.

- interrupts: A single interrupt specifier.

- current-speed: Optional, the current bit rate in bits per second.

Example:
	uart1: serial@1180000000c00 {
		compatible = "cavium,octeon-3860-uart","ns16550";
		reg = <0x11800 0x00000c00 0x0 0x400>;
		current-speed = <115200>;
		interrupts = <0 35>;
	};
```

## Documentation/devicetree/bindings/serial/cdns,uart.txt
```
Binding for Cadence UART Controller

Required properties:
- compatible :
  Use "xlnx,xuartps","cdns,uart-r1p8" for Zynq-7xxx SoC.
  Use "xlnx,zynqmp-uart","cdns,uart-r1p12" for Zynq Ultrascale+ MPSoC.
- reg: Should contain UART controller registers location and length.
- interrupts: Should contain UART controller interrupts.
- clocks: Must contain phandles to the UART clocks
  See ../clocks/clock-bindings.txt for details.
- clock-names: Tuple to identify input clocks, must contain "uart_clk" and "pclk"
  See ../clocks/clock-bindings.txt for details.


Example:
	uart@e0000000 {
		compatible = "cdns,uart-r1p8";
		clocks = <&clkc 23>, <&clkc 40>;
		clock-names = "uart_clk", "pclk";
		reg = <0xE0000000 0x1000>;
		interrupts = <0 27 4>;
	};
```

## Documentation/devicetree/bindings/serial/cdns,uart.yaml
```yaml
# SPDX-License-Identifier: (GPL-2.0-only OR BSD-2-Clause)
%YAML 1.2
---
$id: http://devicetree.org/schemas/serial/cdns,uart.yaml#
$schema: http://devicetree.org/meta-schemas/core.yaml#

title: Cadence UART Controller

maintainers:
  - Michal Simek <michal.simek@amd.com>

properties:
  compatible:
    oneOf:
      - description: UART controller for Zynq-7xxx SoC
        items:
          - const: xlnx,xuartps
          - const: cdns,uart-r1p8
      - description: UART controller for Zynq Ultrascale+ MPSoC
        items:
          - const: xlnx,zynqmp-uart
          - const: cdns,uart-r1p12

  reg:
    maxItems: 1

  interrupts:
    maxItems: 1

  clocks:
    maxItems: 2

  clock-names:
    items:
      - const: uart_clk
      - const: pclk

  cts-override:
    description: |
      Override the CTS modem status signal. This signal will
      always be reported as active instead of being obtained
      from the modem status register. Define this if your serial
      port does not use this pin.
    type: boolean

  power-domains:
    maxItems: 1

  resets:
    maxItems: 1

required:
  - compatible
  - reg
  - interrupts
  - clocks
  - clock-names

allOf:
  - $ref: serial.yaml#
  - $ref: rs485.yaml#
  - if:
      properties:
        compatible:
          contains:
            const: cdns,uart-r1p8
    then:
      properties:
        power-domains: false

unevaluatedProperties: false

examples:
  - |
    uart0: serial@e0000000 {
        compatible = "xlnx,xuartps", "cdns,uart-r1p8";
        clocks = <&clkc 23>, <&clkc 40>;
        clock-names = "uart_clk", "pclk";
        reg = <0xe0000000 0x1000>;
        interrupts = <0 27 4>;
    };
```

## Documentation/devicetree/bindings/serial/cirrus,clps711x-uart.txt
```
* Cirrus Logic CLPS711X Universal Asynchronous Receiver/Transmitter (UART)

Required properties:
- compatible: Should be "cirrus,clps711x-uart".
- reg: Address and length of the register set for the device.
- interrupts: Should contain UART TX and RX interrupt.
- clocks: Should contain UART core clock number.
- syscon: Phandle to SYSCON node, which contain UART control bits.

Optional properties:
- {rts,cts,dtr,dsr,rng,dcd}-gpios: specify a GPIO for RTS/CTS/DTR/DSR/RI/DCD
  line respectively.

Note: Each UART port should have an alias correctly numbered
in "aliases" node.

Example:
	aliases {
		serial0 = &uart1;
	};

	uart1: uart@80000480 {
		compatible = "cirrus,clps711x-uart";
		reg = <0x80000480 0x80>;
		interrupts = <12 13>;
		clocks = <&clks 11>;
		syscon = <&syscon1>;
		cts-gpios = <&sysgpio 0 GPIO_ACTIVE_LOW>;
		dsr-gpios = <&sysgpio 1 GPIO_ACTIVE_LOW>;
		dcd-gpios = <&sysgpio 2 GPIO_ACTIVE_LOW>;
	};
```

## Documentation/devicetree/bindings/serial/cirrus,ep7209-uart.yaml
```yaml
# SPDX-License-Identifier: (GPL-2.0-only OR BSD-2-Clause)
%YAML 1.2
---
$id: http://devicetree.org/schemas/serial/cirrus,ep7209-uart.yaml#
$schema: http://devicetree.org/meta-schemas/core.yaml#

title: Cirrus Logic CLPS711X Universal Asynchronous Receiver/Transmitter (UART)

maintainers:
  - Alexander Shiyan <shc_work@mail.ru>

allOf:
  - $ref: /schemas/serial/serial.yaml#

properties:
  compatible:
    const: cirrus,ep7209-uart

  reg:
    maxItems: 1

  interrupts:
    items:
      - description: UART TX interrupt
      - description: UART RX interrupt

  clocks:
    maxItems: 1

  syscon:
    description: Phandle to SYSCON node, which contains UART control bits.
    $ref: /schemas/types.yaml#/definitions/phandle

required:
  - compatible
  - reg
  - interrupts
  - clocks
  - syscon

unevaluatedProperties: false

examples:
  - |
    #include <dt-bindings/gpio/gpio.h>

    serial@80000480 {
        compatible = "cirrus,ep7209-uart";
        reg = <0x80000480 0x80>;
        interrupts = <12>, <13>;
        clocks = <&clks 11>;
        syscon = <&syscon1>;
        cts-gpios = <&sysgpio 0 GPIO_ACTIVE_LOW>;
        dsr-gpios = <&sysgpio 1 GPIO_ACTIVE_LOW>;
        dcd-gpios = <&sysgpio 2 GPIO_ACTIVE_LOW>;
    };
```

## Documentation/devicetree/bindings/serial/cnxt,cx92755-usart.yaml
```yaml
# SPDX-License-Identifier: (GPL-2.0-only OR BSD-2-Clause)
%YAML 1.2
---
$id: http://devicetree.org/schemas/serial/cnxt,cx92755-usart.yaml#
$schema: http://devicetree.org/meta-schemas/core.yaml#

title: Conexant Digicolor USART

maintainers:
  - Baruch Siach <baruch@tkos.co.il>

description: >
  Note: this binding is only applicable for using the USART peripheral as UART.
  USART also support synchronous serial protocols like SPI and I2S.
  Use the binding that matches the wiring of your system.

allOf:
  - $ref: /schemas/serial/serial.yaml#

properties:
  compatible:
    const: cnxt,cx92755-usart

  reg:
    maxItems: 1

  clocks:
    maxItems: 1

  interrupts:
    maxItems: 1

required:
  - compatible
  - reg
  - clocks
  - interrupts

unevaluatedProperties: false

examples:
  - |
    serial@f0000740 {
        compatible = "cnxt,cx92755-usart";
        reg = <0xf0000740 0x20>;
        clocks = <&main_clk>;
        interrupts = <44>;
    };
```

## Documentation/devicetree/bindings/serial/digicolor-usart.txt
```
Binding for Conexant Digicolor USART

Note: this binding is only applicable for using the USART peripheral as
UART. USART also support synchronous serial protocols like SPI and I2S. Use
the binding that matches the wiring of your system.

Required properties:
- compatible : should be "cnxt,cx92755-usart".
- reg: Should contain USART controller registers location and length.
- interrupts: Should contain a single USART controller interrupt.
- clocks: Must contain phandles to the USART clock
  See ../clocks/clock-bindings.txt for details.

Note: Each UART port should have an alias correctly numbered
in "aliases" node.

Example:
	aliases {
		serial0 = &uart0;
	};

	uart0: uart@f0000740 {
		compatible = "cnxt,cx92755-usart";
		reg = <0xf0000740 0x20>;
		clocks = <&main_clk>;
		interrupts = <44>;
	};
```

## Documentation/devicetree/bindings/serial/efm32-uart.txt
```
* Energymicro efm32 UART

Required properties:
- compatible : Should be "energymicro,efm32-uart"
- reg : Address and length of the register set
- interrupts : Should contain uart interrupt

Optional properties:
- energymicro,location : Decides the location of the USART I/O pins.
  Allowed range : [0 .. 5]
  Default: 0

Example:

uart@4000c400 {
	compatible = "energymicro,efm32-uart";
	reg = <0x4000c400 0x400>;
	interrupts = <15>;
	energymicro,location = <0>;
};
```

## Documentation/devicetree/bindings/serial/esp,esp32-acm.yaml
```yaml
# SPDX-License-Identifier: GPL-2.0-only OR BSD-2-Clause

%YAML 1.2
---
$id: http://devicetree.org/schemas/serial/esp,esp32-acm.yaml#
$schema: http://devicetree.org/meta-schemas/core.yaml#

title: ESP32S3 ACM gadget controller

maintainers:
  - Max Filippov <jcmvbkbc@gmail.com>

description:
  Fixed function USB CDC-ACM gadget controller of the Espressif ESP32S3 SoC.

allOf:
  - $ref: serial.yaml#

properties:
  compatible:
    const: esp,esp32s3-acm

  reg:
    maxItems: 1

  interrupts:
    maxItems: 1

required:
  - compatible
  - reg
  - interrupts

additionalProperties: false

examples:
  - |
    serial@60038000 {
      compatible = "esp,esp32s3-acm";
      reg = <0x60038000 0x1000>;
      interrupts = <96 3 0>;
    };
```

## Documentation/devicetree/bindings/serial/esp,esp32-uart.yaml
```yaml
# SPDX-License-Identifier: GPL-2.0-only OR BSD-2-Clause

%YAML 1.2
---
$id: http://devicetree.org/schemas/serial/esp,esp32-uart.yaml#
$schema: http://devicetree.org/meta-schemas/core.yaml#

title: ESP32xx UART controllers

maintainers:
  - Max Filippov <jcmvbkbc@gmail.com>

description:
  ESP32 UART controller is a part of the ESP32 SoC.
  ESP32S3 UART controller is a part of the ESP32S3 SoC.
  Both SoCs are produced by Espressif Systems Co. Ltd.

allOf:
  - $ref: serial.yaml#

properties:
  compatible:
    enum:
      - esp,esp32-uart
      - esp,esp32s3-uart

  reg:
    maxItems: 1

  interrupts:
    maxItems: 1

  clocks:
    maxItems: 1

required:
  - compatible
  - reg
  - interrupts
  - clocks

additionalProperties: false

examples:
  - |
    serial@60000000 {
      compatible = "esp,esp32s3-uart";
      reg = <0x60000000 0x80>;
      interrupts = <27 1 0>;
      clocks = <&serial_clk>;
    };
```

## Documentation/devicetree/bindings/serial/fsl,s32-linflexuart.txt
```
* Freescale LINFlexD UART

The LINFlexD controller implements several LIN protocol versions, as well as
support for full-duplex UART communication through 8-bit and 9-bit frames.

See chapter 47 ("LINFlexD") in the reference manual[1].

Required properties:
- compatible :
  - "fsl,s32v234-linflexuart" for LINFlexD configured in UART mode, which
    is compatible with the one integrated on S32V234 SoC
- reg : Address and length of the register set for the device
- interrupts : Should contain uart interrupt

Example:
uart0: serial@40053000 {
	compatible = "fsl,s32v234-linflexuart";
	reg = <0x0 0x40053000 0x0 0x1000>;
	interrupts = <0 59 4>;
};

[1] https://www.nxp.com/webapp/Download?colCode=S32V234RM
```

## Documentation/devicetree/bindings/serial/fsl,s32-linflexuart.yaml
```yaml
# SPDX-License-Identifier: (GPL-2.0-only OR BSD-2-Clause)
%YAML 1.2
---
$id: http://devicetree.org/schemas/serial/fsl,s32-linflexuart.yaml#
$schema: http://devicetree.org/meta-schemas/core.yaml#

title: Freescale LINFlexD UART

description: |
  The LINFlexD controller implements several LIN protocol versions, as well
  as support for full-duplex UART communication through 8-bit and 9-bit
  frames. See chapter 47 ("LINFlexD") in the reference manual
  https://www.nxp.com/webapp/Download?colCode=S32V234RM.

maintainers:
  - Chester Lin <clin@suse.com>

allOf:
  - $ref: "serial.yaml"

properties:
  compatible:
    oneOf:
      - const: fsl,s32v234-linflexuart
      - items:
          - const: nxp,s32g2-linflexuart
          - const: fsl,s32v234-linflexuart

  reg:
    maxItems: 1

  interrupts:
    maxItems: 1

required:
  - compatible
  - reg
  - interrupts

unevaluatedProperties: false

examples:
  - |
    serial@40053000 {
        compatible = "fsl,s32v234-linflexuart";
        reg = <0x40053000 0x1000>;
        interrupts = <0 59 4>;
    };
```
