## Documentation/devicetree/bindings/serial/qcom,msm-uartdm.txt
```
* MSM Serial UARTDM

The MSM serial UARTDM hardware is designed for high-speed use cases where the
transmit and/or receive channels can be offloaded to a dma-engine. From a
software perspective it's mostly compatible with the MSM serial UART except
that it supports reading and writing multiple characters at a time.

Required properties:
- compatible: Should contain at least "qcom,msm-uartdm".
              A more specific property should be specified as follows depending
	      on the version:
		"qcom,msm-uartdm-v1.1"
		"qcom,msm-uartdm-v1.2"
		"qcom,msm-uartdm-v1.3"
		"qcom,msm-uartdm-v1.4"
- reg: Should contain UART register locations and lengths. The first
       register shall specify the main control registers. An optional second
       register location shall specify the GSBI control region.
       "qcom,msm-uartdm-v1.3" is the only compatible value that might
       need the GSBI control region.
- interrupts: Should contain UART interrupt.
- clocks: Should contain the core clock and the AHB clock.
- clock-names: Should be "core" for the core clock and "iface" for the
	       AHB clock.

Optional properties:
- dmas: Should contain dma specifiers for transmit and receive channels
- dma-names: Should contain "tx" for transmit and "rx" for receive channels
- qcom,tx-crci: Identificator <u32> for Client Rate Control Interface to be
           used with TX DMA channel. Required when using DMA for transmission
           with UARTDM v1.3 and below.
- qcom,rx-crci: Identificator <u32> for Client Rate Control Interface to be
           used with RX DMA channel. Required when using DMA for reception
           with UARTDM v1.3 and below.

Note: Aliases may be defined to ensure the correct ordering of the UARTs.
The alias serialN will result in the UART being assigned port N.  If any
serialN alias exists, then an alias must exist for each enabled UART.  The
serialN aliases should be in a .dts file instead of in a .dtsi file.

Examples:

- A uartdm v1.4 device with dma capabilities.

	serial@f991e000 {
		compatible = "qcom,msm-uartdm-v1.4", "qcom,msm-uartdm";
		reg = <0xf991e000 0x1000>;
		interrupts = <0 108 0x0>;
		clocks = <&blsp1_uart2_apps_cxc>, <&blsp1_ahb_cxc>;
		clock-names = "core", "iface";
		dmas = <&dma0 0>, <&dma0 1>;
		dma-names = "tx", "rx";
	};

- A uartdm v1.3 device without dma capabilities and part of a GSBI complex.

	serial@19c40000 {
		compatible = "qcom,msm-uartdm-v1.3", "qcom,msm-uartdm";
		reg = <0x19c40000 0x1000>,
		<0x19c00000 0x1000>;
		interrupts = <0 195 0x0>;
		clocks = <&gsbi5_uart_cxc>, <&gsbi5_ahb_cxc>;
		clock-names = "core", "iface";
	};

- serialN alias.

	aliases {
		serial0 = &uarta;
		serial1 = &uartc;
		serial2 = &uartb;
	};

	uarta: serial@12490000 {
		status = "ok";
	};

	uartb: serial@16340000 {
		status = "ok";
	};

	uartc: serial@1a240000 {
		status = "ok";
	};
```

## Documentation/devicetree/bindings/serial/qcom,msm-uartdm.yaml
```yaml
# SPDX-License-Identifier: GPL-2.0 OR BSD-2-Clause
%YAML 1.2
---
$id: http://devicetree.org/schemas/serial/qcom,msm-uartdm.yaml#
$schema: http://devicetree.org/meta-schemas/core.yaml#

title: Qualcomm MSM Serial UARTDM

maintainers:
  - Andy Gross <agross@kernel.org>
  - Bjorn Andersson <bjorn.andersson@linaro.org>
  - Krzysztof Kozlowski <krzysztof.kozlowski@linaro.org>

description: |
  The MSM serial UARTDM hardware is designed for high-speed use cases where the
  transmit and/or receive channels can be offloaded to a dma-engine. From a
  software perspective it's mostly compatible with the MSM serial UART except
  that it supports reading and writing multiple characters at a time.

  Note:: Aliases may be defined to ensure the correct ordering of the UARTs.
  The alias serialN will result in the UART being assigned port N.  If any
  serialN alias exists, then an alias must exist for each enabled UART.  The
  serialN aliases should be in a .dts file instead of in a .dtsi file.

properties:
  compatible:
    items:
      - enum:
          - qcom,msm-uartdm-v1.1
          - qcom,msm-uartdm-v1.2
          - qcom,msm-uartdm-v1.3
          - qcom,msm-uartdm-v1.4
      - const: qcom,msm-uartdm

  clocks:
    maxItems: 2

  clock-names:
    items:
      - const: core
      - const: iface

  dmas:
    maxItems: 2

  dma-names:
    items:
      - const: tx
      - const: rx

  interrupts:
    maxItems: 1

  qcom,rx-crci:
    $ref: /schemas/types.yaml#/definitions/uint32
    description:
      Identificator for Client Rate Control Interface to be used with RX DMA
      channel. Required when using DMA for reception with UARTDM v1.3 and
      below.

  qcom,tx-crci:
    $ref: /schemas/types.yaml#/definitions/uint32
    description:
      Identificator for Client Rate Control Interface to be used with TX DMA
      channel. Required when using DMA for transmission with UARTDM v1.3 and
      below.

  reg:
    minItems: 1
    items:
      - description: Main control registers
      - description: An optional second register location shall specify the GSBI control region.

required:
  - compatible
  - clock-names
  - clocks
  - interrupts
  - reg

unevaluatedProperties: false

allOf:
  - $ref: /schemas/serial/serial.yaml#

  - if:
      properties:
        compatible:
          contains:
            const: qcom,msm-uartdm-v1.3
    then:
      properties:
        reg:
          minItems: 2
    else:
      properties:
        reg:
          maxItems: 1

examples:
  - |
    #include <dt-bindings/interrupt-controller/arm-gic.h>

    serial@f991e000 {
        compatible = "qcom,msm-uartdm-v1.4", "qcom,msm-uartdm";
        reg = <0xf991e000 0x1000>;
        interrupts = <GIC_SPI 108 IRQ_TYPE_LEVEL_HIGH>;
        clocks = <&blsp1_uart2_apps_cxc>, <&blsp1_ahb_cxc>;
        clock-names = "core", "iface";
        dmas = <&dma0 0>, <&dma0 1>;
        dma-names = "tx", "rx";
    };
```

## Documentation/devicetree/bindings/serial/qcom,sa8255p-geni-uart.yaml
```yaml
# SPDX-License-Identifier: (GPL-2.0-only OR BSD-2-Clause)
%YAML 1.2
---
$id: http://devicetree.org/schemas/serial/qcom,sa8255p-geni-uart.yaml#
$schema: http://devicetree.org/meta-schemas/core.yaml#

title: Qualcomm Geni based QUP UART interface

maintainers:
  - Praveen Talari <quic_ptalari@quicinc.com>

allOf:
  - $ref: /schemas/serial/serial.yaml#

properties:
  compatible:
    enum:
      - qcom,sa8255p-geni-uart
      - qcom,sa8255p-geni-debug-uart

  reg:
    maxItems: 1

  interrupts:
    minItems: 1
    items:
      - description: UART core irq
      - description: Wakeup irq (RX GPIO)

  interrupt-names:
    description:
      The UART interrupt and optionally the RX in-band wakeup interrupt
      as not all UART instances have a wakeup-capable interrupt routed
      via the PDC.
    minItems: 1
    items:
      - const: uart
      - const: wakeup

  power-domains:
    minItems: 2
    maxItems: 2

  power-domain-names:
    items:
      - const: power
      - const: perf

required:
  - compatible
  - reg
  - interrupts
  - power-domains
  - power-domain-names

unevaluatedProperties: false

examples:
  - |
    #include <dt-bindings/interrupt-controller/arm-gic.h>

    serial@990000 {
        compatible = "qcom,sa8255p-geni-uart";
        reg = <0x990000 0x4000>;
        interrupts = <GIC_SPI 531 IRQ_TYPE_LEVEL_HIGH>;
        power-domains = <&scmi0_pd 0>, <&scmi0_dvfs 0>;
        power-domain-names = "power", "perf";
    };
...
```

## Documentation/devicetree/bindings/serial/qcom,serial-geni-qcom.yaml
```yaml
# SPDX-License-Identifier: (GPL-2.0-only OR BSD-2-Clause)
%YAML 1.2
---
$id: http://devicetree.org/schemas/serial/qcom,serial-geni-qcom.yaml#
$schema: http://devicetree.org/meta-schemas/core.yaml#

title: Qualcomm Geni based QUP UART interface

maintainers:
  - Andy Gross <agross@kernel.org>
  - Bjorn Andersson <bjorn.andersson@linaro.org>

allOf:
  - $ref: /schemas/serial/serial.yaml#

properties:
  compatible:
    enum:
      - qcom,geni-uart
      - qcom,geni-debug-uart

  clocks:
    maxItems: 1

  clock-names:
    const: se

  interconnects:
    maxItems: 2

  interconnect-names:
    items:
      - const: qup-core
      - const: qup-config

  interrupts:
    minItems: 1
    items:
      - description: UART core irq
      - description: Wakeup irq (RX GPIO)

  operating-points-v2: true

  pinctrl-0: true
  pinctrl-1: true

  pinctrl-names:
    minItems: 1
    items:
      - const: default
      - const: sleep

  power-domains:
    maxItems: 1

  reg:
    maxItems: 1

required:
  - compatible
  - clocks
  - clock-names
  - interrupts
  - reg

unevaluatedProperties: false

examples:
  - |
    #include <dt-bindings/interrupt-controller/arm-gic.h>
    #include <dt-bindings/clock/qcom,gcc-sc7180.h>
    #include <dt-bindings/interconnect/qcom,sc7180.h>

    serial@a88000 {
        compatible = "qcom,geni-uart";
        reg = <0xa88000 0x7000>;
        interrupts = <GIC_SPI 355 IRQ_TYPE_LEVEL_HIGH>;
        clock-names = "se";
        clocks = <&gcc GCC_QUPV3_WRAP0_S0_CLK>;
        pinctrl-0 = <&qup_uart0_default>;
        pinctrl-names = "default";
        interconnects = <&qup_virt MASTER_QUP_CORE_0 0 &qup_virt SLAVE_QUP_CORE_0 0>,
                        <&gem_noc MASTER_APPSS_PROC 0 &config_noc SLAVE_QUP_0 0>;
        interconnect-names = "qup-core", "qup-config";
    };
...
```

## Documentation/devicetree/bindings/serial/rda,8810pl-uart.txt
```
RDA Micro UART

Required properties:
- compatible :  "rda,8810pl-uart" for RDA8810PL SoCs.
- reg        :  Offset and length of the register set for the device.
- interrupts :  Should contain UART interrupt.
- clocks     :  Phandle to the input clock.


Example:

		uart2: serial@20a90000 {
			compatible = "rda,8810pl-uart";
			reg = <0x20a90000 0x1000>;
			interrupts = <11 IRQ_TYPE_LEVEL_HIGH>;
			clocks = <&uart_clk>;
		};
```

## Documentation/devicetree/bindings/serial/rda,8810pl-uart.yaml
```yaml
# SPDX-License-Identifier: (GPL-2.0-only OR BSD-2-Clause)
%YAML 1.2
---
$id: http://devicetree.org/schemas/serial/rda,8810pl-uart.yaml#
$schema: http://devicetree.org/meta-schemas/core.yaml#

title: RDA Micro UART Interface

maintainers:
  - Manivannan Sadhasivam <manivannan.sadhasivam@linaro.org>

allOf:
  - $ref: serial.yaml#

properties:
  compatible:
    const: rda,8810pl-uart

  reg:
    maxItems: 1

  interrupts:
    maxItems: 1

  clocks:
    maxItems: 1

required:
  - compatible
  - reg
  - interrupts
  - clocks

unevaluatedProperties: false

examples:
  - |
    #include <dt-bindings/interrupt-controller/irq.h>

    uart3: serial@20a90000 {
      compatible = "rda,8810pl-uart";
      reg = <0x20a90000 0x1000>;
      interrupts = <11 IRQ_TYPE_LEVEL_HIGH>;
      clocks = <&uart_clk>;
    };
...
```

## Documentation/devicetree/bindings/serial/renesas,em-uart.yaml
```yaml
# SPDX-License-Identifier: (GPL-2.0-only OR BSD-2-Clause)
%YAML 1.2
---
$id: http://devicetree.org/schemas/serial/renesas,em-uart.yaml#
$schema: http://devicetree.org/meta-schemas/core.yaml#

title: Renesas EMMA Mobile UART Interface

maintainers:
  - Magnus Damm <magnus.damm@gmail.com>

properties:
  compatible:
    oneOf:
      - items:
          - enum:
              - renesas,r9a09g011-uart    # RZ/V2M
          - const: renesas,em-uart        # generic EMMA Mobile compatible UART

      - items:
          - const: renesas,em-uart        # generic EMMA Mobile compatible UART

  reg:
    maxItems: 1

  interrupts:
    maxItems: 1

  clocks:
    minItems: 1
    items:
      - description: UART functional clock
      - description: Internal clock to access the registers

  clock-names:
    minItems: 1
    items:
      - const: sclk
      - const: pclk

allOf:
  - $ref: serial.yaml#

  - if:
      properties:
        compatible:
          contains:
            const: renesas,r9a09g011-uart
    then:
      properties:
        clocks:
          minItems: 2
        clock-names:
          minItems: 2

required:
  - compatible
  - reg
  - interrupts
  - clocks
  - clock-names

unevaluatedProperties: false

examples:
  - |
    #include <dt-bindings/interrupt-controller/arm-gic.h>
    uart0: serial@e1020000 {
        compatible = "renesas,em-uart";
        reg = <0xe1020000 0x38>;
        interrupts = <GIC_SPI 8 IRQ_TYPE_LEVEL_HIGH>;
        clocks = <&usia_u0_sclk>;
        clock-names = "sclk";
    };
```
