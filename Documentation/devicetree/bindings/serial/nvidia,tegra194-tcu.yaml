## Documentation/devicetree/bindings/serial/nvidia,tegra194-tcu.yaml
```yaml
# SPDX-License-Identifier: GPL-2.0
%YAML 1.2
---
$id: http://devicetree.org/schemas/serial/nvidia,tegra194-tcu.yaml#
$schema: http://devicetree.org/meta-schemas/core.yaml#

title: NVIDIA Tegra Combined UART (TCU)

maintainers:
  - Thierry Reding <thierry.reding@gmail.com>
  - Jonathan Hunter <jonathanh@nvidia.com>

description:
  The TCU is a system for sharing a hardware UART instance among multiple
  systems within the Tegra SoC. It is implemented through a mailbox-
  based protocol where each "virtual UART" has a pair of mailboxes, one
  for transmitting and one for receiving, that is used to communicate
  with the hardware implementing the TCU.

properties:
  $nodename:
    pattern: "^serial(@.*)?$"

  compatible:
    oneOf:
      - const: nvidia,tegra194-tcu
      - items:
          - enum:
              - nvidia,tegra234-tcu
          - const: nvidia,tegra194-tcu

  mbox-names:
    items:
      - const: rx
      - const: tx

  mboxes:
    description: |
      List of phandles to mailbox channels used for receiving and
      transmitting data from and to the hardware UART.
    items:
      - description: mailbox for receiving data from hardware UART
      - description: mailbox for transmitting data to hardware UART

required:
  - compatible
  - mbox-names
  - mboxes

additionalProperties: false

examples:
  - |
    #include <dt-bindings/mailbox/tegra186-hsp.h>

    tcu: serial {
        compatible = "nvidia,tegra194-tcu";
        mboxes = <&hsp_top0 TEGRA_HSP_MBOX_TYPE_SM 0>,
                 <&hsp_aon TEGRA_HSP_MBOX_TYPE_SM 1>;
        mbox-names = "rx", "tx";
    };
```

## Documentation/devicetree/bindings/serial/nvidia,tegra20-hsuart.txt
```
NVIDIA Tegra20/Tegra30 high speed (DMA based) UART controller driver.

Required properties:
- compatible : should be,
  "nvidia,tegra20-hsuart" for Tegra20,
  "nvidia,tegra30-hsuart" for Tegra30,
  "nvidia,tegra186-hsuart" for Tegra186,
  "nvidia,tegra194-hsuart" for Tegra194.

- reg: Should contain UART controller registers location and length.
- interrupts: Should contain UART controller interrupts.
- clocks: Must contain one entry, for the module clock.
  See ../clocks/clock-bindings.txt for details.
- resets : Must contain an entry for each entry in reset-names.
  See ../reset/reset.txt for details.
- reset-names : Must include the following entries:
  - serial
- dmas : Must contain an entry for each entry in dma-names.
  See ../dma/dma.txt for details.
- dma-names : Must include the following entries:
  - rx
  - tx

Optional properties:
- nvidia,enable-modem-interrupt: Enable modem interrupts. Should be enable
		only if all 8 lines of UART controller are pinmuxed.
- nvidia,adjust-baud-rates: List of entries providing percentage of baud rate
  adjustment within a range.
  Each entry contains sets of 3 values. Range low/high and adjusted rate.
  <range_low range_high adjusted_rate>
  When baud rate set on controller falls within the range mentioned in this
  field, baud rate will be adjusted by percentage mentioned here.
  Ex: <9600 115200 200>
  Increase baud rate by 2% when set baud rate falls within range 9600 to 115200

Baud Rate tolerance:
  Standard UART devices are expected to have tolerance for baud rate error by
  -4 to +4 %. All Tegra devices till Tegra210 had this support. However,
  Tegra186 chip has a known hardware issue. UART Rx baud rate tolerance level
  is 0% to +4% in 1-stop config. Otherwise, the received data will have
  corruption/invalid framing errors. Parker errata suggests adjusting baud
  rate to be higher than the deviations observed in Tx.

  Tx deviation of connected device can be captured over scope (or noted from
  its spec) for valid range and Tegra baud rate has to be set above actual
  Tx baud rate observed. To do this we use nvidia,adjust-baud-rates

  As an example, consider there is deviation observed in Tx for baud rates as
  listed below.
  0 to 9600 has 1% deviation
  9600 to 115200 2% deviation
  This slight deviation is expcted and Tegra UART is expected to handle it. Due
  to the issue stated above, baud rate on Tegra UART should be set equal to or
  above deviation observed for avoiding frame errors.
  Property should be set like this
  nvidia,adjust-baud-rates = <0 9600 100>,
  			     <9600 115200 200>;

Example:

serial@70006000 {
	compatible = "nvidia,tegra30-hsuart", "nvidia,tegra20-hsuart";
	reg = <0x70006000 0x40>;
	reg-shift = <2>;
	interrupts = <0 36 0x04>;
	nvidia,enable-modem-interrupt;
	clocks = <&tegra_car 6>;
	resets = <&tegra_car 6>;
	reset-names = "serial";
	dmas = <&apbdma 8>, <&apbdma 8>;
	dma-names = "rx", "tx";
	nvidia,adjust-baud-rates = <1000000 4000000 136>; /* 1.36% shift */
};
```

## Documentation/devicetree/bindings/serial/nvidia,tegra20-hsuart.yaml
```yaml
# SPDX-License-Identifier: (GPL-2.0-only OR BSD-2-Clause)
%YAML 1.2
---
$id: http://devicetree.org/schemas/serial/nvidia,tegra20-hsuart.yaml#
$schema: http://devicetree.org/meta-schemas/core.yaml#

title: NVIDIA Tegra20/Tegra30 high speed (DMA based) UART controller driver

maintainers:
  - Thierry Reding <thierry.reding@gmail.com>
  - Jon Hunter <jonathanh@nvidia.com>

properties:
  compatible:
    oneOf:
      - enum:
          - nvidia,tegra20-hsuart
          - nvidia,tegra30-hsuart
          - nvidia,tegra186-hsuart
          - nvidia,tegra194-hsuart
      - items:
          - const: nvidia,tegra124-hsuart
          - const: nvidia,tegra30-hsuart

  reg:
    maxItems: 1

  interrupts:
    maxItems: 1

  clocks:
    items:
      - description: module clock

  resets:
    items:
      - description: module reset

  reset-names:
    items:
      - const: serial

  dmas:
    items:
      - description: DMA channel used for reception
      - description: DMA channel used for transmission

  dma-names:
    items:
      - const: rx
      - const: tx

  nvidia,enable-modem-interrupt:
    $ref: /schemas/types.yaml#/definitions/flag
    description: Enable modem interrupts. Should be enable only if all 8 lines of UART controller
      are pinmuxed.

  nvidia,adjust-baud-rates:
    $ref: /schemas/types.yaml#/definitions/uint32-matrix
    description: |
      List of entries providing percentage of baud rate adjustment within a range. Each entry
      contains a set of 3 values: range low/high and adjusted rate. When the baud rate set on the
      controller falls within the range mentioned in this field, the baud rate will be adjusted by
      percentage mentioned here.

      Example: <9600 115200 200>

      Increase baud rate by 2% when set baud rate falls within range 9600 to 115200.

      Standard UART devices are expected to have tolerance for baud rate error by -4 to +4 %. All
      Tegra devices till Tegra210 had this support. However, Tegra186 chip has a known hardware
      issue. UART RX baud rate tolerance level is 0% to +4% in 1-stop config. Otherwise, the
      received data will have corruption/invalid framing errors. Parker errata suggests adjusting
      baud rate to be higher than the deviations observed in TX.

      TX deviation of connected device can be captured over scope (or noted from its spec) for
      valid range and Tegra baud rate has to be set above actual TX baud rate observed. To do this
      we use nvidia,adjust-baud-rates.

      As an example, consider there is deviation observed in TX for baud rates as listed below. 0
      to 9600 has 1% deviation 9600 to 115200 2% deviation. This slight deviation is expcted and
      Tegra UART is expected to handle it. Due to the issue stated above, baud rate on Tegra UART
      should be set equal to or above deviation observed for avoiding frame errors. Property
      should be set like this:

        nvidia,adjust-baud-rates = <0 9600 100>,
                                   <9600 115200 200>;
    items:
      items:
        - description: range lower bound
        - description: range upper bound
        - description: adjustment (in permyriad, i.e. 0.01%)

required:
  - compatible
  - reg
  - interrupts
  - clocks
  - resets
  - reset-names
  - dmas
  - dma-names

allOf:
  - $ref: serial.yaml

unevaluatedProperties: false

examples:
  - |
    #include <dt-bindings/clock/tegra30-car.h>
    #include <dt-bindings/interrupt-controller/arm-gic.h>

    serial@70006000 {
        compatible = "nvidia,tegra30-hsuart";
        reg = <0x70006000 0x40>;
        interrupts = <GIC_SPI 36 IRQ_TYPE_LEVEL_HIGH>;
        nvidia,enable-modem-interrupt;
        clocks = <&tegra_car TEGRA30_CLK_UARTA>;
        resets = <&tegra_car 6>;
        reset-names = "serial";
        dmas = <&apbdma 8>, <&apbdma 8>;
        dma-names = "rx", "tx";
        nvidia,adjust-baud-rates = <1000000 4000000 136>; /* 1.36% shift */
    };
```

## Documentation/devicetree/bindings/serial/nvidia,tegra264-utc.yaml
```yaml
# SPDX-License-Identifier: (GPL-2.0-only OR BSD-2-Clause)
%YAML 1.2
---
$id: http://devicetree.org/schemas/serial/nvidia,tegra264-utc.yaml#
$schema: http://devicetree.org/meta-schemas/core.yaml#

title: NVIDIA Tegra UTC (UART Trace Controller) client

maintainers:
  - Kartik Rajput <kkartik@nvidia.com>
  - Thierry Reding <thierry.reding@gmail.com>
  - Jonathan Hunter <jonathanh@nvidia.com>

description:
  Represents a client interface of the Tegra UTC (UART Trace Controller). The
  Tegra UTC allows multiple clients within the Tegra SoC to share a physical
  UART interface. It supports up to 16 clients. Each client operates as an
  independent UART endpoint with a dedicated interrupt and 128-character TX/RX
  FIFOs.

  The Tegra UTC clients use 8-N-1 configuration and operates on a baudrate
  configured by the bootloader at the controller level.

allOf:
  - $ref: serial.yaml#

properties:
  compatible:
    const: nvidia,tegra264-utc

  reg:
    items:
      - description: TX region.
      - description: RX region.

  reg-names:
    items:
      - const: tx
      - const: rx

  interrupts:
    maxItems: 1

  tx-threshold:
    minimum: 1
    maximum: 128

  rx-threshold:
    minimum: 1
    maximum: 128

required:
  - compatible
  - reg
  - reg-names
  - interrupts
  - tx-threshold
  - rx-threshold

additionalProperties: false

examples:
  - |
    #include <dt-bindings/interrupt-controller/arm-gic.h>

    tegra_utc: serial@c4e0000 {
        compatible = "nvidia,tegra264-utc";
        reg = <0xc4e0000 0x8000>, <0xc4e8000 0x8000>;
        reg-names = "tx", "rx";
        interrupts = <GIC_SPI 514 IRQ_TYPE_LEVEL_HIGH>;
        tx-threshold = <4>;
        rx-threshold = <4>;
    };
```

## Documentation/devicetree/bindings/serial/nxp,lpc1850-uart.txt
```
* NXP LPC1850 UART

Required properties:
- compatible	: "nxp,lpc1850-uart", "ns16550a".
- reg		: offset and length of the register set for the device.
- interrupts	: should contain uart interrupt.
- clocks	: phandle to the input clocks.
- clock-names	: required elements: "uartclk", "reg".

Optional properties:
- dmas		: Two or more DMA channel specifiers following the
		  convention outlined in bindings/dma/dma.txt
- dma-names	: Names for the dma channels, if present. There must
		  be at least one channel named "tx" for transmit
		  and named "rx" for receive.

Since it's also possible to also use the of_serial.c driver all
parameters from 8250.txt also apply but are optional.

Example:
uart0: serial@40081000 {
	compatible = "nxp,lpc1850-uart", "ns16550a";
	reg = <0x40081000 0x1000>;
	reg-shift = <2>;
	interrupts = <24>;
	clocks = <&ccu2 CLK_APB0_UART0>, <&ccu1 CLK_CPU_UART0>;
	clock-names = "uartclk", "reg";
};
```

## Documentation/devicetree/bindings/serial/nxp,lpc3220-hsuart.yaml
```yaml
# SPDX-License-Identifier: (GPL-2.0-only OR BSD-2-Clause)
%YAML 1.2
---
$id: http://devicetree.org/schemas/serial/nxp,lpc3220-hsuart.yaml#
$schema: http://devicetree.org/meta-schemas/core.yaml#

title: NXP LPC32xx SoC High Speed UART

maintainers:
  - Vladimir Zapolskiy <vz@mleia.com>
  - Piotr Wojtaszczyk <piotr.wojtaszczyk@timesys.com>

allOf:
  - $ref: /schemas/serial/serial.yaml#

properties:
  compatible:
    const: nxp,lpc3220-hsuart

  reg:
    maxItems: 1

  interrupts:
    maxItems: 1

required:
  - compatible
  - reg
  - interrupts

unevaluatedProperties: false

examples:
  - |
    serial@40014000 {
        compatible = "nxp,lpc3220-hsuart";
        reg = <0x40014000 0x1000>;
        interrupts = <26 0>;
    };
```

## Documentation/devicetree/bindings/serial/nxp,sc16is7xx.txt
```
* NXP SC16IS7xx advanced Universal Asynchronous Receiver-Transmitter (UART)
* i2c as bus

Required properties:
- compatible: Should be one of the following:
  - "nxp,sc16is740" for NXP SC16IS740,
  - "nxp,sc16is741" for NXP SC16IS741,
  - "nxp,sc16is750" for NXP SC16IS750,
  - "nxp,sc16is752" for NXP SC16IS752,
  - "nxp,sc16is760" for NXP SC16IS760,
  - "nxp,sc16is762" for NXP SC16IS762.
- reg: I2C address of the SC16IS7xx device.
- interrupt-parent: The phandle for the interrupt controller that
  services interrupts for this IC.
- interrupts: Should contain the UART interrupt
- clocks: Reference to the IC source clock.

Optional properties:
- gpio-controller: Marks the device node as a GPIO controller.
- #gpio-cells: Should be two. The first cell is the GPIO number and
  the second cell is used to specify the GPIO polarity:
    0 = active high,
    1 = active low.

Example:
        sc16is750: sc16is750@51 {
                compatible = "nxp,sc16is750";
                reg = <0x51>;
                clocks = <&clk20m>;
                interrupt-parent = <&gpio3>;
                interrupts = <7 IRQ_TYPE_EDGE_FALLING>;
                gpio-controller;
                #gpio-cells = <2>;
        };

* spi as bus

Required properties:
- compatible: Should be one of the following:
  - "nxp,sc16is740" for NXP SC16IS740,
  - "nxp,sc16is741" for NXP SC16IS741,
  - "nxp,sc16is750" for NXP SC16IS750,
  - "nxp,sc16is752" for NXP SC16IS752,
  - "nxp,sc16is760" for NXP SC16IS760,
  - "nxp,sc16is762" for NXP SC16IS762.
- reg: SPI chip select number.
- interrupt-parent: The phandle for the interrupt controller that
  services interrupts for this IC.
- interrupts: Specifies the interrupt source of the parent interrupt
  controller. The format of the interrupt specifier depends on the
  parent interrupt controller.
- clocks: phandle to the IC source clock.

Optional properties:
- gpio-controller: Marks the device node as a GPIO controller.
- #gpio-cells: Should be two. The first cell is the GPIO number and
  the second cell is used to specify the GPIO polarity:
    0 = active high,
    1 = active low.

Example:
	sc16is750: sc16is750@0 {
		compatible = "nxp,sc16is750";
		reg = <0>;
		clocks = <&clk20m>;
		interrupt-parent = <&gpio3>;
		interrupts = <7 IRQ_TYPE_EDGE_FALLING>;
		gpio-controller;
		#gpio-cells = <2>;
	};
```
