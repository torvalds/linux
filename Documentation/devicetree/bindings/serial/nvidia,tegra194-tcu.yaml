## Documentation/devicetree/bindings/serial/nxp,sc16is7xx.yaml
```yaml
# SPDX-License-Identifier: (GPL-2.0-only OR BSD-2-Clause)
%YAML 1.2
---
$id: http://devicetree.org/schemas/serial/nxp,sc16is7xx.yaml#
$schema: http://devicetree.org/meta-schemas/core.yaml#

title: NXP SC16IS7xx Advanced Universal Asynchronous Receiver-Transmitter (UART)

maintainers:
  - Hugo Villeneuve <hvilleneuve@dimonoff.com>

properties:
  compatible:
    enum:
      - nxp,sc16is740
      - nxp,sc16is741
      - nxp,sc16is750
      - nxp,sc16is752
      - nxp,sc16is760
      - nxp,sc16is762

  reg:
    maxItems: 1

  interrupts:
    maxItems: 1

  clocks:
    maxItems: 1

  reset-gpios:
    maxItems: 1

  clock-frequency:
    description:
      When there is no clock provider visible to the platform, this
      is the source crystal or external clock frequency for the IC in Hz.
    minimum: 1
    maximum: 80000000

  gpio-controller: true

  "#gpio-cells":
    const: 2

  gpio-line-names:
    minItems: 1
    maxItems: 8

  irda-mode-ports:
    description: |
      An array that lists the indices of the port that should operate in IrDA
      mode:
      0: port A
      1: port B
    $ref: /schemas/types.yaml#/definitions/uint32-array
    minItems: 1
    maxItems: 2
    items:
      minimum: 0
      maximum: 1

  nxp,modem-control-line-ports:
    description: |
      An array that lists the indices of the port that should have shared GPIO
      lines configured as modem control lines:
      0: port A
      1: port B
    $ref: /schemas/types.yaml#/definitions/uint32-array
    minItems: 1
    maxItems: 2
    items:
      minimum: 0
      maximum: 1

required:
  - compatible
  - reg
  - interrupts

allOf:
  - $ref: /schemas/spi/spi-peripheral-props.yaml#
  - $ref: /schemas/serial/serial.yaml#
  - $ref: /schemas/serial/rs485.yaml#

oneOf:
  - required:
      - clocks
  - required:
      - clock-frequency

unevaluatedProperties: false

examples:
  - |
    #include <dt-bindings/interrupt-controller/irq.h>
    #include <dt-bindings/gpio/gpio.h>
    i2c {
        #address-cells = <1>;
        #size-cells = <0>;

        serial@51 {
            compatible = "nxp,sc16is750";
            reg = <0x51>;
            clocks = <&clk20m>;
            interrupt-parent = <&gpio3>;
            interrupts = <7 IRQ_TYPE_EDGE_FALLING>;
            gpio-controller;
            #gpio-cells = <2>;
        };

        serial@53 {
            compatible = "nxp,sc16is752";
            reg = <0x53>;
            clocks = <&clk20m>;
            interrupt-parent = <&gpio3>;
            interrupts = <7 IRQ_TYPE_EDGE_FALLING>;
            nxp,modem-control-line-ports = <1>; /* Port 1 as modem control lines */
            gpio-controller; /* Port 0 as GPIOs */
            #gpio-cells = <2>;
        };

        serial@54 {
            compatible = "nxp,sc16is752";
            reg = <0x54>;
            clocks = <&clk20m>;
            reset-gpios = <&gpio5 13 GPIO_ACTIVE_LOW>;
            interrupt-parent = <&gpio3>;
            interrupts = <7 IRQ_TYPE_EDGE_FALLING>;
            nxp,modem-control-line-ports = <0 1>; /* Ports 0 and 1 as modem control lines */
        };
    };
```

## Documentation/devicetree/bindings/serial/nxp-lpc32xx-hsuart.txt
```
* NXP LPC32xx SoC High Speed UART

Required properties:
- compatible: Should be "nxp,lpc3220-hsuart"
- reg: Should contain registers location and length
- interrupts: Should contain interrupt

Example:

	uart1: serial@40014000 {
		compatible = "nxp,lpc3220-hsuart";
		reg = <0x40014000 0x1000>;
		interrupts = <26 0>;
	};
```

## Documentation/devicetree/bindings/serial/of-serial.txt
```
* UART (Universal Asynchronous Receiver/Transmitter)

Required properties:
- compatible : one of:
	- "ns8250"
	- "ns16450"
	- "ns16550a"
	- "ns16550"
	- "ns16750"
	- "ns16850"
	- "nvidia,tegra20-uart"
	- "nxp,lpc3220-uart"
	- "ralink,rt2880-uart"
	- "ibm,qpace-nwp-serial"
	- "altr,16550-FIFO32"
	- "altr,16550-FIFO64"
	- "altr,16550-FIFO128"
	- "fsl,16550-FIFO64"
	- "serial" if the port type is unknown.
- reg : offset and length of the register set for the device.
- interrupts : should contain uart interrupt.
- clock-frequency : the input clock frequency for the UART
	 or
  clocks phandle to refer to the clk used as per Documentation/devicetree
  /bindings/clock/clock-bindings.txt

Optional properties:
- current-speed : the current active speed of the UART.
- reg-offset : offset to apply to the mapbase from the start of the registers.
- reg-shift : quantity to shift the register offsets by.
- reg-io-width : the size (in bytes) of the IO accesses that should be
  performed on the device.  There are some systems that require 32-bit
  accesses to the UART (e.g. TI davinci).
- used-by-rtas : set to indicate that the port is in use by the OpenFirmware
  RTAS and should not be registered.
- no-loopback-test: set to indicate that the port does not implements loopback
  test mode
- fifo-size: the fifo size of the UART.
- auto-flow-control: one way to enable automatic flow control support. The
  driver is allowed to detect support for the capability even without this
  property.

Example:

	uart@80230000 {
		compatible = "ns8250";
		reg = <0x80230000 0x100>;
		clock-frequency = <3686400>;
		interrupts = <10>;
		reg-shift = <2>;
	};
```

## Documentation/devicetree/bindings/serial/omap_serial.txt
```
OMAP UART controller

Required properties:
- compatible : should be "ti,omap2-uart" for OMAP2 controllers
- compatible : should be "ti,omap3-uart" for OMAP3 controllers
- compatible : should be "ti,omap4-uart" for OMAP4 controllers
- reg : address and length of the register space
- interrupts or interrupts-extended : Should contain the uart interrupt
                                      specifier or both the interrupt
                                      controller phandle and interrupt
                                      specifier.
- ti,hwmods : Must be "uart<n>", n being the instance number (1-based)

Optional properties:
- clock-frequency : frequency of the clock input to the UART
- dmas : DMA specifier, consisting of a phandle to the DMA controller
         node and a DMA channel number.
- dma-names : "rx" for receive channel, "tx" for transmit channel.

Example:

                uart4: serial@49042000 {
                        compatible = "ti,omap3-uart";
                        reg = <0x49042000 0x400>;
                        interrupts = <80>;
                        dmas = <&sdma 81 &sdma 82>;
                        dma-names = "tx", "rx";
                        ti,hwmods = "uart4";
                        clock-frequency = <48000000>;
                };
```

## Documentation/devicetree/bindings/serial/pl011.txt
```
* ARM AMBA Primecell PL011 serial UART

Required properties:
- compatible: must be "arm,primecell", "arm,pl011"
- reg: exactly one register range with length 0x1000
- interrupts: exactly one interrupt specifier

Optional properties:
- pinctrl:
	   When present, must have one state named "default",
	   and may contain a second name named "sleep". The former
	   state sets up pins for ordinary operation whereas
	   the latter state will put the associated pins to sleep
	   when the UART is unused
- clocks:
	   When present, the first clock listed must correspond to
	   the clock named UARTCLK on the IP block, i.e. the clock
	   to the external serial line, whereas the second clock
	   must correspond to the PCLK clocking the internal logic
	   of the block. Just listing one clock (the first one) is
	   deprecated.
- clocks-names:
	   When present, the first clock listed must be named
	   "uartclk" and the second clock listed must be named
	   "apb_pclk"
- dmas:	
	   When present, may have one or two dma channels.
	   The first one must be named "rx", the second one
	   must be named "tx".
- auto-poll:
	   Enables polling when using RX DMA.
- poll-rate-ms:
	   Rate at which poll occurs when auto-poll is set,
	   default 100ms.
- poll-timeout-ms:
	   Poll timeout when auto-poll is set, default
	   3000ms.

See also bindings/arm/primecell.txt

Example:

uart@80120000 {
	compatible = "arm,pl011", "arm,primecell";
	reg = <0x80120000 0x1000>;
	interrupts = <0 11 IRQ_TYPE_LEVEL_HIGH>;
	dmas = <&dma 13 0 0x2>, <&dma 13 0 0x0>;
	dma-names = "rx", "tx";
	clocks = <&foo_clk>, <&bar_clk>;
	clock-names = "uartclk", "apb_pclk";
};
```

## Documentation/devicetree/bindings/serial/pl011.yaml
```yaml
# SPDX-License-Identifier: GPL-2.0
%YAML 1.2
---
$id: http://devicetree.org/schemas/serial/pl011.yaml#
$schema: http://devicetree.org/meta-schemas/core.yaml#

title: ARM AMBA Primecell PL011 serial UART

maintainers:
  - Rob Herring <robh@kernel.org>

allOf:
  - $ref: serial.yaml#

# Need a custom select here or 'arm,primecell' will match on lots of nodes
select:
  properties:
    compatible:
      contains:
        enum:
          - arm,pl011
  required:
    - compatible

properties:
  compatible:
    items:
      - const: arm,pl011
      - const: arm,primecell

  reg:
    maxItems: 1

  interrupts:
    maxItems: 1

  pinctrl-0: true
  pinctrl-1: true

  pinctrl-names:
    description:
      When present, must have one state named "default",
      and may contain a second name named "sleep". The former
      state sets up pins for ordinary operation whereas
      the latter state will put the associated pins to sleep
      when the UART is unused
    minItems: 1
    items:
      - const: default
      - const: sleep

  clocks:
    description:
      When present, the first clock listed must correspond to
      the clock named UARTCLK on the IP block, i.e. the clock
      to the external serial line, whereas the second clock
      must correspond to the PCLK clocking the internal logic
      of the block. Just listing one clock (the first one) is
      deprecated.
    maxItems: 2

  clock-names:
    items:
      - const: uartclk
      - const: apb_pclk

  dmas:
    minItems: 1
    maxItems: 2

  dma-names:
    minItems: 1
    items:
      - const: rx
      - const: tx

  auto-poll:
    description:
      Enables polling when using RX DMA.
    type: boolean

  poll-rate-ms:
    description:
      Rate at which poll occurs when auto-poll is set.
      default 100ms.
    default: 100

  poll-timeout-ms:
    description:
      Poll timeout when auto-poll is set, default
      3000ms.
    default: 3000

  resets:
    maxItems: 1

required:
  - compatible
  - reg
  - interrupts

dependencies:
  poll-rate-ms: [ auto-poll ]
  poll-timeout-ms: [ auto-poll ]

unevaluatedProperties: false

examples:
  - |
    serial@80120000 {
      compatible = "arm,pl011", "arm,primecell";
      reg = <0x80120000 0x1000>;
      interrupts = <0 11 4>;
      dmas = <&dma 13 0 0x2>, <&dma 13 0 0x0>;
      dma-names = "rx", "tx";
      clocks = <&foo_clk>, <&bar_clk>;
      clock-names = "uartclk", "apb_pclk";
    };

...
```

## Documentation/devicetree/bindings/serial/qca,ar9330-uart.txt
```
* Qualcomm Atheros AR9330 High-Speed UART

Required properties:

- compatible: Must be "qca,ar9330-uart"

- reg: Specifies the physical base address of the controller and
  the length of the memory mapped region.

- interrupts: Specifies the interrupt source of the parent interrupt
  controller. The format of the interrupt specifier depends on the
  parent interrupt controller.

Additional requirements:

  Each UART port must have an alias correctly numbered in "aliases"
  node.

Example:

	aliases {
		serial0 = &uart0;
	};

	uart0: uart@18020000 {
		compatible = "qca,ar9330-uart";
		reg = <0x18020000 0x14>;

		interrupt-parent = <&intc>;
		interrupts = <3>;
	};
```

## Documentation/devicetree/bindings/serial/qca,ar9330-uart.yaml
```yaml
# SPDX-License-Identifier: (GPL-2.0-only OR BSD-2-Clause)
%YAML 1.2
---
$id: http://devicetree.org/schemas/serial/qca,ar9330-uart.yaml#
$schema: http://devicetree.org/meta-schemas/core.yaml#

title: Qualcomm Atheros AR9330 High-Speed UART

maintainers:
  - Oleksij Rempel <o.rempel@pengutronix.de>

allOf:
  - $ref: /schemas/serial.yaml#

properties:
  compatible:
    const: qca,ar9330-uart

  reg:
    maxItems: 1

  interrupts:
    maxItems: 1

  clocks:
    maxItems: 1

  clock-names:
    const: uart

required:
  - compatible
  - reg
  - interrupts
  - clocks
  - clock-names

additionalProperties: false

examples:
  - |
    serial@18020000 {
      compatible = "qca,ar9330-uart";
      reg = <0x18020000 0x14>;
      clocks = <&ref>;
      clock-names = "uart";
      interrupt-parent = <&intc>;
      interrupts = <3>;
    };
...
```

## Documentation/devicetree/bindings/serial/qcom,msm-uart.txt
```
* MSM Serial UART

The MSM serial UART hardware is designed for low-speed use cases where a
dma-engine isn't needed. From a software perspective it's mostly compatible
with the MSM serial UARTDM except that it only supports reading and writing one
character at a time.

Required properties:
- compatible: Should contain "qcom,msm-uart"
- reg: Should contain UART register location and length.
- interrupts: Should contain UART interrupt.
- clocks: Should contain the core clock.
- clock-names: Should be "core".

Example:

A uart device at 0xa9c00000 with interrupt 11.

serial@a9c00000 {
	compatible = "qcom,msm-uart";
	reg = <0xa9c00000 0x1000>;
	interrupts = <11>;
	clocks = <&uart_cxc>;
	clock-names = "core";
};
```

## Documentation/devicetree/bindings/serial/qcom,msm-uart.yaml
```yaml
# SPDX-License-Identifier: GPL-2.0 OR BSD-2-Clause
%YAML 1.2
---
$id: http://devicetree.org/schemas/serial/qcom,msm-uart.yaml#
$schema: http://devicetree.org/meta-schemas/core.yaml#

title: Qualcomm MSM SoC Serial UART

maintainers:
  - Bjorn Andersson <andersson@kernel.org>
  - Krzysztof Kozlowski <krzysztof.kozlowski@linaro.org>

description:
  The MSM serial UART hardware is designed for low-speed use cases where a
  dma-engine isn't needed. From a software perspective it's mostly compatible
  with the MSM serial UARTDM except that it only supports reading and writing
  one character at a time.

properties:
  compatible:
    const: qcom,msm-uart

  clocks:
    maxItems: 1

  clock-names:
    items:
      - const: core

  interrupts:
    maxItems: 1

  reg:
    maxItems: 1

required:
  - compatible
  - clock-names
  - clocks
  - interrupts
  - reg

unevaluatedProperties: false

allOf:
  - $ref: /schemas/serial/serial.yaml#

examples:
  - |
    serial@a9c00000 {
        compatible = "qcom,msm-uart";
        reg = <0xa9c00000 0x1000>;
        interrupts = <11>;
        clocks = <&uart_cxc>;
        clock-names = "core";
    };
```
