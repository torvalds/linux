## Documentation/devicetree/bindings/serio/allwinner,sun4i-a10-ps2.yaml
```yaml
# SPDX-License-Identifier: GPL-2.0
%YAML 1.2
---
$id: http://devicetree.org/schemas/serio/allwinner,sun4i-a10-ps2.yaml#
$schema: http://devicetree.org/meta-schemas/core.yaml#

title: Allwinner A10 PS2 Host Controller Device Tree Bindings

maintainers:
  - Chen-Yu Tsai <wens@csie.org>
  - Maxime Ripard <mripard@kernel.org>

description:
  A20 PS2 is dual role controller (PS2 host and PS2 device). These
  bindings for PS2 A10/A20 host controller. IBM compliant IBM PS2 and
  AT-compatible keyboard and mouse can be connected.

properties:
  compatible:
    const: allwinner,sun4i-a10-ps2

  reg:
    maxItems: 1

  interrupts:
    maxItems: 1

  clocks:
    maxItems: 1

required:
  - compatible
  - reg
  - interrupts
  - clocks

additionalProperties: false

examples:
  - |
    #include <dt-bindings/interrupt-controller/arm-gic.h>
    #include <dt-bindings/clock/sun7i-a20-ccu.h>

    ps20: ps2@1c2a000 {
        compatible = "allwinner,sun4i-a10-ps2";
        reg = <0x01c2a000 0x400>;
        interrupts = <GIC_SPI 62 IRQ_TYPE_LEVEL_HIGH>;
        clocks = <&ccu CLK_APB1_PS20>;
    };

...
```

## Documentation/devicetree/bindings/serio/allwinner,sun4i-ps2.txt
```
* Device tree bindings for Allwinner A10, A20 PS2 host controller

A20 PS2 is dual role controller (PS2 host and PS2 device). These bindings are
for PS2 A10/A20 host controller. IBM compliant IBM PS2 and AT-compatible keyboard
and mouse can be connected.

Required properties:

 - reg             : Offset and length of the register set for the device.
 - compatible      : Should be as of the following:
                     - "allwinner,sun4i-a10-ps2"
 - interrupts      : The interrupt line connected to the PS2.
 - clocks          : The gate clk connected to the PS2.


Example:
	ps20: ps2@0x01c2a000 {
		compatible = "allwinner,sun4i-a10-ps2";
		reg = <0x01c2a000 0x400>;
		interrupts = <0 62 4>;
		clocks = <&apb1_gates 6>;
		status = "disabled";
	};
```

## Documentation/devicetree/bindings/serio/altera_ps2.txt
```
Altera UP PS/2 controller

Required properties:
- compatible : should be "ALTR,ps2-1.0". <DEPRECATED>
- compatible : should be "altr,ps2-1.0".
```

## Documentation/devicetree/bindings/serio/arm,pl050.yaml
```yaml
# SPDX-License-Identifier: (GPL-2.0-only OR BSD-2-Clause)
%YAML 1.2
---
$id: http://devicetree.org/schemas/serio/arm,pl050.yaml#
$schema: http://devicetree.org/meta-schemas/core.yaml#

title: Arm Ltd. PrimeCell PL050 PS/2 Keyboard/Mouse Interface

maintainers:
  - Andre Przywara <andre.przywara@arm.com>

description:
  The Arm PrimeCell PS2 Keyboard/Mouse Interface (KMI) is an AMBA compliant
  peripheral that can be used to implement a keyboard or mouse interface that
  is IBM PS2 or AT compatible.

# We need a select here so we don't match all nodes with 'arm,primecell'
select:
  properties:
    compatible:
      contains:
        const: arm,pl050
  required:
    - compatible

properties:
  compatible:
    items:
      - const: arm,pl050
      - const: arm,primecell

  reg:
    maxItems: 1

  interrupts:
    maxItems: 1

  clocks:
    items:
      - description: KMI reference clock, used to generate the bus timing
      - description: APB register access clock

  clock-names:
    items:
      - const: KMIREFCLK
      - const: apb_pclk

required:
  - compatible
  - reg
  - interrupts
  - clocks
  - clock-names

additionalProperties: false

examples:
  - |
    serio@70000 {
        compatible = "arm,pl050", "arm,primecell";
        reg = <0x070000 0x1000>;
        interrupts = <8>;
        clocks = <&mb_clk24mhz>, <&soc_smc50mhz>;
        clock-names = "KMIREFCLK", "apb_pclk";
    };

...
```

## Documentation/devicetree/bindings/serio/olpc,ap-sp.txt
```
OLPC AP-SP serio interface

Required properties:
- compatible : "olpc,ap-sp"
- reg : base address and length of SoC's WTM registers
- interrupts : SP-AP interrupt

Example:
	ap-sp@d4290000 {
		compatible = "olpc,ap-sp";
		reg = <0xd4290000 0x1000>;
		interrupts = <40>;
	}
```

## Documentation/devicetree/bindings/serio/ps2-gpio.txt
```
Device-Tree binding for ps/2 gpio device

Required properties:
	- compatible = "ps2-gpio"
	- data-gpios: the data pin
	- clk-gpios: the clock pin
	- interrupts: Should trigger on the falling edge of the clock line.

Optional properties:
	- write-enable: Indicates whether write function is provided
	to serio device. Possibly providing the write fn will not work, because
	of the tough timing requirements.

Example nodes:

ps2@0 {
	compatible = "ps2-gpio";
	interrupt-parent = <&gpio>;
	interrupts = <23 IRQ_TYPE_EDGE_FALLING>;
	data-gpios = <&gpio 24 GPIO_ACTIVE_HIGH>;
	clk-gpios = <&gpio 23 GPIO_ACTIVE_HIGH>;
	write-enable;
};
```

## Documentation/devicetree/bindings/serio/ps2-gpio.yaml
```yaml
# SPDX-License-Identifier: (GPL-2.0-only OR BSD-2-Clause)
%YAML 1.2
---
$id: http://devicetree.org/schemas/serio/ps2-gpio.yaml#
$schema: http://devicetree.org/meta-schemas/core.yaml#

title: GPIO based PS/2

maintainers:
  - Danilo Krummrich <danilokrummrich@dk-develop.de>

properties:
  compatible:
    const: ps2-gpio

  data-gpios:
    description:
      the gpio used for the data signal - this should be flagged as
      active high using open drain with (GPIO_ACTIVE_HIGH | GPIO_OPEN_DRAIN)
      from <dt-bindings/gpio/gpio.h> since the signal is open drain by
      definition
    maxItems: 1

  clk-gpios:
    description:
      the gpio used for the clock signal - this should be flagged as
      active high using open drain with (GPIO_ACTIVE_HIGH | GPIO_OPEN_DRAIN)
      from <dt-bindings/gpio/gpio.h> since the signal is open drain by
      definition
    maxItems: 1

  interrupts:
    description:
      The given interrupt should trigger on the falling edge of the clock line.
    maxItems: 1

  write-enable:
    type: boolean
    description:
      Indicates whether write function is provided to serio device. Possibly
      providing the write function will not work, because of the tough timing
      requirements.

required:
  - compatible
  - data-gpios
  - clk-gpios
  - interrupts

additionalProperties: false

examples:
  - |
    #include <dt-bindings/gpio/gpio.h>
    #include <dt-bindings/interrupt-controller/irq.h>

    ps2 {
        compatible = "ps2-gpio";
        interrupt-parent = <&gpio>;
        interrupts = <23 IRQ_TYPE_EDGE_FALLING>;
        data-gpios = <&gpio 24 (GPIO_ACTIVE_HIGH | GPIO_OPEN_DRAIN)>;
        clk-gpios = <&gpio 23 (GPIO_ACTIVE_HIGH | GPIO_OPEN_DRAIN)>;
        write-enable;
    };
```

## Documentation/devicetree/bindings/serio/snps-arc_ps2.txt
```
* ARC PS/2 driver: PS/2 block used in some ARC FPGA's & nSIM OSCI model

Required properties:
- compatible		: "snps,arc_ps2"
- reg			: offset and length (always 0x14) of registers
- interrupts		: interrupt
- interrupt-names	: name of interrupt, must be "arc_ps2_irq"

Example:

serio@c9000400 {
	compatible = "snps,arc_ps2";
	reg = <0xc9000400 0x14>;
	interrupts = <13>;
	interrupt-names = "arc_ps2_irq";
}
```

## Documentation/devicetree/bindings/sifive/sifive-blocks-ip-versioning.txt
```
DT compatible string versioning for SiFive open-source IP blocks

This document describes the version specification for DT "compatible"
strings for open-source SiFive IP blocks.  HDL for these IP blocks
can be found in this public repository:

https://github.com/sifive/sifive-blocks

IP block-specific DT compatible strings are contained within the HDL,
in the form "sifive,<ip-block-name><integer version number>".

An example is "sifive,uart0" from:

https://github.com/sifive/sifive-blocks/blob/v1.0/src/main/scala/devices/uart/UART.scala#L43

Until these IP blocks (or IP integration) support version
auto-discovery, the maintainers of these IP blocks intend to increment
the suffixed number in the compatible string whenever the software
interface to these IP blocks changes, or when the functionality of the
underlying IP blocks changes in a way that software should be aware of.

Driver developers can use compatible string "match" values such as
"sifive,uart0" to indicate that their driver is compatible with the
register interface and functionality associated with the relevant
upstream sifive-blocks commits.  It is expected that most drivers will
match on these IP block-specific compatible strings.

DT data authors, when writing data for a particular SoC, should
continue to specify an SoC-specific compatible string value, such as
"sifive,fu540-c000-uart".  This way, if SoC-specific
integration-specific bug fixes or workarounds are needed, the kernel
or other system software can match on this string to apply them.  The
IP block-specific compatible string (such as "sifive,uart0") should
then be specified as a subsequent value.

An example of this style:

    compatible = "sifive,fu540-c000-uart", "sifive,uart0";
```

## Documentation/devicetree/bindings/siox/eckelmann,siox-gpio.txt
```
Eckelmann SIOX GPIO bus

Required properties:
- compatible : "eckelmann,siox-gpio"
- din-gpios, dout-gpios, dclk-gpios, dld-gpios: references gpios for the
    corresponding bus signals.

Examples:

        siox {
                compatible = "eckelmann,siox-gpio";
                pinctrl-names = "default";
                pinctrl-0 = <&pinctrl_siox>;

                din-gpios = <&gpio6 11 0>;
                dout-gpios = <&gpio6 8 0>;
                dclk-gpios = <&gpio6 9 0>;
                dld-gpios = <&gpio6 10 0>;
        };
```

## Documentation/devicetree/bindings/siox/eckelmann,siox-gpio.yaml
```yaml
# SPDX-License-Identifier: (GPL-2.0-only OR BSD-2-Clause)
%YAML 1.2
---
$id: http://devicetree.org/schemas/siox/eckelmann,siox-gpio.yaml#
$schema: http://devicetree.org/meta-schemas/core.yaml#

title: Eckelmann SIOX GPIO bus

maintainers:
  - Frank Li <Frank.Li@nxp.com>

properties:
  compatible:
    const: eckelmann,siox-gpio

  din-gpios:
    maxItems: 1

  dout-gpios:
    maxItems: 1

  dclk-gpios:
    maxItems: 1

  dld-gpios:
    maxItems: 1

required:
  - compatible
  - din-gpios
  - dout-gpios
  - dclk-gpios
  - dld-gpios

additionalProperties: false

examples:
  - |
    siox {
        compatible = "eckelmann,siox-gpio";
        pinctrl-names = "default";
        pinctrl-0 = <&pinctrl_siox>;

        din-gpios = <&gpio6 11 0>;
        dout-gpios = <&gpio6 8 0>;
        dclk-gpios = <&gpio6 9 0>;
        dld-gpios = <&gpio6 10 0>;
    };
```

## Documentation/devicetree/bindings/slimbus/bus.txt
```
SLIM(Serial Low Power Interchip Media Bus) bus

SLIMbus is a 2-wire bus, and is used to communicate with peripheral
components like audio-codec.

Required property for SLIMbus controller yesde:
- compatible	- name of SLIMbus controller

Child yesdes:
Every SLIMbus controller yesde can contain zero or more child yesdes
representing slave devices on the bus. Every SLIMbus slave device is
uniquely determined by the enumeration address containing 4 fields:
Manufacturer ID, Product code, Device index, and Instance value for
the device.
If child yesde is yest present and it is instantiated after device
discovery (slave device reporting itself present).

In some cases it may be necessary to describe yesn-probeable device
details such as yesn-standard ways of powering up a device. In
such cases, child yesdes for those devices will be present as
slaves of the SLIMbus controller, as detailed below.

Required property for SLIMbus child yesde if it is present:
- reg		- Should be ('Device index', 'Instance ID') from SLIMbus
		  Enumeration  Address.
		  Device Index Uniquely identifies multiple Devices within
		  a single Component.
		  Instance ID Is for the cases where multiple Devices of the
		  same type or Class are attached to the bus.

- compatible	-"slimMID,PID". The textual representation of Manufacturer ID,
	 	  Product Code, shall be in lower case hexadecimal with leading
		  zeroes suppressed

SLIMbus example for Qualcomm's slimbus manager component:

	slim@28080000 {
		compatible = "qcom,apq8064-slim", "qcom,slim";
		reg = <0x28080000 0x2000>,
		interrupts = <0 33 0>;
		clocks = <&lcc SLIMBUS_SRC>, <&lcc AUDIO_SLIMBUS_CLK>;
		clock-names = "iface", "core";
		#address-cells = <2>;
		#size-cell = <0>;

		codec: wcd9310@1,0{
			compatible = "slim217,60";
			reg = <1 0>;
		};
	};
```
