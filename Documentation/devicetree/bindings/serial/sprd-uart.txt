## Documentation/devicetree/bindings/serial/sprd-uart.txt
```
* Spreadtrum serial UART

Required properties:
- compatible: must be one of:
  * "sprd,sc9836-uart"
  * "sprd,sc9860-uart", "sprd,sc9836-uart"

- reg: offset and length of the register set for the device
- interrupts: exactly one interrupt specifier
- clock-names: Should contain following entries:
  "enable" for UART module enable clock,
  "uart" for UART clock,
  "source" for UART source (parent) clock.
- clocks: Should contain a clock specifier for each entry in clock-names.
  UART clock and source clock are optional properties, but enable clock
  is required.

Optional properties:
- dma-names: Should contain "rx" for receive and "tx" for transmit channels.
- dmas: A list of dma specifiers, one for each entry in dma-names.

Example:
	uart0: serial@0 {
		compatible = "sprd,sc9860-uart",
			     "sprd,sc9836-uart";
		reg = <0x0 0x100>;
		interrupts = <GIC_SPI 2 IRQ_TYPE_LEVEL_HIGH>;
		dma-names = "rx", "tx";
		dmas = <&ap_dma 19>, <&ap_dma 20>;
		clock-names = "enable", "uart", "source";
		clocks = <&clk_ap_apb_gates 9>, <&clk_uart0>, <&ext_26m>;
	};
```

## Documentation/devicetree/bindings/serial/sprd-uart.yaml
```yaml
# SPDX-License-Identifier: (GPL-2.0-only OR BSD-2-Clause)
# Copyright 2019 Unisoc Inc.
%YAML 1.2
---
$id: "http://devicetree.org/schemas/serial/sprd-uart.yaml#"
$schema: "http://devicetree.org/meta-schemas/core.yaml#"

title: Spreadtrum serial UART

maintainers:
  - Orson Zhai <orsonzhai@gmail.com>
  - Baolin Wang <baolin.wang7@gmail.com>
  - Chunyan Zhang <zhang.lyra@gmail.com>

properties:
  compatible:
    oneOf:
      - items:
          - enum:
              - sprd,sc9860-uart
              - sprd,sc9863a-uart
          - const: sprd,sc9836-uart
      - const: sprd,sc9836-uart

  reg:
    maxItems: 1

  interrupts:
    maxItems: 1

  clocks:
    minItems: 1
    maxItems: 3

  clock-names:
    description: |
      "enable" for UART module enable clock, "uart" for UART clock, "source" 
      for UART source (parent) clock.
    items:
      - const: enable
      - const: uart
      - const: source

  dmas:
    minItems: 1
    maxItems: 2

  dma-names:
    minItems: 1
    items:
      - const: rx
      - const: tx

required:
  - compatible
  - reg
  - interrupts

examples:
  - |
    #include <dt-bindings/interrupt-controller/arm-gic.h>
    serial@0 {
      compatible = "sprd,sc9860-uart", "sprd,sc9836-uart";
      reg = <0x0 0x100>;
      interrupts = <GIC_SPI 2 IRQ_TYPE_LEVEL_HIGH>;
      dma-names = "rx", "tx";
      dmas = <&ap_dma 19>, <&ap_dma 20>;
      clock-names = "enable", "uart", "source";
      clocks = <&clk_ap_apb_gates 9>, <&clk_uart0>, <&ext_26m>;
    };

...
```

## Documentation/devicetree/bindings/serial/st,asc.yaml
```yaml
# SPDX-License-Identifier: (GPL-2.0-only OR BSD-2-Clause)
%YAML 1.2
---
$id: http://devicetree.org/schemas/serial/st,asc.yaml#
$schema: http://devicetree.org/meta-schemas/core.yaml#

title: STMicroelectronics STi SoCs Serial Port

maintainers:
  - Patrice Chotard <patrice.chotard@foss.st.com>

allOf:
  - $ref: serial.yaml#

properties:
  compatible:
    const: st,asc

  reg:
    maxItems: 1

  interrupts:
    maxItems: 1

  clocks:
    maxItems: 1

  st,hw-flow-ctrl:
    description: When set, enable hardware flow control.
    type: boolean

  st,force-m1:
    description: When set, force asc to be in Mode-1. This is recommended for
      high bit rates above 19.2K.
    type: boolean

required:
  - compatible
  - reg
  - interrupts
  - clocks

unevaluatedProperties: false

examples:
  - |
    #include <dt-bindings/clock/stih407-clks.h>
    #include <dt-bindings/interrupt-controller/arm-gic.h>
    serial@9830000 {
        compatible = "st,asc";
        reg = <0x9830000 0x2c>;
        interrupts = <GIC_SPI 122 IRQ_TYPE_LEVEL_HIGH>;
        clocks = <&clk_s_c0_flexgen CLK_EXT2F_A9>;
    };
...
```

## Documentation/devicetree/bindings/serial/st,stm32-uart.yaml
```yaml
# SPDX-License-Identifier: (GPL-2.0-only OR BSD-2-Clause)
%YAML 1.2
---
$id: http://devicetree.org/schemas/serial/st,stm32-uart.yaml#
$schema: http://devicetree.org/meta-schemas/core.yaml#

maintainers:
  - Erwan Le Ray <erwan.leray@foss.st.com>

title: STMicroelectronics STM32 USART

properties:
  compatible:
    enum:
      - st,stm32-uart
      - st,stm32f7-uart
      - st,stm32h7-uart

  reg:
    maxItems: 1

  interrupts:
    maxItems: 1

  clocks:
    maxItems: 1

  resets:
    maxItems: 1

  label:
    description: label associated with this uart

  st,hw-flow-ctrl:
    description: enable hardware flow control (deprecated)
    $ref: /schemas/types.yaml#/definitions/flag

  rx-tx-swap: true

  dmas:
    minItems: 1
    maxItems: 2

  dma-names:
    items:
      enum: [ rx, tx ]
    minItems: 1
    maxItems: 2

# cts-gpios and rts-gpios properties can be used instead of 'uart-has-rtscts'
# or 'st,hw-flow-ctrl' (deprecated) for making use of any gpio pins for flow
# control instead of dedicated pins.
#
# It should be noted that both cts-gpios/rts-gpios and 'uart-has-rtscts' or
# 'st,hw-flow-ctrl' (deprecated) properties cannot co-exist in a design.
  cts-gpios: true
  rts-gpios: true

  wakeup-source: true

  rx-threshold:
    description:
      If value is set to 1, RX FIFO threshold is disabled.
    enum: [1, 2, 4, 8, 12, 14, 16]
    default: 8

  tx-threshold:
    description:
      If value is set to 1, TX FIFO threshold is disabled.
    enum: [1, 2, 4, 8, 12, 14, 16]
    default: 8

allOf:
  - $ref: rs485.yaml#
  - $ref: serial.yaml#
  - if:
      required:
        - st,hw-flow-ctrl
    then:
      properties:
        cts-gpios: false
        rts-gpios: false
  - if:
      properties:
        compatible:
          const: st,stm32-uart
    then:
      properties:
        rx-tx-swap: false
  - if:
      properties:
        compatible:
          contains:
            enum:
              - st,stm32-uart
              - st,stm32f7-uart
    then:
      properties:
        rx-threshold: false
        tx-threshold: false

required:
  - compatible
  - reg
  - interrupts
  - clocks

unevaluatedProperties: false

examples:
  - |
    #include <dt-bindings/clock/stm32mp1-clks.h>
    usart1: serial@40011000 {
      compatible = "st,stm32h7-uart";
      reg = <0x40011000 0x400>;
      interrupts = <37>;
      clocks = <&rcc 0 164>;
      dmas = <&dma2 2 4 0x414 0x0>,
             <&dma2 7 4 0x414 0x0>;
      dma-names = "rx", "tx";
      rx-threshold = <4>;
      tx-threshold = <4>;
      rs485-rts-active-low;
    };

...
```

## Documentation/devicetree/bindings/serial/st,stm32-usart.txt
```
* STMicroelectronics STM32 USART

Required properties:
- compatible: can be either:
  - "st,stm32-usart",
  - "st,stm32-uart",
  - "st,stm32f7-usart",
  - "st,stm32f7-uart",
  - "st,stm32h7-usart"
  - "st,stm32h7-uart".
  depending on whether the device supports synchronous mode
  and is compatible with stm32(f4), stm32f7 or stm32h7.
- reg: The address and length of the peripheral registers space
- interrupts:
  - The interrupt line for the USART instance,
  - An optional wake-up interrupt.
- clocks: The input clock of the USART instance

Optional properties:
- pinctrl: The reference on the pins configuration
- st,hw-flow-ctrl: bool flag to enable hardware flow control.
- dmas: phandle(s) to DMA controller node(s). Refer to stm32-dma.txt
- dma-names: "rx" and/or "tx"

Examples:
usart4: serial@40004c00 {
	compatible = "st,stm32-uart";
	reg = <0x40004c00 0x400>;
	interrupts = <52>;
	clocks = <&clk_pclk1>;
	pinctrl-names = "default";
	pinctrl-0 = <&pinctrl_usart4>;
};

usart2: serial@40004400 {
	compatible = "st,stm32-usart", "st,stm32-uart";
	reg = <0x40004400 0x400>;
	interrupts = <38>;
	clocks = <&clk_pclk1>;
	st,hw-flow-ctrl;
	pinctrl-names = "default";
	pinctrl-0 = <&pinctrl_usart2 &pinctrl_usart2_rtscts>;
};

usart1: serial@40011000 {
	compatible = "st,stm32-usart", "st,stm32-uart";
	reg = <0x40011000 0x400>;
	interrupts = <37>;
	clocks = <&rcc 0 164>;
	dmas = <&dma2 2 4 0x414 0x0>,
	       <&dma2 7 4 0x414 0x0>;
	dma-names = "rx", "tx";
};
```

## Documentation/devicetree/bindings/serial/st-asc.txt
```
*st-asc(Serial Port)

Required properties:
- compatible : Should be "st,asc".
- reg, reg-names, interrupts, interrupt-names	: Standard way to define device
			resources with names. look in
			Documentation/devicetree/bindings/resource-names.txt

Optional properties:
- st,hw-flow-ctrl	bool flag to enable hardware flow control.
- st,force-m1		bool flat to force asc to be in Mode-1 recommended
			for high bit rates (above 19.2K)
Example:
serial@fe440000{
    compatible    = "st,asc";
    reg         = <0xfe440000 0x2c>;
    interrupts     =  <0 209 0>;
};
```

## Documentation/devicetree/bindings/serial/sunplus,sp7021-uart.yaml
```yaml
# SPDX-License-Identifier: (GPL-2.0-only OR BSD-2-Clause)
# Copyright (C) Sunplus Co., Ltd. 2021
%YAML 1.2
---
$id: "http://devicetree.org/schemas/serial/sunplus,sp7021-uart.yaml#"
$schema: "http://devicetree.org/meta-schemas/core.yaml#"

title: Sunplus SoC SP7021 UART Controller Device Tree Bindings

maintainers:
  - Hammer Hsieh <hammerh0314@gmail.com>

allOf:
  - $ref: serial.yaml#

properties:
  compatible:
    const: sunplus,sp7021-uart

  reg:
    maxItems: 1

  interrupts:
    maxItems: 1

  clocks:
    maxItems: 1

  resets:
    maxItems: 1

required:
  - compatible
  - reg
  - interrupts
  - clocks
  - resets

additionalProperties: false

examples:
  - |
    #include <dt-bindings/interrupt-controller/irq.h>
    aliases {
        serial0 = &uart0;
    };

    uart0: serial@9c000900 {
        compatible = "sunplus,sp7021-uart";
        reg = <0x9c000900 0x80>;
        interrupt-parent = <&intc>;
        interrupts = <53 IRQ_TYPE_LEVEL_HIGH>;
        clocks = <&clkc 0x28>;
        resets = <&rstc 0x18>;
    };
...
```

## Documentation/devicetree/bindings/serial/uniphier-uart.txt
```
UniPhier UART controller

Required properties:
- compatible: should be "socionext,uniphier-uart".
- reg: offset and length of the register set for the device.
- interrupts: a single interrupt specifier.
- clocks: phandle to the input clock.

Optional properties:
-auto-flow-control: enable automatic flow control support.

Example:
	aliases {
		serial0 = &serial0;
	};

	serial0: serial@54006800 {
		compatible = "socionext,uniphier-uart";
		reg = <0x54006800 0x40>;
		interrupts = <0 33 4>;
		clocks = <&uart_clk>;
	};
```

## Documentation/devicetree/bindings/serial/via,vt8500-uart.txt
```
VIA/Wondermedia VT8500 UART Controller
-----------------------------------------------------

Required properties:
- compatible : "via,vt8500-uart"
- reg : Should contain 1 register ranges(address and length)
- interrupts : UART interrupt
- clocks : phandle to the uart source clock (usually a 24Mhz fixed clock)

Example:

	uart@d8210000 {
		compatible = "via,vt8500-uart";
		reg = <0xd8210000 0x1040>;
		interrupts = <47>;
		clocks = <&ref24>;
	};
```

## Documentation/devicetree/bindings/serial/via,vt8500-uart.yaml
```yaml
# SPDX-License-Identifier: (GPL-2.0-only OR BSD-2-Clause)

%YAML 1.2
---
$id: http://devicetree.org/schemas/serial/via,vt8500-uart.yaml#
$schema: http://devicetree.org/meta-schemas/core.yaml#

title: VIA VT8500 and WonderMedia WM8xxx UART Controller

maintainers:
  - Alexey Charkov <alchark@gmail.com>

allOf:
  - $ref: serial.yaml

properties:
  compatible:
    enum:
      - via,vt8500-uart # up to WM8850/WM8950
      - wm,wm8880-uart  # for WM8880 and later

  clocks:
    maxItems: 1

  interrupts:
    maxItems: 1

  reg:
    maxItems: 1

required:
  - compatible
  - clocks
  - interrupts
  - reg

unevaluatedProperties: false

examples:
  - |
    serial@d8200000 {
        compatible = "via,vt8500-uart";
        reg = <0xd8200000 0x1040>;
        interrupts = <32>;
        clocks = <&clkuart0>;
    };
```

## Documentation/devicetree/bindings/serial/vt8500-uart.txt
```
* VIA VT8500 and WonderMedia WM8xxx UART Controller

Required properties:
- compatible: should be "via,vt8500-uart"

- reg: base physical address of the controller and length of memory mapped
	region.

- interrupts: hardware interrupt number

- clocks: shall be the input parent clock phandle for the clock. This should
	be the 24Mhz reference clock.

Aliases may be defined to ensure the correct ordering of the uarts.

Example:
	aliases {
		serial0 = &uart0;
	};

	uart0: serial@d8200000 {
		compatible = "via,vt8500-uart";
		reg = <0xd8200000 0x1040>;
		interrupts = <32>;
		clocks = <&clkuart0>;
	};
```

## Documentation/devicetree/bindings/serial/xlnx,opb-uartlite.txt
```
Xilinx Axi Uartlite controller Device Tree Bindings
---------------------------------------------------------

Required properties:
- compatible		: Can be either of
				"xlnx,xps-uartlite-1.00.a"
				"xlnx,opb-uartlite-1.00.b"
- reg			: Physical base address and size of the Axi Uartlite
			  registers map.
- interrupts		: Should contain the UART controller interrupt.

Optional properties:
- port-number		: Set Uart port number
- clock-names		: Should be "s_axi_aclk"
- clocks		: Input clock specifier. Refer to common clock bindings.

Example:
serial@800c0000 {
	compatible = "xlnx,xps-uartlite-1.00.a";
	reg = <0x0 0x800c0000 0x10000>;
	interrupts = <0x0 0x6e 0x1>;
	port-number = <0>;
};
```

## Documentation/devicetree/bindings/serial/xlnx,opb-uartlite.yaml
```yaml
# SPDX-License-Identifier: GPL-2.0 OR BSD-2-Clause
%YAML 1.2
---
$id: http://devicetree.org/schemas/serial/xlnx,opb-uartlite.yaml#
$schema: http://devicetree.org/meta-schemas/core.yaml#

title: Xilinx Axi Uartlite

maintainers:
  - Peter Korsgaard <jacmet@sunsite.dk>

properties:
  compatible:
    contains:
      enum:
        - xlnx,xps-uartlite-1.00.a
        - xlnx,opb-uartlite-1.00.b

  reg:
    maxItems: 1

  interrupts:
    maxItems: 1

  port-number:
    $ref: /schemas/types.yaml#/definitions/uint32
    description: Set Uart port number

  clocks:
    maxItems: 1

  clock-names:
    const: s_axi_aclk

  current-speed:
    $ref: /schemas/types.yaml#/definitions/uint32
    description:
      The fixed baud rate that the device was configured for.

  xlnx,data-bits:
    enum: [5, 6, 7, 8]
    description:
      The fixed number of data bits that the device was configured for.

  xlnx,use-parity:
    $ref: /schemas/types.yaml#/definitions/uint32
    enum: [0, 1]
    description:
      Whether parity checking was enabled when the device was configured.

  xlnx,odd-parity:
    $ref: /schemas/types.yaml#/definitions/uint32
    enum: [0, 1]
    description:
      Whether odd parity was configured.

required:
  - compatible
  - reg
  - interrupts
  - current-speed
  - xlnx,data-bits
  - xlnx,use-parity

allOf:
  - $ref: serial.yaml#
  - if:
      properties:
        xlnx,use-parity:
          const: 1
    then:
      required:
        - xlnx,odd-parity

unevaluatedProperties: false

examples:
  - |
    serial@800c0000 {
        compatible = "xlnx,xps-uartlite-1.00.a";
        reg = <0x800c0000 0x10000>;
        interrupts = <0x0 0x6e 0x1>;
        port-number = <0>;
        current-speed = <115200>;
        xlnx,data-bits = <8>;
        xlnx,use-parity = <0>;
    };
...
```
