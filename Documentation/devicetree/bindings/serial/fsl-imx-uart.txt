## Documentation/devicetree/bindings/serial/fsl-imx-uart.txt
```
* Freescale i.MX Universal Asynchronous Receiver/Transmitter (UART)

Required properties:
- compatible : Should be "fsl,<soc>-uart"
- reg : Address and length of the register set for the device
- interrupts : Should contain uart interrupt

Optional properties:
- fsl,dte-mode : Indicate the uart works in DTE mode. The uart works
                  in DCE mode by default.
- fsl,inverted-tx , fsl,inverted-rx : Indicate that the hardware attached
  to the peripheral inverts the signal transmitted or received,
  respectively, and that the peripheral should invert its output/input
  using the INVT/INVR registers.
- rs485-rts-delay, rs485-rts-active-low, rs485-rx-during-tx,
  linux,rs485-enabled-at-boot-time: see rs485.txt. Note that for RS485
  you must enable either the "uart-has-rtscts" or the "rts-gpios"
  properties. In case you use "uart-has-rtscts" the signal that controls
  the transceiver is actually CTS_B, not RTS_B. CTS_B is always output,
  and RTS_B is input, regardless of dte-mode.

Please check Documentation/devicetree/bindings/serial/serial.yaml
for the complete list of generic properties.

Note: Each uart controller should have an alias correctly numbered
in "aliases" node.

Example:

aliases {
	serial0 = &uart1;
};

uart1: serial@73fbc000 {
	compatible = "fsl,imx51-uart", "fsl,imx21-uart";
	reg = <0x73fbc000 0x4000>;
	interrupts = <31>;
	uart-has-rtscts;
	fsl,dte-mode;
};
```

## Documentation/devicetree/bindings/serial/fsl-imx-uart.yaml
```yaml
# SPDX-License-Identifier: (GPL-2.0-only OR BSD-2-Clause)
%YAML 1.2
---
$id: http://devicetree.org/schemas/serial/fsl-imx-uart.yaml#
$schema: http://devicetree.org/meta-schemas/core.yaml#

title: Freescale i.MX Universal Asynchronous Receiver/Transmitter (UART)

maintainers:
  - Fabio Estevam <festevam@gmail.com>

properties:
  compatible:
    oneOf:
      - const: fsl,imx1-uart
      - const: fsl,imx21-uart
      - items:
          - enum:
              - fsl,imx25-uart
              - fsl,imx27-uart
              - fsl,imx31-uart
              - fsl,imx35-uart
              - fsl,imx50-uart
              - fsl,imx51-uart
              - fsl,imx53-uart
              - fsl,imx6q-uart
          - const: fsl,imx21-uart
      - items:
          - enum:
              - fsl,imx6sl-uart
              - fsl,imx6sll-uart
              - fsl,imx6sx-uart
          - const: fsl,imx6q-uart
          - const: fsl,imx21-uart
      - items:
          - enum:
              - fsl,imx6ul-uart
              - fsl,imx7d-uart
              - fsl,imx8mm-uart
              - fsl,imx8mn-uart
              - fsl,imx8mp-uart
              - fsl,imx8mq-uart
          - const: fsl,imx6q-uart

  reg:
    maxItems: 1

  clocks:
    maxItems: 2

  clock-names:
    items:
      - const: ipg
      - const: per

  dmas:
    items:
      - description: DMA controller phandle and request line for RX
      - description: DMA controller phandle and request line for TX

  dma-names:
    items:
      - const: rx
      - const: tx

  interrupts:
    items:
      - description: UART RX Interrupt
      - description: UART TX Interrupt
      - description: UART RTS Interrupt
    minItems: 1

  wakeup-source: true

  fsl,dte-mode:
    $ref: /schemas/types.yaml#/definitions/flag
    description: |
      Indicate the uart works in DTE mode. The uart works in DCE mode by default.

  fsl,inverted-tx:
    $ref: /schemas/types.yaml#/definitions/flag
    description: |
      Indicate that the hardware attached to the peripheral inverts the signal
      transmitted, and that the peripheral should invert its output using the
      INVT registers.

  fsl,inverted-rx:
    $ref: /schemas/types.yaml#/definitions/flag
    description: |
      Indicate that the hardware attached to the peripheral inverts the signal
      received, and that the peripheral should invert its input using the
      INVR registers.

  fsl,dma-info:
    $ref: /schemas/types.yaml#/definitions/uint32-array
    minItems: 2
    maxItems: 2
    description: |
      First cell contains the size of DMA buffer chunks, second cell contains
      the amount of chunks used for the device. Multiplying both numbers is
      the total size of memory used for receiving data.
      When not being configured the system will use default settings, which
      are sensible for most use cases. If you need low latency processing on
      slow connections this needs to be configured appropriately.

required:
  - compatible
  - reg
  - clocks
  - clock-names
  - interrupts

allOf:
  - $ref: serial.yaml#
  - $ref: rs485.yaml#

  - if:
      properties:
        compatible:
          contains:
            const: fsl,imx1-uart
    then:
      properties:
        interrupts:
          minItems: 3
          maxItems: 3
    else:
      properties:
        interrupts:
          maxItems: 1

unevaluatedProperties: false

examples:
  - |
    #include <dt-bindings/clock/imx5-clock.h>

    aliases {
        serial0 = &uart1;
    };

    uart1: serial@73fbc000 {
        compatible = "fsl,imx51-uart", "fsl,imx21-uart";
        reg = <0x73fbc000 0x4000>;
        interrupts = <31>;
        clocks = <&clks IMX5_CLK_UART1_IPG_GATE>,
                 <&clks IMX5_CLK_UART1_PER_GATE>;
        clock-names = "ipg", "per";
        dmas = <&sdma 18 4 1>, <&sdma 19 4 2>;
        dma-names = "rx", "tx";
        uart-has-rtscts;
        fsl,dte-mode;
    };
```

## Documentation/devicetree/bindings/serial/fsl-lpuart.txt
```
* Freescale low power universal asynchronous receiver/transmitter (lpuart)

Required properties:
- compatible :
  - "fsl,vf610-lpuart" for lpuart compatible with the one integrated
    on Vybrid vf610 SoC with 8-bit register organization
  - "fsl,ls1021a-lpuart" for lpuart compatible with the one integrated
    on LS1021A SoC with 32-bit big-endian register organization
  - "fsl,ls1028a-lpuart" for lpuart compatible with the one integrated
    on LS1028A SoC with 32-bit little-endian register organization
  - "fsl,imx7ulp-lpuart" for lpuart compatible with the one integrated
    on i.MX7ULP SoC with 32-bit little-endian register organization
  - "fsl,imx8qxp-lpuart" for lpuart compatible with the one integrated
    on i.MX8QXP SoC with 32-bit little-endian register organization
  - "fsl,imx8qm-lpuart" for lpuart compatible with the one integrated
    on i.MX8QM SoC with 32-bit little-endian register organization
- reg : Address and length of the register set for the device
- interrupts : Should contain uart interrupt
- clocks : phandle + clock specifier pairs, one for each entry in clock-names
- clock-names : For vf610/ls1021a/ls1028a/imx7ulp, "ipg" clock is for uart
  bus/baud clock. For imx8qxp lpuart, "ipg" clock is bus clock that is used
  to access lpuart controller registers, it also requires "baud" clock for
  module to receive/transmit data.

Optional properties:
- dmas: A list of two dma specifiers, one for each entry in dma-names.
- dma-names: should contain "tx" and "rx".
- rs485-rts-active-low, linux,rs485-enabled-at-boot-time: see rs485.txt

Note: Optional properties for DMA support. Write them both or both not.

Example:

uart0: serial@40027000 {
		compatible = "fsl,vf610-lpuart";
		reg = <0x40027000 0x1000>;
		interrupts = <0 61 0x00>;
		clocks = <&clks VF610_CLK_UART0>;
		clock-names = "ipg";
		dmas = <&edma0 0 2>,
			<&edma0 0 3>;
		dma-names = "rx","tx";
	};
```

## Documentation/devicetree/bindings/serial/fsl-lpuart.yaml
```yaml
# SPDX-License-Identifier: (GPL-2.0-only OR BSD-2-Clause)
%YAML 1.2
---
$id: http://devicetree.org/schemas/serial/fsl-lpuart.yaml#
$schema: http://devicetree.org/meta-schemas/core.yaml#

title: Freescale low power universal asynchronous receiver/transmitter (lpuart)

maintainers:
  - Fugang Duan <fugang.duan@nxp.com>

allOf:
  - $ref: "rs485.yaml"

properties:
  compatible:
    oneOf:
      - enum:
          - fsl,vf610-lpuart
          - fsl,ls1021a-lpuart
          - fsl,ls1028a-lpuart
          - fsl,imx7ulp-lpuart
          - fsl,imx8qxp-lpuart
          - fsl,imxrt1050-lpuart
      - items:
          - const: fsl,imx8ulp-lpuart
          - const: fsl,imx7ulp-lpuart
      - items:
          - enum:
              - fsl,imx8qm-lpuart
              - fsl,imx8dxl-lpuart
          - const: fsl,imx8qxp-lpuart

  reg:
    maxItems: 1

  interrupts:
    maxItems: 1

  clocks:
    items:
      - description: ipg clock
      - description: baud clock
    minItems: 1

  clock-names:
    items:
      - const: ipg
      - const: baud
    minItems: 1

  dmas:
    items:
      - description: DMA controller phandle and request line for RX
      - description: DMA controller phandle and request line for TX

  dma-names:
    items:
      - const: rx
      - const: tx

  rs485-rts-active-low: true
  linux,rs485-enabled-at-boot-time: true

required:
  - compatible
  - reg
  - interrupts
  - clocks
  - clock-names

unevaluatedProperties: false

examples:
  - |
    #include <dt-bindings/clock/vf610-clock.h>

    serial@40027000 {
        compatible = "fsl,vf610-lpuart";
        reg = <0x40027000 0x1000>;
        interrupts = <0 61 0x00>;
        clocks = <&clks VF610_CLK_UART0>;
        clock-names = "ipg";
        dmas = <&edma0 0 2>, <&edma0 0 3>;
        dma-names = "rx","tx";
    };
```

## Documentation/devicetree/bindings/serial/fsl-mxs-auart.txt
```
* Freescale MXS Application UART (AUART)

Required properties for all SoCs:
- compatible : Should be one of fallowing variants:
	"fsl,imx23-auart" - Freescale i.MX23
	"fsl,imx28-auart" - Freescale i.MX28
	"alphascale,asm9260-auart" - Alphascale ASM9260
- reg : Address and length of the register set for the device
- interrupts : Should contain the auart interrupt numbers
- dmas: DMA specifier, consisting of a phandle to DMA controller node
  and AUART DMA channel ID.
  Refer to dma.txt and fsl-mxs-dma.txt for details.
- dma-names: "rx" for RX channel, "tx" for TX channel.

Required properties for "alphascale,asm9260-auart":
- clocks : the clocks feeding the watchdog timer. See clock-bindings.txt
- clock-names : should be set to
	"mod" - source for tick counter.
	"ahb" - ahb gate.

Optional properties:
- uart-has-rtscts : Indicate the UART has RTS and CTS lines
  for hardware flow control,
	it also means you enable the DMA support for this UART.
- {rts,cts,dtr,dsr,rng,dcd}-gpios: specify a GPIO for RTS/CTS/DTR/DSR/RI/DCD
  line respectively. It will use specified PIO instead of the peripheral
  function pin for the USART feature.
  If unsure, don't specify this property.

Example:
auart0: serial@8006a000 {
	compatible = "fsl,imx28-auart", "fsl,imx23-auart";
	reg = <0x8006a000 0x2000>;
	interrupts = <112>;
	dmas = <&dma_apbx 8>, <&dma_apbx 9>;
	dma-names = "rx", "tx";
	cts-gpios = <&gpio1 15 GPIO_ACTIVE_LOW>;
	dsr-gpios = <&gpio1 16 GPIO_ACTIVE_LOW>;
	dcd-gpios = <&gpio1 17 GPIO_ACTIVE_LOW>;
};

Note: Each auart port should have an alias correctly numbered in "aliases"
node.

Example:

aliases {
	serial0 = &auart0;
	serial1 = &auart1;
	serial2 = &auart2;
	serial3 = &auart3;
	serial4 = &auart4;
};
```

## Documentation/devicetree/bindings/serial/fsl-mxs-auart.yaml
```yaml
# SPDX-License-Identifier: (GPL-2.0-only OR BSD-2-Clause)
%YAML 1.2
---
$id: http://devicetree.org/schemas/serial/fsl-mxs-auart.yaml#
$schema: http://devicetree.org/meta-schemas/core.yaml#

title: Freescale MXS Application UART (AUART)

maintainers:
  - Fabio Estevam <festevam@gmail.com>

allOf:
  - $ref: serial.yaml#

properties:
  compatible:
    enum:
      - fsl,imx23-auart
      - fsl,imx28-auart
      - alphascale,asm9260-auart

  reg:
    maxItems: 1

  interrupts:
    maxItems: 1

  dmas:
    items:
      - description: DMA controller phandle and request line for RX
      - description: DMA controller phandle and request line for TX

  dma-names:
    items:
      - const: rx
      - const: tx

  clocks:
    items:
      - description: mod clock
      - description: ahb clock
    minItems: 1

  clock-names:
    items:
      - const: mod
      - const: ahb
    minItems: 1

  uart-has-rtscts: true
  rts-gpios: true
  cts-gpios: true
  dtr-gpios: true
  dsr-gpios: true
  rng-gpios: true
  dcd-gpios: true

if:
  properties:
    compatible:
      contains:
        enum:
          - alphascale,asm9260-auart
then:
  required:
    - clocks
    - clock-names

required:
  - compatible
  - reg
  - interrupts
  - dmas
  - dma-names

unevaluatedProperties: false

examples:
  - |
    aliases {
        serial0 = &auart0;
    };

    auart0: serial@8006a000 {
        compatible = "fsl,imx28-auart";
        reg = <0x8006a000 0x2000>;
        interrupts = <112>;
        dmas = <&dma_apbx 8>, <&dma_apbx 9>;
        dma-names = "rx", "tx";
        clocks = <&clks 45>;
    };
```

## Documentation/devicetree/bindings/serial/google,goldfish-tty.yaml
```yaml
# SPDX-License-Identifier: (GPL-2.0-only OR BSD-2-Clause)
%YAML 1.2
---
$id: http://devicetree.org/schemas/serial/google,goldfish-tty.yaml#
$schema: http://devicetree.org/meta-schemas/core.yaml#

title: Google Goldfish TTY

maintainers:
  - Kuan-Wei Chiu <visitorckw@gmail.com>

allOf:
  - $ref: /schemas/serial/serial.yaml#

description:
  Android goldfish TTY device generated by Android emulator.

properties:
  compatible:
    const: google,goldfish-tty

  reg:
    maxItems: 1

  interrupts:
    maxItems: 1

required:
  - compatible
  - reg
  - interrupts

unevaluatedProperties: false

examples:
  - |
    serial@1f004000 {
        compatible = "google,goldfish-tty";
        reg = <0x1f004000 0x1000>;
        interrupts = <12>;
    };
```

## Documentation/devicetree/bindings/serial/ingenic,uart.txt
```
* Ingenic SoC UART

Required properties:
- compatible : "ingenic,jz4740-uart", "ingenic,jz4760-uart",
	"ingenic,jz4775-uart" or "ingenic,jz4780-uart"
- reg : offset and length of the register set for the device.
- interrupts : should contain uart interrupt.
- clocks : phandles to the module & baud clocks.
- clock-names: tuple listing input clock names.
	Required elements: "baud", "module"

Example:

uart0: serial@10030000 {
	compatible = "ingenic,jz4740-uart";
	reg = <0x10030000 0x100>;

	interrupt-parent = <&intc>;
	interrupts = <9>;

	clocks = <&ext>, <&cgu JZ4740_CLK_UART0>;
	clock-names = "baud", "module";
};
```
