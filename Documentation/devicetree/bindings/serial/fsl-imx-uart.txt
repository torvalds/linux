## Documentation/devicetree/bindings/serial/mediatek,uart.yaml
```yaml
# SPDX-License-Identifier: (GPL-2.0-only OR BSD-2-Clause)
%YAML 1.2
---
$id: http://devicetree.org/schemas/serial/mediatek,uart.yaml#
$schema: http://devicetree.org/meta-schemas/core.yaml#

title: MediaTek Universal Asynchronous Receiver/Transmitter (UART)

maintainers:
  - Matthias Brugger <matthias.bgg@gmail.com>

allOf:
  - $ref: serial.yaml#

description: |
  The MediaTek UART is based on the basic 8250 UART and compatible
  with 16550A, with enhancements for high speed baud rates and
  support for DMA.

properties:
  compatible:
    oneOf:
      - const: mediatek,mt6577-uart
      - items:
          - enum:
              - mediatek,mt2701-uart
              - mediatek,mt2712-uart
              - mediatek,mt6580-uart
              - mediatek,mt6582-uart
              - mediatek,mt6589-uart
              - mediatek,mt6755-uart
              - mediatek,mt6765-uart
              - mediatek,mt6779-uart
              - mediatek,mt6795-uart
              - mediatek,mt6797-uart
              - mediatek,mt7622-uart
              - mediatek,mt7623-uart
              - mediatek,mt7629-uart
              - mediatek,mt7986-uart
              - mediatek,mt8127-uart
              - mediatek,mt8135-uart
              - mediatek,mt8173-uart
              - mediatek,mt8183-uart
              - mediatek,mt8186-uart
              - mediatek,mt8188-uart
              - mediatek,mt8192-uart
              - mediatek,mt8195-uart
              - mediatek,mt8516-uart
          - const: mediatek,mt6577-uart

  reg:
    description: The base address of the UART register bank
    maxItems: 1

  clocks:
    minItems: 1
    items:
      - description: The clock the baudrate is derived from
      - description: The bus clock for register accesses

  clock-names:
    minItems: 1
    items:
      - const: baud
      - const: bus

  dmas:
    items:
      - description: phandle to TX DMA
      - description: phandle to RX DMA

  dma-names:
    items:
      - const: tx
      - const: rx

  interrupts:
    minItems: 1
    maxItems: 2

  interrupt-names:
    description:
      The UART interrupt and optionally the RX in-band wakeup interrupt.
    minItems: 1
    items:
      - const: uart
      - const: wakeup

  pinctrl-0: true
  pinctrl-1: true

  pinctrl-names:
    minItems: 1
    items:
      - const: default
      - const: sleep

required:
  - compatible
  - reg
  - clocks
  - interrupts

unevaluatedProperties: false

examples:
  - |
    #include <dt-bindings/interrupt-controller/arm-gic.h>

    serial@11006000 {
        compatible = "mediatek,mt6589-uart", "mediatek,mt6577-uart";
        reg = <0x11006000 0x400>;
        interrupts = <GIC_SPI 51 IRQ_TYPE_LEVEL_LOW>,
                     <GIC_SPI 52 IRQ_TYPE_EDGE_FALLING>;
        interrupt-names = "uart", "wakeup";
        clocks = <&uart_clk>, <&bus_clk>;
        clock-names = "baud", "bus";
        pinctrl-0 = <&uart_pin>;
        pinctrl-1 = <&uart_pin_sleep>;
        pinctrl-names = "default", "sleep";
    };
```

## Documentation/devicetree/bindings/serial/microchip,pic32-uart.txt
```
* Microchip Universal Asynchronous Receiver Transmitter (UART)

Required properties:
- compatible: Should be "microchip,pic32mzda-uart"
- reg: Should contain registers location and length
- interrupts: Should contain interrupt
- clocks: Phandle to the clock.
          See: Documentation/devicetree/bindings/clock/clock-bindings.txt
- pinctrl-names: A pinctrl state names "default" must be defined.
- pinctrl-0: Phandle referencing pin configuration of the UART peripheral.
             See: Documentation/devicetree/bindings/pinctrl/pinctrl-binding.txt

Optional properties:
- cts-gpios: CTS pin for UART

Example:
	uart1: serial@1f822000 {
		compatible = "microchip,pic32mzda-uart";
		reg = <0x1f822000 0x50>;
		interrupts = <112 IRQ_TYPE_LEVEL_HIGH>,
			<113 IRQ_TYPE_LEVEL_HIGH>,
			<114 IRQ_TYPE_LEVEL_HIGH>;
		clocks = <&rootclk PB2CLK>;
		pinctrl-names = "default";
		pinctrl-0 = <&pinctrl_uart1
				&pinctrl_uart1_cts
				&pinctrl_uart1_rts>;
		cts-gpios = <&gpio1 15 0>;
	};
```

## Documentation/devicetree/bindings/serial/microchip,pic32mzda-uart.yaml
```yaml
# SPDX-License-Identifier: (GPL-2.0-only OR BSD-2-Clause)
%YAML 1.2
---
$id: http://devicetree.org/schemas/serial/microchip,pic32mzda-uart.yaml#
$schema: http://devicetree.org/meta-schemas/core.yaml#

title: Microchip PIC32 UART

maintainers:
  - Andrei Pistirica <andrei.pistirica@microchip.com>
  - Purna Chandra Mandal <purna.mandal@microchip.com>

allOf:
  - $ref: /schemas/serial/serial.yaml#

properties:
  compatible:
    const: microchip,pic32mzda-uart

  reg:
    maxItems: 1

  interrupts:
    items:
      - description: Fault
      - description: RX
      - description: TX

  clocks:
    maxItems: 1

required:
  - compatible
  - reg
  - interrupts
  - clocks

unevaluatedProperties: false

examples:
  - |
    #include <dt-bindings/interrupt-controller/irq.h>
    #include <dt-bindings/clock/microchip,pic32-clock.h>

    serial@1f822000 {
        compatible = "microchip,pic32mzda-uart";
        reg = <0x1f822000 0x50>;
        interrupts = <112 IRQ_TYPE_LEVEL_HIGH>,
                    <113 IRQ_TYPE_LEVEL_HIGH>,
                    <114 IRQ_TYPE_LEVEL_HIGH>;
        clocks = <&rootclk PB2CLK>;
        cts-gpios = <&gpio1 15 0>;
    };
```

## Documentation/devicetree/bindings/serial/milbeaut-uart.txt
```
Socionext Milbeaut UART controller

Required properties:
- compatible: should be "socionext,milbeaut-usio-uart".
- reg: offset and length of the register set for the device.
- interrupts: two interrupts specifier.
- interrupt-names: should be "rx", "tx".
- clocks: phandle to the input clock.

Optional properties:
- auto-flow-control: flow control enable.

Example:
	usio1: usio_uart@1e700010 {
		compatible = "socionext,milbeaut-usio-uart";
		reg = <0x1e700010 0x10>;
		interrupts = <0 141 0x4>, <0 149 0x4>;
		interrupt-names = "rx", "tx";
		clocks = <&clk 2>;
		auto-flow-control;
	};
```

## Documentation/devicetree/bindings/serial/mrvl,pxa-ssp.txt
```
Device tree bindings for Marvell PXA SSP ports

Required properties:

	- compatible:	Must be one of
				mrvl,pxa25x-ssp
				mvrl,pxa25x-nssp
				mrvl,pxa27x-ssp
				mrvl,pxa3xx-ssp
				mvrl,pxa168-ssp
				mrvl,pxa910-ssp
				mrvl,ce4100-ssp

	- reg:		The memory base
	- dmas:		Two dma phandles, one for rx, one for tx
	- dma-names:	Must be "rx", "tx"


Example for PXA3xx:

	ssp0: ssp@41000000 {
		compatible = "mrvl,pxa3xx-ssp";
		reg = <0x41000000 0x40>;
		ssp-id = <1>;
		interrupts = <24>;
		clock-names = "pxa27x-ssp.0";
		dmas = <&dma 13
			&dma 14>;
		dma-names = "rx", "tx";
	};

	ssp1: ssp@41700000 {
		compatible = "mrvl,pxa3xx-ssp";
		reg = <0x41700000 0x40>;
		ssp-id = <2>;
		interrupts = <16>;
		clock-names = "pxa27x-ssp.1";
		dmas = <&dma 15
			&dma 16>;
		dma-names = "rx", "tx";
	};

	ssp2: ssp@41900000 {
		compatibl3 = "mrvl,pxa3xx-ssp";
		reg = <0x41900000 0x40>;
		ssp-id = <3>;
		interrupts = <0>;
		clock-names = "pxa27x-ssp.2";
		dmas = <&dma 66
			&dma 67>;
		dma-names = "rx", "tx";
	};

	ssp3: ssp@41a00000 {
		compatible = "mrvl,pxa3xx-ssp";
		reg = <0x41a00000 0x40>;
		ssp-id = <4>;
		interrupts = <13>;
		clock-names = "pxa27x-ssp.3";
		dmas = <&dma 2
			&dma 3>;
		dma-names = "rx", "tx";
	};
```

## Documentation/devicetree/bindings/serial/mrvl-serial.txt
```
PXA UART controller

Required properties:
- compatible : should be "mrvl,mmp-uart" or "mrvl,pxa-uart".
```

## Documentation/devicetree/bindings/serial/mtk-uart.txt
```
* Mediatek Universal Asynchronous Receiver/Transmitter (UART)

Required properties:
- compatible should contain:
  * "mediatek,mt2701-uart" for MT2701 compatible UARTS
  * "mediatek,mt6580-uart" for MT6580 compatible UARTS
  * "mediatek,mt6582-uart" for MT6582 compatible UARTS
  * "mediatek,mt6589-uart" for MT6589 compatible UARTS
  * "mediatek,mt6755-uart" for MT6755 compatible UARTS
  * "mediatek,mt6795-uart" for MT6795 compatible UARTS
  * "mediatek,mt6797-uart" for MT6797 compatible UARTS
  * "mediatek,mt7622-uart" for MT7622 compatible UARTS
  * "mediatek,mt7623-uart" for MT7623 compatible UARTS
  * "mediatek,mt8127-uart" for MT8127 compatible UARTS
  * "mediatek,mt8135-uart" for MT8135 compatible UARTS
  * "mediatek,mt8173-uart" for MT8173 compatible UARTS
  * "mediatek,mt6577-uart" for MT6577 and all of the above

- reg: The base address of the UART register bank.

- interrupts: A single interrupt specifier.

- clocks : Must contain an entry for each entry in clock-names.
  See ../clocks/clock-bindings.txt for details.
- clock-names:
  - "baud": The clock the baudrate is derived from
  - "bus": The bus clock for register accesses (optional)

For compatibility with older device trees an unnamed clock is used for the
baud clock if the baudclk does not exist. Do not use this for new designs.

Example:

	uart0: serial@11006000 {
		compatible = "mediatek,mt6589-uart", "mediatek,mt6577-uart";
		reg = <0x11006000 0x400>;
		interrupts = <GIC_SPI 51 IRQ_TYPE_LEVEL_LOW>;
		clocks = <&uart_clk>, <&bus_clk>;
		clock-names = "baud", "bus";
	};
```

## Documentation/devicetree/bindings/serial/mvebu-uart.txt
```
* Marvell UART : Non standard UART used in some of Marvell EBU SoCs
                 e.g., Armada-3700.

Required properties:
- compatible:
    - "marvell,armada-3700-uart" for the standard variant of the UART
      (32 bytes FIFO, no DMA, level interrupts, 8-bit access to the
      FIFO), called also UART1.
    - "marvell,armada-3700-uart-ext" for the extended variant of the
      UART (128 bytes FIFO, DMA, front interrupts, 8-bit or 32-bit
      accesses to the FIFO), called also UART2.
- reg: offset and length of the register set for the device.
- clocks: UART reference clock used to derive the baudrate. If no clock
      is provided (possible only with the "marvell,armada-3700-uart"
      compatible string for backward compatibility), it will only work
      if the baudrate was initialized by the bootloader and no baudrate
      change will then be possible.
- interrupts:
    - Must contain three elements for the standard variant of the IP
      (marvell,armada-3700-uart): "uart-sum", "uart-tx" and "uart-rx",
      respectively the UART sum interrupt, the UART TX interrupt and
      UART RX interrupt. A corresponding interrupt-names property must
      be defined.
    - Must contain two elements for the extended variant of the IP
      (marvell,armada-3700-uart-ext): "uart-tx" and "uart-rx",
      respectively the UART TX interrupt and the UART RX interrupt. A
      corresponding interrupt-names property must be defined.
    - For backward compatibility reasons, a single element interrupts
      property is also supported for the standard variant of the IP,
      containing only the UART sum interrupt. This form is deprecated
      and should no longer be used.

Example:
	uart0: serial@12000 {
		compatible = "marvell,armada-3700-uart";
		reg = <0x12000 0x18>;
		clocks = <&xtalclk>;
		interrupts =
		<GIC_SPI 11 IRQ_TYPE_LEVEL_HIGH>,
		<GIC_SPI 12 IRQ_TYPE_LEVEL_HIGH>,
		<GIC_SPI 13 IRQ_TYPE_LEVEL_HIGH>;
		interrupt-names = "uart-sum", "uart-tx", "uart-rx";
	};

	uart1: serial@12200 {
		compatible = "marvell,armada-3700-uart-ext";
		reg = <0x12200 0x30>;
		clocks = <&xtalclk>;
		interrupts =
		<GIC_SPI 30 IRQ_TYPE_EDGE_RISING>,
		<GIC_SPI 31 IRQ_TYPE_EDGE_RISING>;
		interrupt-names = "uart-tx", "uart-rx";
	};
```

## Documentation/devicetree/bindings/serial/nuvoton,ma35d1-serial.yaml
```yaml
# SPDX-License-Identifier: (GPL-2.0-only OR BSD-2-Clause)
%YAML 1.2
---
$id: http://devicetree.org/schemas/serial/nuvoton,ma35d1-serial.yaml#
$schema: http://devicetree.org/meta-schemas/core.yaml#

title: Nuvoton MA35D1 Universal Asynchronous Receiver/Transmitter (UART)

maintainers:
  - Min-Jen Chen <mjchen@nuvoton.com>
  - Jacky Huang <ychuang3@nuvoton.com>

allOf:
  - $ref: serial.yaml

properties:
  compatible:
    const: nuvoton,ma35d1-uart

  reg:
    maxItems: 1

  interrupts:
    maxItems: 1

  clocks:
    maxItems: 1

required:
  - compatible
  - reg
  - interrupts
  - clocks

unevaluatedProperties: false

examples:
  - |
    #include <dt-bindings/interrupt-controller/arm-gic.h>
    #include <dt-bindings/clock/nuvoton,ma35d1-clk.h>

    serial@40700000 {
        compatible = "nuvoton,ma35d1-uart";
        reg = <0x40700000 0x100>;
        interrupts = <GIC_SPI 59 IRQ_TYPE_LEVEL_HIGH>;
        clocks = <&clk UART0_GATE>;
    };
...
```

## Documentation/devicetree/bindings/serial/nvidia,tegra194-tcu.txt
```
NVIDIA Tegra Combined UART (TCU)

The TCU is a system for sharing a hardware UART instance among multiple
systems within the Tegra SoC. It is implemented through a mailbox-
based protocol where each "virtual UART" has a pair of mailboxes, one
for transmitting and one for receiving, that is used to communicate
with the hardware implementing the TCU.

Required properties:
- name : Should be tcu
- compatible
    Array of strings
    One of:
    - "nvidia,tegra194-tcu"
- mbox-names:
    "rx" - Mailbox for receiving data from hardware UART
    "tx" - Mailbox for transmitting data to hardware UART
- mboxes: Mailboxes corresponding to the mbox-names.

This node is a mailbox consumer. See the following files for details of
the mailbox subsystem, and the specifiers implemented by the relevant
provider(s):

- .../mailbox/mailbox.txt
- .../mailbox/nvidia,tegra186-hsp.txt

Example bindings:
-----------------

tcu: tcu {
	compatible = "nvidia,tegra194-tcu";
	mboxes = <&hsp_top0 TEGRA_HSP_MBOX_TYPE_SM 0>,
	         <&hsp_aon TEGRA_HSP_MBOX_TYPE_SM 1>;
	mbox-names = "rx", "tx";
};
```
