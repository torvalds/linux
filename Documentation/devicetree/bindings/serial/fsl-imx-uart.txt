## Documentation/devicetree/bindings/serial/ingenic,uart.yaml
```yaml
# SPDX-License-Identifier: (GPL-2.0-only OR BSD-2-Clause)
%YAML 1.2
---
$id: http://devicetree.org/schemas/serial/ingenic,uart.yaml#
$schema: http://devicetree.org/meta-schemas/core.yaml#

title: Ingenic SoCs UART controller devicetree bindings

maintainers:
  - Paul Cercueil <paul@crapouillou.net>

properties:
  $nodename:
    pattern: "^serial@[0-9a-f]+$"

  compatible:
    oneOf:
      - enum:
        - ingenic,jz4740-uart
        - ingenic,jz4760-uart
        - ingenic,jz4780-uart
        - ingenic,x1000-uart
      - items:
        - enum:
          - ingenic,jz4770-uart
          - ingenic,jz4775-uart
        - const: ingenic,jz4760-uart
      - items:
        - const: ingenic,jz4725b-uart
        - const: ingenic,jz4740-uart

  reg:
    maxItems: 1

  interrupts:
    maxItems: 1

  clocks:
    items:
      - description: Baud clock
      - description: UART module clock

  clock-names:
    items:
      - const: baud
      - const: module

  dmas:
    items:
      - description: DMA controller phandle and request line for RX
      - description: DMA controller phandle and request line for TX

  dma-names:
    items:
      - const: rx
      - const: tx

required:
  - compatible
  - reg
  - interrupts
  - clocks
  - clock-names
  - dmas
  - dma-names

examples:
  - |
    #include <dt-bindings/clock/jz4780-cgu.h>
    #include <dt-bindings/dma/jz4780-dma.h>
    #include <dt-bindings/gpio/gpio.h>
    serial@10032000 {
      compatible = "ingenic,jz4780-uart";
      reg = <0x10032000 0x100>;

      interrupt-parent = <&intc>;
      interrupts = <49>;

      clocks = <&ext>, <&cgu JZ4780_CLK_UART2>;
      clock-names = "baud", "module";

      dmas = <&dma JZ4780_DMA_UART2_RX 0xffffffff>,
             <&dma JZ4780_DMA_UART2_TX 0xffffffff>;
      dma-names = "rx", "tx";

      bluetooth {
        compatible = "brcm,bcm4330-bt";
        reset-gpios = <&gpf 8 GPIO_ACTIVE_HIGH>;
        vcc-supply = <&wlan0_power>;
        device-wakeup-gpios = <&gpf 5 GPIO_ACTIVE_HIGH>;
        host-wakeup-gpios = <&gpf 6 GPIO_ACTIVE_HIGH>;
        shutdown-gpios = <&gpf 4 GPIO_ACTIVE_LOW>;
      };
    };
```

## Documentation/devicetree/bindings/serial/lantiq,asc.yaml
```yaml
# SPDX-License-Identifier: (GPL-2.0-only OR BSD-2-Clause)
%YAML 1.2
---
$id: http://devicetree.org/schemas/serial/lantiq,asc.yaml#
$schema: http://devicetree.org/meta-schemas/core.yaml#

title: Lantiq SoC ASC serial controller

maintainers:
  - John Crispin <john@phrozen.org>
  - Songjun Wu <songjun.wu@linux.intel.com>

allOf:
  - $ref: /schemas/serial/serial.yaml#

properties:
  compatible:
    const: lantiq,asc

  reg:
    maxItems: 1

  interrupts:
    items:
      - description: TX interrupt
      - description: RX interrupt
      - description: Error interrupt

  clocks:
    items:
      - description: Frequency clock
      - description: Gate clock

  clock-names:
    items:
      - const: freq
      - const: asc

required:
  - compatible
  - reg
  - interrupts

unevaluatedProperties: false

examples:
  - |
    #include <dt-bindings/interrupt-controller/mips-gic.h>

    serial@16600000 {
        compatible = "lantiq,asc";
        reg = <0x16600000 0x100000>;
        interrupts = <GIC_SHARED 103 IRQ_TYPE_LEVEL_HIGH>,
                     <GIC_SHARED 105 IRQ_TYPE_LEVEL_HIGH>,
                     <GIC_SHARED 106 IRQ_TYPE_LEVEL_HIGH>;
    };
```

## Documentation/devicetree/bindings/serial/lantiq_asc.txt
```
Lantiq SoC ASC serial controller

Required properties:
- compatible : Should be "lantiq,asc"
- reg : Address and length of the register set for the device
- interrupts: the 3 (tx rx err) interrupt numbers. The interrupt specifier
  depends on the interrupt-parent interrupt controller.

Optional properties:
- clocks: Should contain frequency clock and gate clock
- clock-names: Should be "freq" and "asc"

Example:

asc0: serial@16600000 {
	compatible = "lantiq,asc";
	reg = <0x16600000 0x100000>;
	interrupt-parent = <&gic>;
	interrupts = <GIC_SHARED 103 IRQ_TYPE_LEVEL_HIGH>,
		<GIC_SHARED 105 IRQ_TYPE_LEVEL_HIGH>,
		<GIC_SHARED 106 IRQ_TYPE_LEVEL_HIGH>;
	clocks = <&cgu CLK_SSX4>, <&cgu GCLK_UART>;
	clock-names = "freq", "asc";
};

asc1: serial@e100c00 {
	compatible = "lantiq,asc";
	reg = <0xE100C00 0x400>;
	interrupt-parent = <&icu0>;
	interrupts = <112 113 114>;
};
```

## Documentation/devicetree/bindings/serial/litex,liteuart.yaml
```yaml
# SPDX-License-Identifier: GPL-2.0-only OR BSD-2-Clause

%YAML 1.2
---
$id: http://devicetree.org/schemas/serial/litex,liteuart.yaml#
$schema: http://devicetree.org/meta-schemas/core.yaml#

title: LiteUART serial controller

maintainers:
  - Karol Gugala <kgugala@antmicro.com>
  - Mateusz Holenko <mholenko@antmicro.com>

description: |
  LiteUART serial controller is a part of the LiteX FPGA SoC builder. It supports
  multiple CPU architectures, currently including e.g. OpenRISC and RISC-V.

properties:
  compatible:
    const: litex,liteuart

  reg:
    maxItems: 1

  interrupts:
    maxItems: 1

required:
  - compatible
  - reg

additionalProperties: false

examples:
  - |
    uart0: serial@e0001800 {
      compatible = "litex,liteuart";
      reg = <0xe0001800 0x100>;
      interrupts = <2>;
    };
```

## Documentation/devicetree/bindings/serial/marvell,armada-3700-uart.yaml
```yaml
# SPDX-License-Identifier: (GPL-2.0-only OR BSD-2-Clause)
%YAML 1.2
---
$id: http://devicetree.org/schemas/serial/marvell,armada-3700-uart.yaml#
$schema: http://devicetree.org/meta-schemas/core.yaml#

title: Marvell Armada-3700 UART

maintainers:
  - Pali Rohár <pali@kernel.org>

description:
  Marvell UART is a non standard UART used in some of Marvell EBU SoCs (e.g.
  Armada-3700).

properties:
  compatible:
    enum:
      - marvell,armada-3700-uart
      - marvell,armada-3700-uart-ext

  reg:
    maxItems: 1

  clocks:
    maxItems: 1
    description:
      UART reference clock used to derive the baud rate. If absent, only fixed
      baud rate from the bootloader is supported.

  interrupts:
    minItems: 2
    items:
      - description: UART sum interrupt
      - description: UART TX interrupt
      - description: UART RX interrupt

  interrupt-names:
    minItems: 2
    maxItems: 3

required:
  - compatible
  - reg
  - interrupts
  - interrupt-names

unevaluatedProperties: false

allOf:
  - $ref: /schemas/serial/serial.yaml#
  - if:
      properties:
        compatible:
          const: marvell,armada-3700-uart-ext
    then:
      properties:
        interrupts:
          maxItems: 2

        interrupt-names:
          items:
            - const: uart-tx
            - const: uart-rx
    else:
      properties:
        interrupts:
          minItems: 3

        interrupt-names:
          items:
            - const: uart-sum
            - const: uart-tx
            - const: uart-rx

examples:
  - |
    #include <dt-bindings/interrupt-controller/arm-gic.h>

    serial@12000 {
        compatible = "marvell,armada-3700-uart";
        reg = <0x12000 0x18>;
        clocks = <&uartclk 0>;
        interrupts =
            <GIC_SPI 11 IRQ_TYPE_LEVEL_HIGH>,
            <GIC_SPI 12 IRQ_TYPE_LEVEL_HIGH>,
            <GIC_SPI 13 IRQ_TYPE_LEVEL_HIGH>;
        interrupt-names = "uart-sum", "uart-tx", "uart-rx";
    };

  - |
    #include <dt-bindings/interrupt-controller/arm-gic.h>

    serial@12200 {
        compatible = "marvell,armada-3700-uart-ext";
        reg = <0x12200 0x30>;
        clocks = <&uartclk 1>;
        interrupts =
            <GIC_SPI 30 IRQ_TYPE_EDGE_RISING>,
            <GIC_SPI 31 IRQ_TYPE_EDGE_RISING>;
        interrupt-names = "uart-tx", "uart-rx";
    };
```

## Documentation/devicetree/bindings/serial/maxim,max310x.txt
```
* Maxim MAX310X advanced Universal Asynchronous Receiver-Transmitter (UART)

Required properties:
- compatible: Should be one of the following:
  - "maxim,max3107" for Maxim MAX3107,
  - "maxim,max3108" for Maxim MAX3108,
  - "maxim,max3109" for Maxim MAX3109,
  - "maxim,max14830" for Maxim MAX14830.
- reg: SPI chip select number.
- interrupt-parent: The phandle for the interrupt controller that
  services interrupts for this IC.
- interrupts: Specifies the interrupt source of the parent interrupt
  controller. The format of the interrupt specifier depends on the
  parent interrupt controller.
- clocks: phandle to the IC source clock.
- clock-names: Should be "xtal" if clock is an external crystal or
  "osc" if an external clock source is used.

Optional properties:
- gpio-controller: Marks the device node as a GPIO controller.
- #gpio-cells: Should be two. The first cell is the GPIO number and
  the second cell is used to specify the GPIO polarity:
    0 = active high,
    1 = active low.

Example:

/ {
	clocks {
		spi_uart_clk: osc_max14830 {
			compatible = "fixed-clock";
			#clock-cells = <0>;
			clock-frequency = <3686400>;
		};

	};
};

&spi0 {
	max14830: max14830@0 {
		compatible = "maxim,max14830";
		reg = <0>;
		clocks = <&spi_uart_clk>;
		clock-names = "osc";
		interrupt-parent = <&gpio3>;
		interrupts = <7 IRQ_TYPE_LEVEL_LOW>;
		gpio-controller;
		#gpio-cells = <2>;
	};
};
```

## Documentation/devicetree/bindings/serial/maxim,max310x.yaml
```yaml
# SPDX-License-Identifier: (GPL-2.0-only OR BSD-2-Clause)
%YAML 1.2
---
$id: http://devicetree.org/schemas/serial/maxim,max310x.yaml#
$schema: http://devicetree.org/meta-schemas/core.yaml#

title: Maxim MAX310X Advanced Universal Asynchronous Receiver-Transmitter (UART)

maintainers:
  - Hugo Villeneuve <hvilleneuve@dimonoff.com>

description:
  The MAX310X is a family of SPI/I2C UARTs with one (max3107, max3108),
  two (max3109) or four (max14830) channels. Single-channel parts are
  described as a serial node with RS-485 properties on the chip node;
  multi-channel parts use one "serial@N" child node per channel, each
  carrying its own serial/RS-485 properties.

properties:
  compatible:
    enum:
      - maxim,max3107
      - maxim,max3108
      - maxim,max3109
      - maxim,max14830

  reg:
    maxItems: 1

  interrupts:
    maxItems: 1

  clocks:
    maxItems: 1

  clock-names:
    enum:
      - xtal # External crystal
      - osc  # External clock source

  gpio-controller: true

  "#gpio-cells":
    const: 2

  gpio-line-names:
    minItems: 1
    maxItems: 16

required:
  - compatible
  - reg
  - interrupts
  - clocks
  - clock-names

allOf:
  - $ref: /schemas/spi/spi-peripheral-props.yaml#

  - if:
      properties:
        compatible:
          contains:
            enum:
              - maxim,max3107
              - maxim,max3108
    then:
      allOf:
        - $ref: /schemas/serial/serial.yaml#
        - $ref: /schemas/serial/rs485.yaml#

  - if:
      properties:
        compatible:
          contains:
            enum:
              - maxim,max3109
              - maxim,max14830
    then:
      properties:
        "#address-cells":
          const: 1
        "#size-cells":
          const: 0
      patternProperties:
        "^serial@[0-3]$":
          type: object
          description: A single UART channel of the chip.
          allOf:
            - $ref: /schemas/serial/serial.yaml#
            - $ref: /schemas/serial/rs485.yaml#
          properties:
            reg:
              description: UART channel number on the chip.
              maximum: 3
          required:
            - reg
          unevaluatedProperties: false

  - if:
      properties:
        compatible:
          contains:
            const: maxim,max3109
    then:
      patternProperties:
        "^serial@[23]$": false

unevaluatedProperties: false

examples:
  - |
    #include <dt-bindings/interrupt-controller/irq.h>
    i2c {
        #address-cells = <1>;
        #size-cells = <0>;

        serial@2c {
            compatible = "maxim,max3107";
            reg = <0x2c>;
            clocks = <&xtal4m>;
            clock-names = "xtal";
            interrupt-parent = <&gpio3>;
            interrupts = <7 IRQ_TYPE_LEVEL_LOW>;
            gpio-controller;
            #gpio-cells = <2>;
            rs485-rts-active-low;
            linux,rs485-enabled-at-boot-time;
        };
    };

  - |
    #include <dt-bindings/interrupt-controller/irq.h>
    spi {
        #address-cells = <1>;
        #size-cells = <0>;

        serial@0 {
            compatible = "maxim,max14830";
            reg = <0>;
            spi-max-frequency = <26000000>;
            clocks = <&xtal4m>;
            clock-names = "xtal";
            interrupt-parent = <&gpio3>;
            interrupts = <7 IRQ_TYPE_LEVEL_LOW>;
            gpio-controller;
            #gpio-cells = <2>;
            #address-cells = <1>;
            #size-cells = <0>;

            serial@0 {
                reg = <0>;
                rs485-rts-active-low;
                linux,rs485-enabled-at-boot-time;
            };

            serial@2 {
                reg = <2>;
                rs485-rts-active-low;
            };
        };
    };
```
