## Documentation/devicetree/bindings/bus/baikal,bt1-apb.yaml
```yaml
# SPDX-License-Identifier: (GPL-2.0-only OR BSD-2-Clause)
# Copyright (C) 2020 BAIKAL ELECTRONICS, JSC
%YAML 1.2
---
$id: http://devicetree.org/schemas/bus/baikal,bt1-apb.yaml#
$schema: http://devicetree.org/meta-schemas/core.yaml#

title: Baikal-T1 APB-bus

maintainers:
  - Serge Semin <fancer.lancer@gmail.com>

description: |
  Baikal-T1 CPU or DMAC MMIO requests are handled by the AMBA 3 AXI Interconnect
  which routes them to the AXI-APB bridge. This interface is a single master
  multiple slaves bus in turn serializing IO accesses and routing them to the
  addressed APB slave devices. In case of any APB protocol collisions, slave
  device not responding on timeout an IRQ is raised with an erroneous address
  reported to the APB terminator (APB Errors Handler Block).

allOf:
 - $ref: /schemas/simple-bus.yaml#

properties:
  compatible:
    contains:
      const: baikal,bt1-apb

  reg:
    items:
      - description: APB EHB MMIO registers
      - description: APB MMIO region with no any device mapped

  reg-names:
    items:
      - const: ehb
      - const: nodev

  interrupts:
    maxItems: 1

  clocks:
    items:
      - description: APB reference clock

  clock-names:
    items:
      - const: pclk

  resets:
    items:
      - description: APB domain reset line

  reset-names:
    items:
      - const: prst

unevaluatedProperties: false

required:
  - compatible
  - reg
  - reg-names
  - interrupts
  - clocks
  - clock-names

examples:
  - |
    #include <dt-bindings/interrupt-controller/mips-gic.h>

    bus@1f059000 {
      compatible = "baikal,bt1-apb", "simple-bus";
      reg = <0x1f059000 0x1000>,
            <0x1d000000 0x2040000>;
      reg-names = "ehb", "nodev";
      #address-cells = <1>;
      #size-cells = <1>;

      ranges;

      interrupts = <GIC_SHARED 16 IRQ_TYPE_LEVEL_HIGH>;

      clocks = <&ccu_sys 1>;
      clock-names = "pclk";

      resets = <&ccu_sys 1>;
      reset-names = "prst";
    };
...
```

## Documentation/devicetree/bindings/bus/baikal,bt1-axi.yaml
```yaml
# SPDX-License-Identifier: (GPL-2.0-only OR BSD-2-Clause)
# Copyright (C) 2020 BAIKAL ELECTRONICS, JSC
%YAML 1.2
---
$id: http://devicetree.org/schemas/bus/baikal,bt1-axi.yaml#
$schema: http://devicetree.org/meta-schemas/core.yaml#

title: Baikal-T1 AXI-bus

maintainers:
  - Serge Semin <fancer.lancer@gmail.com>

description: |
  AXI3-bus is the main communication bus of Baikal-T1 SoC connecting all
  high-speed peripheral IP-cores with RAM controller and with MIPS P5600
  cores. Traffic arbitration is done by means of DW AXI Interconnect (so
  called AXI Main Interconnect) routing IO requests from one block to
  another: from CPU to SoC peripherals and between some SoC peripherals
  (mostly between peripheral devices and RAM, but also between DMA and
  some peripherals). In case of any protocol error, device not responding
  an IRQ is raised and a faulty situation is reported to the AXI EHB
  (Errors Handler Block) embedded on top of the DW AXI Interconnect and
  accessible by means of the Baikal-T1 System Controller.

allOf:
 - $ref: /schemas/simple-bus.yaml#

properties:
  compatible:
    contains:
      const: baikal,bt1-axi

  reg:
    minItems: 1
    items:
      - description: Synopsys DesignWare AXI Interconnect QoS registers
      - description: AXI EHB MMIO system controller registers

  reg-names:
    minItems: 1
    items:
      - const: qos
      - const: ehb

  '#interconnect-cells':
    const: 1

  syscon:
    $ref: /schemas/types.yaml#definitions/phandle
    description: Phandle to the Baikal-T1 System Controller DT node

  interrupts:
    maxItems: 1

  clocks:
    items:
      - description: Main Interconnect uplink reference clock

  clock-names:
    items:
      - const: aclk

  resets:
    items:
      - description: Main Interconnect reset line

  reset-names:
    items:
      - const: arst

unevaluatedProperties: false

required:
  - compatible
  - reg
  - reg-names
  - syscon
  - interrupts
  - clocks
  - clock-names

examples:
  - |
    #include <dt-bindings/interrupt-controller/mips-gic.h>

    bus@1f05a000 {
      compatible = "baikal,bt1-axi", "simple-bus";
      reg = <0x1f05a000 0x1000>,
            <0x1f04d110 0x8>;
      reg-names = "qos", "ehb";
      #address-cells = <1>;
      #size-cells = <1>;
      #interconnect-cells = <1>;

      syscon = <&syscon>;

      ranges;

      interrupts = <GIC_SHARED 127 IRQ_TYPE_LEVEL_HIGH>;

      clocks = <&ccu_axi 0>;
      clock-names = "aclk";

      resets = <&ccu_axi 0>;
      reset-names = "arst";
    };
...
```

## Documentation/devicetree/bindings/bus/bcma.txt
```
Driver for ARM AXI Bus with Broadcom Plugins (bcma)

Required properties:

- compatible : brcm,bus-axi

- reg : iomem address range of chipcommon core

The cores on the AXI bus are automatically detected by bcma with the
memory ranges they are using and they get registered afterwards.
Automatic detection of the IRQ number is not working on
BCM47xx/BCM53xx ARM SoCs. To assign IRQ numbers to the cores, provide
them manually through device tree. Use an interrupt-map to specify the
IRQ used by the devices on the bus. The first address is just an index,
because we do not have any special register.

The top-level axi bus may contain children representing attached cores
(devices). This is needed since some hardware details can't be auto
detected (e.g. IRQ numbers). Also some of the cores may be responsible
for extra things, e.g. ChipCommon providing access to the GPIO chip.

Example:

	axi@18000000 {
		compatible = "brcm,bus-axi";
		reg = <0x18000000 0x1000>;
		ranges = <0x00000000 0x18000000 0x00100000>;
		#address-cells = <1>;
		#size-cells = <1>;
		#interrupt-cells = <1>;
		interrupt-map-mask = <0x000fffff 0xffff>;
		interrupt-map =
			/* Ethernet Controller 0 */
			<0x00024000 0 &gic GIC_SPI 147 IRQ_TYPE_LEVEL_HIGH>,

			/* Ethernet Controller 1 */
			<0x00025000 0 &gic GIC_SPI 148 IRQ_TYPE_LEVEL_HIGH>;

			/* PCIe Controller 0 */
			<0x00012000 0 &gic GIC_SPI 126 IRQ_TYPE_LEVEL_HIGH>,
			<0x00012000 1 &gic GIC_SPI 127 IRQ_TYPE_LEVEL_HIGH>,
			<0x00012000 2 &gic GIC_SPI 128 IRQ_TYPE_LEVEL_HIGH>,
			<0x00012000 3 &gic GIC_SPI 129 IRQ_TYPE_LEVEL_HIGH>,
			<0x00012000 4 &gic GIC_SPI 130 IRQ_TYPE_LEVEL_HIGH>,
			<0x00012000 5 &gic GIC_SPI 131 IRQ_TYPE_LEVEL_HIGH>;

		chipcommon {
			reg = <0x00000000 0x1000>;

			gpio-controller;
			#gpio-cells = <2>;
		};
	};
```

## Documentation/devicetree/bindings/bus/brcm,gisb-arb.txt
```
Broadcom GISB bus Arbiter controller

Required properties:

- compatible:
    "brcm,bcm7278-gisb-arb" for V7 28nm chips
    "brcm,gisb-arb" or "brcm,bcm7445-gisb-arb" for other 28nm chips
    "brcm,bcm7435-gisb-arb" for newer 40nm chips
    "brcm,bcm7400-gisb-arb" for older 40nm chips and all 65nm chips
    "brcm,bcm7038-gisb-arb" for 130nm chips
- reg: specifies the base physical address and size of the registers
- interrupts: specifies the two interrupts (timeout and TEA) to be used from
  the parent interrupt controller. A third optional interrupt may be specified
  for breakpoints.

Optional properties:

- brcm,gisb-arb-master-mask: 32-bits wide bitmask used to specify which GISB
  masters are valid at the system level
- brcm,gisb-arb-master-names: string list of the litteral name of the GISB
  masters. Should match the number of bits set in brcm,gisb-master-mask and
  the order in which they appear

Example:

gisb-arb@f0400000 {
	compatible = "brcm,gisb-arb";
	reg = <0xf0400000 0x800>;
	interrupts = <0>, <2>;
	interrupt-parent = <&sun_l2_intc>;

	brcm,gisb-arb-master-mask = <0x7>;
	brcm,gisb-arb-master-names = "bsp_0", "scpu_0", "cpu_0";
};
```

## Documentation/devicetree/bindings/bus/brcm,gisb-arb.yaml
```yaml
# SPDX-License-Identifier: (GPL-2.0-only OR BSD-2-Clause)
%YAML 1.2
---
$id: http://devicetree.org/schemas/bus/brcm,gisb-arb.yaml#
$schema: http://devicetree.org/meta-schemas/core.yaml#

title: Broadcom GISB bus Arbiter controller

maintainers:
  - Florian Fainelli <f.fainelli@gmail.com>

properties:
  compatible:
    oneOf:
      - items:
          - enum:
              - brcm,bcm7445-gisb-arb  # for other 28nm chips
          - const: brcm,gisb-arb
      - items:
          - enum:
              - brcm,bcm74165-gisb-arb  # for V7 new style 16nm chips
              - brcm,bcm7278-gisb-arb  # for V7 28nm chips
              - brcm,bcm7435-gisb-arb  # for newer 40nm chips
              - brcm,bcm7400-gisb-arb  # for older 40nm chips and all 65nm chips
              - brcm,bcm7038-gisb-arb  # for 130nm chips
              - brcm,gisb-arb          # fallback compatible

  reg:
    maxItems: 1

  interrupts:
    minItems: 2
    items:
      - description: timeout interrupt line
      - description: target abort interrupt line
      - description: breakpoint interrupt line

  brcm,gisb-arb-master-mask:
    $ref: /schemas/types.yaml#/definitions/uint32
    description: >
      32-bits wide bitmask used to specify which GISB masters are valid at the
      system level

  brcm,gisb-arb-master-names:
    $ref: /schemas/types.yaml#/definitions/string-array
    description: >
      String list of the literal name of the GISB masters. Should match the
      number of bits set in brcm,gisb-master-mask and the order in which they
      appear from MSB to LSB.

required:
  - compatible
  - reg
  - interrupts

additionalProperties: false

examples:
  - |
    gisb-arb@f0400000 {
      compatible = "brcm,gisb-arb";
      reg = <0xf0400000 0x800>;
      interrupts = <0>, <2>;
      interrupt-parent = <&sun_l2_intc>;
      brcm,gisb-arb-master-mask = <0x7>;
      brcm,gisb-arb-master-names = "bsp_0", "scpu_0", "cpu_0";
    };
```

## Documentation/devicetree/bindings/bus/cznic,moxtet.yaml
```yaml
# SPDX-License-Identifier: (GPL-2.0-only OR BSD-2-Clause)
%YAML 1.2
---
$id: http://devicetree.org/schemas/bus/cznic,moxtet.yaml#
$schema: http://devicetree.org/meta-schemas/core.yaml#

title: Turris Moxtet SPI bus

maintainers:
  - Marek Behún <kabel@kernel.org>

description: >
  Turris Mox module status and configuration bus (over SPI)

  The driver finds the devices connected to the bus by itself, but it may be
  needed to reference some of them from other parts of the device tree. In that
  case the devices can be defined as subnodes of the moxtet node.

properties:
  compatible:
    const: cznic,moxtet

  reg:
    maxItems: 1

  "#address-cells":
    const: 1

  "#size-cells":
    const: 0

  spi-cpol: true

  spi-cpha: true

  spi-max-frequency: true

  interrupt-controller: true

  "#interrupt-cells":
    const: 1

  interrupts:
    maxItems: 1

  reset-gpios:
    maxItems: 1

required:
  - compatible
  - reg
  - "#address-cells"
  - "#size-cells"
  - spi-cpol
  - spi-cpha
  - interrupts
  - interrupt-controller
  - "#interrupt-cells"

additionalProperties:
  type: object

  required:
    - reg

examples:
  - |
    #include <dt-bindings/interrupt-controller/irq.h>

    spi {
        #address-cells = <1>;
        #size-cells = <0>;

        moxtet@1 {
            compatible = "cznic,moxtet";
            #address-cells = <1>;
            #size-cells = <0>;
            reg = <1>;
            spi-max-frequency = <10000000>;
            spi-cpol;
            spi-cpha;
            interrupt-controller;
            #interrupt-cells = <1>;
            interrupt-parent = <&gpiosb>;
            interrupts = <5 IRQ_TYPE_EDGE_FALLING>;

            gpio@0 {
                compatible = "cznic,moxtet-gpio";
                gpio-controller;
                #gpio-cells = <2>;
                reg = <0>;
            };
        };
    };
```

## Documentation/devicetree/bindings/bus/fsl,imx8mp-aipstz.yaml
```yaml
# SPDX-License-Identifier: (GPL-2.0-only OR BSD-2-Clause)
%YAML 1.2
---
$id: http://devicetree.org/schemas/bus/fsl,imx8mp-aipstz.yaml#
$schema: http://devicetree.org/meta-schemas/core.yaml#

title: Secure AHB to IP Slave bus (AIPSTZ) bridge

description:
  The secure AIPS bridge (AIPSTZ) acts as a bridge for AHB masters issuing
  transactions to IP Slave peripherals. Additionally, this module offers access
  control configurations meant to restrict which peripherals a master can
  access.

maintainers:
  - Laurentiu Mihalcea <laurentiu.mihalcea@nxp.com>

properties:
  compatible:
    const: fsl,imx8mp-aipstz

  reg:
    maxItems: 1

  power-domains:
    maxItems: 1

  "#address-cells":
    const: 1

  "#size-cells":
    const: 1

  "#access-controller-cells":
    const: 3
    description:
      First cell - consumer ID
      Second cell - consumer type (master or peripheral)
      Third cell - configuration value

  ranges: true

# borrowed from simple-bus.yaml, no additional requirements for children
patternProperties:
  "@(0|[1-9a-f][0-9a-f]*)$":
    type: object
    additionalProperties: true
    properties:
      reg:
        items:
          minItems: 2
          maxItems: 4
        minItems: 1
        maxItems: 1024
      ranges:
        oneOf:
          - items:
              minItems: 3
              maxItems: 7
            minItems: 1
            maxItems: 1024
          - $ref: /schemas/types.yaml#/definitions/flag
    anyOf:
      - required:
          - reg
      - required:
          - ranges

required:
  - compatible
  - reg
  - power-domains
  - "#address-cells"
  - "#size-cells"
  - "#access-controller-cells"
  - ranges

additionalProperties: false

examples:
  - |
    #include <dt-bindings/clock/imx8mp-clock.h>
    #include <dt-bindings/interrupt-controller/arm-gic.h>

    bus@30df0000 {
        compatible = "fsl,imx8mp-aipstz";
        reg = <0x30df0000 0x10000>;
        ranges = <0x30c00000 0x30c00000 0x400000>;
        power-domains = <&pgc_audio>;
        #address-cells = <1>;
        #size-cells = <1>;
        #access-controller-cells = <3>;

        dma-controller@30e00000 {
            compatible = "fsl,imx8mp-sdma", "fsl,imx8mq-sdma";
            reg = <0x30e00000 0x10000>;
            #dma-cells = <3>;
            clocks = <&audio_blk_ctrl IMX8MP_CLK_AUDIOMIX_SDMA3_ROOT>,
                     <&clk IMX8MP_CLK_AUDIO_ROOT>;
            clock-names = "ipg", "ahb";
            interrupts = <GIC_SPI 34 IRQ_TYPE_LEVEL_HIGH>;
            fsl,sdma-ram-script-name = "imx/sdma/sdma-imx7d.bin";
        };
    };
```
