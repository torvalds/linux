## Documentation/devicetree/bindings/auxdisplay/hit,hd44780.yaml
```yaml
# SPDX-License-Identifier: (GPL-2.0-only OR BSD-2-Clause)
%YAML 1.2
---
$id: http://devicetree.org/schemas/auxdisplay/hit,hd44780.yaml#
$schema: http://devicetree.org/meta-schemas/core.yaml#

title: Hitachi HD44780 Character LCD Controller

maintainers:
  - Geert Uytterhoeven <geert@linux-m68k.org>

description:
  The Hitachi HD44780 Character LCD Controller is commonly used on character
  LCDs that can display one or more lines of text. It exposes an M6800 bus
  interface, which can be used in either 4-bit or 8-bit mode. By using a
  GPIO expander it is possible to use the driver with one of the popular I2C
  expander boards based on the PCF8574 available for these displays. For
  an example see below.

properties:
  compatible:
    const: hit,hd44780

  data-gpios:
    description:
      GPIO pins connected to the data signal lines DB0-DB7 (8-bit mode) or
      DB4-DB7 (4-bit mode) of the LCD Controller's bus interface.
    oneOf:
      - maxItems: 4
      - maxItems: 8

  enable-gpios:
    description:
      GPIO pin connected to the "E" (Enable) signal line of the LCD
      Controller's bus interface.
    maxItems: 1

  rs-gpios:
    description:
      GPIO pin connected to the "RS" (Register Select) signal line of the LCD
      Controller's bus interface.
    maxItems: 1

  rw-gpios:
    description:
      GPIO pin connected to the "RW" (Read/Write) signal line of the LCD
      Controller's bus interface.
    maxItems: 1

  backlight-gpios:
    description: GPIO pin used for enabling the LCD's backlight.
    maxItems: 1

  display-height-chars:
    description: Height of the display, in character cells,
    $ref: /schemas/types.yaml#/definitions/uint32
    minimum: 1
    maximum: 4

  display-width-chars:
    description: Width of the display, in character cells.
    $ref: /schemas/types.yaml#/definitions/uint32
    minimum: 1
    maximum: 64

  internal-buffer-width:
    description:
      Internal buffer width (default is 40 for displays with 1 or 2 lines, and
      display-width-chars for displays with more than 2 lines).
    $ref: /schemas/types.yaml#/definitions/uint32
    minimum: 1
    maximum: 64

required:
  - compatible
  - data-gpios
  - enable-gpios
  - rs-gpios
  - display-height-chars
  - display-width-chars

additionalProperties: false

examples:
  - |
    #include <dt-bindings/gpio/gpio.h>
    auxdisplay {
            compatible = "hit,hd44780";

            data-gpios = <&hc595 0 GPIO_ACTIVE_HIGH>,
                         <&hc595 1 GPIO_ACTIVE_HIGH>,
                         <&hc595 2 GPIO_ACTIVE_HIGH>,
                         <&hc595 3 GPIO_ACTIVE_HIGH>;
            enable-gpios = <&hc595 4 GPIO_ACTIVE_HIGH>;
            rs-gpios = <&hc595 5 GPIO_ACTIVE_HIGH>;

            display-height-chars = <2>;
            display-width-chars = <16>;
    };
  - |
    #include <dt-bindings/gpio/gpio.h>
    i2c {
            #address-cells = <1>;
            #size-cells = <0>;

            pcf8574: pcf8574@27 {
                    compatible = "nxp,pcf8574";
                    reg = <0x27>;
                    gpio-controller;
                    #gpio-cells = <2>;
            };
    };
    hd44780 {
            compatible = "hit,hd44780";
            display-height-chars = <2>;
            display-width-chars = <16>;
            data-gpios = <&pcf8574 4 0>,
                         <&pcf8574 5 0>,
                         <&pcf8574 6 0>,
                         <&pcf8574 7 0>;
            enable-gpios = <&pcf8574 2 0>;
            rs-gpios = <&pcf8574 0 0>;
            rw-gpios = <&pcf8574 1 0>;
            backlight-gpios = <&pcf8574 3 0>;
    };
```

## Documentation/devicetree/bindings/auxdisplay/holtek,ht16k33.yaml
```yaml
# SPDX-License-Identifier: (GPL-2.0-only OR BSD-2-Clause)
%YAML 1.2
---
$id: http://devicetree.org/schemas/auxdisplay/holtek,ht16k33.yaml#
$schema: http://devicetree.org/meta-schemas/core.yaml#

title: Holtek HT16K33 RAM mapping 16*8 LED controller with keyscan

maintainers:
  - Robin van der Gracht <robin@protonic.nl>

allOf:
  - $ref: /schemas/input/matrix-keymap.yaml#

properties:
  compatible:
    oneOf:
      - items:
          - enum:
              - adafruit,3108  # 0.56" 4-Digit 7-Segment FeatherWing Display (Red)
              - adafruit,3130  # 0.54" Quad Alphanumeric FeatherWing Display (Red)
          - const: holtek,ht16k33

      - const: holtek,ht16k33     # Generic 16*8 LED controller with dot-matrix display

  reg:
    maxItems: 1

  refresh-rate-hz:
    maxItems: 1
    description: Display update interval in Hertz for dot-matrix displays

  interrupts:
    maxItems: 1

  debounce-delay-ms:
    maxItems: 1
    description: Debouncing interval time in milliseconds

  linux,keymap: true

  linux,no-autorepeat:
    type: boolean
    description: Disable keyrepeat

  default-brightness-level:
    minimum: 1
    maximum: 16
    default: 16
    description: Initial brightness level

  led:
    type: object
    $ref: /schemas/leds/common.yaml#
    unevaluatedProperties: false

required:
  - compatible
  - reg

if:
  properties:
    compatible:
      const: holtek,ht16k33
then:
  required:
    - refresh-rate-hz

additionalProperties: false

examples:
  - |
    #include <dt-bindings/interrupt-controller/irq.h>
    #include <dt-bindings/input/input.h>
    #include <dt-bindings/leds/common.h>
    i2c {
        #address-cells = <1>;
        #size-cells = <0>;

        display-controller@70 {
            compatible = "holtek,ht16k33";
            reg = <0x70>;
            refresh-rate-hz = <20>;
            interrupt-parent = <&gpio4>;
            interrupts = <5 (IRQ_TYPE_LEVEL_HIGH | IRQ_TYPE_EDGE_RISING)>;
            debounce-delay-ms = <50>;
            linux,keymap = <MATRIX_KEY(2, 0, KEY_F6)>,
                           <MATRIX_KEY(3, 0, KEY_F8)>,
                           <MATRIX_KEY(4, 0, KEY_F10)>,
                           <MATRIX_KEY(5, 0, KEY_F4)>,
                           <MATRIX_KEY(6, 0, KEY_F2)>,
                           <MATRIX_KEY(2, 1, KEY_F5)>,
                           <MATRIX_KEY(3, 1, KEY_F7)>,
                           <MATRIX_KEY(4, 1, KEY_F9)>,
                           <MATRIX_KEY(5, 1, KEY_F3)>,
                           <MATRIX_KEY(6, 1, KEY_F1)>;

            led {
                color = <LED_COLOR_ID_RED>;
                function = LED_FUNCTION_BACKLIGHT;
                linux,default-trigger = "backlight";
            };
        };
    };
```

## Documentation/devicetree/bindings/auxdisplay/img,ascii-lcd.yaml
```yaml
# SPDX-License-Identifier: (GPL-2.0-only OR BSD-2-Clause)
%YAML 1.2
---
$id: http://devicetree.org/schemas/auxdisplay/img,ascii-lcd.yaml#
$schema: http://devicetree.org/meta-schemas/core.yaml#

title: ASCII LCD displays on Imagination Technologies boards

maintainers:
  - Paul Burton <paulburton@kernel.org>

properties:
  compatible:
    enum:
      - img,boston-lcd
      - mti,malta-lcd
      - mti,sead3-lcd

  reg:
    maxItems: 1

  offset:
    $ref: /schemas/types.yaml#/definitions/uint32
    description:
      Offset in bytes to the LCD registers within the system controller

required:
  - compatible

oneOf:
  - required:
      - reg
  - required:
      - offset

if:
  properties:
    compatible:
      contains:
        const: img,boston-lcd
then:
  required:
    - reg
else:
  required:
    - offset

additionalProperties: false

examples:
  - |
    lcd: lcd@17fff000 {
            compatible = "img,boston-lcd";
            reg = <0x17fff000 0x8>;
    };
```

## Documentation/devicetree/bindings/auxdisplay/img-ascii-lcd.txt
```
Binding for ASCII LCD displays on Imagination Technologies boards

Required properties:
- compatible : should be one of:
    "img,boston-lcd"
    "mti,malta-lcd"
    "mti,sead3-lcd"

Required properties for "img,boston-lcd":
- reg : memory region locating the device registers

Required properties for "mti,malta-lcd" or "mti,sead3-lcd":
- regmap: phandle of the system controller containing the LCD registers
- offset: offset in bytes to the LCD registers within the system controller

The layout of the registers & properties of the display are determined
from the compatible string, making this binding somewhat trivial.
```

## Documentation/devicetree/bindings/auxdisplay/maxim,max6959.yaml
```yaml
# SPDX-License-Identifier: (GPL-2.0-only OR BSD-2-Clause)
%YAML 1.2
---
$id: http://devicetree.org/schemas/auxdisplay/maxim,max6959.yaml#
$schema: http://devicetree.org/meta-schemas/core.yaml#

title: MAX6958/6959 7-segment LED display controller

maintainers:
  - Andy Shevchenko <andriy.shevchenko@linux.intel.com>

description:
  The Maxim MAX6958/6959 7-segment LED display controller provides
  an I2C interface to up to four 7-segment LED digits. The MAX6959,
  in comparison to MAX6958, adds input support. Type of the chip can
  be autodetected via specific register read, and hence the features
  may be enabled in the driver at run-time, in case they are requested
  via Device Tree. A given hardware is simple and does not provide
  any additional pins, such as reset or power enable.

properties:
  compatible:
    const: maxim,max6959

  reg:
    maxItems: 1

required:
  - compatible
  - reg

additionalProperties: false

examples:
  - |
    i2c {
        #address-cells = <1>;
        #size-cells = <0>;

        display-controller@38 {
            compatible = "maxim,max6959";
            reg = <0x38>;
        };
    };
```

## Documentation/devicetree/bindings/auxdisplay/modtronix,lcd2s.yaml
```yaml
# SPDX-License-Identifier: (GPL-2.0-only OR BSD-2-Clause)
%YAML 1.2
---
$id: http://devicetree.org/schemas/auxdisplay/modtronix,lcd2s.yaml#
$schema: http://devicetree.org/meta-schemas/core.yaml#

title: Modtronix engineering LCD2S Character LCD Display

maintainers:
  - Lars Poeschel <poeschel@lemonage.de>

description:
  The LCD2S is a Character LCD Display manufactured by Modtronix Engineering.
  The display supports a serial I2C and SPI interface. The driver currently
  only supports the I2C interface.

properties:
  compatible:
    const: modtronix,lcd2s

  reg:
    maxItems: 1
    description:
      I2C bus address of the display.

  display-height-chars:
    description: Height of the display, in character cells.
    $ref: /schemas/types.yaml#/definitions/uint32
    minimum: 1
    maximum: 4

  display-width-chars:
    description: Width of the display, in character cells.
    $ref: /schemas/types.yaml#/definitions/uint32
    minimum: 16
    maximum: 20

required:
  - compatible
  - reg
  - display-height-chars
  - display-width-chars

additionalProperties: false

examples:
  - |
    i2c {
      #address-cells = <1>;
      #size-cells = <0>;

      lcd2s: auxdisplay@28 {
        compatible = "modtronix,lcd2s";
        reg = <0x28>;
        display-height-chars = <4>;
        display-width-chars = <20>;
      };
    };
```

## Documentation/devicetree/bindings/bmc/npcm7xx-jtag-master.txt
```
Nuvoton NPCM7xx JTAG MASTER interface

Nuvoton BMC NPCM7xx JTAG Master is used for debugging host CPU or programming
CPLD device. The driver is implemented as an SPI device driver that enabling
the option to transfer JTAG data with the assistance of SPI HW.

Required properties for jtag_master node
- compatible		: "nuvoton,npcm750-jtag-master" for Poleg NPCM7XX.
- spi-max-frequency	: specify the max spi bus frequency.
- reg 				: always 0
- pinctrl-names		: contain 2 pinctrl states "pspi" and "gpio", which indicates
					  the TCK/TDI/TDO pin state in HW mode(using PSPI hw) and
					  SW mode (using GPIO bitbang) respectively.
- tck-gpios			: specify the GPIO number of TCK pin
- tdi-gpios			: specify the GPIO number of TDI pin
- tdo-gpios			: specify the GPIO number of TDO pin
- tms-gpios			: specify the GPIO number of TMS pin

Example:
spi1: spi@201000 {
	...
	jtag_master {
		compatible = "nuvoton,npcm750-jtag-master";
		spi-max-frequency = <25000000>;
		reg = <0>;

		pinctrl-names = "pspi", "gpio";
		pinctrl-0 = <&pspi2_pins>;
		pinctrl-1 = <&gpio17_pins &gpio18o_pins
			&gpio19ol_pins>;

		tck-gpios = <&gpio0 19 GPIO_ACTIVE_HIGH>;
		tdi-gpios = <&gpio0 18 GPIO_ACTIVE_HIGH>;
		tdo-gpios = <&gpio0 17 GPIO_ACTIVE_HIGH>;
		tms-gpios = <&gpio0 16 GPIO_ACTIVE_HIGH>;
		status = "okay";
	};
};
```

## Documentation/devicetree/bindings/bmc/npcm7xx-lpc-bpc.txt
```
Nuvoton NPCM7xx LPC BPC interface

Nuvoton BMC NPCM7xx BIOS Post Code (BPC) monitoring two
configurable I/O addresses written by the host on the
Low Pin Count (LPC) bus, the capure data stored in 128-word FIFO.

NPCM7xx BPC supports capture double words, when using capture
double word only I/O address 1 is monitored.

Required properties for lpc_bpc node
- compatible	: "nuvoton,npcm750-lpc-bpc" for Poleg NPCM7XX.
- reg 			: specifies physical base address and size of the registers.
- interrupts	: contain the LPC BPC with flags for falling edge.
- monitor-ports : contain monitor I/O addresses, at least one monitor I/O
				  address required

Optional property for lpc_bpc node
- bpc-en-dwcapture : enable capture double words support.

Example:
	lpc_bpc: lpc-bpc@f0007040 {
		compatible = "nuvoton,npcm7xx-lpc-bpc";
		reg = <0xf0007040 0x14>;
		monitor-ports = <0x80>;
		interrupts = <GIC_SPI 9 IRQ_TYPE_LEVEL_HIGH>;
	};
```

## Documentation/devicetree/bindings/bmc/npcm7xx-pci-mbox.txt
```
Nuvoton NPCM7xx PCI mail box interface

Nuvoton BMC NPCM7xx PCI mail box, The mailbox is a high-bandwidth
communication module between the BMC CPU and host CPU.

Required properties for lpc_bpc node
- compatible	: "nuvoton,npcm750-pci-mbox" for Poleg NPCM7XX.
- reg 			: specifies two address space
					1. physical base address and size of the registers.
					2. physical base address and size of the dual-ported RAM.
- interrupts	: contain the PCI mail box interrupt with flags for falling edge.

Example:
	pcimbox: pcimbox@f0848000 {
		compatible = "nuvoton,npcm750-pci-mbox", "simple-mfd", "syscon";
		reg = <0xf084C000 0x8
			0xf0848000 0x3F00>;
		interrupts = <GIC_SPI 8 IRQ_TYPE_LEVEL_HIGH>;
	};
```

## Documentation/devicetree/bindings/board/fsl,bcsr.yaml
```yaml
# SPDX-License-Identifier: (GPL-2.0-only OR BSD-2-Clause)
%YAML 1.2
---
$id: http://devicetree.org/schemas/board/fsl,bcsr.yaml#
$schema: http://devicetree.org/meta-schemas/core.yaml#

title: Board Control and Status

maintainers:
  - Frank Li <Frank.Li@nxp.com>

properties:
  compatible:
    enum:
      - fsl,mpc8360mds-bcsr

  reg:
    maxItems: 1

required:
  - compatible
  - reg

additionalProperties: false

examples:
  - |
    board@f8000000 {
        compatible = "fsl,mpc8360mds-bcsr";
        reg = <0xf8000000 0x8000>;
    };
```
