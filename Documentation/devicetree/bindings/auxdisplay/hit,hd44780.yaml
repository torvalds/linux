## Documentation/devicetree/bindings/board/fsl,fpga-qixis-i2c.yaml
```yaml
# SPDX-License-Identifier: (GPL-2.0-only OR BSD-2-Clause)
%YAML 1.2
---
$id: http://devicetree.org/schemas/board/fsl,fpga-qixis-i2c.yaml#
$schema: http://devicetree.org/meta-schemas/core.yaml#

title: Freescale on-board FPGA connected on I2C bus

maintainers:
  - Frank Li <Frank.Li@nxp.com>

properties:
  compatible:
    oneOf:
      - items:
          - enum:
              - fsl,bsc9132qds-fpga
          - const: fsl,fpga-qixis-i2c
      - items:
          - enum:
              - fsl,ls1028aqds-fpga
              - fsl,lx2160aqds-fpga
          - const: fsl,fpga-qixis-i2c
          - const: simple-mfd
      - const: fsl,lx2160ardb-fpga

  "#address-cells":
    const: 1

  "#size-cells":
    const: 0

  interrupts:
    maxItems: 1

  reg:
    maxItems: 1

  mux-controller:
    $ref: /schemas/mux/reg-mux.yaml

patternProperties:
  "^gpio@[0-9a-f]+$":
    type: object
    additionalProperties: true

    properties:
      compatible:
        contains:
          enum:
            - fsl,lx2160ardb-fpga-gpio-sfp

required:
  - compatible
  - reg

allOf:
  - if:
      properties:
        compatible:
          contains:
            enum:
              - fsl,lx2160ardb-fpga
    then:
      required:
        - "#address-cells"
        - "#size-cells"
    else:
      properties:
        "#address-cells": false
        "#size-cells": false

additionalProperties: false

examples:
  - |
    i2c {
        #address-cells = <1>;
        #size-cells = <0>;

        board-control@66 {
            compatible = "fsl,bsc9132qds-fpga", "fsl,fpga-qixis-i2c";
            reg = <0x66>;
        };
    };

  - |
    i2c {
        #address-cells = <1>;
        #size-cells = <0>;

        board-control@66 {
            compatible = "fsl,ls1028aqds-fpga", "fsl,fpga-qixis-i2c",
                         "simple-mfd";
            reg = <0x66>;

            mux-controller {
                compatible = "reg-mux";
                #mux-control-cells = <1>;
                mux-reg-masks = <0x54 0xf0>; /* 0: reg 0x54, bits 7:4 */
            };
        };
    };

  - |
    i2c {
        #address-cells = <1>;
        #size-cells = <0>;

        board-control@66 {
            compatible = "fsl,lx2160ardb-fpga";
            reg = <0x66>;
            #address-cells = <1>;
            #size-cells = <0>;

            gpio@19 {
                compatible = "fsl,lx2160ardb-fpga-gpio-sfp";
                reg = <0x19>;
                gpio-controller;
                #gpio-cells = <2>;
                gpio-line-names =
                    "SFP2_TX_EN", "",
                    "", "",
                    "SFP2_RX_LOS", "SFP2_TX_FAULT",
                    "", "SFP2_MOD_ABS";
            };
        };
    };
```

## Documentation/devicetree/bindings/board/fsl,fpga-qixis.yaml
```yaml
# SPDX-License-Identifier: (GPL-2.0-only OR BSD-2-Clause)
%YAML 1.2
---
$id: http://devicetree.org/schemas/board/fsl,fpga-qixis.yaml#
$schema: http://devicetree.org/meta-schemas/core.yaml#

title: Freescale on-board FPGA/CPLD

maintainers:
  - Frank Li <Frank.Li@nxp.com>

properties:
  compatible:
    oneOf:
      - items:
          - const: fsl,p1022ds-fpga
          - const: fsl,fpga-ngpixis
      - items:
          - enum:
              - fsl,ls1088aqds-fpga
              - fsl,ls1088ardb-fpga
              - fsl,ls2080aqds-fpga
              - fsl,ls2080ardb-fpga
          - const: fsl,fpga-qixis
      - items:
          - enum:
              - fsl,ls1043aqds-fpga
              - fsl,ls1043ardb-fpga
              - fsl,ls1046aqds-fpga
              - fsl,ls1046ardb-fpga
              - fsl,ls208xaqds-fpga
          - const: fsl,fpga-qixis
          - const: simple-mfd
      - enum:
          - fsl,ls1043ardb-cpld
          - fsl,ls1046ardb-cpld
          - fsl,t1040rdb-cpld
          - fsl,t1042rdb-cpld
          - fsl,t1042rdb_pi-cpld

  interrupts:
    maxItems: 1

  reg:
    maxItems: 1

  "#address-cells":
    const: 1

  "#size-cells":
    const: 1

  ranges:
    maxItems: 1

patternProperties:
  '^mdio-mux@[a-f0-9,]+$':
    $ref: /schemas/net/mdio-mux-mmioreg.yaml

required:
  - compatible
  - reg

additionalProperties: false

examples:
  - |
    #include <dt-bindings/interrupt-controller/irq.h>
    board-control@3 {
        compatible = "fsl,p1022ds-fpga", "fsl,fpga-ngpixis";
        reg = <3 0x30>;
        interrupt-parent = <&mpic>;
        interrupts = <8 IRQ_TYPE_LEVEL_LOW 0 0>;
    };

  - |
    board-control@3 {
        compatible = "fsl,ls2080ardb-fpga", "fsl,fpga-qixis";
        reg = <0x3 0x10000>;
    };
```

## Documentation/devicetree/bindings/board/fsl-board.txt
```
Freescale Reference Board Bindings

This document describes device tree bindings for various devices that
exist on some Freescale reference boards.

* Board Control and Status (BCSR)

Required properties:

 - compatible : Should be "fsl,<board>-bcsr"
 - reg : Offset and length of the register set for the device

Example:

	bcsr@f8000000 {
		compatible = "fsl,mpc8360mds-bcsr";
		reg = <f8000000 8000>;
	};

* Freescale on-board FPGA

This is the memory-mapped registers for on board FPGA.

Required properties:
- compatible: should be a board-specific string followed by a string
  indicating the type of FPGA.  Example:
	"fsl,<board>-fpga", "fsl,fpga-pixis", or
	"fsl,<board>-fpga", "fsl,fpga-qixis"
- reg: should contain the address and the length of the FPGA register set.

Optional properties:
- interrupts: should specify event (wakeup) IRQ.

Example (P1022DS):

	 board-control@3,0 {
		 compatible = "fsl,p1022ds-fpga", "fsl,fpga-ngpixis";
		 reg = <3 0 0x30>;
		 interrupt-parent = <&mpic>;
		 interrupts = <8 8 0 0>;
	 };

Example (LS2080A-RDB):

        cpld@3,0 {
                compatible = "fsl,ls2080ardb-fpga", "fsl,fpga-qixis";
                reg = <0x3 0 0x10000>;
        };

* Freescale on-board FPGA connected on I2C bus

Some Freescale boards like BSC9132QDS have on board FPGA connected on
the i2c bus.

Required properties:
- compatible: Should be a board-specific string followed by a string
  indicating the type of FPGA.  Example:
	"fsl,<board>-fpga", "fsl,fpga-qixis-i2c"
- reg: Should contain the address of the FPGA

Example:
	fpga: fpga@66 {
		compatible = "fsl,bsc9132qds-fpga", "fsl,fpga-qixis-i2c";
		reg = <0x66>;
	};

* Freescale on-board CPLD

Some Freescale boards like T1040RDB have an on board CPLD connected.

Required properties:
- compatible: Should be a board-specific string like "fsl,<board>-cpld"
  Example:
	"fsl,t1040rdb-cpld", "fsl,t1042rdb-cpld", "fsl,t1042rdb_pi-cpld"
- reg: should describe CPLD registers

Example:
	cpld@3,0 {
		compatible = "fsl,t1040rdb-cpld";
		reg = <3 0 0x300>;
	};
```

## Documentation/devicetree/bindings/btmrvl.txt
```
btmrvl
------

Required properties:

  - compatible : must be "btmrvl,cfgdata"

Optional properties:

  - btmrvl,cal-data : Calibration data downloaded to the device during
		      initialization. This is an array of 28 values(u8).

  - btmrvl,gpio-gap : gpio and gap (in msecs) combination to be
		      configured.

Example:

GPIO pin 13 is configured as a wakeup source and GAP is set to 100 msecs
in below example.

btmrvl {
	compatible = "btmrvl,cfgdata";

	btmrvl,cal-data = /bits/ 8 <
		0x37 0x01 0x1c 0x00 0xff 0xff 0xff 0xff 0x01 0x7f 0x04 0x02
		0x00 0x00 0xba 0xce 0xc0 0xc6 0x2d 0x00 0x00 0x00 0x00 0x00
		0x00 0x00 0xf0 0x00>;
	btmrvl,gpio-gap = <0x0d64>;
};
```

## Documentation/devicetree/bindings/bus/allwinner,sun50i-a64-de2.yaml
```yaml
# SPDX-License-Identifier: GPL-2.0
%YAML 1.2
---
$id: http://devicetree.org/schemas/bus/allwinner,sun50i-a64-de2.yaml#
$schema: http://devicetree.org/meta-schemas/core.yaml#

title: Allwinner A64 Display Engine Bus Device Tree Bindings

maintainers:
  - Chen-Yu Tsai <wens@csie.org>
  - Maxime Ripard <maxime.ripard@bootlin.com>

properties:
  $nodename:
    pattern: "^bus(@[0-9a-f]+)?$"

  "#address-cells":
    const: 1

  "#size-cells":
    const: 1

  compatible:
    oneOf:
      - const: allwinner,sun50i-a64-de2
      - items:
          - const: allwinner,sun50i-h6-de3
          - const: allwinner,sun50i-a64-de2

  reg:
    maxItems: 1

  allwinner,sram:
    allOf:
      - $ref: /schemas/types.yaml#definitions/phandle-array
      - maxItems: 1
    description:
      The SRAM that needs to be claimed to access the display engine
      bus.

  ranges: true

patternProperties:
  # All other properties should be child nodes with unit-address and 'reg'
  "^[a-zA-Z][a-zA-Z0-9,+\\-._]{0,63}@[0-9a-fA-F]+$":
    type: object
    properties:
      reg:
        maxItems: 1

    required:
      - reg

required:
  - compatible
  - reg
  - "#address-cells"
  - "#size-cells"
  - ranges
  - allwinner,sram

additionalProperties: false

examples:
  - |
    bus@1000000 {
        compatible = "allwinner,sun50i-a64-de2";
        reg = <0x1000000 0x400000>;
        allwinner,sram = <&de2_sram 1>;
        #address-cells = <1>;
        #size-cells = <1>;
        ranges = <0 0x1000000 0x400000>;

        display_clocks: clock@0 {
            compatible = "allwinner,sun50i-a64-de2-clk";
            reg = <0x0 0x100000>;
            clocks = <&ccu 52>, <&ccu 99>;
            clock-names = "bus", "mod";
            resets = <&ccu 30>;
            #clock-cells = <1>;
            #reset-cells = <1>;
        };
    };

...
```

## Documentation/devicetree/bindings/bus/allwinner,sun8i-a23-rsb.yaml
```yaml
# SPDX-License-Identifier: GPL-2.0
%YAML 1.2
---
$id: http://devicetree.org/schemas/bus/allwinner,sun8i-a23-rsb.yaml#
$schema: http://devicetree.org/meta-schemas/core.yaml#

title: Allwinner A23 RSB Device Tree Bindings

maintainers:
  - Chen-Yu Tsai <wens@csie.org>
  - Maxime Ripard <maxime.ripard@bootlin.com>

properties:
  "#address-cells":
    const: 1

  "#size-cells":
    const: 0

  compatible:
    oneOf:
      - const: allwinner,sun8i-a23-rsb
      - items:
        - const: allwinner,sun8i-a83t-rsb
        - const: allwinner,sun8i-a23-rsb

  reg:
    maxItems: 1

  interrupts:
    maxItems: 1

  clocks:
    maxItems: 1

  resets:
    maxItems: 1

  clock-frequency:
    minimum: 1
    maximum: 20000000

patternProperties:
  "^.*@[0-9a-fA-F]+$":
    properties:
      reg:
        maxItems: 1

    required:
      - reg

required:
  - compatible
  - reg
  - interrupts
  - clocks
  - resets

examples:
  - |
    rsb@1f03400 {
        compatible = "allwinner,sun8i-a23-rsb";
        reg = <0x01f03400 0x400>;
        interrupts = <0 39 4>;
        clocks = <&apb0_gates 3>;
        clock-frequency = <3000000>;
        resets = <&apb0_rst 3>;
        #address-cells = <1>;
        #size-cells = <0>;

        pmic@3e3 {
            compatible = "...";
            reg = <0x3e3>;

            /* ... */
        };
    };

additionalProperties: false
```

## Documentation/devicetree/bindings/bus/arm,integrator-ap-lm.yaml
```yaml
# SPDX-License-Identifier: (GPL-2.0-only OR BSD-2-Clause)
%YAML 1.2
---
$id: http://devicetree.org/schemas/bus/arm,integrator-ap-lm.yaml#
$schema: http://devicetree.org/meta-schemas/core.yaml#

title: Integrator/AP Logic Module extension bus

maintainers:
  - Linus Walleij <linusw@kernel.org>

description: The Integrator/AP is a prototyping platform and as such has a
  site for stacking up to four logic modules (LM) designed specifically for
  use with this platform. A special system controller register can be read to
  determine if a logic module is connected at index 0, 1, 2 or 3. The logic
  module connector is described in this binding. The logic modules per se
  then have their own specific per-module bindings and they will be described
  as subnodes under this logic module extension bus.

properties:
  "#address-cells":
    const: 1

  "#size-cells":
    const: 1

  compatible:
    items:
      - const: arm,integrator-ap-lm

  ranges: true
  dma-ranges: true

patternProperties:
  "^bus(@[0-9a-f]*)?$":
    description: Nodes on the Logic Module bus represent logic modules
      and are named with bus. The first module is at 0xc0000000, the second
      at 0xd0000000 and so on until the top of the memory of the system at
      0xffffffff. All information about the memory used by the module is
      in ranges and dma-ranges.
    type: object

    required:
      - compatible

required:
  - compatible

examples:
  - |
    bus@c0000000 {
      compatible = "arm,integrator-ap-lm";
      #address-cells = <1>;
      #size-cells = <1>;
      ranges = <0xc0000000 0xc0000000 0x40000000>;
      dma-ranges;

      bus@c0000000 {
        compatible = "simple-bus";
        ranges = <0x00000000 0xc0000000 0x10000000>;
        /* The Logic Modules sees the Core Module 0 RAM @80000000 */
        dma-ranges = <0x00000000 0x80000000 0x10000000>;
        #address-cells = <1>;
        #size-cells = <1>;

        serial@100000 {
          compatible = "arm,pl011", "arm,primecell";
          reg = <0x00100000 0x1000>;
          interrupts-extended = <&impd1_vic 1>;
        };

        impd1_vic: interrupt-controller@3000000 {
          compatible = "arm,pl192-vic";
          interrupt-controller;
          #interrupt-cells = <1>;
          reg = <0x03000000 0x1000>;
          valid-mask = <0x00000bff>;
          interrupts-extended = <&pic 9>;
        };
      };
    };

additionalProperties: false
```

## Documentation/devicetree/bindings/bus/aspeed,ast2600-ahbc.yaml
```yaml
# SPDX-License-Identifier: (GPL-2.0-only OR BSD-2-Clause)
%YAML 1.2
---
$id: http://devicetree.org/schemas/bus/aspeed,ast2600-ahbc.yaml#
$schema: http://devicetree.org/meta-schemas/core.yaml#

title: ASPEED Advanced High-Performance Bus Controller (AHBC)

maintainers:
  - Neal Liu <neal_liu@aspeedtech.com>
  - Chia-Wei Wang <chiawei_wang@aspeedtech.com>

description: |
  Advanced High-performance Bus Controller (AHBC) supports plenty of mechanisms
  including a priority arbiter, an address decoder and a data multiplexer
  to control the overall operations of Advanced High-performance Bus (AHB).

properties:
  compatible:
    enum:
      - aspeed,ast2600-ahbc

  reg:
    maxItems: 1

required:
  - compatible
  - reg

additionalProperties: false

examples:
  - |
    ahbc@1e600000 {
        compatible = "aspeed,ast2600-ahbc";
        reg = <0x1e600000 0x100>;
    };
```
