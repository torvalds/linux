## Documentation/devicetree/bindings/ata/sata_highbank.yaml
```yaml
# SPDX-License-Identifier: (GPL-2.0-only OR BSD-2-Clause)
%YAML 1.2
---
$id: http://devicetree.org/schemas/ata/sata_highbank.yaml#
$schema: http://devicetree.org/meta-schemas/core.yaml#

title: Calxeda AHCI SATA Controller

description: |
  The Calxeda SATA controller mostly conforms to the AHCI interface
  with some special extensions to add functionality, to map GPIOs for
  activity LEDs and for mapping the ComboPHYs.

maintainers:
  - Andre Przywara <andre.przywara@arm.com>

properties:
  compatible:
    const: calxeda,hb-ahci

  reg:
    maxItems: 1

  interrupts:
    maxItems: 1

  dma-coherent: true

  calxeda,pre-clocks:
    $ref: /schemas/types.yaml#/definitions/uint32
    description: |
      Indicates the number of additional clock cycles to transmit before
      sending an SGPIO pattern.

  calxeda,post-clocks:
    $ref: /schemas/types.yaml#/definitions/uint32
    description: |
      Indicates the number of additional clock cycles to transmit after
      sending an SGPIO pattern.

  calxeda,led-order:
    description: Maps port numbers to offsets within the SGPIO bitstream.
    $ref: /schemas/types.yaml#/definitions/uint32-array
    minItems: 1
    maxItems: 8

  calxeda,port-phys:
    description: |
      phandle-combophy and lane assignment, which maps each SATA port to a
      combophy and a lane within that combophy
    $ref: /schemas/types.yaml#/definitions/phandle-array
    minItems: 1
    maxItems: 8

  calxeda,tx-atten:
    description: |
      Contains TX attenuation override codes, one per port.
      The upper 24 bits of each entry are always 0 and thus ignored.
    $ref: /schemas/types.yaml#/definitions/uint32-array
    minItems: 1
    maxItems: 8

  calxeda,sgpio-gpio:
    maxItems: 3
    description: |
      phandle-gpio bank, bit offset, and default on or off, which indicates
      that the driver supports SGPIO indicator lights using the indicated
      GPIOs.

required:
  - compatible
  - reg
  - interrupts

additionalProperties: false

examples:
  - |
    sata@ffe08000 {
        compatible = "calxeda,hb-ahci";
        reg = <0xffe08000 0x1000>;
        interrupts = <115>;
        dma-coherent;
        calxeda,port-phys = <&combophy5 0>, <&combophy0 0>, <&combophy0 1>,
                             <&combophy0 2>, <&combophy0 3>;
        calxeda,sgpio-gpio =<&gpioh 5 1>, <&gpioh 6 1>, <&gpioh 7 1>;
        calxeda,led-order = <4 0 1 2 3>;
        calxeda,tx-atten = <0xff 22 0xff 0xff 23>;
        calxeda,pre-clocks = <10>;
        calxeda,post-clocks = <0>;
    };

...
```

## Documentation/devicetree/bindings/ata/sata_rcar.txt
```
* Renesas R-Car SATA

Required properties:
- compatible		: should contain one or more of the following:
			  - "renesas,sata-r8a7779" for R-Car H1
			  - "renesas,sata-r8a7790-es1" for R-Car H2 ES1
			  - "renesas,sata-r8a7790" for R-Car H2 other than ES1
			  - "renesas,sata-r8a7791" for R-Car M2-W
			  - "renesas,sata-r8a7793" for R-Car M2-N
			  - "renesas,sata-r8a7795" for R-Car H3
			  - "renesas,sata-r8a77965" for R-Car M3-N
			  - "renesas,rcar-gen2-sata" for a generic R-Car Gen2 compatible device
			  - "renesas,rcar-gen3-sata" for a generic R-Car Gen3 compatible device
			  - "renesas,rcar-sata" is deprecated

			  When compatible with the generic version nodes
			  must list the SoC-specific version corresponding
			  to the platform first followed by the generic
			  version.

- reg			: address and length of the SATA registers;
- interrupts		: must consist of one interrupt specifier.
- clocks		: must contain a reference to the functional clock.

Example:

sata0: sata@ee300000 {
	compatible = "renesas,sata-r8a7791", "renesas,rcar-gen2-sata";
	reg = <0 0xee300000 0 0x2000>;
	interrupt-parent = <&gic>;
	interrupts = <0 105 IRQ_TYPE_LEVEL_HIGH>;
	clocks = <&mstp8_clks R8A7791_CLK_SATA0>;
};
```

## Documentation/devicetree/bindings/ata/snps,dwc-ahci-common.yaml
```yaml
# SPDX-License-Identifier: (GPL-2.0-only OR BSD-2-Clause)
%YAML 1.2
---
$id: http://devicetree.org/schemas/ata/snps,dwc-ahci-common.yaml#
$schema: http://devicetree.org/meta-schemas/core.yaml#

title: Synopsys DWC AHCI SATA controller properties

maintainers:
  - Serge Semin <fancer.lancer@gmail.com>

description:
  This document defines device tree schema for the generic Synopsys DWC
  AHCI controller properties.

select: false

allOf:
  - $ref: ahci-common.yaml#

properties:
  reg:
    maxItems: 1

  interrupts:
    maxItems: 1

  clocks:
    description:
      Basic DWC AHCI SATA clock sources like application AXI/AHB BIU clock,
      PM-alive clock, RxOOB detection clock, embedded PHYs reference (Rx/Tx)
      clock, etc.
    minItems: 1
    maxItems: 6

  clock-names:
    minItems: 1
    maxItems: 6
    items:
      oneOf:
        - description: Application APB/AHB/AXI BIU clock
          enum:
            - pclk
            - aclk
            - hclk
            - sata
        - description: Power Module keep-alive clock
          const: pmalive
        - description: RxOOB detection clock
          const: rxoob
        - description: PHY Transmit Clock
          const: asic
        - description: PHY Receive Clock
          const: rbc
        - description: SATA Ports reference clock
          const: ref

  resets:
    description:
      At least basic application and reference clock domains resets are
      normally supported by the DWC AHCI SATA controller.
    minItems: 1
    maxItems: 4

  reset-names:
    minItems: 1
    maxItems: 4
    items:
      oneOf:
        - description: Application AHB/AXI BIU clock domain reset control
          enum:
            - arst
            - hrst
        - description: Power Module keep-alive clock domain reset control
          const: pmalive
        - description: RxOOB detection clock domain reset control
          const: rxoob
        - description: Reference clock domain reset control
          const: ref

patternProperties:
  "^sata-port@[0-9a-e]$":
    $ref: '#/$defs/dwc-ahci-port'

additionalProperties: true

$defs:
  dwc-ahci-port:
    $ref: /schemas/ata/ahci-common.yaml#/$defs/ahci-port

    properties:
      reg:
        minimum: 0
        maximum: 7

      snps,tx-ts-max:
        $ref: /schemas/types.yaml#/definitions/uint32
        description: Maximal size of Tx DMA transactions in FIFO words
        enum: [ 1, 2, 4, 8, 16, 32, 64, 128, 256, 512, 1024 ]

      snps,rx-ts-max:
        $ref: /schemas/types.yaml#/definitions/uint32
        description: Maximal size of Rx DMA transactions in FIFO words
        enum: [ 1, 2, 4, 8, 16, 32, 64, 128, 256, 512, 1024 ]

...
```

## Documentation/devicetree/bindings/ata/snps,dwc-ahci.yaml
```yaml
# SPDX-License-Identifier: (GPL-2.0-only OR BSD-2-Clause)
%YAML 1.2
---
$id: http://devicetree.org/schemas/ata/snps,dwc-ahci.yaml#
$schema: http://devicetree.org/meta-schemas/core.yaml#

title: Synopsys DWC AHCI SATA controller

maintainers:
  - Serge Semin <fancer.lancer@gmail.com>

description:
  This document defines device tree bindings for the generic Synopsys DWC
  implementation of the AHCI SATA controller.

select:
  properties:
    compatible:
      enum:
        - snps,dwc-ahci
        - snps,spear-ahci
  required:
    - compatible

allOf:
  - $ref: snps,dwc-ahci-common.yaml#

properties:
  compatible:
    oneOf:
      - description: Synopsys AHCI SATA-compatible devices
        const: snps,dwc-ahci
      - description: SPEAr1340 AHCI SATA device
        const: snps,spear-ahci

patternProperties:
  "^sata-port@[0-9a-e]$":
    $ref: /schemas/ata/snps,dwc-ahci-common.yaml#/$defs/dwc-ahci-port

    unevaluatedProperties: false

required:
  - compatible
  - reg
  - interrupts

unevaluatedProperties: false

examples:
  - |
    #include <dt-bindings/interrupt-controller/arm-gic.h>
    #include <dt-bindings/ata/ahci.h>

    sata@122f0000 {
      compatible = "snps,dwc-ahci";
      reg = <0x122F0000 0x1ff>;
      #address-cells = <1>;
      #size-cells = <0>;

      interrupts = <GIC_SPI 115 IRQ_TYPE_LEVEL_HIGH>;

      clocks = <&clock1>, <&clock2>;
      clock-names = "aclk", "ref";

      phys = <&sata_phy>;
      phy-names = "sata-phy";

      ports-implemented = <0x1>;

      sata-port@0 {
        reg = <0>;

        hba-port-cap = <HBA_PORT_FBSCP>;

        snps,tx-ts-max = <512>;
        snps,rx-ts-max = <512>;
      };
    };

...
```

## Documentation/devicetree/bindings/ata/st,ahci.yaml
```yaml
# SPDX-License-Identifier: (GPL-2.0-only OR BSD-2-Clause)
%YAML 1.2
---
$id: http://devicetree.org/schemas/ata/st,ahci.yaml#
$schema: http://devicetree.org/meta-schemas/core.yaml#

title: STMicroelectronics STi SATA controller

maintainers:
  - Patrice Chotard <patrice.chotard@foss.st.com>

allOf:
  - $ref: ahci-common.yaml#

properties:
  compatible:
    const: st,ahci

  interrupt-names:
    items:
      - const: hostc

  clocks:
    maxItems: 1

  clock-names:
    items:
      - const: ahci_clk

  resets:
    items:
      - description: Power-down line
      - description: Soft-reset line
      - description: Power-reset line

  reset-names:
    items:
      - const: pwr-dwn
      - const: sw-rst
      - const: pwr-rst

required:
  - compatible
  - interrupt-names
  - phys
  - phy-names
  - clocks
  - clock-names

unevaluatedProperties: false

examples:
  - |
    #include <dt-bindings/interrupt-controller/arm-gic.h>
    #include <dt-bindings/phy/phy.h>
    #include <dt-bindings/reset/stih407-resets.h>
    #include <dt-bindings/clock/stih407-clks.h>

    sata@9b20000 {
        compatible    = "st,ahci";
        reg           = <0x9b20000 0x1000>;
        interrupts    = <GIC_SPI 159 IRQ_TYPE_NONE>;
        interrupt-names = "hostc";
        phys          = <&phy_port0 PHY_TYPE_SATA>;
        phy-names     = "sata-phy";
        resets        = <&powerdown STIH407_SATA0_POWERDOWN>,
                         <&softreset STIH407_SATA0_SOFTRESET>,
                         <&softreset STIH407_SATA0_PWR_SOFTRESET>;
        reset-names   = "pwr-dwn", "sw-rst", "pwr-rst";
        clocks        = <&clk_s_c0_flexgen CLK_ICN_REG>;
        clock-names   = "ahci_clk";
    };
```

## Documentation/devicetree/bindings/ata/ti,da850-ahci.yaml
```yaml
# SPDX-License-Identifier: (GPL-2.0-only OR BSD-2-Clause)
%YAML 1.2
---
$id: http://devicetree.org/schemas/ata/ti,da850-ahci.yaml#
$schema: http://devicetree.org/meta-schemas/core.yaml#

title: TI DA850 AHCI SATA Controller

maintainers:
  - Animesh Agarwal <animeshagarwal28@gmail.com>

properties:
  compatible:
    const: ti,da850-ahci

  reg:
    items:
      - description: Address and size of the register map as defined by the AHCI 1.1 standard.
      - description:
          Address and size of Power Down Control Register (PWRDN) for enabling/disabling the SATA clock
          receiver.

  interrupts:
    maxItems: 1

required:
  - compatible
  - reg
  - interrupts

additionalProperties: false

examples:
  - |
    sata@218000 {
        compatible = "ti,da850-ahci";
        reg = <0x218000 0x2000>, <0x22c018 0x4>;
        interrupts = <67>;
    };
```

## Documentation/devicetree/bindings/ata/ti,dm816-ahci.yaml
```yaml
# SPDX-License-Identifier: (GPL-2.0-only OR BSD-2-Clause)
%YAML 1.2
---
$id: http://devicetree.org/schemas/ata/ti,dm816-ahci.yaml#
$schema: http://devicetree.org/meta-schemas/core.yaml#

title: TI DM816 AHCI SATA Controller

maintainers:
  - Bartosz Golaszewski <brgl@bgdev.pl>

allOf:
  - $ref: ahci-common.yaml#

properties:
  compatible:
    const: ti,dm816-ahci

  reg:
    maxItems: 1

  clocks:
    items:
      - description: functional clock
      - description: external reference clock

  ti,hwmods:
    const: sata

required:
  - compatible
  - clocks

unevaluatedProperties: false

examples:
  - |
    sata@4a140000 {
        compatible = "ti,dm816-ahci";
        reg = <0x4a140000 0x10000>;
        interrupts = <16>;
        clocks = <&sysclk5_ck>, <&sata_refclk>;
    };
```

## Documentation/devicetree/bindings/auxdisplay/arm,versatile-lcd.yaml
```yaml
# SPDX-License-Identifier: (GPL-2.0-only OR BSD-2-Clause)
%YAML 1.2
---
$id: http://devicetree.org/schemas/auxdisplay/arm,versatile-lcd.yaml#
$schema: http://devicetree.org/meta-schemas/core.yaml#

title: ARM Versatile Character LCD

maintainers:
  - Linus Walleij <linus.walleij@linaro.org>
  - Rob Herring <robh@kernel.org>

description:
  This binding defines the character LCD interface found on ARM Versatile AB
  and PB reference platforms.

properties:
  compatible:
    const: arm,versatile-lcd

  reg:
    maxItems: 1

  clocks:
    maxItems: 1

  clock-names:
    maxItems: 1

  interrupts:
    maxItems: 1

required:
  - compatible
  - reg

additionalProperties: false

examples:
  - |
    lcd@10008000 {
        compatible = "arm,versatile-lcd";
        reg = <0x10008000 0x1000>;
    };
```

## Documentation/devicetree/bindings/auxdisplay/gpio-7-segment.yaml
```yaml
# SPDX-License-Identifier: (GPL-2.0-only OR BSD-2-Clause)
%YAML 1.2
---
$id: http://devicetree.org/schemas/auxdisplay/gpio-7-segment.yaml#
$schema: http://devicetree.org/meta-schemas/core.yaml#

title: GPIO based LED segment display

maintainers:
  - Chris Packham <chris.packham@alliedtelesis.co.nz>

properties:
  compatible:
    const: gpio-7-segment

  segment-gpios:
    description: |
      An array of GPIOs one per segment. The first GPIO corresponds to the A
      segment, the seventh GPIO corresponds to the G segment. Some LED blocks
      also have a decimal point which can be specified as an optional eighth
      segment.

               -a-
              |   |
              f   b
              |   |
               -g-
              |   |
              e   c
              |   |
               -d-  dp

    minItems: 7
    maxItems: 8

required:
  - segment-gpios

additionalProperties: false

examples:
  - |

    #include <dt-bindings/gpio/gpio.h>

    led-7seg {
        compatible = "gpio-7-segment";
        segment-gpios = <&gpio 0 GPIO_ACTIVE_LOW>,
                        <&gpio 1 GPIO_ACTIVE_LOW>,
                        <&gpio 2 GPIO_ACTIVE_LOW>,
                        <&gpio 3 GPIO_ACTIVE_LOW>,
                        <&gpio 4 GPIO_ACTIVE_LOW>,
                        <&gpio 5 GPIO_ACTIVE_LOW>,
                        <&gpio 6 GPIO_ACTIVE_LOW>;
    };
```
