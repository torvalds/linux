## Documentation/devicetree/bindings/ata/imx-sata.txt
```
* Freescale i.MX AHCI SATA Controller

The Freescale i.MX SATA controller mostly conforms to the AHCI interface
with some special extensions at integration level.

Required properties:
- compatible : should be one of the following:
   - "fsl,imx53-ahci" for i.MX53 SATA controller
   - "fsl,imx6q-ahci" for i.MX6Q SATA controller
- interrupts : interrupt mapping for SATA IRQ
- reg : registers mapping
- clocks : list of clock specifiers, must contain an entry for each
  required entry in clock-names
- clock-names : should include "sata", "sata_ref" and "ahb" entries

Optional properties:
- fsl,transmit-level-mV : transmit voltage level, in millivolts.
- fsl,transmit-boost-mdB : transmit boost level, in milli-decibels
- fsl,transmit-atten-16ths : transmit attenuation, in 16ths
- fsl,receive-eq-mdB : receive equalisation, in milli-decibels
  Please refer to the technical documentation or the driver source code
  for the list of legal values for these options.
- fsl,no-spread-spectrum : disable spread-spectrum clocking on the SATA
  link.

Examples:

sata@02200000 {
	compatible = "fsl,imx6q-ahci";
	reg = <0x02200000 0x4000>;
	interrupts = <0 39 IRQ_TYPE_LEVEL_HIGH>;
	clocks = <&clks IMX6QDL_CLK_SATA>,
		 <&clks IMX6QDL_CLK_SATA_REF_100M>,
		 <&clks IMX6QDL_CLK_AHB>;
	clock-names = "sata", "sata_ref", "ahb";
};
```

## Documentation/devicetree/bindings/ata/imx-sata.yaml
```yaml
# SPDX-License-Identifier: (GPL-2.0-only OR BSD-2-Clause)
%YAML 1.2
---
$id: http://devicetree.org/schemas/ata/imx-sata.yaml#
$schema: http://devicetree.org/meta-schemas/core.yaml#

title: Freescale i.MX AHCI SATA Controller

maintainers:
  - Shawn Guo <shawn.guo@linaro.org>

description: |
  The Freescale i.MX SATA controller mostly conforms to the AHCI interface
  with some special extensions at integration level.

properties:
  compatible:
    enum:
      - fsl,imx53-ahci
      - fsl,imx6q-ahci
      - fsl,imx6qp-ahci
      - fsl,imx8qm-ahci

  reg:
    maxItems: 1

  interrupts:
    maxItems: 1

  clocks:
    minItems: 2
    items:
      - description: sata clock
      - description: sata reference clock
      - description: ahb clock

  clock-names:
    minItems: 2
    items:
      - const: sata
      - const: sata_ref
      - const: ahb

  fsl,transmit-level-mV:
    $ref: /schemas/types.yaml#/definitions/uint32
    description: transmit voltage level, in millivolts.

  fsl,transmit-boost-mdB:
    $ref: /schemas/types.yaml#/definitions/uint32
    description: transmit boost level, in milli-decibels.

  fsl,transmit-atten-16ths:
    $ref: /schemas/types.yaml#/definitions/uint32
    description: transmit attenuation, in 16ths.

  fsl,receive-eq-mdB:
    $ref: /schemas/types.yaml#/definitions/uint32
    description: receive equalisation, in milli-decibels.

  fsl,no-spread-spectrum:
    $ref: /schemas/types.yaml#/definitions/flag
    description: if present, disable spread-spectrum clocking on the SATA link.

  phys:
    items:
      - description: phandle to SATA PHY.
          Since "REXT" pin is only present for first lane of i.MX8QM PHY, it's
          calibration result will be stored, passed through second lane, and
          shared with all three lanes PHY. The first two lanes PHY are used as
          calibration PHYs, although only the third lane PHY is used by SATA.
      - description: phandle to the first lane PHY of i.MX8QM.
      - description: phandle to the second lane PHY of i.MX8QM.

  phy-names:
    items:
      - const: sata-phy
      - const: cali-phy0
      - const: cali-phy1

  power-domains:
    maxItems: 1

  target-supply:
    description: Power regulator for the SATA target device.

required:
  - compatible
  - reg
  - interrupts
  - clocks
  - clock-names

allOf:
  - if:
      properties:
        compatible:
          contains:
            enum:
              - fsl,imx53-ahci
              - fsl,imx6q-ahci
              - fsl,imx6qp-ahci
    then:
      properties:
        clock-names:
          minItems: 3

  - if:
      properties:
        compatible:
          contains:
            enum:
              - fsl,imx8qm-ahci
    then:
      properties:
        clock-names:
          minItems: 2

additionalProperties: false

examples:
  - |
    #include <dt-bindings/clock/imx6qdl-clock.h>
    #include <dt-bindings/interrupt-controller/arm-gic.h>

    sata@2200000 {
        compatible = "fsl,imx6q-ahci";
        reg = <0x02200000 0x4000>;
        interrupts = <0 39 IRQ_TYPE_LEVEL_HIGH>;
        clocks = <&clks IMX6QDL_CLK_SATA>,
                 <&clks IMX6QDL_CLK_SATA_REF_100M>,
                 <&clks IMX6QDL_CLK_AHB>;
        clock-names = "sata", "sata_ref", "ahb";
    };
```

## Documentation/devicetree/bindings/ata/intel,ixp4xx-compact-flash.yaml
```yaml
# SPDX-License-Identifier: (GPL-2.0-only OR BSD-2-Clause)
%YAML 1.2
---
$id: http://devicetree.org/schemas/ata/intel,ixp4xx-compact-flash.yaml#
$schema: http://devicetree.org/meta-schemas/core.yaml#

title: Intel IXP4xx CompactFlash Card Controller

maintainers:
  - Linus Walleij <linus.walleij@linaro.org>

description: |
  The IXP4xx network processors have a CompactFlash interface that presents
  a CompactFlash card to the system as a true IDE (parallel ATA) device. The
  device is always connected to the expansion bus of the IXP4xx SoCs using one
  or two chip select areas and address translating logic on the board. The
  node must be placed inside a chip select node on the IXP4xx expansion bus.

properties:
  compatible:
    const: intel,ixp4xx-compact-flash

  reg:
    items:
      - description: Command interface registers
      - description: Control interface registers

  interrupts:
    maxItems: 1

required:
  - compatible
  - reg
  - interrupts

allOf:
  - $ref: pata-common.yaml#
  - $ref: /schemas/memory-controllers/intel,ixp4xx-expansion-peripheral-props.yaml#

unevaluatedProperties: false

examples:
  - |
    #include <dt-bindings/interrupt-controller/irq.h>

    bus@c4000000 {
      compatible = "intel,ixp43x-expansion-bus-controller", "syscon";
      reg = <0xc4000000 0x1000>;
      native-endian;
      #address-cells = <2>;
      #size-cells = <1>;
      ranges = <0 0x0 0x50000000 0x01000000>, <1 0x0 0x51000000 0x01000000>;
      dma-ranges = <0 0x0 0x50000000 0x01000000>, <1 0x0 0x51000000 0x01000000>;
      ide@1,0 {
        compatible = "intel,ixp4xx-compact-flash";
        reg = <1 0x00000000 0x1000>, <1 0x00040000 0x1000>;
        interrupt-parent = <&gpio0>;
        interrupts = <12 IRQ_TYPE_EDGE_RISING>;
      };
    };

...
```

## Documentation/devicetree/bindings/ata/marvell,orion-sata.yaml
```yaml
# SPDX-License-Identifier: (GPL-2.0-only OR BSD-2-Clause)
%YAML 1.2
---
$id: http://devicetree.org/schemas/ata/marvell,orion-sata.yaml#
$schema: http://devicetree.org/meta-schemas/core.yaml#

title: Marvell Orion SATA

maintainers:
  - Andrew Lunn <andrew@lunn.ch>
  - Gregory Clement <gregory.clement@bootlin.com>

allOf:
  - $ref: sata-common.yaml#

properties:
  compatible:
    enum:
      - marvell,orion-sata
      - marvell,armada-370-sata

  reg:
    maxItems: 1

  clocks:
    minItems: 1
    maxItems: 8

  clock-names:
    minItems: 1
    items:
      - const: '0'
      - const: '1'
      - const: '2'
      - const: '3'
      - const: '4'
      - const: '5'
      - const: '6'
      - const: '7'

  interrupts:
    maxItems: 1

  nr-ports:
    description:
      Number of SATA ports in use.
    $ref: /schemas/types.yaml#/definitions/uint32
    maximum: 8

  phys:
    minItems: 1
    maxItems: 8

  phy-names:
    minItems: 1
    items:
      - const: port0
      - const: port1
      - const: port2
      - const: port3
      - const: port4
      - const: port5
      - const: port6
      - const: port7

required:
  - compatible
  - reg
  - interrupts
  - nr-ports

unevaluatedProperties: false

examples:
  - |
    sata@80000 {
        compatible = "marvell,orion-sata";
        reg = <0x80000 0x5000>;
        interrupts = <21>;
        phys = <&sata_phy0>, <&sata_phy1>;
        phy-names = "port0", "port1";
        nr-ports = <2>;
    };
```

## Documentation/devicetree/bindings/ata/marvell.txt
```
* Marvell Orion SATA

Required Properties:
- compatibility : "marvell,orion-sata" or "marvell,armada-370-sata"
- reg           : Address range of controller
- interrupts    : Interrupt controller is using
- nr-ports      : Number of SATA ports in use.

Optional Properties:
- phys		: List of phandles to sata phys
- phy-names	: Should be "0", "1", etc, one number per phandle

Example:

	sata@80000 {
		compatible = "marvell,orion-sata";
		reg = <0x80000 0x5000>;
		interrupts = <21>;
		phys = <&sata_phy0>, <&sata_phy1>;
		phy-names = "0", "1";
		nr-ports = <2>;
	}
```

## Documentation/devicetree/bindings/ata/mediatek,mtk-ahci.yaml
```yaml
# SPDX-License-Identifier: GPL-2.0-only OR BSD-2-Clause
%YAML 1.2
---
$id: http://devicetree.org/schemas/ata/mediatek,mtk-ahci.yaml#
$schema: http://devicetree.org/meta-schemas/core.yaml#

title: MediaTek Serial ATA controller

maintainers:
  - Ryder Lee <ryder.lee@mediatek.com>

allOf:
  - $ref: ahci-common.yaml#

properties:
  compatible:
    items:
      - enum:
          - mediatek,mt7622-ahci
      - const: mediatek,mtk-ahci

  reg:
    maxItems: 1

  interrupts:
    maxItems: 1

  interrupt-names:
    const: hostc

  clocks:
    maxItems: 5

  clock-names:
    items:
      - const: ahb
      - const: axi
      - const: asic
      - const: rbc
      - const: pm

  power-domains:
    maxItems: 1

  resets:
    maxItems: 3

  reset-names:
    items:
      - const: axi
      - const: sw
      - const: reg

  mediatek,phy-mode:
    description: System controller phandle, used to enable SATA function
    $ref: /schemas/types.yaml#/definitions/phandle

required:
  - reg
  - interrupts
  - interrupt-names
  - clocks
  - clock-names
  - phys
  - phy-names
  - ports-implemented

unevaluatedProperties: false

examples:
  - |
    #include <dt-bindings/clock/mt7622-clk.h>
    #include <dt-bindings/interrupt-controller/arm-gic.h>
    #include <dt-bindings/phy/phy.h>
    #include <dt-bindings/power/mt7622-power.h>
    #include <dt-bindings/reset/mt7622-reset.h>

    sata@1a200000 {
        compatible = "mediatek,mt7622-ahci", "mediatek,mtk-ahci";
        reg = <0x1a200000 0x1100>;
        interrupts = <GIC_SPI 233 IRQ_TYPE_LEVEL_HIGH>;
        interrupt-names = "hostc";
        clocks = <&pciesys CLK_SATA_AHB_EN>,
                 <&pciesys CLK_SATA_AXI_EN>,
                 <&pciesys CLK_SATA_ASIC_EN>,
                 <&pciesys CLK_SATA_RBC_EN>,
                 <&pciesys CLK_SATA_PM_EN>;
        clock-names = "ahb", "axi", "asic", "rbc", "pm";
        phys = <&u3port1 PHY_TYPE_SATA>;
        phy-names = "sata-phy";
        ports-implemented = <0x1>;
        power-domains = <&scpsys MT7622_POWER_DOMAIN_HIF0>;
        resets = <&pciesys MT7622_SATA_AXI_BUS_RST>,
                 <&pciesys MT7622_SATA_PHY_SW_RST>,
                 <&pciesys MT7622_SATA_PHY_REG_RST>;
        reset-names = "axi", "sw", "reg";
        mediatek,phy-mode = <&pciesys>;
    };
```

## Documentation/devicetree/bindings/ata/nvidia,tegra-ahci.yaml
```yaml
# SPDX-License-Identifier: (GPL-2.0 OR BSD-2-Clause)
%YAML 1.2
---
$id: http://devicetree.org/schemas/ata/nvidia,tegra-ahci.yaml#
$schema: http://devicetree.org/meta-schemas/core.yaml#

title: Tegra AHCI SATA Controller

maintainers:
  - Thierry Reding <thierry.reding@gmail.com>
  - Jonathan Hunter <jonathanh@nvidia.com>

properties:
  compatible:
    enum:
      - nvidia,tegra124-ahci
      - nvidia,tegra132-ahci
      - nvidia,tegra210-ahci
      - nvidia,tegra186-ahci

  reg:
    minItems: 2
    maxItems: 3
    items:
      - description: AHCI registers
      - description: SATA configuration and IPFS registers
      - description: SATA AUX registers

  interrupts:
    maxItems: 1

  clock-names:
    items:
      - const: sata
      - const: sata-oob

  clocks:
    maxItems: 2

  reset-names:
    minItems: 2
    items:
      - const: sata
      - const: sata-cold
      - const: sata-oob

  resets:
    minItems: 2
    maxItems: 3

  iommus:
    maxItems: 1

  interconnect-names:
    items:
      - const: dma-mem
      - const: write

  interconnects:
    maxItems: 2

  power-domains:
    items:
      - description: SAX power-domain

  phy-names:
    items:
      - const: sata-0

  phys:
    maxItems: 1

  hvdd-supply:
    description: SATA HVDD regulator supply.

  vddio-supply:
    description: SATA VDDIO regulator supply.

  avdd-supply:
    description: SATA AVDD regulator supply.

  target-5v-supply:
    description: SATA 5V power regulator supply.

  target-12v-supply:
    description: SATA 12V power regulator supply.

required:
  - compatible
  - reg
  - interrupts
  - clock-names
  - clocks
  - reset-names
  - resets

allOf:
  - if:
      properties:
        compatible:
          contains:
            enum:
              - nvidia,tegra124-ahci
              - nvidia,tegra132-ahci
    then:
      properties:
        reg:
          maxItems: 2
        reset-names:
          minItems: 3
        resets:
          minItems: 3
      required:
        - phys
        - phy-names
        - hvdd-supply
        - vddio-supply
        - avdd-supply

  - if:
      properties:
        compatible:
          contains:
            enum:
              - nvidia,tegra210-ahci
    then:
      properties:
        reg:
          minItems: 3
        reset-names:
          minItems: 3
        resets:
          minItems: 3

  - if:
      properties:
        compatible:
          contains:
            enum:
              - nvidia,tegra186-ahci
    then:
      properties:
        reg:
          minItems: 3
        reset-names:
          maxItems: 2
        resets:
          maxItems: 2
      required:
        - iommus
        - interconnect-names
        - interconnects
        - power-domains

additionalProperties: true

examples:
  - |
    #include <dt-bindings/clock/tegra210-car.h>
    #include <dt-bindings/reset/tegra210-car.h>
    #include <dt-bindings/interrupt-controller/arm-gic.h>

    sata@70020000 {
            compatible = "nvidia,tegra210-ahci";
            reg = <0x70027000 0x00002000>, /* AHCI */
                  <0x70020000 0x00007000>, /* SATA */
                  <0x70001100 0x00010000>; /* SATA AUX */
            interrupts = <GIC_SPI 23 IRQ_TYPE_LEVEL_HIGH>;
            clocks = <&tegra_car TEGRA210_CLK_SATA>,
                     <&tegra_car TEGRA210_CLK_SATA_OOB>;
            clock-names = "sata", "sata-oob";
            resets = <&tegra_car 124>,
                     <&tegra_car 129>,
                     <&tegra_car 123>;
            reset-names = "sata", "sata-cold", "sata-oob";
    };
```
