## Documentation/devicetree/bindings/ata/nvidia,tegra124-ahci.txt
```
Tegra SoC SATA AHCI controller

Required properties :
- compatible : Must be one of:
  - Tegra124 : "nvidia,tegra124-ahci"
  - Tegra132 : "nvidia,tegra132-ahci", "nvidia,tegra124-ahci"
  - Tegra210 : "nvidia,tegra210-ahci"
- reg : Should contain 2 entries:
  - AHCI register set (SATA BAR5)
  - SATA register set
- interrupts : Defines the interrupt used by SATA
- clocks : Must contain an entry for each entry in clock-names.
  See ../clocks/clock-bindings.txt for details.
- clock-names : Must include the following entries:
  - sata
  - sata-oob
- resets : Must contain an entry for each entry in reset-names.
  See ../reset/reset.txt for details.
- reset-names : Must include the following entries:
  - sata
  - sata-oob
  - sata-cold
- phys : Must contain an entry for each entry in phy-names.
  See ../phy/phy-bindings.txt for details.
- phy-names : Must include the following entries:
  - For Tegra124 and Tegra132:
    - sata-phy : XUSB PADCTL SATA PHY
- For Tegra124 and Tegra132:
  - hvdd-supply : Defines the SATA HVDD regulator
  - vddio-supply : Defines the SATA VDDIO regulator
  - avdd-supply : Defines the SATA AVDD regulator
  - target-5v-supply : Defines the SATA 5V power regulator
  - target-12v-supply : Defines the SATA 12V power regulator

Optional properties:
- reg :
  - AUX register set
- clock-names :
  - cml1 :
    cml1 clock should be defined here if the PHY driver
    doesn't manage them. If it does, they should not be.
- phy-names :
  - For T210:
    - sata-phy
```

## Documentation/devicetree/bindings/ata/pata-arasan.txt
```
* ARASAN PATA COMPACT FLASH CONTROLLER

Required properties:
- compatible: "arasan,cf-spear1340"
- reg: Address range of the CF registers
- interrupt-parent: Should be the phandle for the interrupt controller
  that services interrupts for this device
- interrupt: Should contain the CF interrupt number
- clock-frequency: Interface clock rate, in Hz, one of
       25000000
       33000000
       40000000
       50000000
       66000000
       75000000
      100000000
      125000000
      150000000
      166000000
      200000000

Optional properties:
- arasan,broken-udma: if present, UDMA mode is unusable
- arasan,broken-mwdma: if present, MWDMA mode is unusable
- arasan,broken-pio: if present, PIO mode is unusable
- dmas: one DMA channel, as described in bindings/dma/dma.txt
  required unless both UDMA and MWDMA mode are broken
- dma-names: the corresponding channel name, must be "data"

Example:

	cf@fc000000 {
		compatible = "arasan,cf-spear1340";
		reg = <0xfc000000 0x1000>;
		interrupt-parent = <&vic1>;
		interrupts = <12>;
		dmas = <&dma-controller 23>;
		dma-names = "data";
	};
```

## Documentation/devicetree/bindings/ata/pata-common.yaml
```yaml
# SPDX-License-Identifier: (GPL-2.0-only OR BSD-2-Clause)
%YAML 1.2
---
$id: http://devicetree.org/schemas/ata/pata-common.yaml#
$schema: http://devicetree.org/meta-schemas/core.yaml#

title: Common Properties for Parallel AT attachment (PATA) controllers

maintainers:
  - Linus Walleij <linus.walleij@linaro.org>

description: |
  This document defines device tree properties common to most Parallel
  ATA (PATA, also known as IDE) AT attachment storage devices.
  It doesn't constitute a device tree binding specification by itself but is
  meant to be referenced by device tree bindings.

  The PATA (IDE) controller-specific device tree bindings are responsible for
  defining whether each property is required or optional.

properties:
  $nodename:
    pattern: "^ide(@.*)?$"
    description:
      Specifies the host controller node. PATA host controller nodes are named
      "ide".

  "#address-cells":
    const: 1

  "#size-cells":
    const: 0

patternProperties:
  "^ide-port@[0-1]$":
    description: |
      DT nodes for ports connected on the PATA host. The master drive will have
      ID number 0 and the slave drive will have ID number 1. The PATA port
      nodes will be named "ide-port".
    type: object
    additionalProperties: false

    properties:
      reg:
        minimum: 0
        maximum: 1
        description:
          The ID number of the drive port, 0 for the master port and 1 for the
          slave port.

additionalProperties: true

...
```

## Documentation/devicetree/bindings/ata/qcom-sata.txt
```
* Qualcomm AHCI SATA Controller

SATA nodes are defined to describe on-chip Serial ATA controllers.
Each SATA controller should have its own node.

Required properties:
- compatible		: compatible list, must contain "generic-ahci"
- interrupts		: <interrupt mapping for SATA IRQ>
- reg			: <registers mapping>
- phys			: Must contain exactly one entry as specified
			  in phy-bindings.txt
- phy-names		: Must be "sata-phy"

Required properties for "qcom,ipq806x-ahci" compatible:
- clocks		: Must contain an entry for each entry in clock-names.
- clock-names		: Shall be:
				"slave_iface" - Fabric port AHB clock for SATA
				"iface" - AHB clock
				"core" - core clock
				"rxoob" - RX out-of-band clock
				"pmalive" - Power Module Alive clock
- assigned-clocks	: Shall be:
				SATA_RXOOB_CLK
				SATA_PMALIVE_CLK
- assigned-clock-rates	: Shall be:
				100Mhz (100000000) for SATA_RXOOB_CLK
				100Mhz (100000000) for SATA_PMALIVE_CLK

Example:
	sata@29000000 {
		compatible = "qcom,ipq806x-ahci", "generic-ahci";
		reg = <0x29000000 0x180>;

		interrupts = <0 209 0x0>;

		clocks = <&gcc SFAB_SATA_S_H_CLK>,
			 <&gcc SATA_H_CLK>,
			 <&gcc SATA_A_CLK>,
			 <&gcc SATA_RXOOB_CLK>,
			 <&gcc SATA_PMALIVE_CLK>;
		clock-names = "slave_iface", "iface", "core",
				"rxoob", "pmalive";
		assigned-clocks = <&gcc SATA_RXOOB_CLK>, <&gcc SATA_PMALIVE_CLK>;
		assigned-clock-rates = <100000000>, <100000000>;

		phys = <&sata_phy>;
		phy-names = "sata-phy";
	};
```

## Documentation/devicetree/bindings/ata/renesas,rcar-sata.yaml
```yaml
# SPDX-License-Identifier: (GPL-2.0-only OR BSD-2-Clause)
%YAML 1.2
---
$id: "http://devicetree.org/schemas/ata/renesas,rcar-sata.yaml#"
$schema: "http://devicetree.org/meta-schemas/core.yaml#"

title: Renesas R-Car Serial-ATA Interface

maintainers:
  - Geert Uytterhoeven <geert+renesas@glider.be>

properties:
  compatible:
    oneOf:
      - items:
          - enum:
              - renesas,sata-r8a7779      # R-Car H1
      - items:
          - enum:
              - renesas,sata-r8a7742      # RZ/G1H
              - renesas,sata-r8a7790-es1  # R-Car H2 ES1
              - renesas,sata-r8a7790      # R-Car H2 other than ES1
              - renesas,sata-r8a7791      # R-Car M2-W
              - renesas,sata-r8a7793      # R-Car M2-N
          - const: renesas,rcar-gen2-sata # generic R-Car Gen2
      - items:
          - enum:
              - renesas,sata-r8a774b1     # RZ/G2N
              - renesas,sata-r8a7795      # R-Car H3
              - renesas,sata-r8a77965     # R-Car M3-N
          - const: renesas,rcar-gen3-sata # generic R-Car Gen3 or RZ/G2

  reg:
    maxItems: 1

  interrupts:
    maxItems: 1

  clocks:
    maxItems: 1

  iommus:
    maxItems: 1

  power-domains:
    maxItems: 1

  resets:
    maxItems: 1

required:
  - compatible
  - reg
  - interrupts
  - clocks
  - power-domains

if:
  not:
    properties:
      compatible:
        contains:
          const: renesas,sata-r8a7779
then:
  required:
    - resets

additionalProperties: false

examples:
  - |
    #include <dt-bindings/clock/r8a7791-cpg-mssr.h>
    #include <dt-bindings/interrupt-controller/arm-gic.h>
    #include <dt-bindings/power/r8a7791-sysc.h>

    sata@ee300000 {
            compatible = "renesas,sata-r8a7791", "renesas,rcar-gen2-sata";
            reg = <0xee300000 0x200000>;
            interrupts = <GIC_SPI 105 IRQ_TYPE_LEVEL_HIGH>;
            clocks = <&cpg CPG_MOD 815>;
            power-domains = <&sysc R8A7791_PD_ALWAYS_ON>;
            resets = <&cpg 815>;
    };
```

## Documentation/devicetree/bindings/ata/rockchip,dwc-ahci.yaml
```yaml
# SPDX-License-Identifier: (GPL-2.0-only OR BSD-2-Clause)
%YAML 1.2
---
$id: http://devicetree.org/schemas/ata/rockchip,dwc-ahci.yaml#
$schema: http://devicetree.org/meta-schemas/core.yaml#

title: Synopsys DWC AHCI SATA controller for Rockchip devices

maintainers:
  - Serge Semin <fancer.lancer@gmail.com>

description:
  This document defines device tree bindings for the Synopsys DWC
  implementation of the AHCI SATA controller found in Rockchip
  devices.

select:
  properties:
    compatible:
      contains:
        enum:
          - rockchip,rk3568-dwc-ahci
          - rockchip,rk3588-dwc-ahci
  required:
    - compatible

properties:
  compatible:
    items:
      - enum:
          - rockchip,rk3568-dwc-ahci
          - rockchip,rk3588-dwc-ahci
      - const: snps,dwc-ahci

  ports-implemented:
    const: 1

  power-domains:
    maxItems: 1

  sata-port@0:
    $ref: /schemas/ata/snps,dwc-ahci-common.yaml#/$defs/dwc-ahci-port

    properties:
      reg:
        const: 0

    unevaluatedProperties: false

patternProperties:
  "^sata-port@[1-9a-e]$": false

required:
  - compatible
  - reg
  - interrupts
  - clocks
  - clock-names
  - ports-implemented

allOf:
  - $ref: snps,dwc-ahci-common.yaml#
  - if:
      properties:
        compatible:
          contains:
            enum:
              - rockchip,rk3588-dwc-ahci
    then:
      properties:
        clocks:
          maxItems: 5
        clock-names:
          items:
            - const: sata
            - const: pmalive
            - const: rxoob
            - const: ref
            - const: asic
  - if:
      properties:
        compatible:
          contains:
            enum:
              - rockchip,rk3568-dwc-ahci
    then:
      properties:
        clocks:
          maxItems: 3
        clock-names:
          items:
            - const: sata
            - const: pmalive
            - const: rxoob

unevaluatedProperties: false

examples:
  - |
    #include <dt-bindings/clock/rockchip,rk3588-cru.h>
    #include <dt-bindings/interrupt-controller/arm-gic.h>
    #include <dt-bindings/ata/ahci.h>
    #include <dt-bindings/phy/phy.h>

    sata@fe210000 {
      compatible = "rockchip,rk3588-dwc-ahci", "snps,dwc-ahci";
      reg = <0xfe210000 0x1000>;
      clocks = <&cru ACLK_SATA0>, <&cru CLK_PMALIVE0>,
               <&cru CLK_RXOOB0>, <&cru CLK_PIPEPHY0_REF>,
               <&cru CLK_PIPEPHY0_PIPE_ASIC_G>;
      clock-names = "sata", "pmalive", "rxoob", "ref", "asic";
      interrupts = <GIC_SPI 273 IRQ_TYPE_LEVEL_HIGH 0>;
      ports-implemented = <0x1>;
      #address-cells = <1>;
      #size-cells = <0>;

      sata-port@0 {
        reg = <0>;
        hba-port-cap = <HBA_PORT_FBSCP>;
        phys = <&combphy0_ps PHY_TYPE_SATA>;
        phy-names = "sata-phy";
        snps,rx-ts-max = <32>;
        snps,tx-ts-max = <32>;
      };
    };

...
```

## Documentation/devicetree/bindings/ata/sata-common.yaml
```yaml
# SPDX-License-Identifier: (GPL-2.0-only OR BSD-2-Clause)
%YAML 1.2
---
$id: http://devicetree.org/schemas/ata/sata-common.yaml#
$schema: http://devicetree.org/meta-schemas/core.yaml#

title: Common Properties for Serial AT attachment (SATA) controllers

maintainers:
  - Linus Walleij <linus.walleij@linaro.org>

description: |
  This document defines device tree properties common to most Serial
  AT attachment (SATA) storage devices. It doesn't constitute a device tree
  binding specification by itself but is meant to be referenced by device
  tree bindings.

  The SATA controller-specific device tree bindings are responsible for
  defining whether each property is required or optional.

properties:
  $nodename:
    pattern: "^sata(@.*)?$"
    description:
      Specifies the host controller node. SATA host controller nodes are named
      "sata"

  "#address-cells":
    const: 1

  "#size-cells":
    const: 0

  dma-coherent: true

patternProperties:
  "^sata-port@[0-9a-e]$":
    $ref: '#/$defs/sata-port'
    description: |
      DT nodes for ports connected on the SATA host. The SATA port
      nodes will be named "sata-port".

additionalProperties: true

$defs:
  sata-port:
    type: object

    properties:
      reg:
        minimum: 0
        description:
          The ID number of the SATA port. Aside with being directly used,
          each port can have a Port Multiplier attached thus allowing to
          access more than one drive by means of a single SATA port.

...
```

## Documentation/devicetree/bindings/ata/sata_highbank.txt
```
* Calxeda AHCI SATA Controller

SATA nodes are defined to describe on-chip Serial ATA controllers.
The Calxeda SATA controller mostly conforms to the AHCI interface
with some special extensions to add functionality.
Each SATA controller should have its own node.

Required properties:
- compatible        : compatible list, contains "calxeda,hb-ahci"
- interrupts        : <interrupt mapping for SATA IRQ>
- reg               : <registers mapping>

Optional properties:
- dma-coherent      : Present if dma operations are coherent
- calxeda,port-phys : phandle-combophy and lane assignment, which maps each
			SATA port to a combophy and a lane within that
			combophy
- calxeda,sgpio-gpio: phandle-gpio bank, bit offset, and default on or off,
			which indicates that the driver supports SGPIO
			indicator lights using the indicated GPIOs
- calxeda,led-order : a u32 array that map port numbers to offsets within the
			SGPIO bitstream.
- calxeda,tx-atten  : a u32 array that contains TX attenuation override
			codes, one per port. The upper 3 bytes are always
			0 and thus ignored.
- calxeda,pre-clocks : a u32 that indicates the number of additional clock
			cycles to transmit before sending an SGPIO pattern
- calxeda,post-clocks: a u32 that indicates the number of additional clock
			cycles to transmit after sending an SGPIO pattern

Example:
        sata@ffe08000 {
		compatible = "calxeda,hb-ahci";
		reg = <0xffe08000 0x1000>;
		interrupts = <115>;
		dma-coherent;
		calxeda,port-phys = <&combophy5 0 &combophy0 0 &combophy0 1
					&combophy0 2 &combophy0 3>;
		calxeda,sgpio-gpio =<&gpioh 5 1 &gpioh 6 1 &gpioh 7 1>;
		calxeda,led-order = <4 0 1 2 3>;
		calxeda,tx-atten = <0xff 22 0xff 0xff 23>;
		calxeda,pre-clocks = <10>;
		calxeda,post-clocks = <0>;
        };
```
