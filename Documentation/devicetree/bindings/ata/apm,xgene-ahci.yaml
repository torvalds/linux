## Documentation/devicetree/bindings/ata/faraday,ftide010.txt
```
* Faraday Technology FTIDE010 PATA controller

This controller is the first Faraday IDE interface block, used in the
StorLink SL2312 and SL3516, later known as the Cortina Systems Gemini
platform. The controller can do PIO modes 0 through 4, Multi-word DMA
(MWDM)modes 0 through 2 and Ultra DMA modes 0 through 6.

On the Gemini platform, this PATA block is accompanied by a PATA to
SATA bridge in order to support SATA. This is why a phandle to that
controller is compulsory on that platform.

The timing properties are unique per-SoC, not per-board.

Required properties:
- compatible: should be one of
  "cortina,gemini-pata", "faraday,ftide010"
  "faraday,ftide010"
- interrupts: interrupt for the block
- reg: registers and size for the block

Optional properties:
- clocks: a SoC clock running the peripheral.
- clock-names: should be set to "PCLK" for the peripheral clock.

Required properties for "cortina,gemini-pata" compatible:
- sata: a phande to the Gemini PATA to SATA bridge, see
  cortina,gemini-sata-bridge.txt for details.

Example:

ata@63000000 {
	compatible = "cortina,gemini-pata", "faraday,ftide010";
	reg = <0x63000000 0x100>;
	interrupts = <4 IRQ_TYPE_EDGE_RISING>;
	clocks = <&gcc GEMINI_CLK_GATE_IDE>;
	clock-names = "PCLK";
	sata = <&sata>;
};
```

## Documentation/devicetree/bindings/ata/faraday,ftide010.yaml
```yaml
# SPDX-License-Identifier: (GPL-2.0-only OR BSD-2-Clause)
%YAML 1.2
---
$id: http://devicetree.org/schemas/ata/faraday,ftide010.yaml#
$schema: http://devicetree.org/meta-schemas/core.yaml#

title: Faraday Technology FTIDE010 PATA controller

maintainers:
  - Linus Walleij <linus.walleij@linaro.org>

description: |
  This controller is the first Faraday IDE interface block, used in the
  StorLink SL3512 and SL3516, later known as the Cortina Systems Gemini
  platform. The controller can do PIO modes 0 through 4, Multi-word DMA
  (MWDM) modes 0 through 2 and Ultra DMA modes 0 through 6.

  On the Gemini platform, this PATA block is accompanied by a PATA to
  SATA bridge in order to support SATA. This is why a phandle to that
  controller is compulsory on that platform.

  The timing properties are unique per-SoC, not per-board.

properties:
  compatible:
    oneOf:
      - const: faraday,ftide010
      - items:
          - const: cortina,gemini-pata
          - const: faraday,ftide010

  reg:
    maxItems: 1

  interrupts:
    maxItems: 1

  clocks:
    minItems: 1

  clock-names:
    const: PCLK

  sata:
    description:
      phandle to the Gemini PATA to SATA bridge, if available
    $ref: /schemas/types.yaml#/definitions/phandle

required:
  - compatible
  - reg
  - interrupts

allOf:
  - $ref: pata-common.yaml#

  - if:
      properties:
        compatible:
          contains:
            const: cortina,gemini-pata

    then:
      required:
        - sata

examples:
  - |
    #include <dt-bindings/interrupt-controller/irq.h>
    #include <dt-bindings/clock/cortina,gemini-clock.h>

    ide@63000000 {
      compatible = "cortina,gemini-pata", "faraday,ftide010";
      reg = <0x63000000 0x100>;
      interrupts = <4 IRQ_TYPE_EDGE_RISING>;
      clocks = <&gcc GEMINI_CLK_GATE_IDE>;
      clock-names = "PCLK";
      sata = <&sata>;
      #address-cells = <1>;
      #size-cells = <0>;
      ide-port@0 {
        reg = <0>;
      };
      ide-port@1 {
        reg = <1>;
      };
    };

...
```

## Documentation/devicetree/bindings/ata/fsl,ahci.yaml
```yaml
# SPDX-License-Identifier: (GPL-2.0-only OR BSD-2-Clause)
%YAML 1.2
---
$id: http://devicetree.org/schemas/ata/fsl,ahci.yaml#
$schema: http://devicetree.org/meta-schemas/core.yaml#

title: Freescale QorIQ AHCI SATA Controller

maintainers:
  - Frank Li <Frank.Li@nxp.com>

properties:
  compatible:
    oneOf:
      - description: SATA controller for ls1012a
        items:
          - const: fsl,ls1012a-ahci
          - const: fsl,ls1043a-ahci
      - enum:
          - fsl,ls1021a-ahci
          - fsl,ls1028a-ahci
          - fsl,ls1043a-ahci
          - fsl,ls1046a-ahci
          - fsl,ls1088a-ahci
          - fsl,ls2080a-ahci
          - fsl,lx2160a-ahci

  reg:
    minItems: 1
    maxItems: 2

  reg-names:
    items:
      - const: ahci
      - const: sata-ecc
    minItems: 1

  clocks:
    maxItems: 1

  interrupts:
    maxItems: 1

  dma-coherent: true

required:
  - compatible
  - reg
  - clocks
  - interrupts

additionalProperties: false

examples:
  - |
    #include <dt-bindings/interrupt-controller/arm-gic.h>

    sata@3200000 {
        compatible = "fsl,ls1021a-ahci";
        reg = <0x3200000 0x10000>;
        interrupts = <GIC_SPI 101 IRQ_TYPE_LEVEL_HIGH>;
        clocks = <&platform_clk 1>;
        dma-coherent;
    };
```

## Documentation/devicetree/bindings/ata/fsl,imx-pata.yaml
```yaml
# SPDX-License-Identifier: (GPL-2.0-only OR BSD-2-Clause)
%YAML 1.2
---
$id: http://devicetree.org/schemas/ata/fsl,imx-pata.yaml#
$schema: http://devicetree.org/meta-schemas/core.yaml#

title: Freescale i.MX PATA Controller

maintainers:
  - Animesh Agarwal <animeshagarwal28@gmail.com>

properties:
  compatible:
    oneOf:
      - items:
          - enum:
              - fsl,imx31-pata
              - fsl,imx51-pata
          - const: fsl,imx27-pata
      - const: fsl,imx27-pata

  reg:
    maxItems: 1

  interrupts:
    items:
      - description: PATA Controller interrupts

  clocks:
    items:
      - description: PATA Controller clocks

additionalProperties: false

examples:
  - |
    pata: pata@83fe0000 {
        compatible = "fsl,imx51-pata", "fsl,imx27-pata";
        reg = <0x83fe0000 0x4000>;
        interrupts = <70>;
        clocks = <&clks 161>;
    };
```

## Documentation/devicetree/bindings/ata/fsl,pq-sata.yaml
```yaml
# SPDX-License-Identifier: (GPL-2.0-only OR BSD-2-Clause)
%YAML 1.2
---
$id: http://devicetree.org/schemas/ata/fsl,pq-sata.yaml#
$schema: http://devicetree.org/meta-schemas/core.yaml#

title: Freescale 8xxx/3.0 Gb/s SATA nodes

maintainers:
  - J. Neuschäfer <j.ne@posteo.net>

description:
  SATA nodes are defined to describe on-chip Serial ATA controllers.
  Each SATA controller should have its own node.

properties:
  compatible:
    oneOf:
      - items:
          - enum:
              - fsl,mpc8377-sata
              - fsl,mpc8536-sata
              - fsl,mpc8315-sata
              - fsl,mpc8379-sata
          - const: fsl,pq-sata
      - const: fsl,pq-sata-v2

  reg:
    maxItems: 1

  interrupts:
    maxItems: 1

  cell-index:
    $ref: /schemas/types.yaml#/definitions/uint32
    enum: [1, 2, 3, 4]
    description: |
      1 for controller @ 0x18000
      2 for controller @ 0x19000
      3 for controller @ 0x1a000
      4 for controller @ 0x1b000

required:
  - compatible
  - interrupts
  - cell-index

additionalProperties: false

examples:
  - |
    #include <dt-bindings/interrupt-controller/irq.h>
    sata@18000 {
        compatible = "fsl,mpc8379-sata", "fsl,pq-sata";
        reg = <0x18000 0x1000>;
        cell-index = <1>;
        interrupts = <44 IRQ_TYPE_LEVEL_LOW>;
    };

...
```

## Documentation/devicetree/bindings/ata/fsl-sata.txt
```
* Freescale 8xxx/3.0 Gb/s SATA nodes

SATA nodes are defined to describe on-chip Serial ATA controllers.
Each SATA port should have its own node.

Required properties:
- compatible        : compatible list, contains 2 entries, first is
		 "fsl,CHIP-sata", where CHIP is the processor
		 (mpc8315, mpc8379, etc.) and the second is
		 "fsl,pq-sata"
- interrupts        : <interrupt mapping for SATA IRQ>
- cell-index        : controller index.
                          1 for controller @ 0x18000
                          2 for controller @ 0x19000
                          3 for controller @ 0x1a000
                          4 for controller @ 0x1b000

Optional properties:
- reg               : <registers mapping>

Example:
	sata@18000 {
		compatible = "fsl,mpc8379-sata", "fsl,pq-sata";
		reg = <0x18000 0x1000>;
		cell-index = <1>;
		interrupts = <2c 8>;
		interrupt-parent = < &ipic >;
	};
```

## Documentation/devicetree/bindings/ata/imx-pata.txt
```
* Freescale i.MX PATA Controller

Required properties:
- compatible: "fsl,imx27-pata"
- reg: Address range of the PATA Controller
- interrupts: The interrupt of the PATA Controller
- clocks: the clocks for the PATA Controller

Example:

	pata: pata@83fe0000 {
		compatible = "fsl,imx51-pata", "fsl,imx27-pata";
		reg = <0x83fe0000 0x4000>;
		interrupts = <70>;
		clocks = <&clks 161>;
		status = "disabled";
	};
```
