## Documentation/devicetree/bindings/ata/apm,xgene-ahci.yaml
```yaml
# SPDX-License-Identifier: (GPL-2.0-only OR BSD-2-Clause)
%YAML 1.2
---
$id: http://devicetree.org/schemas/ata/apm,xgene-ahci.yaml#
$schema: http://devicetree.org/meta-schemas/core.yaml#

title: APM X-Gene 6.0 Gb/s SATA host controller

maintainers:
  - Rob Herring <robh@kernel.org>

properties:
  compatible:
    enum:
      - apm,xgene-ahci
      - apm,xgene-ahci-v2

  reg:
    minItems: 4
    items:
      - description: AHCI memory resource
      - description: Host controller core
      - description: Host controller diagnostic
      - description: Host controller AXI
      - description: Host controller MUX

  interrupts:
    maxItems: 1

  clocks:
    maxItems: 1

required:
  - compatible

unevaluatedProperties: false

allOf:
  - $ref: ahci-common.yaml#
  - if:
      properties:
        compatible:
          contains:
            const: apm,xgene-ahci
    then:
      required:
        - clocks
        - phys
        - phy-names

examples:
  - |
    sata@1a400000 {
        compatible = "apm,xgene-ahci";
        reg = <0x1a400000 0x1000>,
              <0x1f220000 0x1000>,
              <0x1f22d000 0x1000>,
              <0x1f22e000 0x1000>,
              <0x1f227000 0x1000>;
        clocks = <&sataclk 0>;
        dma-coherent;
        interrupts = <0x0 0x87 0x4>;
        phys = <&phy2 0>;
        phy-names = "sata-phy";
    };
```

## Documentation/devicetree/bindings/ata/apm-xgene.txt
```
* APM X-Gene 6.0 Gb/s SATA host controller nodes

SATA host controller nodes are defined to describe on-chip Serial ATA
controllers. Each SATA controller (pair of ports) have its own node.

Required properties:
- compatible		: Shall contain:
  * "apm,xgene-ahci"
- reg			: First memory resource shall be the AHCI memory
			  resource.
			  Second memory resource shall be the host controller
			  core memory resource.
			  Third memory resource shall be the host controller
			  diagnostic memory resource.
			  4th memory resource shall be the host controller
			  AXI memory resource.
			  5th optional memory resource shall be the host
			  controller MUX memory resource if required.
- interrupts		: Interrupt-specifier for SATA host controller IRQ.
- clocks		: Reference to the clock entry.
- phys			: A list of phandles + phy-specifiers, one for each
			  entry in phy-names.
- phy-names		: Should contain:
  * "sata-phy" for the SATA 6.0Gbps PHY

Optional properties:
- status		: Shall be "ok" if enabled or "disabled" if disabled.
			  Default is "ok".

Example:
		sataclk: sataclk {
			compatible = "fixed-clock";
			#clock-cells = <1>;
			clock-frequency = <100000000>;
			clock-output-names = "sataclk";
		};

		phy2: phy@1f22a000 {
			compatible = "apm,xgene-phy";
			reg = <0x0 0x1f22a000 0x0 0x100>;
			#phy-cells = <1>;
		};

		phy3: phy@1f23a000 {
			compatible = "apm,xgene-phy";
			reg = <0x0 0x1f23a000 0x0 0x100>;
			#phy-cells = <1>;
		};

		sata2: sata@1a400000 {
			compatible = "apm,xgene-ahci";
			reg = <0x0 0x1a400000 0x0 0x1000>,
			      <0x0 0x1f220000 0x0 0x1000>,
			      <0x0 0x1f22d000 0x0 0x1000>,
			      <0x0 0x1f22e000 0x0 0x1000>,
			      <0x0 0x1f227000 0x0 0x1000>;
			interrupts = <0x0 0x87 0x4>;
			status = "ok";
			clocks = <&sataclk 0>;
			phys = <&phy2 0>;
			phy-names = "sata-phy";
		};

		sata3: sata@1a800000 {
			compatible = "apm,xgene-ahci-pcie";
			reg = <0x0 0x1a800000 0x0 0x1000>,
			      <0x0 0x1f230000 0x0 0x1000>,
			      <0x0 0x1f23d000 0x0 0x1000>,
			      <0x0 0x1f23e000 0x0 0x1000>,
			      <0x0 0x1f237000 0x0 0x1000>;
			interrupts = <0x0 0x88 0x4>;
			status = "ok";
			clocks = <&sataclk 0>;
			phys = <&phy3 0>;
			phy-names = "sata-phy";
		};
```

## Documentation/devicetree/bindings/ata/arasan,cf-spear1340.yaml
```yaml
# SPDX-License-Identifier: (GPL-2.0-only OR BSD-2-Clause)
%YAML 1.2
---
$id: http://devicetree.org/schemas/ata/arasan,cf-spear1340.yaml#
$schema: http://devicetree.org/meta-schemas/core.yaml#

title: Arasan PATA Compact Flash Controller

maintainers:
  - Viresh Kumar <viresh.kumar@linaro.org>

properties:
  compatible:
    const: arasan,cf-spear1340

  reg:
    maxItems: 1

  interrupts:
    maxItems: 1

  clocks:
    maxItems: 1

  arasan,broken-udma:
    description: UDMA mode is unusable
    type: boolean

  arasan,broken-mwdma:
    description: MWDMA mode is unusable
    type: boolean

  arasan,broken-pio:
    description: PIO mode is unusable
    type: boolean

  dmas:
    maxItems: 1

  dma-names:
    items:
      - const: data

required:
  - compatible
  - reg
  - interrupts

additionalProperties: false

allOf:
  - if:
      not:
        required:
          - arasan,broken-udma
          - arasan,broken-mwdma
    then:
      required:
        - dmas
        - dma-names

examples:
  - |
    cf@fc000000 {
        compatible = "arasan,cf-spear1340";
        reg = <0xfc000000 0x1000>;
        interrupts = <12>;
        dmas = <&dma 23>;
        dma-names = "data";
    };
```

## Documentation/devicetree/bindings/ata/ata-generic.yaml
```yaml
# SPDX-License-Identifier: (GPL-2.0-only OR BSD-2-Clause)
%YAML 1.2
---
$id: http://devicetree.org/schemas/ata/ata-generic.yaml#
$schema: http://devicetree.org/meta-schemas/core.yaml#

title: Generic Parallel ATA Controller

maintainers:
  - Linus Walleij <linus.walleij@linaro.org>

description:
  Generic Parallel ATA controllers supporting PIO modes only.

properties:
  compatible:
    items:
      - enum:
          - arm,vexpress-cf
          - fsl,mpc8349emitx-pata
      - const: ata-generic

  reg:
    items:
      - description: Command interface registers
      - description: Control interface registers

  reg-shift:
    enum: [ 1, 2 ]

  interrupts:
    maxItems: 1

  ata-generic,use16bit:
    type: boolean
    description: Use 16-bit accesses instead of 32-bit for data transfers

  pio-mode:
    description: Maximum ATA PIO transfer mode
    $ref: /schemas/types.yaml#/definitions/uint32
    maximum: 6
    default: 0

required:
  - compatible
  - reg

additionalProperties: false

examples:
  - |
    compact-flash@1a000 {
        compatible = "arm,vexpress-cf", "ata-generic";
        reg = <0x1a000 0x100>,
              <0x1a100 0xf00>;
        reg-shift = <2>;
    };
...
```

## Documentation/devicetree/bindings/ata/atmel-at91_cf.txt
```
Atmel AT91RM9200 CompactFlash

Required properties:
- compatible : "atmel,at91rm9200-cf".
- reg : should specify localbus address and size used.
- gpios : specifies the gpio pins to control the CF device. Detect
  and reset gpio's are mandatory while irq and vcc gpio's are
  optional and may be set to 0 if not present.

Example:
compact-flash@50000000 {
	compatible = "atmel,at91rm9200-cf";
	reg = <0x50000000 0x30000000>;
	gpios = <&pioC 13 0	/* irq */
		 &pioC 15 0 	/* detect */
		 0		/* vcc */
		 &pioC  5 0	/* reset */
		>;
};
```

## Documentation/devicetree/bindings/ata/baikal,bt1-ahci.yaml
```yaml
# SPDX-License-Identifier: (GPL-2.0-only OR BSD-2-Clause)
%YAML 1.2
---
$id: http://devicetree.org/schemas/ata/baikal,bt1-ahci.yaml#
$schema: http://devicetree.org/meta-schemas/core.yaml#

title: Baikal-T1 SoC AHCI SATA controller

maintainers:
  - Serge Semin <fancer.lancer@gmail.com>

description:
  AHCI SATA controller embedded into the Baikal-T1 SoC is based on the
  DWC AHCI SATA v4.10a IP-core.

allOf:
  - $ref: snps,dwc-ahci-common.yaml#

properties:
  compatible:
    const: baikal,bt1-ahci

  clocks:
    items:
      - description: Peripheral APB bus clock
      - description: Application AXI BIU clock
      - description: SATA Ports reference clock

  clock-names:
    items:
      - const: pclk
      - const: aclk
      - const: ref

  resets:
    items:
      - description: Application AXI BIU domain reset
      - description: SATA Ports clock domain reset

  reset-names:
    items:
      - const: arst
      - const: ref

  ports-implemented:
    maximum: 0x3

patternProperties:
  "^sata-port@[0-1]$":
    $ref: /schemas/ata/snps,dwc-ahci-common.yaml#/$defs/dwc-ahci-port

    properties:
      reg:
        minimum: 0
        maximum: 1

      snps,tx-ts-max:
        $ref: /schemas/types.yaml#/definitions/uint32
        description:
          Due to having AXI3 bus interface utilized the maximum Tx DMA
          transaction size can't exceed 16 beats (AxLEN[3:0]).
        enum: [ 1, 2, 4, 8, 16 ]

      snps,rx-ts-max:
        $ref: /schemas/types.yaml#/definitions/uint32
        description:
          Due to having AXI3 bus interface utilized the maximum Rx DMA
          transaction size can't exceed 16 beats (AxLEN[3:0]).
        enum: [ 1, 2, 4, 8, 16 ]

    unevaluatedProperties: false

required:
  - compatible
  - reg
  - interrupts
  - clocks
  - clock-names
  - resets

unevaluatedProperties: false

examples:
  - |
    sata@1f050000 {
      compatible = "baikal,bt1-ahci";
      reg = <0x1f050000 0x2000>;
      #address-cells = <1>;
      #size-cells = <0>;

      interrupts = <0 64 4>;

      clocks = <&ccu_sys 1>, <&ccu_axi 2>, <&sata_ref_clk>;
      clock-names = "pclk", "aclk", "ref";

      resets = <&ccu_axi 2>, <&ccu_sys 0>;
      reset-names = "arst", "ref";

      ports-implemented = <0x3>;

      sata-port@0 {
        reg = <0>;

        snps,tx-ts-max = <4>;
        snps,rx-ts-max = <4>;
      };

      sata-port@1 {
        reg = <1>;

        snps,tx-ts-max = <4>;
        snps,rx-ts-max = <4>;
      };
    };
...
```

## Documentation/devicetree/bindings/ata/brcm,sata-brcm.txt
```
* Broadcom SATA3 AHCI Controller

SATA nodes are defined to describe on-chip Serial ATA controllers.
Each SATA controller should have its own node.

Required properties:
- compatible         : should be one or more of
			"brcm,bcm7425-ahci"
			"brcm,bcm7445-ahci"
			"brcm,bcm-nsp-ahci"
			"brcm,sata3-ahci"
- reg                : register mappings for AHCI and SATA_TOP_CTRL
- reg-names          : "ahci" and "top-ctrl"
- interrupts         : interrupt mapping for SATA IRQ

Also see ahci-platform.txt.

Example:

	sata@f045a000 {
		compatible = "brcm,bcm7445-ahci", "brcm,sata3-ahci";
		reg = <0xf045a000 0xa9c>, <0xf0458040 0x24>;
		reg-names = "ahci", "top-ctrl";
		interrupts = <0 30 0>;
		#address-cells = <1>;
		#size-cells = <0>;

		sata0: sata-port@0 {
			reg = <0>;
			phys = <&sata_phy 0>;
		};

		sata1: sata-port@1 {
			reg = <1>;
			phys = <&sata_phy 1>;
		};
	};
```

## Documentation/devicetree/bindings/ata/brcm,sata-brcm.yaml
```yaml
# SPDX-License-Identifier: (GPL-2.0-only OR BSD-2-Clause)
%YAML 1.2
---
$id: http://devicetree.org/schemas/ata/brcm,sata-brcm.yaml#
$schema: http://devicetree.org/meta-schemas/core.yaml#

title: Broadcom SATA3 AHCI Controller

description:
  SATA nodes are defined to describe on-chip Serial ATA controllers.
  Each SATA controller should have its own node.

maintainers:
  - Florian Fainelli <f.fainelli@gmail.com>

allOf:
  - $ref: ahci-common.yaml#

properties:
  compatible:
    oneOf:
      - items:
          - enum:
              - brcm,bcm7216-ahci
              - brcm,bcm7445-ahci
              - brcm,bcm7425-ahci
              - brcm,bcm63138-ahci
          - const: brcm,sata3-ahci
      - items:
          - const: brcm,bcm-nsp-ahci

  reg:
    maxItems: 2

  reg-names:
    items:
      - const: ahci
      - const: top-ctrl

  interrupts:
    maxItems: 1

if:
  properties:
    compatible:
      contains:
        enum:
          - brcm,bcm7216-ahci
          - brcm,bcm63138-ahci
then:
  properties:
    resets:
      maxItems: 1
    reset-names:
      enum:
        - rescal
        - ahci

required:
  - compatible
  - reg
  - interrupts
  - "#address-cells"
  - "#size-cells"

unevaluatedProperties: false

examples:
  - |
    sata@f045a000 {
        compatible = "brcm,bcm7445-ahci", "brcm,sata3-ahci";
        reg = <0xf045a000 0xa9c>, <0xf0458040 0x24>;
        reg-names = "ahci", "top-ctrl";
        interrupts = <0 30 0>;
        #address-cells = <1>;
        #size-cells = <0>;

        sata0: sata-port@0 {
            reg = <0>;
            phys = <&sata_phy 0>;
        };

        sata1: sata-port@1 {
            reg = <1>;
            phys = <&sata_phy 1>;
        };
    };
```

## Documentation/devicetree/bindings/ata/calxeda-sata.txt
```
* Calxeda SATA Controller

SATA nodes are defined to describe on-chip Serial ATA controllers.
Each SATA controller should have its own node.

Required properties:
- compatible        : compatible list, contains "calxeda,hb-ahci"
- interrupts        : <interrupt mapping for SATA IRQ>
- reg               : <registers mapping>

Example:
        sata@ffe08000 {
		compatible = "calxeda,hb-ahci";
                reg = <0xffe08000 0x1000>;
                interrupts = <115>;
        };
```

## Documentation/devicetree/bindings/ata/cavium,ebt3000-compact-flash.yaml
```yaml
# SPDX-License-Identifier: (GPL-2.0-only OR BSD-2-Clause)
%YAML 1.2
---
$id: http://devicetree.org/schemas/ata/cavium,ebt3000-compact-flash.yaml#
$schema: http://devicetree.org/meta-schemas/core.yaml#

title: Cavium Compact Flash

maintainers:
  - Rob Herring <robh@kernel.org>

description:
  The Cavium Compact Flash device is connected to the Octeon Boot Bus, and is
  thus a child of the Boot Bus device.  It can read and write industry standard
  compact flash devices.

properties:
  compatible:
    const: cavium,ebt3000-compact-flash

  reg:
    description: The base address of the CF chip select banks.
    items:
      - description: CF chip select bank 0
      - description: CF chip select bank 1

  cavium,bus-width:
    description: The width of the connection to the CF devices.
    $ref: /schemas/types.yaml#/definitions/uint32
    enum: [8, 16]

  cavium,true-ide:
    description: True IDE mode when present.
    type: boolean

  cavium,dma-engine-handle:
    description: A phandle for the DMA Engine connected to this device.
    $ref: /schemas/types.yaml#/definitions/phandle

required:
  - compatible
  - reg

additionalProperties: false

examples:
  - |
    bus {
        #address-cells = <2>;
        #size-cells = <1>;

        compact-flash@5,0 {
            compatible = "cavium,ebt3000-compact-flash";
            reg = <5 0 0x10000>, <6 0 0x10000>;
            cavium,bus-width = <16>;
            cavium,true-ide;
            cavium,dma-engine-handle = <&dma0>;
        };
    };
```

## Documentation/devicetree/bindings/ata/cavium-compact-flash.txt
```
* Compact Flash

The Cavium Compact Flash device is connected to the Octeon Boot Bus,
and is thus a child of the Boot Bus device.  It can read and write
industry standard compact flash devices.

Properties:
- compatible: "cavium,ebt3000-compact-flash";

  Compatibility with many Cavium evaluation boards.

- reg: The base address of the CF chip select banks.  Depending on
  the device configuration, there may be one or two banks.

- cavium,bus-width: The width of the connection to the CF devices.  Valid
  values are 8 and 16.

- cavium,true-ide: Optional, if present the CF connection is in True IDE mode.

- cavium,dma-engine-handle: Optional, a phandle for the DMA Engine connected
  to this device.

Example:
	compact-flash@5,0 {
		compatible = "cavium,ebt3000-compact-flash";
		reg = <5 0 0x10000>, <6 0 0x10000>;
		cavium,bus-width = <16>;
		cavium,true-ide;
		cavium,dma-engine-handle = <&dma0>;
	};
```
