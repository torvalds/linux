## Documentation/devicetree/bindings/ata/ceva,ahci-1v84.yaml
```yaml
# SPDX-License-Identifier: (GPL-2.0-only OR BSD-2-Clause)
%YAML 1.2
---
$id: http://devicetree.org/schemas/ata/ceva,ahci-1v84.yaml#
$schema: http://devicetree.org/meta-schemas/core.yaml#

title: Ceva AHCI SATA Controller

maintainers:
  - Radhey Shyam Pandey <radhey.shyam.pandey@amd.com>

description: |
  The Ceva SATA controller mostly conforms to the AHCI interface with some
  special extensions to add functionality, is a high-performance dual-port
  SATA host controller with an AHCI compliant command layer which supports
  advanced features such as native command queuing and frame information
  structure (FIS) based switching for systems employing port multipliers.

properties:
  compatible:
    const: ceva,ahci-1v84

  reg:
    maxItems: 1

  clocks:
    maxItems: 1

  dma-coherent: true

  interrupts:
    maxItems: 1

  iommus:
    maxItems: 4

  power-domains:
    maxItems: 1

  ceva,p0-cominit-params:
    $ref: /schemas/types.yaml#/definitions/uint8-array
    description: |
      OOB timing value for COMINIT parameter for port 0.
      The fields for the above parameter must be as shown below:-
      ceva,p0-cominit-params = /bits/ 8 <CIBGMN CIBGMX CIBGN CINMP>;
    items:
      - description: CINMP - COMINIT Negate Minimum Period.
      - description: CIBGN - COMINIT Burst Gap Nominal.
      - description: CIBGMX - COMINIT Burst Gap Maximum.
      - description: CIBGMN - COMINIT Burst Gap Minimum.

  ceva,p0-comwake-params:
    $ref: /schemas/types.yaml#/definitions/uint8-array
    description: |
      OOB timing value for COMWAKE parameter for port 0.
      The fields for the above parameter must be as shown below:-
      ceva,p0-comwake-params = /bits/ 8 <CWBGMN CWBGMX CWBGN CWNMP>;
    items:
      - description: CWBGMN - COMWAKE Burst Gap Minimum.
      - description: CWBGMX - COMWAKE Burst Gap Maximum.
      - description: CWBGN - COMWAKE Burst Gap Nominal.
      - description: CWNMP - COMWAKE Negate Minimum Period.

  ceva,p0-burst-params:
    $ref: /schemas/types.yaml#/definitions/uint8-array
    description: |
      Burst timing value for COM parameter for port 0.
      The fields for the above parameter must be as shown below:-
      ceva,p0-burst-params = /bits/ 8 <BMX BNM SFD PTST>;
    items:
      - description: BMX - COM Burst Maximum.
      - description: BNM - COM Burst Nominal.
      - description: SFD - Signal Failure Detection value.
      - description: PTST - Partial to Slumber timer value.

  ceva,p0-retry-params:
    $ref: /schemas/types.yaml#/definitions/uint16-array
    description: |
      Retry interval timing value for port 0.
      The fields for the above parameter must be as shown below:-
      ceva,p0-retry-params = /bits/ 16 <RIT RCT>;
    items:
      - description: RIT - Retry Interval Timer.
      - description: RCT - Rate Change Timer.

  ceva,p1-cominit-params:
    $ref: /schemas/types.yaml#/definitions/uint8-array
    description: |
      OOB timing value for COMINIT parameter for port 1.
      The fields for the above parameter must be as shown below:-
      ceva,p1-cominit-params = /bits/ 8 <CIBGMN CIBGMX CIBGN CINMP>;
    items:
      - description: CINMP - COMINIT Negate Minimum Period.
      - description: CIBGN - COMINIT Burst Gap Nominal.
      - description: CIBGMX - COMINIT Burst Gap Maximum.
      - description: CIBGMN - COMINIT Burst Gap Minimum.

  ceva,p1-comwake-params:
    $ref: /schemas/types.yaml#/definitions/uint8-array
    description: |
      OOB timing value for COMWAKE parameter for port 1.
      The fields for the above parameter must be as shown below:-
      ceva,p1-comwake-params = /bits/ 8 <CWBGMN CWBGMX CWBGN CWNMP>;
    items:
      - description: CWBGMN - COMWAKE Burst Gap Minimum.
      - description: CWBGMX - COMWAKE Burst Gap Maximum.
      - description: CWBGN - COMWAKE Burst Gap Nominal.
      - description: CWNMP - COMWAKE Negate Minimum Period.

  ceva,p1-burst-params:
    $ref: /schemas/types.yaml#/definitions/uint8-array
    description: |
      Burst timing value for COM parameter for port 1.
      The fields for the above parameter must be as shown below:-
      ceva,p1-burst-params = /bits/ 8 <BMX BNM SFD PTST>;
    items:
      - description: BMX - COM Burst Maximum.
      - description: BNM - COM Burst Nominal.
      - description: SFD - Signal Failure Detection value.
      - description: PTST - Partial to Slumber timer value.

  ceva,p1-retry-params:
    $ref: /schemas/types.yaml#/definitions/uint16-array
    description: |
      Retry interval timing value for port 1.
      The fields for the above parameter must be as shown below:-
      ceva,pN-retry-params = /bits/ 16 <RIT RCT>;
    items:
      - description: RIT - Retry Interval Timer.
      - description: RCT - Rate Change Timer.

  ceva,broken-gen2:
    $ref: /schemas/types.yaml#/definitions/flag
    description: |
      limit to gen1 speed instead of gen2.

  phys:
    maxItems: 1

  phy-names:
    items:
      - const: sata-phy

  resets:
    maxItems: 1

required:
  - compatible
  - reg
  - clocks
  - interrupts
  - ceva,p0-cominit-params
  - ceva,p0-comwake-params
  - ceva,p0-burst-params
  - ceva,p0-retry-params
  - ceva,p1-cominit-params
  - ceva,p1-comwake-params
  - ceva,p1-burst-params
  - ceva,p1-retry-params

additionalProperties: false

examples:
  - |
    #include <dt-bindings/interrupt-controller/irq.h>
    #include <dt-bindings/power/xlnx-zynqmp-power.h>
    #include <dt-bindings/reset/xlnx-zynqmp-resets.h>
    #include <dt-bindings/phy/phy.h>

    sata: ahci@fd0c0000 {
        compatible = "ceva,ahci-1v84";
        reg = <0xfd0c0000 0x200>;
        interrupt-parent = <&gic>;
        interrupts = <0 133 IRQ_TYPE_LEVEL_HIGH>;
        clocks = <&zynqmp_clk 22>;
        ceva,p0-cominit-params = /bits/ 8 <0x0F 0x25 0x18 0x29>;
        ceva,p0-comwake-params = /bits/ 8 <0x04 0x0B 0x08 0x0F>;
        ceva,p0-burst-params = /bits/ 8 <0x0A 0x08 0x4A 0x06>;
        ceva,p0-retry-params = /bits/ 16 <0x0216 0x7F06>;
        ceva,p1-cominit-params = /bits/ 8 <0x0F 0x25 0x18 0x29>;
        ceva,p1-comwake-params = /bits/ 8 <0x04 0x0B 0x08 0x0F>;
        ceva,p1-burst-params = /bits/ 8 <0x0A 0x08 0x4A 0x06>;
        ceva,p1-retry-params = /bits/ 16 <0x0216 0x7F06>;
        ceva,broken-gen2;
        phys = <&psgtr 1 PHY_TYPE_SATA 1 1>;
        resets = <&zynqmp_reset ZYNQMP_RESET_SATA>;
    };
```

## Documentation/devicetree/bindings/ata/cirrus,ep9312-pata.yaml
```yaml
# SPDX-License-Identifier: (GPL-2.0-only OR BSD-2-Clause)
%YAML 1.2
---
$id: http://devicetree.org/schemas/ata/cirrus,ep9312-pata.yaml#
$schema: http://devicetree.org/meta-schemas/core.yaml#

title: Cirrus Logic EP9312 PATA controller

maintainers:
  - Damien Le Moal <dlemoal@kernel.org>

properties:
  compatible:
    oneOf:
      - const: cirrus,ep9312-pata
      - items:
          - const: cirrus,ep9315-pata
          - const: cirrus,ep9312-pata

  reg:
    maxItems: 1

  interrupts:
    maxItems: 1

required:
  - compatible
  - reg
  - interrupts

additionalProperties: false

examples:
  - |
    ide@800a0000 {
        compatible = "cirrus,ep9312-pata";
        reg = <0x800a0000 0x38>;
        interrupt-parent = <&vic1>;
        interrupts = <8>;
        pinctrl-names = "default";
        pinctrl-0 = <&ide_default_pins>;
    };
```

## Documentation/devicetree/bindings/ata/cortina,gemini-sata-bridge.txt
```
* Cortina Systems Gemini SATA Bridge

The Gemini SATA bridge in a SoC-internal PATA to SATA bridge that
takes two Faraday Technology FTIDE010 PATA controllers and bridges
them in different configurations to two SATA ports.

Required properties:
- compatible: should be
  "cortina,gemini-sata-bridge"
- reg: registers and size for the block
- resets: phandles to the reset lines for both SATA bridges
- reset-names: must be "sata0", "sata1"
- clocks: phandles to the compulsory peripheral clocks
- clock-names: must be "SATA0_PCLK", "SATA1_PCLK"
- syscon: a phandle to the global Gemini system controller
- cortina,gemini-ata-muxmode: tell the desired multiplexing mode for
  the ATA controller and SATA bridges. Values 0..3:
  Mode 0: ata0 master <-> sata0
          ata1 master <-> sata1
          ata0 slave interface brought out on IDE pads
  Mode 1: ata0 master <-> sata0
          ata1 master <-> sata1
          ata1 slave interface brought out on IDE pads
  Mode 2: ata1 master <-> sata1
          ata1 slave  <-> sata0
          ata0 master and slave interfaces brought out
               on IDE pads
  Mode 3: ata0 master <-> sata0
          ata0 slave  <-> sata1
          ata1 master and slave interfaces brought out
               on IDE pads

Optional boolean properties:
- cortina,gemini-enable-ide-pins: enables the PATA to IDE connection.
  The muxmode setting decides whether ATA0 or ATA1 is brought out,
  and whether master, slave or both interfaces get brought out.
- cortina,gemini-enable-sata-bridge: enables the PATA to SATA bridge
  inside the Gemnini SoC. The Muxmode decides what PATA blocks will
  be muxed out and how.

Example:

sata: sata@46000000 {
	compatible = "cortina,gemini-sata-bridge";
	reg = <0x46000000 0x100>;
	resets = <&rcon 26>, <&rcon 27>;
	reset-names = "sata0", "sata1";
	clocks = <&gcc GEMINI_CLK_GATE_SATA0>,
		 <&gcc GEMINI_CLK_GATE_SATA1>;
	clock-names = "SATA0_PCLK", "SATA1_PCLK";
	syscon = <&syscon>;
	cortina,gemini-ata-muxmode = <3>;
	cortina,gemini-enable-ide-pins;
	cortina,gemini-enable-sata-bridge;
};
```

## Documentation/devicetree/bindings/ata/cortina,gemini-sata-bridge.yaml
```yaml
# SPDX-License-Identifier: (GPL-2.0-only OR BSD-2-Clause)
%YAML 1.2
---
$id: http://devicetree.org/schemas/ata/cortina,gemini-sata-bridge.yaml#
$schema: http://devicetree.org/meta-schemas/core.yaml#

title: Cortina Systems Gemini SATA Bridge

maintainers:
  - Linus Walleij <linus.walleij@linaro.org>

description: |
    The Gemini SATA bridge in a SoC-internal PATA to SATA bridge that
    takes two Faraday Technology FTIDE010 PATA controllers and bridges
    them in different configurations to two SATA ports.

properties:
  compatible:
    const: cortina,gemini-sata-bridge

  reg:
    maxItems: 1

  resets:
    minItems: 2
    maxItems: 2
    description: phandles to the reset lines for both SATA bridges

  reset-names:
    items:
      - const: sata0
      - const: sata1

  clocks:
    minItems: 2
    maxItems: 2
    description: phandles to the compulsory peripheral clocks

  clock-names:
    items:
      - const: SATA0_PCLK
      - const: SATA1_PCLK

  syscon:
    $ref: /schemas/types.yaml#/definitions/phandle
    description: a phandle to the global Gemini system controller

  cortina,gemini-ata-muxmode:
    $ref: /schemas/types.yaml#/definitions/uint32
    enum:
      - 0
      - 1
      - 2
      - 3
    description: |
      Tell the desired multiplexing mode for the ATA controller and SATA
      bridges.
      Mode 0: ata0 master <-> sata0
              ata1 master <-> sata1
              ata0 slave interface brought out on IDE pads
      Mode 1: ata0 master <-> sata0
              ata1 master <-> sata1
              ata1 slave interface brought out on IDE pads
      Mode 2: ata1 master <-> sata1
              ata1 slave  <-> sata0
              ata0 master and slave interfaces brought out on IDE pads
      Mode 3: ata0 master <-> sata0
              ata0 slave  <-> sata1
              ata1 master and slave interfaces brought out on IDE pads

  cortina,gemini-enable-ide-pins:
    type: boolean
    description: Enables the PATA to IDE connection.
      The muxmode setting decides whether ATA0 or ATA1 is brought out,
      and whether master, slave or both interfaces get brought out.

  cortina,gemini-enable-sata-bridge:
    type: boolean
    description: Enables the PATA to SATA bridge inside the Gemnini SoC.
      The Muxmode decides what PATA blocks will be muxed out and how.

required:
  - clocks
  - clock-names
  - cortina,gemini-ata-muxmode
  - resets
  - reset-names
  - compatible
  - reg
  - syscon

additionalProperties: false

examples:
  - |
    #include <dt-bindings/clock/cortina,gemini-clock.h>
    sata@46000000 {
      compatible = "cortina,gemini-sata-bridge";
      reg = <0x46000000 0x100>;
      resets = <&rcon 26>, <&rcon 27>;
      reset-names = "sata0", "sata1";
      clocks = <&gcc GEMINI_CLK_GATE_SATA0>,
               <&gcc GEMINI_CLK_GATE_SATA1>;
      clock-names = "SATA0_PCLK", "SATA1_PCLK";
      syscon = <&syscon>;
      cortina,gemini-ata-muxmode = <3>;
      cortina,gemini-enable-ide-pins;
      cortina,gemini-enable-sata-bridge;
    };
```

## Documentation/devicetree/bindings/ata/eswin,eic7700-ahci.yaml
```yaml
# SPDX-License-Identifier: (GPL-2.0-only OR BSD-2-Clause)
%YAML 1.2
---
$id: http://devicetree.org/schemas/ata/eswin,eic7700-ahci.yaml#
$schema: http://devicetree.org/meta-schemas/core.yaml#

title: Eswin EIC7700 SoC SATA Controller

maintainers:
  - Yulin Lu <luyulin@eswincomputing.com>
  - Huan He <hehuan1@eswincomputing.com>

description:
  AHCI SATA controller embedded into the EIC7700 SoC is based on the DWC AHCI
  SATA v5.00a IP core.

select:
  properties:
    compatible:
      const: eswin,eic7700-ahci
  required:
    - compatible

allOf:
  - $ref: snps,dwc-ahci-common.yaml#

properties:
  compatible:
    items:
      - const: eswin,eic7700-ahci
      - const: snps,dwc-ahci

  clocks:
    minItems: 2
    maxItems: 2

  clock-names:
    items:
      - const: pclk
      - const: aclk

  resets:
    maxItems: 1

  reset-names:
    const: arst

  ports-implemented:
    const: 1

required:
  - compatible
  - reg
  - interrupts
  - clocks
  - clock-names
  - resets
  - reset-names
  - phys
  - phy-names
  - ports-implemented

unevaluatedProperties: false

examples:
  - |
    sata@50420000 {
        compatible = "eswin,eic7700-ahci", "snps,dwc-ahci";
        reg = <0x50420000 0x10000>;
        interrupt-parent = <&plic>;
        interrupts = <58>;
        clocks = <&clock 171>, <&clock 186>;
        clock-names = "pclk", "aclk";
        phys = <&sata_phy>;
        phy-names = "sata-phy";
        ports-implemented = <0x1>;
        resets = <&reset 96>;
        reset-names = "arst";
    };
```

## Documentation/devicetree/bindings/ata/exynos-sata-phy.txt
```
* Samsung SATA PHY Controller

SATA PHY nodes are defined to describe on-chip SATA Physical layer controllers.
Each SATA PHY controller should have its own node.

Required properties:
- compatible        : compatible list, contains "samsung,exynos5-sata-phy"
- reg               : <registers mapping>

Example:
        sata@ffe07000 {
                compatible = "samsung,exynos5-sata-phy";
                reg = <0xffe07000 0x1000>;
        };
```

## Documentation/devicetree/bindings/ata/exynos-sata.txt
```
* Samsung AHCI SATA Controller

SATA nodes are defined to describe on-chip Serial ATA controllers.
Each SATA controller should have its own node.

Required properties:
- compatible		: compatible list, contains "samsung,exynos5-sata"
- interrupts		: <interrupt mapping for SATA IRQ>
- reg			: <registers mapping>
- samsung,sata-freq	: <frequency in MHz>
- phys			: Must contain exactly one entry as specified
			  in phy-bindings.txt
- phy-names		: Must be "sata-phy"

Optional properties:
- clocks		: Must contain an entry for each entry in clock-names.
- clock-names		: Shall be "sata" for the external SATA bus clock,
			  and "sclk_sata" for the internal controller clock.

Example:
	sata@122f0000 {
		compatible = "snps,dwc-ahci";
		samsung,sata-freq = <66>;
		reg = <0x122f0000 0x1ff>;
		interrupts = <0 115 0>;
		clocks = <&clock 277>, <&clock 143>;
		clock-names = "sata", "sclk_sata";
		phys = <&sata_phy>;
		phy-names = "sata-phy";
	};
```
