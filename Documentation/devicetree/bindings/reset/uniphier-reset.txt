## Documentation/devicetree/bindings/riscv/microchip.yaml
```yaml
# SPDX-License-Identifier: (GPL-2.0-only OR BSD-2-Clause)
%YAML 1.2
---
$id: http://devicetree.org/schemas/riscv/microchip.yaml#
$schema: http://devicetree.org/meta-schemas/core.yaml#

title: Microchip PolarFire SoC-based boards

maintainers:
  - Conor Dooley <conor.dooley@microchip.com>
  - Daire McNamara <daire.mcnamara@microchip.com>

description:
  Microchip PolarFire SoC-based boards

properties:
  $nodename:
    const: '/'
  compatible:
    oneOf:
      - items:
          - const: microchip,mpfs-icicle-prod-reference-rtl-v2507
          - const: microchip,mpfs-icicle-kit-prod
          - const: microchip,mpfs-icicle-kit
          - const: microchip,mpfs-prod
          - const: microchip,mpfs

      - items:
          - enum:
              - microchip,mpfs-icicle-reference-rtlv2203
              - microchip,mpfs-icicle-reference-rtlv2210
              - microchip,mpfs-icicle-es-reference-rtl-v2507
          - const: microchip,mpfs-icicle-kit
          - const: microchip,mpfs

      - items:
          - const: microchip,mpfs-disco-kit-reference-rtl-v2507
          - const: microchip,mpfs-disco-kit
          - const: microchip,mpfs

      - items:
          - enum:
              - aldec,tysom-m-mpfs250t-rev2
              - aries,m100pfsevp
              - beagle,beaglev-fire
              - microchip,mpfs-sev-kit
              - sundance,polarberry
          - const: microchip,mpfs

additionalProperties: true

...
```

## Documentation/devicetree/bindings/riscv/sifive-l2-cache.txt
```
SiFive L2 Cache Controller
--------------------------
The SiFive Level 2 Cache Controller is used to provide access to fast copies
of memory for masters in a Core Complex. The Level 2 Cache Controller also
acts as directory-based coherency manager.
All the properties in ePAPR/DeviceTree specification applies for this platform

Required Properties:
--------------------
- compatible: Should be "sifive,fu540-c000-ccache" and "cache"

- cache-block-size: Specifies the block size in bytes of the cache.
  Should be 64

- cache-level: Should be set to 2 for a level 2 cache

- cache-sets: Specifies the number of associativity sets of the cache.
  Should be 1024

- cache-size: Specifies the size in bytes of the cache. Should be 2097152

- cache-unified: Specifies the cache is a unified cache

- interrupts: Must contain 3 entries (DirError, DataError and DataFail signals)

- reg: Physical base address and size of L2 cache controller registers map

Optional Properties:
--------------------
- next-level-cache: phandle to the next level cache if present.

- memory-region: reference to the reserved-memory for the L2 Loosely Integrated
  Memory region. The reserved memory node should be defined as per the bindings
  in reserved-memory.txt


Example:

	cache-controller@2010000 {
		compatible = "sifive,fu540-c000-ccache", "cache";
		cache-block-size = <64>;
		cache-level = <2>;
		cache-sets = <1024>;
		cache-size = <2097152>;
		cache-unified;
		interrupt-parent = <&plic0>;
		interrupts = <1 2 3>;
		reg = <0x0 0x2010000 0x0 0x1000>;
		next-level-cache = <&L25 &L40 &L36>;
		memory-region = <&l2_lim>;
	};
```

## Documentation/devicetree/bindings/riscv/sifive.yaml
```yaml
# SPDX-License-Identifier: (GPL-2.0 OR MIT)
%YAML 1.2
---
$id: http://devicetree.org/schemas/riscv/sifive.yaml#
$schema: http://devicetree.org/meta-schemas/core.yaml#

title: SiFive SoC-based boards

maintainers:
  - Paul Walmsley <paul.walmsley@sifive.com>
  - Palmer Dabbelt <palmer@sifive.com>

description:
  SiFive SoC-based boards

properties:
  $nodename:
    const: '/'
  compatible:
    items:
      - enum:
          - sifive,hifive-unleashed-a00
      - const: sifive,fu540-c000
      - const: sifive,fu540

additionalProperties: true

...
```

## Documentation/devicetree/bindings/riscv/sophgo.yaml
```yaml
# SPDX-License-Identifier: (GPL-2.0-only OR BSD-2-Clause)
%YAML 1.2
---
$id: http://devicetree.org/schemas/riscv/sophgo.yaml#
$schema: http://devicetree.org/meta-schemas/core.yaml#

title: Sophgo SoC-based boards

maintainers:
  - Chao Wei <chao.wei@sophgo.com>
  - Chen Wang <unicorn_wang@outlook.com>

description:
  Sophgo SoC-based boards

properties:
  $nodename:
    const: '/'
  compatible:
    oneOf:
      - items:
          - enum:
              - milkv,duo
          - const: sophgo,cv1800b
      - items:
          - enum:
              - milkv,pioneer
          - const: sophgo,sg2042

additionalProperties: true

...
```

## Documentation/devicetree/bindings/riscv/spacemit.yaml
```yaml
# SPDX-License-Identifier: (GPL-2.0-only OR BSD-2-Clause)
%YAML 1.2
---
$id: http://devicetree.org/schemas/riscv/spacemit.yaml#
$schema: http://devicetree.org/meta-schemas/core.yaml#

title: SpacemiT SoC-based boards

maintainers:
  - Guodong Xu <guodong@riscstar.com>
  - Yangyu Chen <cyy@cyyself.name>
  - Yixun Lan <dlan@gentoo.org>

description:
  SpacemiT SoC-based boards

properties:
  $nodename:
    const: '/'
  compatible:
    oneOf:
      - items:
          - enum:
              - bananapi,bpi-f3
              - milkv,jupiter
              - spacemit,musepi-pro
              - xunlong,orangepi-r2s
              - xunlong,orangepi-rv2
          - const: spacemit,k1
      - items:
          - enum:
              - spacemit,k3-pico-itx
          - const: spacemit,k3

additionalProperties: true

...
```

## Documentation/devicetree/bindings/riscv/starfive-jh7110.yaml
```yaml
# SPDX-License-Identifier: (GPL-2.0-only OR BSD-2-Clause)
%YAML 1.2
---
$id: http://devicetree.org/schemas/riscv/starfive.yaml#
$schema: http://devicetree.org/meta-schemas/core.yaml#

title: StarFive JH7110 SoC-based boards

maintainers:
  - Michael Zhu <michael.zhu@starfivetech.com>
  - Jianlong Huang <jianlong.huang@starfivetech.com>

description:
  StarFive JH7110 SoC-based boards

properties:
  $nodename:
    const: '/'
  compatible:
    oneOf:
      - items:
          - const: starfive,jh7110
          - const: starfive,jh7110-evb
          - const: starfive,visionfive-v2

additionalProperties: true

...
```

## Documentation/devicetree/bindings/riscv/starfive.yaml
```yaml
# SPDX-License-Identifier: (GPL-2.0-only OR BSD-2-Clause)
%YAML 1.2
---
$id: http://devicetree.org/schemas/riscv/starfive.yaml#
$schema: http://devicetree.org/meta-schemas/core.yaml#

title: StarFive SoC-based boards

maintainers:
  - Michael Zhu <michael.zhu@starfivetech.com>
  - Drew Fustini <drew@beagleboard.org>

description:
  StarFive SoC-based boards

properties:
  $nodename:
    const: '/'
  compatible:
    oneOf:
      - items:
          - enum:
              - beagle,beaglev-starlight-jh7100-r0
              - starfive,visionfive-v1
          - const: starfive,jh7100

      - items:
          - enum:
              - milkv,mars
              - starfive,visionfive-2-v1.2a
              - starfive,visionfive-2-v1.3b
          - const: starfive,jh7110

additionalProperties: true

...
```

## Documentation/devicetree/bindings/riscv/sunxi.yaml
```yaml
# SPDX-License-Identifier: (GPL-2.0-only OR BSD-2-Clause)
%YAML 1.2
---
$id: http://devicetree.org/schemas/riscv/sunxi.yaml#
$schema: http://devicetree.org/meta-schemas/core.yaml#

title: Allwinner RISC-V SoC-based boards

maintainers:
  - Chen-Yu Tsai <wens@csie.org>
  - Jernej Skrabec <jernej.skrabec@gmail.com>
  - Samuel Holland <samuel@sholland.org>

description:
  Allwinner RISC-V SoC-based boards

properties:
  $nodename:
    const: '/'
  compatible:
    oneOf:
      - description: Dongshan Nezha STU SoM
        items:
          - const: 100ask,dongshan-nezha-stu
          - const: allwinner,sun20i-d1

      - description: D1 Nezha board
        items:
          - const: allwinner,d1-nezha
          - const: allwinner,sun20i-d1

      - description: ClockworkPi R-01 SoM and v3.14 board
        items:
          - const: clockwork,r-01-clockworkpi-v3.14
          - const: allwinner,sun20i-d1

      - description: ClockworkPi R-01 SoM, v3.14 board, and DevTerm expansion
        items:
          - const: clockwork,r-01-devterm-v3.14
          - const: clockwork,r-01-clockworkpi-v3.14
          - const: allwinner,sun20i-d1

      - description: Lichee RV SoM
        items:
          - const: sipeed,lichee-rv
          - const: allwinner,sun20i-d1

      - description: Carrier boards for the Lichee RV SoM
        items:
          - enum:
              - sipeed,lichee-rv-86-panel-480p
              - sipeed,lichee-rv-86-panel-720p
              - sipeed,lichee-rv-dock
          - const: sipeed,lichee-rv
          - const: allwinner,sun20i-d1

      - description: MangoPi MQ board
        items:
          - const: widora,mangopi-mq
          - const: allwinner,sun20i-d1s

      - description: MangoPi MQ Pro board
        items:
          - const: widora,mangopi-mq-pro
          - const: allwinner,sun20i-d1

      - description: MangoPi MQ-R board
        items:
          - const: widora,mangopi-mq-r-f133
          - const: allwinner,sun20i-d1s

additionalProperties: true

...
```

## Documentation/devicetree/bindings/riscv/tenstorrent.yaml
```yaml
# SPDX-License-Identifier: (GPL-2.0-only OR BSD-2-Clause)
%YAML 1.2
---
$id: http://devicetree.org/schemas/riscv/tenstorrent.yaml#
$schema: http://devicetree.org/meta-schemas/core.yaml#

title: Tenstorrent SoC-based boards

maintainers:
  - Drew Fustini <dfustini@oss.tenstorrent.com>
  - Joel Stanley <jms@oss.tenstorrent.com>

description:
  Tenstorrent SoC-based boards

properties:
  $nodename:
    const: '/'
  compatible:
    oneOf:
      - description: Tenstorrent Blackhole PCIe card
        items:
          - const: tenstorrent,blackhole-card
          - const: tenstorrent,blackhole

additionalProperties: true

...
```

## Documentation/devicetree/bindings/riscv/thead.yaml
```yaml
# SPDX-License-Identifier: (GPL-2.0-only OR BSD-2-Clause)
%YAML 1.2
---
$id: http://devicetree.org/schemas/riscv/thead.yaml#
$schema: http://devicetree.org/meta-schemas/core.yaml#

title: T-HEAD SoC-based boards

maintainers:
  - Jisheng Zhang <jszhang@kernel.org>

description:
  T-HEAD SoC-based boards

properties:
  $nodename:
    const: '/'
  compatible:
    oneOf:
      - description: Sipeed Lichee Pi 4A board for the Sipeed Lichee Module 4A
        items:
          - enum:
              - sipeed,lichee-pi-4a
          - const: sipeed,lichee-module-4a
          - const: thead,th1520

additionalProperties: true

...
```

## Documentation/devicetree/bindings/rkflash/nandc.txt
```
Rockchip NANDC Controller for SOC

Required properties:
- compatible : "rockchip,rk-nandc".
- reg : shall contain registers location and length for data and reg.
- interrupts : shall define the nandc controller interrupt.
- nandc_id : shall reference the number of nandc controllers;
- clocks : shall reference nandc controller clocks.
- clock-names : nandc controller internal clock names. Shall contain :
    * "clk_nandc" : nand controller clock
    * "hclk_nandc" : nandc ahb clock gate
    * "g_clk_nandc" : nandc enable clock gate

Examples:
nandc: nandc@30100000 {
	compatible = "rockchip,rk-nandc";
	reg = <0x0 0xff4b0000 0x0 0x4000>;
	interrupts = <GIC_SPI 14 IRQ_TYPE_LEVEL_HIGH>;
	nandc_id = <0>;
	clocks = <&clk_nandc>, <&clk_gates15 3>, <&clk_gates5 3>;
	clock-names = "clk_nandc", "hclk_nandc", "g_clk_nandc";
	status = "disabled";
};
```

## Documentation/devicetree/bindings/rkflash/sfc.txt
```
Rockchip SFC Controller for SOC

Required properties:
- compatible : "rockchip,sfc".
- reg : shall contain registers location and length for data and reg.
- interrupts : shall define the nand controller interrupt.
- clocks : shall reference sfc controller clocks.
- clock-names : sfc controller internal clock names. Shall contain :
    * "clk_sfc" : sfc controller clock
    * "hclk_sfc" : sfc ahb clock gate
- assigned-clocks : sclk preset by dts
- assigned-clock-frequency : sclk frequency, io clk = sclk/2;

Examples:
sfc: sfc@301c0000 {
	compatible = "rockchip,sfc";
	reg = <0x301c0000 0x200>;
	interrupts = <GIC_SPI 56 IRQ_TYPE_LEVEL_HIGH>;
	clocks = <&clk_sfc>, <&clk_gates15 10>;
	clock-names = "clk_sfc", "hclk_sfc";
	assigned-clocks = <&cru SCLK_SFC>;
	assigned-clock-frequency = <100000000>;
	status = "okay";
};
```
