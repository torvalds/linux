## Documentation/devicetree/bindings/reset/uniphier-reset.txt
```
UniPhier glue reset controller


Peripheral core reset in glue layer
-----------------------------------

Some peripheral core reset belongs to its own glue layer. Before using
this core reset, it is necessary to control the clocks and resets to enable
this layer. These clocks and resets should be described in each property.

Required properties:
- compatible: Should be
    "socionext,uniphier-pro4-usb3-reset" - for Pro4 SoC USB3
    "socionext,uniphier-pro5-usb3-reset" - for Pro5 SoC USB3
    "socionext,uniphier-pxs2-usb3-reset" - for PXs2 SoC USB3
    "socionext,uniphier-ld20-usb3-reset" - for LD20 SoC USB3
    "socionext,uniphier-pxs3-usb3-reset" - for PXs3 SoC USB3
    "socionext,uniphier-pro4-ahci-reset" - for Pro4 SoC AHCI
    "socionext,uniphier-pxs2-ahci-reset" - for PXs2 SoC AHCI
    "socionext,uniphier-pxs3-ahci-reset" - for PXs3 SoC AHCI
- #reset-cells: Should be 1.
- reg: Specifies offset and length of the register set for the device.
- clocks: A list of phandles to the clock gate for the glue layer.
	According to the clock-names, appropriate clocks are required.
- clock-names: Should contain
    "gio", "link" - for Pro4 and Pro5 SoCs
    "link"        - for others
- resets: A list of phandles to the reset control for the glue layer.
	According to the reset-names, appropriate resets are required.
- reset-names: Should contain
    "gio", "link" - for Pro4 and Pro5 SoCs
    "link"        - for others

Example:

	usb-glue@65b00000 {
		compatible = "socionext,uniphier-ld20-dwc3-glue",
			     "simple-mfd";
		#address-cells = <1>;
		#size-cells = <1>;
		ranges = <0 0x65b00000 0x400>;

		usb_rst: reset@0 {
			compatible = "socionext,uniphier-ld20-usb3-reset";
			reg = <0x0 0x4>;
			#reset-cells = <1>;
			clock-names = "link";
			clocks = <&sys_clk 14>;
			reset-names = "link";
			resets = <&sys_rst 14>;
		};

		regulator {
			...
		};

		phy {
			...
		};
		...
	};
```

## Documentation/devicetree/bindings/reset/xlnx,zynqmp-reset.txt
```
--------------------------------------------------------------------------
 =  Zynq UltraScale+ MPSoC and Versal reset driver binding =
--------------------------------------------------------------------------
The Zynq UltraScale+ MPSoC and Versal has several different resets.

See Chapter 36 of the Zynq UltraScale+ MPSoC TRM (UG) for more information
about zynqmp resets.

Please also refer to reset.txt in this directory for common reset
controller binding usage.

Required Properties:
- compatible:	"xlnx,zynqmp-reset" for Zynq UltraScale+ MPSoC platform
		"xlnx,versal-reset" for Versal platform
- #reset-cells:	Specifies the number of cells needed to encode reset
		line, should be 1

-------
Example
-------

firmware {
	zynqmp_firmware: zynqmp-firmware {
		compatible = "xlnx,zynqmp-firmware";
		method = "smc";

		zynqmp_reset: reset-controller {
			compatible = "xlnx,zynqmp-reset";
			#reset-cells = <1>;
		};
	};
};

Specifying reset lines connected to IP modules
==============================================

Device nodes that need access to reset lines should
specify them as a reset phandle in their corresponding node as
specified in reset.txt.

For list of all valid reset indices for Zynq UltraScale+ MPSoC see
<dt-bindings/reset/xlnx-zynqmp-resets.h>
For list of all valid reset indices for Versal see
<dt-bindings/reset/xlnx-versal-resets.h>

Example:

serdes: zynqmp_phy@fd400000 {
	...

	resets = <&zynqmp_reset ZYNQMP_RESET_SATA>;
	reset-names = "sata_rst";

	...
};
```

## Documentation/devicetree/bindings/reset/xlnx,zynqmp-reset.yaml
```yaml
# SPDX-License-Identifier: GPL-2.0-only OR BSD-2-Clause
%YAML 1.2
---
$id: http://devicetree.org/schemas/reset/xlnx,zynqmp-reset.yaml#
$schema: http://devicetree.org/meta-schemas/core.yaml#

title: Zynq UltraScale+ MPSoC and Versal reset

maintainers:
  - Mubin Sayyed <mubin.sayyed@amd.com>
  - Radhey Shyam Pandey <radhey.shyam.pandey@amd.com>

description: |
  The Zynq UltraScale+ MPSoC and Versal has several different resets.

  The PS reset subsystem is responsible for handling the external reset
  input to the device and that all internal reset requirements are met
  for the system (as a whole) and for the functional units.

  Please also refer to reset.txt in this directory for common reset
  controller binding usage. Device nodes that need access to reset
  lines should specify them as a reset phandle in their corresponding
  node as specified in reset.txt.

  For list of all valid reset indices for Zynq UltraScale+ MPSoC
  <dt-bindings/reset/xlnx-zynqmp-resets.h>

  For list of all valid reset indices for Versal
  <dt-bindings/reset/xlnx-versal-resets.h>

properties:
  compatible:
    enum:
      - xlnx,zynqmp-reset
      - xlnx,versal-reset
      - xlnx,versal-net-reset

  "#reset-cells":
    const: 1

required:
  - compatible
  - "#reset-cells"

additionalProperties: false

examples:
  - |
    zynqmp_reset: reset-controller {
        compatible = "xlnx,zynqmp-reset";
        #reset-cells = <1>;
    };

...
```

## Documentation/devicetree/bindings/reset/zte,zx2967-reset.txt
```
ZTE zx2967 SoCs Reset Controller
=======================================

Please also refer to reset.txt in this directory for common reset
controller binding usage.

Required properties:
- compatible: should be one of the following.
	* zte,zx296718-reset
- reg: physical base address of the controller and length of memory mapped
	region.
- #reset-cells: must be 1.

example:

	reset: reset-controller@1461060 {
		compatible = "zte,zx296718-reset";
		reg = <0x01461060 0x8>;
		#reset-cells = <1>;
	};
```

## Documentation/devicetree/bindings/reset/zynq-reset.txt
```
Xilinx Zynq Reset Manager

The Zynq AP-SoC has several different resets.

See Chapter 26 of the Zynq TRM (UG585) for more information about Zynq resets.

Required properties:
- compatible: "xlnx,zynq-reset"
- reg: SLCR offset and size taken via syscon <0x200 0x48>
- syscon: <&slcr>
  This should be a phandle to the Zynq's SLCR registers.
- #reset-cells: Must be 1

The Zynq Reset Manager needs to be a childnode of the SLCR.

Example:
	rstc: rstc@200 {
		compatible = "xlnx,zynq-reset";
		reg = <0x200 0x48>;
		#reset-cells = <1>;
		syscon = <&slcr>;
	};

Reset outputs:
 0  : soft reset
 32 : ddr reset
 64 : topsw reset
 96 : dmac reset
 128: usb0 reset
 129: usb1 reset
 160: gem0 reset
 161: gem1 reset
 164: gem0 rx reset
 165: gem1 rx reset
 166: gem0 ref reset
 167: gem1 ref reset
 192: sdio0 reset
 193: sdio1 reset
 196: sdio0 ref reset
 197: sdio1 ref reset
 224: spi0 reset
 225: spi1 reset
 226: spi0 ref reset
 227: spi1 ref reset
 256: can0 reset
 257: can1 reset
 258: can0 ref reset
 259: can1 ref reset
 288: i2c0 reset
 289: i2c1 reset
 320: uart0 reset
 321: uart1 reset
 322: uart0 ref reset
 323: uart1 ref reset
 352: gpio reset
 384: lqspi reset
 385: qspi ref reset
 416: smc reset
 417: smc ref reset
 448: ocm reset
 512: fpga0 out reset
 513: fpga1 out reset
 514: fpga2 out reset
 515: fpga3 out reset
 544: a9 reset 0
 545: a9 reset 1
 552: peri reset
```

## Documentation/devicetree/bindings/resource-names.txt
```
Some properties contain an ordered list of 1 or more datum which are
normally accessed by index.  However, some devices will have multiple
values which are more naturally accessed by name.  Device nodes can
include a supplemental property for assigning names to each of the list
items.  The names property consists of a list of strings in the same
order as the data in the resource property.

The following supplemental names properties are defined.

Resource Property	Supplemental Names Property
-----------------	---------------------------
reg			reg-names
clocks			clock-names
interrupts		interrupt-names

Usage:

The -names property must be used in conjunction with the normal resource
property. If not it will be ignored.

Examples:

l4-abe {
	compatible = "simple-bus";
	#address-cells = <2>;
	#size-cells = <1>;
	ranges = <0 0 0x48000000 0x00001000>, /* MPU path */
		 <1 0 0x49000000 0x00001000>; /* L3 path */
	mcasp {
		compatible = "ti,mcasp";
		reg = <0 0x10 0x10>, <0 0x20 0x10>,
		      <1 0x10 0x10>, <1 0x20 0x10>;
		reg-names = "mpu", "dat",
			    "dma", "dma_dat";
		interrupts = <11>, <12>;
		interrupt-names = "rx", "tx";
	};

	timer {
		compatible = "ti,timer";
		reg = <0 0x40 0x10>, <1 0x40 0x10>;
		reg-names = "mpu", "dma";
	};
};


usb {
	compatible = "ti,usb-host";
	reg = <0x4a064000 0x800>, <0x4a064800 0x200>,
	      <0x4a064c00 0x200>;
	reg-names = "config", "ohci", "ehci";
	interrupts = <14>, <15>;
	interrupt-names = "ohci", "ehci";
};
```

## Documentation/devicetree/bindings/riscv/andes.yaml
```yaml
# SPDX-License-Identifier: (GPL-2.0-only OR BSD-2-Clause)
%YAML 1.2
---
$id: http://devicetree.org/schemas/riscv/andes.yaml#
$schema: http://devicetree.org/meta-schemas/core.yaml#

title: Andes SoC-based boards

maintainers:
  - Ben Zong-You Xie <ben717@andestech.com>

description:
  Andes SoC-based boards

properties:
  $nodename:
    const: '/'
  compatible:
    oneOf:
      - items:
          - enum:
              - andestech,voyager
          - const: andestech,qilai

additionalProperties: true
```

## Documentation/devicetree/bindings/riscv/anlogic.yaml
```yaml
# SPDX-License-Identifier: (GPL-2.0-only OR BSD-2-Clause)
%YAML 1.2
---
$id: http://devicetree.org/schemas/riscv/anlogic.yaml#
$schema: http://devicetree.org/meta-schemas/core.yaml#

title: Anlogic SoC-based boards

maintainers:
  - Junhui Liu <junhui.liu@pigmoral.tech>

description:
  Anlogic SoC-based boards

properties:
  $nodename:
    const: '/'
  compatible:
    oneOf:
      - items:
          - enum:
              - milianke,mlkpai-fs01
          - const: anlogic,dr1v90

additionalProperties: true

...
```

## Documentation/devicetree/bindings/riscv/canaan.yaml
```yaml
# SPDX-License-Identifier: (GPL-2.0-only OR BSD-2-Clause)
%YAML 1.2
---
$id: http://devicetree.org/schemas/riscv/canaan.yaml#
$schema: http://devicetree.org/meta-schemas/core.yaml#

title: Canaan SoC-based boards

maintainers:
  - Damien Le Moal <dlemoal@kernel.org>

description:
  Canaan Kendryte SoC-based boards

properties:
  $nodename:
    const: '/'
  compatible:
    oneOf:
      - items:
          - const: sipeed,maix-bit
          - const: sipeed,maix-bitm
          - const: canaan,kendryte-k210

      - items:
          - const: sipeed,maix-go
          - const: canaan,kendryte-k210

      - items:
          - const: sipeed,maix-dock-m1
          - const: sipeed,maix-dock-m1w
          - const: canaan,kendryte-k210

      - items:
          - const: sipeed,maixduino
          - const: canaan,kendryte-k210

      - items:
          - const: canaan,kendryte-kd233
          - const: canaan,kendryte-k210

      - items:
          - const: canaan,kendryte-k210

      - items:
          - enum:
              - canaan,canmv-k230
              - canaan,k230-usip-lp3-evb
          - const: canaan,kendryte-k230

additionalProperties: true

...
```
