## Documentation/devicetree/bindings/reset/sirf,rstc.txt
```
CSR SiRFSoC Reset Controller
======================================

Please also refer to reset.txt in this directory for common reset
controller binding usage.

Required properties:
- compatible: Should be "sirf,prima2-rstc" or "sirf,marco-rstc"
- reg: should be register base and length as documented in the
  datasheet
- #reset-cells: 1, see below

example:

rstc: reset-controller@88010000 {
	compatible = "sirf,prima2-rstc";
	reg = <0x88010000 0x1000>;
	#reset-cells = <1>;
};

Specifying reset lines connected to IP modules
==============================================

The reset controller(rstc) manages various reset sources. This module provides
reset signals for most blocks in system. Those device nodes should specify the
reset line on the rstc in their resets property, containing a phandle to the
rstc device node and a RESET_INDEX specifying which module to reset, as described
in reset.txt.

For SiRFSoC, RESET_INDEX is just reset_bit defined in SW_RST0 and SW_RST1 registers.
For modules whose rest_bit is in SW_RST0, its RESET_INDEX is 0~31. For modules whose
rest_bit is in SW_RST1, its RESET_INDEX is 32~63.

example:

vpp@90020000 {
	compatible = "sirf,prima2-vpp";
	reg = <0x90020000 0x10000>;
	interrupts = <31>;
	clocks = <&clks 35>;
	resets = <&rstc 6>;
};
```

## Documentation/devicetree/bindings/reset/snps,axs10x-reset.txt
```
Binding for the AXS10x reset controller

This binding describes the ARC AXS10x boards custom IP-block which allows
to control reset signals of selected peripherals. For example DW GMAC, etc...
This block is controlled via memory-mapped register (AKA CREG) which
represents up-to 32 reset lines.

As of today only the following lines are used:
 - DW GMAC - line 5

This binding uses the common reset binding[1].

[1] Documentation/devicetree/bindings/reset/reset.txt

Required properties:
- compatible: should be "snps,axs10x-reset".
- reg: should always contain pair address - length: for creg reset
  bits register.
- #reset-cells: from common reset binding; Should always be set to 1.

Example:
	reset: reset-controller@11220 {
		compatible = "snps,axs10x-reset";
		#reset-cells = <1>;
		reg = <0x11220 0x4>;
	};

Specifying reset lines connected to IP modules:
	ethernet@.... {
		....
		resets = <&reset 5>;
		....
	};
```

## Documentation/devicetree/bindings/reset/snps,axs10x-reset.yaml
```yaml
# SPDX-License-Identifier: (GPL-2.0-only OR BSD-2-Clause)
%YAML 1.2
---
$id: http://devicetree.org/schemas/reset/snps,axs10x-reset.yaml#
$schema: http://devicetree.org/meta-schemas/core.yaml#

title: AXS10x reset controller

maintainers:
  - Eugeniy Paltsev <Eugeniy.Paltsev@synopsys.com>

description: |
  This binding describes the ARC AXS10x boards custom IP-block which allows
  to control reset signals of selected peripherals. For example DW GMAC, etc...
  This block is controlled via memory-mapped register (AKA CREG) which
  represents up-to 32 reset lines.
  As of today only the following lines are used:
   - DW GMAC - line 5

properties:
  compatible:
    const: snps,axs10x-reset

  reg:
    maxItems: 1

  '#reset-cells':
    const: 1

required:
  - compatible
  - reg
  - '#reset-cells'

additionalProperties: false

examples:
  - |
    reset: reset-controller@11220 {
        compatible = "snps,axs10x-reset";
        #reset-cells = <1>;
        reg = <0x11220 0x4>;
    };

    // Specifying reset lines connected to IP modules:
    ethernet {
        resets = <&reset 5>;
    };
```

## Documentation/devicetree/bindings/reset/snps,dw-reset.txt
```
Synopsys DesignWare Reset controller
=======================================

Please also refer to reset.txt in this directory for common reset
controller binding usage.

Required properties:

- compatible: should be one of the following.
	"snps,dw-high-reset" - for active high configuration
	"snps,dw-low-reset" - for active low configuration

- reg: physical base address of the controller and length of memory mapped
	region.

- #reset-cells: must be 1.

example:

	dw_rst_1: reset-controller@0000 {
		compatible = "snps,dw-high-reset";
		reg = <0x0000 0x4>;
		#reset-cells = <1>;
	};

	dw_rst_2: reset-controller@1000 {
		compatible = "snps,dw-low-reset";
		reg = <0x1000 0x8>;
		#reset-cells = <1>;
	};
```

## Documentation/devicetree/bindings/reset/snps,dw-reset.yaml
```yaml
# SPDX-License-Identifier: (GPL-2.0-only OR BSD-2-Clause)
%YAML 1.2
---
$id: http://devicetree.org/schemas/reset/snps,dw-reset.yaml#
$schema: http://devicetree.org/meta-schemas/core.yaml#

title: Synopsys DesignWare Reset controller

maintainers:
  - Philipp Zabel <p.zabel@pengutronix.de>

properties:
  compatible:
    enum:
      - snps,dw-high-reset
      - snps,dw-low-reset

  reg:
    maxItems: 1

  '#reset-cells':
    const: 1

  reset-controller: true

required:
  - compatible
  - reg
  - '#reset-cells'

additionalProperties: false

examples:
  - |
    reset-controller@0 {
        compatible = "snps,dw-high-reset";
        reg = <0x0000 0x4>;
        #reset-cells = <1>;
    };
```

## Documentation/devicetree/bindings/reset/snps,hsdk-reset.txt
```
Binding for the Synopsys HSDK reset controller

This binding uses the common reset binding[1].

[1] Documentation/devicetree/bindings/reset/reset.txt

Required properties:
- compatible: should be "snps,hsdk-reset".
- reg: should always contain 2 pairs address - length: first for reset
  configuration register and second for corresponding SW reset and status bits
  register.
- #reset-cells: from common reset binding; Should always be set to 1.

Example:
	reset: reset@880 {
		compatible = "snps,hsdk-reset";
		#reset-cells = <1>;
		reg = <0x8A0 0x4>, <0xFF0 0x4>;
	};

Specifying reset lines connected to IP modules:
	ethernet@.... {
		....
		resets = <&reset HSDK_V1_ETH_RESET>;
		....
	};

The index could be found in <dt-bindings/reset/snps,hsdk-reset.h>
```

## Documentation/devicetree/bindings/reset/snps,hsdk-v1-reset.txt
```
Binding for the HSDK v1 reset controller

This binding uses the common reset binding[1].

[1] Documentation/devicetree/bindings/reset/reset.txt

Required properties:
- compatible: should be "snps,hsdk-v1.0-reset".
- reg: should always contain 2 pairs address - length: first for reset
  configuration register and second for corresponding SW reset and status bits
  register.
- #reset-cells: from common reset binding; Should always be set to 1.

Example:
	reset: reset@880 {
		compatible = "snps,hsdk-v1.0-reset";
		#reset-cells = <1>;
		reg = <0x8A0 0x4>, <0xFF0 0x4>;
	};

Specifying reset lines connected to IP modules:
	ethernet@.... {
		....
		resets = <&reset HSDK_V1_ETH_RESET>;
		....
	};

The index could be found in <dt-bindings/reset/snps,hsdk-v1-reset.h>
```

## Documentation/devicetree/bindings/reset/socfpga-reset.txt
```
Altera SOCFPGA Reset Manager

Required properties:
- compatible : "altr,rst-mgr" for (Cyclone5/Arria5/Arria10)
	       "altr,stratix10-rst-mgr","altr,rst-mgr" for Stratix10 ARM64 SoC
- reg : Should contain 1 register ranges(address and length)
- altr,modrst-offset : Should contain the offset of the first modrst register.
- #reset-cells: 1

Example:
	 rstmgr@ffd05000 {
		#reset-cells = <1>;
		compatible = "altr,rst-mgr";
		reg = <0xffd05000 0x1000>;
		altr,modrst-offset = <0x10>;
	};
```

## Documentation/devicetree/bindings/reset/socionext,uniphier-glue-reset.yaml
```yaml
# SPDX-License-Identifier: (GPL-2.0-only OR BSD-2-Clause)
%YAML 1.2
---
$id: http://devicetree.org/schemas/reset/socionext,uniphier-glue-reset.yaml#
$schema: http://devicetree.org/meta-schemas/core.yaml#

title: Socionext UniPhier peripheral core reset in glue layer

description: |
  Some peripheral core reset belongs to its own glue layer. Before using
  this core reset, it is necessary to control the clocks and resets to
  enable this layer. These clocks and resets should be described in each
  property.

maintainers:
  - Kunihiko Hayashi <hayashi.kunihiko@socionext.com>

properties:
  compatible:
    enum:
      - socionext,uniphier-pro4-usb3-reset
      - socionext,uniphier-pro5-usb3-reset
      - socionext,uniphier-pxs2-usb3-reset
      - socionext,uniphier-ld20-usb3-reset
      - socionext,uniphier-pxs3-usb3-reset
      - socionext,uniphier-nx1-usb3-reset
      - socionext,uniphier-pro4-ahci-reset
      - socionext,uniphier-pxs2-ahci-reset
      - socionext,uniphier-pxs3-ahci-reset

  reg:
    maxItems: 1

  "#reset-cells":
    const: 1

  clocks:
    minItems: 1
    maxItems: 2

  clock-names:
    minItems: 1
    maxItems: 2

  resets:
    minItems: 1
    maxItems: 2

  reset-names:
    minItems: 1
    maxItems: 2

allOf:
  - if:
      properties:
        compatible:
          contains:
            enum:
              - socionext,uniphier-pro4-usb3-reset
              - socionext,uniphier-pro5-usb3-reset
              - socionext,uniphier-pro4-ahci-reset
    then:
      properties:
        clocks:
          minItems: 2
          maxItems: 2
        clock-names:
          items:
            - const: gio
            - const: link
        resets:
          minItems: 2
          maxItems: 2
        reset-names:
          items:
            - const: gio
            - const: link
    else:
      properties:
        clocks:
          maxItems: 1
        clock-names:
          const: link
        resets:
          maxItems: 1
        reset-names:
          const: link

additionalProperties: false

required:
  - compatible
  - reg
  - "#reset-cells"
  - clocks
  - clock-names
  - resets
  - reset-names

examples:
  - |
    usb_rst: reset-controller@0 {
        compatible = "socionext,uniphier-ld20-usb3-reset";
        reg = <0x0 0x4>;
        #reset-cells = <1>;
        clock-names = "link";
        clocks = <&sys_clk 14>;
        reset-names = "link";
        resets = <&sys_rst 14>;
    };
```

## Documentation/devicetree/bindings/reset/socionext,uniphier-reset.yaml
```yaml
# SPDX-License-Identifier: GPL-2.0-only OR BSD-2-Clause
%YAML 1.2
---
$id: http://devicetree.org/schemas/reset/socionext,uniphier-reset.yaml#
$schema: http://devicetree.org/meta-schemas/core.yaml#

title: UniPhier reset controller

maintainers:
  - Masahiro Yamada <yamada.masahiro@socionext.com>

properties:
  compatible:
    oneOf:
      - description: System reset
        enum:
          - socionext,uniphier-ld4-reset
          - socionext,uniphier-pro4-reset
          - socionext,uniphier-sld8-reset
          - socionext,uniphier-pro5-reset
          - socionext,uniphier-pxs2-reset
          - socionext,uniphier-ld6b-reset
          - socionext,uniphier-ld11-reset
          - socionext,uniphier-ld20-reset
          - socionext,uniphier-pxs3-reset
          - socionext,uniphier-nx1-reset
      - description: Media I/O (MIO) reset, SD reset
        enum:
          - socionext,uniphier-ld4-mio-reset
          - socionext,uniphier-pro4-mio-reset
          - socionext,uniphier-sld8-mio-reset
          - socionext,uniphier-pro5-sd-reset
          - socionext,uniphier-pxs2-sd-reset
          - socionext,uniphier-ld11-mio-reset
          - socionext,uniphier-ld11-sd-reset
          - socionext,uniphier-ld20-sd-reset
          - socionext,uniphier-pxs3-sd-reset
          - socionext,uniphier-nx1-sd-reset
      - description: Peripheral reset
        enum:
          - socionext,uniphier-ld4-peri-reset
          - socionext,uniphier-pro4-peri-reset
          - socionext,uniphier-sld8-peri-reset
          - socionext,uniphier-pro5-peri-reset
          - socionext,uniphier-pxs2-peri-reset
          - socionext,uniphier-ld11-peri-reset
          - socionext,uniphier-ld20-peri-reset
          - socionext,uniphier-pxs3-peri-reset
          - socionext,uniphier-nx1-peri-reset
      - description: Analog signal amplifier reset
        enum:
          - socionext,uniphier-ld11-adamv-reset
          - socionext,uniphier-ld20-adamv-reset

  "#reset-cells":
    const: 1

  resets:
    maxItems: 1

additionalProperties: false

required:
  - compatible
  - "#reset-cells"

examples:
  - |
    reset-controller {
        compatible = "socionext,uniphier-ld11-reset";
        #reset-cells = <1>;
    };
```

## Documentation/devicetree/bindings/reset/sophgo,sg2042-reset.yaml
```yaml
# SPDX-License-Identifier: (GPL-2.0 OR BSD-2-Clause)
%YAML 1.2
---
$id: http://devicetree.org/schemas/reset/sophgo,sg2042-reset.yaml#
$schema: http://devicetree.org/meta-schemas/core.yaml#

title: Sophgo SG2042 SoC Reset Controller

maintainers:
  - Chen Wang <unicorn_wang@outlook.com>

properties:
  compatible:
    oneOf:
      - items:
          - enum:
              - sophgo,sg2044-reset
          - const: sophgo,sg2042-reset
      - enum:
          - sophgo,cv1800b-reset
          - sophgo,sg2042-reset

  reg:
    maxItems: 1

  "#reset-cells":
    const: 1

required:
  - compatible
  - reg
  - "#reset-cells"

additionalProperties: false

examples:
  - |
    rstgen: reset-controller@c00 {
        compatible = "sophgo,sg2042-reset";
        reg = <0xc00 0xc>;
        #reset-cells = <1>;
    };
```

## Documentation/devicetree/bindings/reset/st,sti-picophyreset.txt
```
STMicroelectronics STi family Sysconfig Picophy SoftReset Controller
=============================================================================

This binding describes a reset controller device that is used to enable and
disable on-chip PicoPHY USB2 phy(s) using "softreset" control bits found in
the STi family SoC system configuration registers.

The actual action taken when softreset is asserted is hardware dependent.
However, when asserted it may not be possible to access the hardware's
registers and after an assert/deassert sequence the hardware's previous state
may no longer be valid.

Please refer to Documentation/devicetree/bindings/reset/reset.txt
for common reset controller binding usage.

Required properties:
- compatible: Should be "st,stih407-picophyreset"
- #reset-cells: 1, see below

Example:

	picophyreset: picophyreset-controller {
		compatible = "st,stih407-picophyreset";
		#reset-cells = <1>;
	};

Specifying picophyreset control of devices
=======================================

Device nodes should specify the reset channel required in their "resets"
property, containing a phandle to the picophyreset device node and an
index specifying which channel to use, as described in
Documentation/devicetree/bindings/reset/reset.txt.

Example:

	usb2_picophy0: usbpicophy@0 {
		resets = <&picophyreset STIH407_PICOPHY0_RESET>;
	};

Macro definitions for the supported reset channels can be found in:
include/dt-bindings/reset-controller/stih407-resets.h
```
