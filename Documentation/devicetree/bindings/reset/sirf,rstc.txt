## Documentation/devicetree/bindings/reset/st,sti-powerdown.txt
```
STMicroelectronics STi family Sysconfig Peripheral Powerdown Reset Controller
=============================================================================

This binding describes a reset controller device that is used to enable and
disable on-chip peripheral controllers such as USB and SATA, using
"powerdown" control bits found in the STi family SoC system configuration
registers. These have been grouped together into a single reset controller
device for convenience.

The actual action taken when powerdown is asserted is hardware dependent.
However, when asserted it may not be possible to access the hardware's
registers and after an assert/deassert sequence the hardware's previous state
may no longer be valid.

Please refer to reset.txt in this directory for common reset
controller binding usage.

Required properties:
- compatible: Should be "st,<chip>-powerdown"
	ex: "st,stih415-powerdown", "st,stih416-powerdown"
- #reset-cells: 1, see below

example:

	powerdown: powerdown-controller {
		#reset-cells = <1>;
		compatible = "st,stih415-powerdown";
	};


Specifying powerdown control of devices
=======================================

Device nodes should specify the reset channel required in their "resets"
property, containing a phandle to the powerdown device node and an
index specifying which channel to use, as described in reset.txt

example:

	usb1: usb@fe200000 {
		resets	= <&powerdown STIH41X_USB1_POWERDOWN>;
	};

Macro definitions for the supported reset channels can be found in:

include/dt-bindings/reset-controller/stih415-resets.h
include/dt-bindings/reset-controller/stih416-resets.h
```

## Documentation/devicetree/bindings/reset/st,sti-softreset.txt
```
STMicroelectronics STi family Sysconfig Peripheral SoftReset Controller
=============================================================================

This binding describes a reset controller device that is used to enable and
disable on-chip peripheral controllers such as USB and SATA, using
"softreset" control bits found in the STi family SoC system configuration
registers.

The actual action taken when softreset is asserted is hardware dependent.
However, when asserted it may not be possible to access the hardware's
registers and after an assert/deassert sequence the hardware's previous state
may no longer be valid.

Please refer to reset.txt in this directory for common reset
controller binding usage.

Required properties:
- compatible: Should be "st,stih407-softreset";
- #reset-cells: 1, see below

example:

	softreset: softreset-controller {
		#reset-cells = <1>;
		compatible = "st,stih407-softreset";
	};


Specifying softreset control of devices
=======================================

Device nodes should specify the reset channel required in their "resets"
property, containing a phandle to the softreset device node and an
index specifying which channel to use, as described in reset.txt

example:

	ethernet0{
		resets			= <&softreset STIH415_ETH0_SOFTRESET>;
	};

Macro definitions for the supported reset channels can be found in:

include/dt-bindings/reset/stih407-resets.h
```

## Documentation/devicetree/bindings/reset/st,stih407-picophyreset.yaml
```yaml
# SPDX-License-Identifier: (GPL-2.0-only OR BSD-2-Clause)
%YAML 1.2
---
$id: http://devicetree.org/schemas/reset/st,stih407-picophyreset.yaml#
$schema: http://devicetree.org/meta-schemas/core.yaml#

title: STMicroelectronics STi family Sysconfig Picophy SoftReset Controller

maintainers:
  - Peter Griffin <peter.griffin@linaro.org>

description: |
  This binding describes a reset controller device that is used to enable and
  disable on-chip PicoPHY USB2 phy(s) using "softreset" control bits found in
  the STi family SoC system configuration registers.

  The actual action taken when softreset is asserted is hardware dependent.
  However, when asserted it may not be possible to access the hardware's
  registers and after an assert/deassert sequence the hardware's previous state
  may no longer be valid.

properties:
  compatible:
    const: st,stih407-picophyreset

  '#reset-cells':
    const: 1

required:
  - compatible
  - '#reset-cells'

additionalProperties: false

examples:
  - |
    #include <dt-bindings/reset/stih407-resets.h>

    picophyreset: picophyreset-controller {
        compatible = "st,stih407-picophyreset";
        #reset-cells = <1>;
    };

    // Specifying picophyreset control of devices
    usb2_picophy0: usbpicophy {
        resets = <&picophyreset STIH407_PICOPHY0_RESET>;
    };
```

## Documentation/devicetree/bindings/reset/st,stih407-powerdown.yaml
```yaml
# SPDX-License-Identifier: (GPL-2.0-only OR BSD-2-Clause)
%YAML 1.2
---
$id: http://devicetree.org/schemas/reset/st,stih407-powerdown.yaml#
$schema: http://devicetree.org/meta-schemas/core.yaml#

title: STMicroelectronics STi family Sysconfig Peripheral Powerdown Reset Controller

maintainers:
  - Srinivas Kandagatla <srinivas.kandagatla@st.com>

description: |
  This binding describes a reset controller device that is used to enable and
  disable on-chip peripheral controllers such as USB and SATA, using
  "powerdown" control bits found in the STi family SoC system configuration
  registers. These have been grouped together into a single reset controller
  device for convenience.

  The actual action taken when powerdown is asserted is hardware dependent.
  However, when asserted it may not be possible to access the hardware's
  registers and after an assert/deassert sequence the hardware's previous state
  may no longer be valid.

properties:
  compatible:
    const: st,stih407-powerdown

  '#reset-cells':
    const: 1

required:
  - compatible
  - '#reset-cells'

additionalProperties: false

examples:
  - |
    #include <dt-bindings/reset/stih407-resets.h>

    powerdown: powerdown-controller {
        compatible = "st,stih407-powerdown";
        #reset-cells = <1>;
    };

    // Specifying powerdown control of devices:
    st_dwc3: dwc3 {
        resets = <&powerdown STIH407_USB3_POWERDOWN>;
    };
```

## Documentation/devicetree/bindings/reset/starfive,jh7100-reset.yaml
```yaml
# SPDX-License-Identifier: GPL-2.0-only OR BSD-2-Clause
%YAML 1.2
---
$id: http://devicetree.org/schemas/reset/starfive,jh7100-reset.yaml#
$schema: http://devicetree.org/meta-schemas/core.yaml#

title: StarFive JH7100 SoC Reset Controller

maintainers:
  - Emil Renner Berthing <kernel@esmil.dk>

properties:
  compatible:
    enum:
      - starfive,jh7100-reset

  reg:
    maxItems: 1

  "#reset-cells":
    const: 1

required:
  - compatible
  - reg
  - "#reset-cells"

additionalProperties: false

examples:
  - |
    reset-controller@11840000 {
        compatible = "starfive,jh7100-reset";
        reg = <0x11840000 0x10000>;
        #reset-cells = <1>;
    };

...
```

## Documentation/devicetree/bindings/reset/sunplus,reset.yaml
```yaml
# SPDX-License-Identifier: (GPL-2.0-only OR BSD-2-Clause)
# Copyright (C) Sunplus Co., Ltd. 2021
%YAML 1.2
---
$id: http://devicetree.org/schemas/reset/sunplus,reset.yaml#
$schema: http://devicetree.org/meta-schemas/core.yaml#

title: Sunplus SoC Reset Controller

maintainers:
  - Qin Jian <qinjian@cqplus1.com>

properties:
  compatible:
    const: sunplus,sp7021-reset

  reg:
    maxItems: 1

  "#reset-cells":
    const: 1

required:
  - compatible
  - reg
  - "#reset-cells"

additionalProperties: false

examples:
  - |
    rstc: reset@9c000054 {
      compatible = "sunplus,sp7021-reset";
      reg = <0x9c000054 0x28>;
      #reset-cells = <1>;
    };

...
```

## Documentation/devicetree/bindings/reset/thead,th1520-reset.yaml
```yaml
# SPDX-License-Identifier: (GPL-2.0-only OR BSD-2-Clause)
%YAML 1.2
---
$id: http://devicetree.org/schemas/reset/thead,th1520-reset.yaml#
$schema: http://devicetree.org/meta-schemas/core.yaml#

title: T-HEAD TH1520 SoC Reset Controller

description:
  The T-HEAD TH1520 reset controller is a hardware block that asserts/deasserts
  resets for SoC subsystems.

maintainers:
  - Michal Wilczynski <m.wilczynski@samsung.com>

properties:
  compatible:
    enum:
      - thead,th1520-reset # Reset controller for VO subsystem
      - thead,th1520-reset-ao
      - thead,th1520-reset-ap
      - thead,th1520-reset-dsp
      - thead,th1520-reset-misc
      - thead,th1520-reset-vi
      - thead,th1520-reset-vp

  reg:
    maxItems: 1

  "#reset-cells":
    const: 1

required:
  - compatible
  - reg
  - "#reset-cells"

additionalProperties: false

examples:
  - |
    soc {
      #address-cells = <2>;
      #size-cells = <2>;
      rst: reset-controller@ffef528000 {
        compatible = "thead,th1520-reset";
        reg = <0xff 0xef528000 0x0 0x1000>;
        #reset-cells = <1>;
      };
    };
```

## Documentation/devicetree/bindings/reset/ti,sci-reset.txt
```
Texas Instruments System Control Interface (TI-SCI) Reset Controller
=====================================================================

Some TI SoCs contain a system controller (like the Power Management Micro
Controller (PMMC) on Keystone 66AK2G SoC) that are responsible for controlling
the state of the various hardware modules present on the SoC. Communication
between the host processor running an OS and the system controller happens
through a protocol called TI System Control Interface (TI-SCI protocol).
For TI SCI details, please refer to the document,
Documentation/devicetree/bindings/arm/keystone/ti,sci.txt

TI-SCI Reset Controller Node
============================
This reset controller node uses the TI SCI protocol to perform the reset
management of various hardware modules present on the SoC. Must be a child
node of the associated TI-SCI system controller node.

Required properties:
--------------------
 - compatible	: Should be "ti,sci-reset"
 - #reset-cells	: Should be 2. Please see the reset consumer node below for
		  usage details.

TI-SCI Reset Consumer Nodes
===========================
Each of the reset consumer nodes should have the following properties,
in addition to their own properties.

Required properties:
--------------------
 - resets	: A phandle and reset specifier pair, one pair for each reset
		  signal that affects the device, or that the device manages.
		  The phandle should point to the TI-SCI reset controller node,
		  and the reset specifier should have 2 cell-values. The first
		  cell should contain the device ID. The second cell should
		  contain the reset mask value used by system controller.
		  Please refer to the protocol documentation for these values
		  to be used for different devices,
		  http://processors.wiki.ti.com/index.php/TISCI#66AK2G02_Data

Please also refer to Documentation/devicetree/bindings/reset/reset.txt for
common reset controller usage by consumers.

Example:
--------
The following example demonstrates both a TI-SCI reset controller node and a
consumer (a DSP device) on the 66AK2G SoC.

pmmc: pmmc {
	compatible = "ti,k2g-sci";

	k2g_reset: reset-controller {
		compatible = "ti,sci-reset";
		#reset-cells = <2>;
	};
};

dsp0: dsp@10800000 {
	...
	resets = <&k2g_reset 0x0046 0x1>;
	...
};
```

## Documentation/devicetree/bindings/reset/ti,sci-reset.yaml
```yaml
# SPDX-License-Identifier: (GPL-2.0-only or BSD-2-Clause)
%YAML 1.2
---
$id: http://devicetree.org/schemas/reset/ti,sci-reset.yaml#
$schema: http://devicetree.org/meta-schemas/core.yaml#

title: TI-SCI reset controller

maintainers:
  - Nishanth Menon <nm@ti.com>

description: |
  Some TI SoCs contain a system controller (like the Power Management Micro
  Controller (PMMC) on Keystone 66AK2G SoC) that are responsible for controlling
  the state of the various hardware modules present on the SoC. Communication
  between the host processor running an OS and the system controller happens
  through a protocol called TI System Control Interface (TI-SCI protocol).

  This reset controller node uses the TI SCI protocol to perform the reset
  management of various hardware modules present on the SoC. Must be a child
  node of the associated TI-SCI system controller node.

properties:
  $nodename:
    pattern: "^reset-controller$"

  compatible:
    const: ti,sci-reset

  "#reset-cells":
    const: 2
    description:
      The two cells represent values that the TI-SCI controller defines.

      The first cell should contain the device ID.

      The second cell should contain the reset mask corresponding to the device
      used by system controller.

      Please see  http://processors.wiki.ti.com/index.php/TISCI for
      protocol documentation for the values to be used for different devices.


additionalProperties: false

examples:
  - |
    k3_reset: reset-controller {
        compatible = "ti,sci-reset";
        #reset-cells = <2>;
    };
```

## Documentation/devicetree/bindings/reset/ti,tps380x-reset.yaml
```yaml
# SPDX-License-Identifier: (GPL-2.0-only OR BSD-2-Clause)
%YAML 1.2
---
$id: http://devicetree.org/schemas/reset/ti,tps380x-reset.yaml#
$schema: http://devicetree.org/meta-schemas/core.yaml#

title: TI TPS380x reset controller

maintainers:
  - Marco Felsch <kernel@pengutronix.de>

description: |
  The TPS380x family [1] of supervisory circuits monitor supply voltages to
  provide circuit initialization and timing supervision. The devices assert a
  RESET signal if the voltage drops below a preset threshold or upon a manual
  reset input (MR). The RESET output remains asserted for the factory
  programmed delay after the voltage return above its threshold or after the
  manual reset input is released.

  [1] https://www.ti.com/product/TPS3801

properties:
  compatible:
    enum:
      - ti,tps3801

  reset-gpios:
    maxItems: 1
    description: Reference to the GPIO connected to the MR pin.

  "#reset-cells":
    const: 0

required:
  - compatible
  - reset-gpios
  - "#reset-cells"

additionalProperties: false

examples:
  - |
    #include <dt-bindings/gpio/gpio.h>
    reset: reset-controller {
        compatible = "ti,tps3801";
        #reset-cells = <0>;
        reset-gpios = <&gpio3 2 GPIO_ACTIVE_LOW>;
    };
...
```
