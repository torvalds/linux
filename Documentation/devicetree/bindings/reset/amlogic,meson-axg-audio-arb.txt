## Documentation/devicetree/bindings/reset/delta,tn48m-reset.yaml
```yaml
# SPDX-License-Identifier: (GPL-2.0-only OR BSD-2-Clause)
%YAML 1.2
---
$id: http://devicetree.org/schemas/reset/delta,tn48m-reset.yaml#
$schema: http://devicetree.org/meta-schemas/core.yaml#

title: Delta Networks TN48M CPLD reset controller

maintainers:
  - Robert Marko <robert.marko@sartura.hr>

description: |
  This module is part of the Delta TN48M multi-function device. For more
  details see ../mfd/delta,tn48m-cpld.yaml.

  Reset controller modules provides resets for the following:
  * 88F7040 SoC
  * 88F6820 SoC
  * 98DX3265 switch MAC-s
  * 88E1680 PHY-s
  * 88E1512 PHY
  * PoE PSE controller

properties:
  compatible:
    const: delta,tn48m-reset

  "#reset-cells":
    const: 1

required:
  - compatible
  - "#reset-cells"

additionalProperties: false
```

## Documentation/devicetree/bindings/reset/eswin,eic7700-reset.yaml
```yaml
# SPDX-License-Identifier: (GPL-2.0-only OR BSD-2-Clause)
%YAML 1.2
---
$id: http://devicetree.org/schemas/reset/eswin,eic7700-reset.yaml#
$schema: http://devicetree.org/meta-schemas/core.yaml#

title: ESWIN EIC7700 SoC reset controller

maintainers:
  - Yifeng Huang <huangyifeng@eswincomputing.com>
  - Xuyang Dong <dongxuyang@eswincomputing.com>

description:
  The system reset controller can be used to reset various peripheral
  controllers in ESWIN eic7700 SoC.

properties:
  compatible:
    const: eswin,eic7700-reset

  reg:
    maxItems: 1

  '#reset-cells':
    const: 1

required:
  - compatible
  - reg
  - '#reset-cells'

additionalProperties: false

examples:
  - |
    #include <dt-bindings/reset/eswin,eic7700-reset.h>

    reset-controller@51828300 {
        compatible = "eswin,eic7700-reset";
        reg = <0x51828300 0x200>;
        #reset-cells = <1>;
    };
```

## Documentation/devicetree/bindings/reset/fsl,imx-src.txt
```
Freescale i.MX System Reset Controller
======================================

Please also refer to reset.txt in this directory for common reset
controller binding usage.

Required properties:
- compatible: Should be "fsl,<chip>-src"
- reg: should be register base and length as documented in the
  datasheet
- interrupts: Should contain SRC interrupt and CPU WDOG interrupt,
  in this order.
- #reset-cells: 1, see below

example:

src: src@020d8000 {
        compatible = "fsl,imx6q-src";
        reg = <0x020d8000 0x4000>;
        interrupts = <0 91 0x04 0 96 0x04>;
        #reset-cells = <1>;
};

Specifying reset lines connected to IP modules
==============================================

The system reset controller can be used to reset the GPU, VPU,
IPU, and OpenVG IP modules on i.MX5 and i.MX6 ICs. Those device
nodes should specify the reset line on the SRC in their resets
property, containing a phandle to the SRC device node and a
RESET_INDEX specifying which module to reset, as described in
reset.txt

example:

        ipu1: ipu@02400000 {
                resets = <&src 2>;
        };
        ipu2: ipu@02800000 {
                resets = <&src 4>;
        };

The following RESET_INDEX values are valid for i.MX5:
GPU_RESET     0
VPU_RESET     1
IPU1_RESET    2
OPEN_VG_RESET 3
The following additional RESET_INDEX value is valid for i.MX6:
IPU2_RESET    4
```

## Documentation/devicetree/bindings/reset/fsl,imx-src.yaml
```yaml
# SPDX-License-Identifier: (GPL-2.0-only OR BSD-2-Clause)
%YAML 1.2
---
$id: http://devicetree.org/schemas/reset/fsl,imx-src.yaml#
$schema: http://devicetree.org/meta-schemas/core.yaml#

title: Freescale i.MX System Reset Controller

maintainers:
  - Philipp Zabel <p.zabel@pengutronix.de>

description: |
  The system reset controller can be used to reset the GPU, VPU,
  IPU, and OpenVG IP modules on i.MX5 and i.MX6 ICs. Those device
  nodes should specify the reset line on the SRC in their resets
  property, containing a phandle to the SRC device node and a
  RESET_INDEX specifying which module to reset, as described in
  reset.txt

  The following RESET_INDEX values are valid for i.MX5:
    GPU_RESET     0
    VPU_RESET     1
    IPU1_RESET    2
    OPEN_VG_RESET 3
  The following additional RESET_INDEX value is valid for i.MX6:
    IPU2_RESET    4

properties:
  compatible:
    oneOf:
      - const: "fsl,imx51-src"
      - items:
          - const: "fsl,imx50-src"
          - const: "fsl,imx51-src"
      - items:
          - const: "fsl,imx53-src"
          - const: "fsl,imx51-src"
      - items:
          - const: "fsl,imx6q-src"
          - const: "fsl,imx51-src"
      - items:
          - const: "fsl,imx6sx-src"
          - const: "fsl,imx51-src"
      - items:
          - const: "fsl,imx6sl-src"
          - const: "fsl,imx51-src"
      - items:
          - const: "fsl,imx6ul-src"
          - const: "fsl,imx51-src"
      - items:
          - const: "fsl,imx6sll-src"
          - const: "fsl,imx51-src"

  reg:
    maxItems: 1

  interrupts:
    items:
      - description: SRC interrupt
      - description: CPU WDOG interrupts out of SRC
    minItems: 1
    maxItems: 2

  '#reset-cells':
    const: 1

required:
  - compatible
  - reg
  - interrupts
  - '#reset-cells'

additionalProperties: false

examples:
  - |
    reset-controller@73fd0000 {
        compatible = "fsl,imx51-src";
        reg = <0x73fd0000 0x4000>;
        interrupts = <75>;
        #reset-cells = <1>;
    };
```

## Documentation/devicetree/bindings/reset/fsl,imx7-src.txt
```
Freescale i.MX7 System Reset Controller
======================================

Please also refer to reset.txt in this directory for common reset
controller binding usage.

Required properties:
- compatible:
	- For i.MX7 SoCs should be "fsl,imx7d-src", "syscon"
	- For i.MX8MQ SoCs should be "fsl,imx8mq-src", "syscon"
	- For i.MX8MM SoCs should be "fsl,imx8mm-src", "fsl,imx8mq-src", "syscon"
- reg: should be register base and length as documented in the
  datasheet
- interrupts: Should contain SRC interrupt
- #reset-cells: 1, see below

example:

src: reset-controller@30390000 {
     compatible = "fsl,imx7d-src", "syscon";
     reg = <0x30390000 0x2000>;
     interrupts = <GIC_SPI 89 IRQ_TYPE_LEVEL_HIGH>;
     #reset-cells = <1>;
};


Specifying reset lines connected to IP modules
==============================================

The system reset controller can be used to reset various set of
peripherals. Device nodes that need access to reset lines should
specify them as a reset phandle in their corresponding node as
specified in reset.txt.

Example:

	pcie: pcie@33800000 {

		...

		resets = <&src IMX7_RESET_PCIEPHY>,
			 <&src IMX7_RESET_PCIE_CTRL_APPS_EN>;
		reset-names = "pciephy", "apps";

		...
        };


For list of all valid reset indices see
<dt-bindings/reset/imx7-reset.h> for i.MX7,
<dt-bindings/reset/imx8mq-reset.h> for i.MX8MQ and
<dt-bindings/reset/imx8mq-reset.h> for i.MX8MM
```

## Documentation/devicetree/bindings/reset/fsl,imx7-src.yaml
```yaml
# SPDX-License-Identifier: (GPL-2.0-only OR BSD-2-Clause)
%YAML 1.2
---
$id: http://devicetree.org/schemas/reset/fsl,imx7-src.yaml#
$schema: http://devicetree.org/meta-schemas/core.yaml#

title: Freescale i.MX7 System Reset Controller

maintainers:
  - Andrey Smirnov <andrew.smirnov@gmail.com>

description: |
  The system reset controller can be used to reset various set of
  peripherals. Device nodes that need access to reset lines should
  specify them as a reset phandle in their corresponding node as
  specified in reset.txt.

  For list of all valid reset indices see
    <dt-bindings/reset/imx7-reset.h> for i.MX7,
    <dt-bindings/reset/imx8mq-reset.h> for i.MX8MQ, i.MX8MM and i.MX8MN,
    <dt-bindings/reset/imx8mp-reset.h> for i.MX8MP.

properties:
  compatible:
    oneOf:
      - items:
          - enum:
              - fsl,imx7d-src
              - fsl,imx8mq-src
              - fsl,imx8mp-src
          - const: syscon
      - items:
          - enum:
              - fsl,imx8mm-src
              - fsl,imx8mn-src
          - const: fsl,imx8mq-src
          - const: syscon

  reg:
    maxItems: 1

  interrupts:
    maxItems: 1

  '#reset-cells':
    const: 1

required:
  - compatible
  - reg
  - interrupts
  - '#reset-cells'

additionalProperties: false

examples:
  - |
    #include <dt-bindings/interrupt-controller/arm-gic.h>

    reset-controller@30390000 {
        compatible = "fsl,imx7d-src", "syscon";
        reg = <0x30390000 0x2000>;
        interrupts = <GIC_SPI 89 IRQ_TYPE_LEVEL_HIGH>;
        #reset-cells = <1>;
    };
```

## Documentation/devicetree/bindings/reset/gpio-reset.txt
```
GPIO reset controller
=====================

A GPIO reset controller controls a single GPIO that is connected to the reset
pin of a peripheral IC. Please also refer to reset.txt in this directory for
common reset controller binding usage.

Required properties:
- compatible: Should be "gpio-reset"
- reset-gpios: A gpio used as reset line. The gpio specifier for this property
               depends on the gpio controller that provides the gpio.
- #reset-cells: 0, see below

Optional properties:
- reset-delay-us: delay in microseconds. The gpio reset line will be asserted for
                  this duration to reset.
- initially-in-reset: boolean. If not set, the initial state should be a
                      deasserted reset line. If this property exists, the
                      reset line should be kept in reset.

example:

sii902x_reset: gpio-reset {
	compatible = "gpio-reset";
	reset-gpios = <&gpio5 0 GPIO_ACTIVE_LOW>;
	reset-delay-us = <10000>;
	initially-in-reset;
	#reset-cells = <0>;
};

/* Device with nRESET pin connected to GPIO5_0 */
sii902x@39 {
	/* ... */
	resets = <&sii902x_reset>; /* active-low GPIO5_0, 10 ms delay */
};
```

## Documentation/devicetree/bindings/reset/hisilicon,hi3660-reset.txt
```
Hisilicon System Reset Controller
======================================

Please also refer to reset.txt in this directory for common reset
controller binding usage.

The reset controller registers are part of the system-ctl block on
hi3660 SoC.

Required properties:
- compatible: should be
		 "hisilicon,hi3660-reset"
- hisi,rst-syscon: phandle of the reset's syscon.
- #reset-cells : Specifies the number of cells needed to encode a
  reset source.  The type shall be a <u32> and the value shall be 2.

	 Cell #1 : offset of the reset assert control
	           register from the syscon register base
		   offset + 4: deassert control register
		   offset + 8: status control register
	 Cell #2 : bit position of the reset in the reset control register

Example:
	iomcu: iomcu@ffd7e000 {
		compatible = "hisilicon,hi3660-iomcu", "syscon";
		reg = <0x0 0xffd7e000 0x0 0x1000>;
	};

	iomcu_rst: iomcu_rst_controller {
		compatible = "hisilicon,hi3660-reset";
		hisi,rst-syscon = <&iomcu>;
		#reset-cells = <2>;
	};

Specifying reset lines connected to IP modules
==============================================
example:

        i2c0: i2c@..... {
                ...
		resets = <&iomcu_rst 0x20 3>; /* offset: 0x20; bit: 3 */
                ...
        };
```
