## Documentation/devicetree/bindings/reset/amlogic,meson-axg-audio-arb.txt
```
* Amlogic audio memory arbiter controller

The Amlogic Audio ARB is a simple device which enables or
disables the access of Audio FIFOs to DDR on AXG based SoC.

Required properties:
- compatible: 'amlogic,meson-axg-audio-arb'
- reg: physical base address of the controller and length of memory
       mapped region.
- clocks: phandle to the fifo peripheral clock provided by the audio
	  clock controller.
- #reset-cells: must be 1.

Example on the A113 SoC:

arb: reset-controller@280 {
	compatible = "amlogic,meson-axg-audio-arb";
	reg = <0x0 0x280 0x0 0x4>;
	#reset-cells = <1>;
	clocks = <&clkc_audio AUD_CLKID_DDR_ARB>;
};
```

## Documentation/devicetree/bindings/reset/amlogic,meson-axg-audio-arb.yaml
```yaml
# SPDX-License-Identifier: (GPL-2.0 OR BSD-2-Clause)
# Copyright 2019 BayLibre, SAS
%YAML 1.2
---
$id: http://devicetree.org/schemas/reset/amlogic,meson-axg-audio-arb.yaml#
$schema: http://devicetree.org/meta-schemas/core.yaml#

title: Amlogic audio memory arbiter controller

maintainers:
  - Jerome Brunet <jbrunet@baylibre.com>

description: The Amlogic Audio ARB is a simple device which enables or disables
  the access of Audio FIFOs to DDR on AXG based SoC.

properties:
  compatible:
    enum:
      - amlogic,meson-axg-audio-arb
      - amlogic,meson-sm1-audio-arb

  reg:
    maxItems: 1

  clocks:
    maxItems: 1
    description: |
      phandle to the fifo peripheral clock provided by the audio clock
      controller.

  "#reset-cells":
    const: 1

required:
  - compatible
  - reg
  - clocks
  - "#reset-cells"

additionalProperties: false

examples:
  - |
    // on the A113 SoC:
    #include <dt-bindings/clock/axg-audio-clkc.h>
    bus {
        #address-cells = <2>;
        #size-cells = <2>;

        arb: reset-controller@280 {
            compatible = "amlogic,meson-axg-audio-arb";
            reg = <0x0 0x280 0x0 0x4>;
            #reset-cells = <1>;
            clocks = <&clkc_audio AUD_CLKID_DDR_ARB>;
        };
    };
```

## Documentation/devicetree/bindings/reset/amlogic,meson-reset.txt
```
Amlogic Meson SoC Reset Controller
=======================================

Please also refer to reset.txt in this directory for common reset
controller binding usage.

Required properties:
- compatible: Should be "amlogic,meson8b-reset", "amlogic,meson-gxbb-reset" or
	"amlogic,meson-axg-reset".
- reg: should contain the register address base
- #reset-cells: 1, see below

example:

reset: reset-controller {
	compatible = "amlogic,meson-gxbb-reset";
	reg = <0x0 0x04404 0x0 0x20>;
	#reset-cells = <1>;
};
```

## Documentation/devicetree/bindings/reset/amlogic,meson-reset.yaml
```yaml
# SPDX-License-Identifier: (GPL-2.0 OR BSD-2-Clause)
# Copyright 2019 BayLibre, SAS
%YAML 1.2
---
$id: http://devicetree.org/schemas/reset/amlogic,meson-reset.yaml#
$schema: http://devicetree.org/meta-schemas/core.yaml#

title: Amlogic Meson SoC Reset Controller

maintainers:
  - Neil Armstrong <neil.armstrong@linaro.org>

properties:
  compatible:
    enum:
      - amlogic,meson8b-reset # Reset Controller on Meson8b and compatible SoCs
      - amlogic,meson-gxbb-reset # Reset Controller on GXBB and compatible SoCs
      - amlogic,meson-axg-reset # Reset Controller on AXG and compatible SoCs
      - amlogic,meson-a1-reset # Reset Controller on A1 and compatible SoCs
      - amlogic,meson-s4-reset # Reset Controller on S4 and compatible SoCs
      - amlogic,c3-reset # Reset Controller on C3 and compatible SoCs

  reg:
    maxItems: 1

  "#reset-cells":
    const: 1

required:
  - compatible
  - reg
  - "#reset-cells"

additionalProperties: false

examples:
  - |
    reset-controller@c884404 {
          compatible = "amlogic,meson-gxbb-reset";
          reg = <0xc884404 0x20>;
          #reset-cells = <1>;
    };
```

## Documentation/devicetree/bindings/reset/ath79-reset.txt
```
Binding for Qualcomm Atheros AR7xxx/AR9XXX reset controller

Please also refer to reset.txt in this directory for common reset
controller binding usage.

Required Properties:
- compatible: has to be "qca,<soctype>-reset", "qca,ar7100-reset"
              as fallback
- reg: Base address and size of the controllers memory area
- #reset-cells : Specifies the number of cells needed to encode reset
                 line, should be 1

Example:

	reset-controller@1806001c {
		compatible = "qca,ar9132-reset", "qca,ar7100-reset";
		reg = <0x1806001c 0x4>;

		#reset-cells = <1>;
	};
```

## Documentation/devicetree/bindings/reset/atmel,at91sam9260-reset.yaml
```yaml
# SPDX-License-Identifier: (GPL-2.0-only OR BSD-2-Clause)
%YAML 1.2
---
$id: http://devicetree.org/schemas/reset/atmel,at91sam9260-reset.yaml#
$schema: http://devicetree.org/meta-schemas/core.yaml#

title: Atmel/Microchip System Reset Controller

maintainers:
  - Claudiu Beznea <claudiu.beznea@microchip.com>

description: |
  The system reset controller can be used to reset the CPU. In case of
  SAMA7G5 it can also reset some devices (e.g. USB PHYs).

properties:
  compatible:
    oneOf:
      - items:
          - enum:
              - atmel,at91sam9260-rstc
              - atmel,at91sam9g45-rstc
              - atmel,sama5d3-rstc
              - microchip,sam9x60-rstc
              - microchip,sama7g5-rstc
      - items:
          - const: atmel,sama5d3-rstc
          - const: atmel,at91sam9g45-rstc
      - items:
          - enum:
              - microchip,sam9x7-rstc
          - const: microchip,sam9x60-rstc

  reg:
    minItems: 1
    items:
      - description: base registers for system reset control
      - description: registers for device specific reset control

  clocks:
    maxItems: 1

  "#reset-cells":
    const: 1

required:
  - compatible
  - reg
  - clocks

allOf:
  - if:
      properties:
        compatible:
          contains:
            enum:
              - microchip,sama7g5-rstc
    then:
      required:
        - "#reset-cells"

additionalProperties: false

examples:
  - |
    #include <dt-bindings/clock/at91.h>

    reset-controller@fffffd00 {
        compatible = "atmel,at91sam9260-rstc";
        reg = <0xfffffd00 0x10>;
        clocks = <&pmc PMC_TYPE_CORE PMC_SLOW>;
    };
```

## Documentation/devicetree/bindings/reset/berlin,reset.txt
```
Marvell Berlin reset controller
===============================

Please also refer to reset.txt in this directory for common reset
controller binding usage.

The reset controller yesde must be a sub-yesde of the chip controller
yesde on Berlin SoCs.

Required properties:
- compatible: should be "marvell,berlin2-reset"
- #reset-cells: must be set to 2

Example:

chip_rst: reset {
	compatible = "marvell,berlin2-reset";
	#reset-cells = <2>;
};

&usb_phy0 {
	resets = <&chip_rst 0x104 12>;
};
```

## Documentation/devicetree/bindings/reset/bitmain,bm1880-reset.txt
```
Bitmain BM1880 SoC Reset Controller
===================================

Please also refer to reset.txt in this directory for common reset
controller binding usage.

Required properties:
- compatible:   Should be "bitmain,bm1880-reset"
- reg:          Offset and length of reset controller space in SCTRL.
- #reset-cells: Must be 1.

Example:

        rst: reset-controller@c00 {
                compatible = "bitmain,bm1880-reset";
                reg = <0xc00 0x8>;
                #reset-cells = <1>;
        };
```

## Documentation/devicetree/bindings/reset/bitmain,bm1880-reset.yaml
```yaml
# SPDX-License-Identifier: (GPL-2.0 OR BSD-2-Clause)
# Copyright 2019 Manivannan Sadhasivam <mani@kernel.org>
%YAML 1.2
---
$id: http://devicetree.org/schemas/reset/bitmain,bm1880-reset.yaml#
$schema: http://devicetree.org/meta-schemas/core.yaml#

title: Bitmain BM1880 SoC Reset Controller

maintainers:
  - Manivannan Sadhasivam <mani@kernel.org>

properties:
  compatible:
    const: bitmain,bm1880-reset

  reg:
    maxItems: 1

  "#reset-cells":
    const: 1

required:
  - compatible
  - reg
  - "#reset-cells"

additionalProperties: false

examples:
  - |
    rst: reset-controller@c00 {
        compatible = "bitmain,bm1880-reset";
        reg = <0xc00 0x8>;
        #reset-cells = <1>;
    };
```

## Documentation/devicetree/bindings/reset/brcm,bcm4908-misc-pcie-reset.yaml
```yaml
# SPDX-License-Identifier: GPL-2.0-only OR BSD-2-Clause
%YAML 1.2
---
$id: http://devicetree.org/schemas/reset/brcm,bcm4908-misc-pcie-reset.yaml#
$schema: http://devicetree.org/meta-schemas/core.yaml#

title: Broadcom MISC block PCIe reset controller

description: This document describes reset controller handling PCIe PERST#
  signals. On BCM4908 it's a part of the MISC block.

maintainers:
  - Rafał Miłecki <rafal@milecki.pl>

properties:
  compatible:
    const: brcm,bcm4908-misc-pcie-reset

  reg:
    maxItems: 1

  "#reset-cells":
    description: PCIe core id
    const: 1

required:
  - compatible
  - reg
  - "#reset-cells"

additionalProperties: false

examples:
  - |
    reset-controller@ff802644 {
        compatible = "brcm,bcm4908-misc-pcie-reset";
        reg = <0xff802644 0x04>;
        #reset-cells = <1>;
    };
```

## Documentation/devicetree/bindings/reset/brcm,bcm63138-pmb.txt
```
Broadcom BCM63138 Processor Monitor Bus binding
===============================================

Please also refer to reset.txt in this directory for common reset
controller binding usage.

Require properties:

- compatible: must be "brcm,bcm63138-pmb"
- reg: base register address and size for this bus controller
- #reset-cells: must be 2 first cell is the address within the bus instance designated
  by the phandle, and the second is the number of zones for this peripheral

Example:
	pmb0: reset-controller@4800c0 {
		compatible = "brcm,bcm63138-pmb";
		reg = <0x4800c0 0x10>;
		#reset-cells = <2>;
	};
```

## Documentation/devicetree/bindings/reset/brcm,bcm6345-reset.yaml
```yaml
# SPDX-License-Identifier: (GPL-2.0-only OR BSD-2-Clause)
%YAML 1.2
---
$id: http://devicetree.org/schemas/reset/brcm,bcm6345-reset.yaml#
$schema: http://devicetree.org/meta-schemas/core.yaml#

title: BCM6345 reset controller

description: This document describes the BCM6345 reset controller.

maintainers:
  - Álvaro Fernández Rojas <noltari@gmail.com>

properties:
  compatible:
    enum:
      - brcm,bcm6345-reset
      - brcm,bcm63xx-ephy-ctrl

  reg:
    maxItems: 1

  "#reset-cells":
    const: 1

required:
  - compatible
  - reg
  - "#reset-cells"

additionalProperties: false

examples:
  - |
    reset-controller@10000010 {
      compatible = "brcm,bcm6345-reset";
      reg = <0x10000010 0x4>;
      #reset-cells = <1>;
    };
```

## Documentation/devicetree/bindings/reset/brcm,bcm7216-pcie-sata-rescal.yaml
```yaml
# SPDX-License-Identifier: (GPL-2.0 OR BSD-2-Clause)
# Copyright 2020 Broadcom
%YAML 1.2
---
$id: "http://devicetree.org/schemas/reset/brcm,bcm7216-pcie-sata-rescal.yaml#"
$schema: "http://devicetree.org/meta-schemas/core.yaml#"

title: BCM7216 RESCAL reset controller

description: This document describes the BCM7216 RESCAL reset controller which is responsible for controlling the reset of the SATA and PCIe0/1 instances on BCM7216.

maintainers:
  - Florian Fainelli <f.fainelli@gmail.com>
  - Jim Quinlan <jim2101024@gmail.com>

properties:
  compatible:
    const: brcm,bcm7216-pcie-sata-rescal

  reg:
    maxItems: 1

  "#reset-cells":
    const: 0

required:
  - compatible
  - reg
  - "#reset-cells"

examples:
  - |
    reset-controller@8b2c800 {
          compatible = "brcm,bcm7216-pcie-sata-rescal";
          reg = <0x8b2c800 0x10>;
          #reset-cells = <0>;
    };
```

## Documentation/devicetree/bindings/reset/brcm,brcmstb-reset.txt
```
Broadcom STB SW_INIT-style reset controller
===========================================

Broadcom STB SoCs have a SW_INIT-style reset controller with separate
SET/CLEAR/STATUS registers and possibly multiple banks, each of 32 bit
reset lines.

Please also refer to reset.txt in this directory for common reset
controller binding usage.

Required properties:
- compatible: should be brcm,brcmstb-reset
- reg: register base and length
- #reset-cells: must be set to 1

Example:

	reset: reset-controller@8404318 {
		compatible = "brcm,brcmstb-reset";
		reg = <0x8404318 0x30>;
		#reset-cells = <1>;
	};

	&ethernet_switch {
		resets = <&reset 26>;
		reset-names = "switch";
	};
```

## Documentation/devicetree/bindings/reset/brcm,brcmstb-reset.yaml
```yaml
# SPDX-License-Identifier: (GPL-2.0 OR BSD-2-Clause)
%YAML 1.2
---
$id: "http://devicetree.org/schemas/reset/brcm,brcmstb-reset.yaml#"
$schema: "http://devicetree.org/meta-schemas/core.yaml#"

title: Broadcom STB SW_INIT-style reset controller

description:
  Broadcom STB SoCs have a SW_INIT-style reset controller with separate
  SET/CLEAR/STATUS registers and possibly multiple banks, each of 32 bit
  reset lines.

  Please also refer to reset.txt in this directory for common reset
  controller binding usage.

maintainers:
  - Florian Fainelli <f.fainelli@gmail.com>

properties:
  compatible:
    const: brcm,brcmstb-reset

  reg:
    maxItems: 1

  "#reset-cells":
    const: 1

required:
  - compatible
  - reg
  - "#reset-cells"

additionalProperties: false

examples:
  - |
    reset: reset-controller@8404318 {
      compatible = "brcm,brcmstb-reset";
      reg = <0x8404318 0x30>;
      #reset-cells = <1>;
    };

    ethernet_switch {
      resets = <&reset 26>;
      reset-names = "switch";
    };
```

## Documentation/devicetree/bindings/reset/canaan,k210-rst.yaml
```yaml
# SPDX-License-Identifier: (GPL-2.0-only OR BSD-2-Clause)
%YAML 1.2
---
$id: http://devicetree.org/schemas/reset/canaan,k210-rst.yaml#
$schema: http://devicetree.org/meta-schemas/core.yaml#

title: Canaan Kendryte K210 Reset Controller

maintainers:
  - Damien Le Moal <dlemoal@kernel.org>

description: |
  Canaan Kendryte K210 reset controller driver which supports the SoC
  system controller supplied reset registers for the various peripherals
  of the SoC. The K210 reset controller node must be defined as a child
  node of the K210 system controller node.

  See also:
  - dt-bindings/reset/k210-rst.h

properties:
  compatible:
    const: canaan,k210-rst

  '#reset-cells':
    const: 1

required:
  - '#reset-cells'
  - compatible

additionalProperties: false

examples:
  - |
    #include <dt-bindings/reset/k210-rst.h>
    sysrst: reset-controller {
      compatible = "canaan,k210-rst";
      #reset-cells = <1>;
    };
```

## Documentation/devicetree/bindings/reset/canaan,k230-rst.yaml
```yaml
# SPDX-License-Identifier: (GPL-2.0-only OR BSD-2-Clause)
%YAML 1.2
---
$id: http://devicetree.org/schemas/reset/canaan,k230-rst.yaml#
$schema: http://devicetree.org/meta-schemas/core.yaml#

title: Canaan Kendryte K230 Reset Controller

maintainers:
  - Junhui Liu <junhui.liu@pigmoral.tech>

description:
  The Canaan Kendryte K230 reset controller is part of the SoC's system
  controller and controls the reset registers for CPUs and various peripherals.

properties:
  compatible:
    const: canaan,k230-rst

  reg:
    maxItems: 1

  '#reset-cells':
    const: 1

required:
  - compatible
  - reg
  - '#reset-cells'

additionalProperties: false

examples:
  - |
    reset-controller@91101000 {
      compatible = "canaan,k230-rst";
      reg = <0x91101000 0x1000>;
      #reset-cells = <1>;
    };
```
