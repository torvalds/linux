## Documentation/devicetree/bindings/reset/nuvoton,npcm750-reset.yaml
```yaml
# SPDX-License-Identifier: (GPL-2.0-only OR BSD-2-Clause)
%YAML 1.2
---
$id: http://devicetree.org/schemas/reset/nuvoton,npcm750-reset.yaml#
$schema: http://devicetree.org/meta-schemas/core.yaml#

title: Nuvoton NPCM Reset controller

maintainers:
  - Tomer Maimon <tmaimon77@gmail.com>

properties:
  compatible:
    enum:
      - nuvoton,npcm750-reset        # Poleg NPCM7XX SoC
      - nuvoton,npcm845-reset        # Arbel NPCM8XX SoC

  reg:
    maxItems: 1

  '#reset-cells':
    const: 2

  '#clock-cells':
    const: 1

  clocks:
    items:
      - description: specify external 25MHz reference clock.

  nuvoton,sysgcr:
    $ref: /schemas/types.yaml#/definitions/phandle
    description: a phandle to access GCR registers.

  nuvoton,sw-reset-number:
    $ref: /schemas/types.yaml#/definitions/uint32
    minimum: 1
    maximum: 4
    description: |
      Contains the software reset number to restart the SoC.
      If not specified, software reset is disabled.

required:
  - compatible
  - reg
  - '#reset-cells'
  - nuvoton,sysgcr

if:
  properties:
    compatible:
      contains:
        enum:
          - nuvoton,npcm845-reset
then:
  required:
    - '#clock-cells'
    - clocks

additionalProperties: false

examples:
  - |
    #include <dt-bindings/reset/nuvoton,npcm7xx-reset.h>
    rstc: rstc@f0801000 {
        compatible = "nuvoton,npcm750-reset";
        reg = <0xf0801000 0x70>;
        #reset-cells = <2>;
        nuvoton,sysgcr = <&gcr>;
        nuvoton,sw-reset-number = <2>;
    };

    // Specifying reset lines connected to IP NPCM7XX modules
    spi0: spi {
        resets = <&rstc NPCM7XX_RESET_IPSRST2 NPCM7XX_RESET_PSPI1>;
    };
```

## Documentation/devicetree/bindings/reset/nxp,lpc1850-rgu.txt
```
NXP LPC1850  Reset Generation Unit (RGU)
========================================

Please also refer to reset.txt in this directory for common reset
controller binding usage.

Required properties:
- compatible: Should be "nxp,lpc1850-rgu"
- reg: register base and length
- clocks: phandle and clock specifier to RGU clocks
- clock-names: should contain "delay" and "reg"
- #reset-cells: should be 1

See table below for valid peripheral reset numbers. Numbers not
in the table below are either reserved or not applicable for
normal operation.

Reset	Peripheral
  9	System control unit (SCU)
 12	ARM Cortex-M0 subsystem core (LPC43xx only)
 13	CPU core
 16	LCD controller
 17	USB0
 18	USB1
 19	DMA
 20	SDIO
 21	External memory controller (EMC)
 22	Ethernet
 25	Flash bank A
 27	EEPROM
 28	GPIO
 29	Flash bank B
 32	Timer0
 33	Timer1
 34	Timer2
 35	Timer3
 36	Repetitive Interrupt timer (RIT)
 37	State Configurable Timer (SCT)
 38	Motor control PWM (MCPWM)
 39	QEI
 40	ADC0
 41	ADC1
 42	DAC
 44	USART0
 45	UART1
 46	USART2
 47	USART3
 48	I2C0
 49	I2C1
 50	SSP0
 51	SSP1
 52	I2S0 and I2S1
 53	Serial Flash Interface (SPIFI)
 54	C_CAN1
 55	C_CAN0
 56	ARM Cortex-M0 application core (LPC4370 only)
 57	SGPIO (LPC43xx only)
 58	SPI (LPC43xx only)
 60	ADCHS (12-bit ADC) (LPC4370 only)

Refer to NXP LPC18xx or LPC43xx user manual for more details about
the reset signals and the connected block/peripheral.

Reset provider example:
rgu: reset-controller@40053000 {
	compatible = "nxp,lpc1850-rgu";
	reg = <0x40053000 0x1000>;
	clocks = <&cgu BASE_SAFE_CLK>, <&ccu1 CLK_CPU_BUS>;
	clock-names = "delay", "reg";
	#reset-cells = <1>;
};

Reset consumer example:
mac: ethernet@40010000 {
	compatible = "nxp,lpc1850-dwmac", "snps,dwmac-3.611", "snps,dwmac";
	reg = <0x40010000 0x2000>;
	interrupts = <5>;
	interrupt-names = "macirq";
	clocks = <&ccu1 CLK_CPU_ETHERNET>;
	clock-names = "stmmaceth";
	resets = <&rgu 22>;
	reset-names = "stmmaceth";
};
```

## Documentation/devicetree/bindings/reset/nxp,lpc1850-rgu.yaml
```yaml
# SPDX-License-Identifier: (GPL-2.0-only OR BSD-2-Clause)
%YAML 1.2
---
$id: http://devicetree.org/schemas/reset/nxp,lpc1850-rgu.yaml#
$schema: http://devicetree.org/meta-schemas/core.yaml#

title: NXP LPC1850  Reset Generation Unit (RGU)

maintainers:
  - Frank Li <Frank.Li@nxp.com>

properties:
  compatible:
    const: nxp,lpc1850-rgu

  reg:
    maxItems: 1

  clocks:
    maxItems: 2

  clock-names:
    items:
      - const: delay
      - const: reg

  '#reset-cells':
    const: 1
    description: |
      See table below for valid peripheral reset numbers. Numbers not
      in the table below are either reserved or not applicable for
      normal operation.

      Reset	Peripheral
        9	System control unit (SCU)
       12	ARM Cortex-M0 subsystem core (LPC43xx only)
       13	CPU core
       16	LCD controller
       17	USB0
       18	USB1
       19	DMA
       20	SDIO
       21	External memory controller (EMC)
       22	Ethernet
       25	Flash bank A
       27	EEPROM
       28	GPIO
       29	Flash bank B
       32	Timer0
       33	Timer1
       34	Timer2
       35	Timer3
       36	Repetitive Interrupt timer (RIT)
       37	State Configurable Timer (SCT)
       38	Motor control PWM (MCPWM)
       39	QEI
       40	ADC0
       41	ADC1
       42	DAC
       44	USART0
       45	UART1
       46	USART2
       47	USART3
       48	I2C0
       49	I2C1
       50	SSP0
       51	SSP1
       52	I2S0 and I2S1
       53	Serial Flash Interface (SPIFI)
       54	C_CAN1
       55	C_CAN0
       56	ARM Cortex-M0 application core (LPC4370 only)
       57	SGPIO (LPC43xx only)
       58	SPI (LPC43xx only)
       60	ADCHS (12-bit ADC) (LPC4370 only)

      Refer to NXP LPC18xx or LPC43xx user manual for more details about
      the reset signals and the connected block/peripheral.

required:
  - compatible
  - reg
  - clocks
  - clock-names
  - '#reset-cells'

additionalProperties: false

examples:
  - |
    #include <dt-bindings/clock/lpc18xx-ccu.h>
    #include <dt-bindings/clock/lpc18xx-cgu.h>

    reset-controller@40053000 {
        compatible = "nxp,lpc1850-rgu";
        reg = <0x40053000 0x1000>;
        clocks = <&cgu BASE_SAFE_CLK>, <&ccu1 CLK_CPU_BUS>;
        clock-names = "delay", "reg";
        #reset-cells = <1>;
    };
```

## Documentation/devicetree/bindings/reset/oxnas,reset.txt
```
Oxford Semiconductor OXNAS SoC Family RESET Controller
================================================

Please also refer to reset.txt in this directory for common reset
controller binding usage.

Required properties:
- compatible: For OX810SE, should be "oxsemi,ox810se-reset"
	      For OX820, should be "oxsemi,ox820-reset"
- #reset-cells: 1, see below

Parent node should have the following properties :
- compatible: For OX810SE, should be :
			"oxsemi,ox810se-sys-ctrl", "syscon", "simple-mfd"
	      For OX820, should be :
			"oxsemi,ox820-sys-ctrl", "syscon", "simple-mfd"

Reset indices are in dt-bindings include files :
- For OX810SE: include/dt-bindings/reset/oxsemi,ox810se.h
- For OX820: include/dt-bindings/reset/oxsemi,ox820.h

example:

sys: sys-ctrl@000000 {
	compatible = "oxsemi,ox810se-sys-ctrl", "syscon", "simple-mfd";
	reg = <0x000000 0x100000>;

	reset: reset-controller {
		compatible = "oxsemi,ox810se-reset";
		#reset-cells = <1>;
	};
};
```

## Documentation/devicetree/bindings/reset/qca,ar7100-reset.yaml
```yaml
# SPDX-License-Identifier: (GPL-2.0 OR BSD-2-Clause)
# Copyright 2015 Alban Bedel <albeu@free.fr>
%YAML 1.2
---
$id: http://devicetree.org/schemas/reset/qca,ar7100-reset.yaml#
$schema: http://devicetree.org/meta-schemas/core.yaml#

title: Qualcomm Atheros AR7xxx/AR9XXX reset controller

maintainers:
  - Alban Bedel <albeu@free.fr>

properties:
  compatible:
    items:
      - enum:
          - qca,ar9132-reset
          - qca,ar9331-reset
      - const: qca,ar7100-reset

  reg:
    maxItems: 1

  "#reset-cells":
    const: 1

required:
  - compatible
  - reg
  - "#reset-cells"

additionalProperties: false

examples:
  - |
    reset-controller@1806001c {
          compatible = "qca,ar9132-reset", "qca,ar7100-reset";
          reg = <0x1806001c 0x4>;
          #reset-cells = <1>;
    };
```

## Documentation/devicetree/bindings/reset/qcom,aoss-reset.txt
```
Qualcomm AOSS Reset Controller
======================================

This binding describes a reset-controller found on AOSS-CC (always on subsystem)
for Qualcomm SDM845 SoCs.

Required properties:
- compatible:
	Usage: required
	Value type: <string>
	Definition: must be:
		    "qcom,sdm845-aoss-cc"

- reg:
	Usage: required
	Value type: <prop-encoded-array>
	Definition: must specify the base address and size of the register
	            space.

- #reset-cells:
	Usage: required
	Value type: <uint>
	Definition: must be 1; cell entry represents the reset index.

Example:

aoss_reset: reset-controller@c2a0000 {
	compatible = "qcom,sdm845-aoss-cc";
	reg = <0xc2a0000 0x31000>;
	#reset-cells = <1>;
};

Specifying reset lines connected to IP modules
==============================================

Device nodes that need access to reset lines should
specify them as a reset phandle in their corresponding node as
specified in reset.txt.

For list of all valid reset indicies see
<dt-bindings/reset/qcom,sdm845-aoss.h>

Example:

modem-pil@4080000 {
	...

	resets = <&aoss_reset AOSS_CC_MSS_RESTART>;
	reset-names = "mss_restart";

	...
};
```

## Documentation/devicetree/bindings/reset/qcom,aoss-reset.yaml
```yaml
# SPDX-License-Identifier: (GPL-2.0-only OR BSD-2-Clause)
%YAML 1.2
---
$id: http://devicetree.org/schemas/reset/qcom,aoss-reset.yaml#
$schema: http://devicetree.org/meta-schemas/core.yaml#

title: Qualcomm AOSS Reset Controller

maintainers:
  - Sibi Sankar <sibis@codeaurora.org>

description:
  The bindings describe the reset-controller found on AOSS-CC (always on
  subsystem) for Qualcomm Technologies Inc SoCs.

properties:
  compatible:
    oneOf:
      - description: on SC7180 SoCs the following compatibles must be specified
        items:
          - const: "qcom,sc7180-aoss-cc"
          - const: "qcom,sdm845-aoss-cc"

      - description: on SDM845 SoCs the following compatibles must be specified
        items:
          - const: "qcom,sdm845-aoss-cc"

  reg:
    maxItems: 1

  '#reset-cells':
    const: 1

required:
  - compatible
  - reg
  - '#reset-cells'

additionalProperties: false

examples:
  - |
    aoss_reset: reset-controller@c2a0000 {
      compatible = "qcom,sdm845-aoss-cc";
      reg = <0xc2a0000 0x31000>;
      #reset-cells = <1>;
    };
```

## Documentation/devicetree/bindings/reset/qcom,pdc-global.txt
```
PDC Global
======================================

This binding describes a reset-controller found on PDC-Global (Power Domain
Controller) block for Qualcomm Technologies Inc SDM845 SoCs.

Required properties:
- compatible:
	Usage: required
	Value type: <string>
	Definition: must be:
		    "qcom,sdm845-pdc-global"

- reg:
	Usage: required
	Value type: <prop-encoded-array>
	Definition: must specify the base address and size of the register
	            space.

- #reset-cells:
	Usage: required
	Value type: <uint>
	Definition: must be 1; cell entry represents the reset index.

Example:

pdc_reset: reset-controller@b2e0000 {
	compatible = "qcom,sdm845-pdc-global";
	reg = <0xb2e0000 0x20000>;
	#reset-cells = <1>;
};

PDC reset clients
======================================

Device nodes that need access to reset lines should
specify them as a reset phandle in their corresponding node as
specified in reset.txt.

For a list of all valid reset indices see
<dt-bindings/reset/qcom,sdm845-pdc.h>

Example:

modem-pil@4080000 {
	...

	resets = <&pdc_reset PDC_MODEM_SYNC_RESET>;
	reset-names = "pdc_reset";

	...
};
```

## Documentation/devicetree/bindings/reset/qcom,pdc-global.yaml
```yaml
# SPDX-License-Identifier: (GPL-2.0-only OR BSD-2-Clause)
%YAML 1.2
---
$id: http://devicetree.org/schemas/reset/qcom,pdc-global.yaml#
$schema: http://devicetree.org/meta-schemas/core.yaml#

title: Qualcomm PDC Global

maintainers:
  - Sibi Sankar <sibis@codeaurora.org>

description:
  The bindings describes the reset-controller found on PDC-Global (Power Domain
  Controller) block for Qualcomm Technologies Inc SoCs.

properties:
  compatible:
    oneOf:
      - description: on SC7180 SoCs the following compatibles must be specified
        items:
          - const: "qcom,sc7180-pdc-global"
          - const: "qcom,sdm845-pdc-global"

      - description: on SC7280 SoCs the following compatibles must be specified
        items:
          - const: "qcom,sc7280-pdc-global"

      - description: on SDM845 SoCs the following compatibles must be specified
        items:
          - const: "qcom,sdm845-pdc-global"

  reg:
    maxItems: 1

  '#reset-cells':
    const: 1

required:
  - compatible
  - reg
  - '#reset-cells'

additionalProperties: false

examples:
  - |
    pdc_reset: reset-controller@b2e0000 {
      compatible = "qcom,sdm845-pdc-global";
      reg = <0xb2e0000 0x20000>;
      #reset-cells = <1>;
    };
```

## Documentation/devicetree/bindings/reset/renesas,rst.txt
```
DT bindings for the Renesas R-Car and RZ/G Reset Controllers

The R-Car and RZ/G Reset Controllers provide reset control, and implement the
following functions:
  - Latching of the levels on mode pins when PRESET# is negated,
  - Mode monitoring register,
  - Reset control of peripheral devices (on R-Car Gen1),
  - Watchdog timer (on R-Car Gen1),
  - Register-based reset control and boot address registers for the various CPU
    cores (on R-Car Gen2 and Gen3, and on RZ/G).


Required properties:
  - compatible: Should be
		  - "renesas,<soctype>-reset-wdt" for R-Car Gen1,
		  - "renesas,<soctype>-rst" for R-Car Gen2 and Gen3, and RZ/G
		Examples with soctypes are:
		  - "renesas,r8a7743-rst" (RZ/G1M)
		  - "renesas,r8a7745-rst" (RZ/G1E)
		  - "renesas,r8a7778-reset-wdt" (R-Car M1A)
		  - "renesas,r8a7779-reset-wdt" (R-Car H1)
		  - "renesas,r8a7790-rst" (R-Car H2)
		  - "renesas,r8a7791-rst" (R-Car M2-W)
		  - "renesas,r8a7792-rst" (R-Car V2H
		  - "renesas,r8a7793-rst" (R-Car M2-N)
		  - "renesas,r8a7794-rst" (R-Car E2)
		  - "renesas,r8a7795-rst" (R-Car H3)
		  - "renesas,r8a7796-rst" (R-Car M3-W)
		  - "renesas,r8a77970-rst" (R-Car V3M)
		  - "renesas,r8a77980-rst" (R-Car V3H)
		  - "renesas,r8a77995-rst" (R-Car D3)
  - reg: Address start and address range for the device.


Example:

	rst: reset-controller@e6160000 {
		compatible = "renesas,r8a7795-rst";
		reg = <0 0xe6160000 0 0x0200>;
	};
```
