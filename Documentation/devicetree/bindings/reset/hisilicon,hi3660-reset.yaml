## Documentation/devicetree/bindings/reset/renesas,rst.yaml
```yaml
# SPDX-License-Identifier: (GPL-2.0-only OR BSD-2-Clause)
%YAML 1.2
---
$id: http://devicetree.org/schemas/reset/renesas,rst.yaml#
$schema: http://devicetree.org/meta-schemas/core.yaml#

title: Renesas R-Car and RZ/G Reset Controller

maintainers:
  - Geert Uytterhoeven <geert+renesas@glider.be>
  - Magnus Damm <magnus.damm@gmail.com>

description: |
  The R-Car and RZ/G Reset Controllers provide reset control, and implement the
  following functions:
    - Latching of the levels on mode pins when PRESET# is negated,
    - Mode monitoring register,
    - Reset control of peripheral devices (on R-Car Gen1),
    - Watchdog timer (on R-Car Gen1),
    - Register-based reset control and boot address registers for the various
      CPU cores (on R-Car Gen2 and Gen3, and on RZ/G).

properties:
  compatible:
    enum:
      - renesas,r8a7742-rst       # RZ/G1H
      - renesas,r8a7743-rst       # RZ/G1M
      - renesas,r8a7744-rst       # RZ/G1N
      - renesas,r8a7745-rst       # RZ/G1E
      - renesas,r8a77470-rst      # RZ/G1C
      - renesas,r8a774a1-rst      # RZ/G2M
      - renesas,r8a774b1-rst      # RZ/G2N
      - renesas,r8a774c0-rst      # RZ/G2E
      - renesas,r8a774e1-rst      # RZ/G2H
      - renesas,r8a7778-reset-wdt # R-Car M1A
      - renesas,r8a7779-reset-wdt # R-Car H1
      - renesas,r8a7790-rst       # R-Car H2
      - renesas,r8a7791-rst       # R-Car M2-W
      - renesas,r8a7792-rst       # R-Car V2H
      - renesas,r8a7793-rst       # R-Car M2-N
      - renesas,r8a7794-rst       # R-Car E2
      - renesas,r8a7795-rst       # R-Car H3
      - renesas,r8a7796-rst       # R-Car M3-W
      - renesas,r8a77961-rst      # R-Car M3-W+
      - renesas,r8a77965-rst      # R-Car M3-N
      - renesas,r8a77970-rst      # R-Car V3M
      - renesas,r8a77980-rst      # R-Car V3H
      - renesas,r8a77990-rst      # R-Car E3
      - renesas,r8a77995-rst      # R-Car D3
      - renesas,r8a779a0-rst      # R-Car V3U
      - renesas,r8a779f0-rst      # R-Car S4-8
      - renesas,r8a779g0-rst      # R-Car V4H
      - renesas,r8a779h0-rst      # R-Car V4M

  reg:
    maxItems: 1

required:
  - compatible
  - reg

additionalProperties: false

examples:
  - |
    rst: reset-controller@e6160000 {
            compatible = "renesas,r8a7795-rst";
            reg = <0xe6160000 0x0200>;
    };
```

## Documentation/devicetree/bindings/reset/renesas,rzg2l-usbphy-ctrl.yaml
```yaml
# SPDX-License-Identifier: (GPL-2.0-only OR BSD-2-Clause)
%YAML 1.2
---
$id: http://devicetree.org/schemas/reset/renesas,rzg2l-usbphy-ctrl.yaml#
$schema: http://devicetree.org/meta-schemas/core.yaml#

title: Renesas RZ/{G2L,V2L} USBPHY Control

maintainers:
  - Biju Das <biju.das.jz@bp.renesas.com>

description:
  The RZ/G2L USBPHY Control mainly controls reset and power down of the
  USB/PHY.

properties:
  compatible:
    items:
      - enum:
          - renesas,r9a07g043-usbphy-ctrl # RZ/G2UL and RZ/Five
          - renesas,r9a07g044-usbphy-ctrl # RZ/G2{L,LC}
          - renesas,r9a07g054-usbphy-ctrl # RZ/V2L
      - const: renesas,rzg2l-usbphy-ctrl

  reg:
    maxItems: 1

  clocks:
    maxItems: 1

  resets:
    maxItems: 1

  power-domains:
    maxItems: 1

  '#reset-cells':
    const: 1
    description: |
      The phandle's argument in the reset specifier is the PHY reset associated
      with the USB port.
      0 = Port 1 Phy reset
      1 = Port 2 Phy reset

  regulator-vbus:
    type: object
    description: USB VBUS regulator
    $ref: /schemas/regulator/regulator.yaml#
    unevaluatedProperties: false

required:
  - compatible
  - reg
  - clocks
  - resets
  - power-domains
  - '#reset-cells'
  - regulator-vbus

additionalProperties: false

examples:
  - |
    #include <dt-bindings/clock/r9a07g044-cpg.h>

    phyrst: usbphy-ctrl@11c40000 {
        compatible = "renesas,r9a07g044-usbphy-ctrl",
                     "renesas,rzg2l-usbphy-ctrl";
        reg = <0x11c40000 0x10000>;
        clocks = <&cpg CPG_MOD R9A07G044_USB_PCLK>;
        resets = <&cpg R9A07G044_USB_PRESETN>;
        power-domains = <&cpg>;
        #reset-cells = <1>;
        regulator-vbus {
            regulator-name = "vbus";
        };
    };
```

## Documentation/devicetree/bindings/reset/renesas,rzv2h-usb2phy-reset.yaml
```yaml
# SPDX-License-Identifier: (GPL-2.0-only OR BSD-2-Clause)
%YAML 1.2
---
$id: http://devicetree.org/schemas/reset/renesas,rzv2h-usb2phy-reset.yaml#
$schema: http://devicetree.org/meta-schemas/core.yaml#

title: Renesas RZ/V2H(P) USB2PHY Port reset Control

maintainers:
  - Lad Prabhakar <prabhakar.mahadev-lad.rj@bp.renesas.com>

description:
  The RZ/V2H(P) USB2PHY Control mainly controls Port reset and power down of the
  USB2.0 PHY.

properties:
  compatible:
    oneOf:
      - items:
          - const: renesas,r9a09g056-usb2phy-reset # RZ/V2N
          - const: renesas,r9a09g057-usb2phy-reset

      - const: renesas,r9a09g057-usb2phy-reset # RZ/V2H(P)

  reg:
    maxItems: 1

  clocks:
    maxItems: 1

  resets:
    maxItems: 1

  power-domains:
    maxItems: 1

  '#reset-cells':
    const: 0

required:
  - compatible
  - reg
  - clocks
  - resets
  - power-domains
  - '#reset-cells'

additionalProperties: false

examples:
  - |
    #include <dt-bindings/clock/renesas,r9a09g057-cpg.h>

    reset-controller@15830000 {
        compatible = "renesas,r9a09g057-usb2phy-reset";
        reg = <0x15830000 0x10000>;
        clocks = <&cpg CPG_MOD 0xb6>;
        resets = <&cpg 0xaf>;
        power-domains = <&cpg>;
        #reset-cells = <0>;
    };
```

## Documentation/devicetree/bindings/reset/reset.txt
```
= Reset Signal Device Tree Bindings =

This binding is intended to represent the hardware reset signals present
internally in most IC (SoC, FPGA, ...) designs. Reset signals for whole
standalone chips are most likely better represented as GPIOs, although there
are likely to be exceptions to this rule.

Hardware blocks typically receive a reset signal. This signal is generated by
a reset provider (e.g. power management or clock module) and received by a
reset consumer (the module being reset, or a module managing when a sub-
ordinate module is reset). This binding exists to represent the provider and
consumer, and provide a way to couple the two together.

A reset signal is represented by the phandle of the provider, plus a reset
specifier - a list of DT cells that represents the reset signal within the
provider. The length (number of cells) and semantics of the reset specifier
are dictated by the binding of the reset provider, although common schemes
are described below.

A word on where to place reset signal consumers in device tree: It is possible
in hardware for a reset signal to affect multiple logically separate HW blocks
at once. In this case, it would be unwise to represent this reset signal in
the DT node of each affected HW block, since if activated, an unrelated block
may be reset. Instead, reset signals should be represented in the DT node
where it makes most sense to control it; this may be a bus node if all
children of the bus are affected by the reset signal, or an individual HW
block node for dedicated reset signals. The intent of this binding is to give
appropriate software access to the reset signals in order to manage the HW,
rather than to slavishly enumerate the reset signal that affects each HW
block.

= Reset providers =

Required properties:
#reset-cells:	Number of cells in a reset specifier; Typically 0 for nodes
		with a single reset output and 1 for nodes with multiple
		reset outputs.

For example:

	rst: reset-controller {
		#reset-cells = <1>;
	};

= Reset consumers =

Required properties:
resets:		List of phandle and reset specifier pairs, one pair
		for each reset signal that affects the device, or that the
		device manages. Note: if the reset provider specifies '0' for
		#reset-cells, then only the phandle portion of the pair will
		appear.

Optional properties:
reset-names:	List of reset signal name strings sorted in the same order as
		the resets property. Consumers drivers will use reset-names to
		match reset signal names with reset specifiers.

For example:

	device {
		resets = <&rst 20>;
		reset-names = "reset";
	};

This represents a device with a single reset signal named "reset".

	bus {
		resets = <&rst 10> <&rst 11> <&rst 12> <&rst 11>;
		reset-names = "i2s1", "i2s2", "dma", "mixer";
	};

This represents a bus that controls the reset signal of each of four sub-
ordinate devices. Consider for example a bus that fails to operate unless no
child device has reset asserted.
```
