## Documentation/devicetree/bindings/reset/hisilicon,hi3660-reset.yaml
```yaml
# SPDX-License-Identifier: (GPL-2.0-only OR BSD-2-Clause)
%YAML 1.2
---
$id: http://devicetree.org/schemas/reset/hisilicon,hi3660-reset.yaml#
$schema: http://devicetree.org/meta-schemas/core.yaml#

title: Hisilicon System Reset Controller

maintainers:
  - Wei Xu <xuwei5@hisilicon.com>

description: |
  Please also refer to reset.txt in this directory for common reset
  controller binding usage.
  The reset controller registers are part of the system-ctl block on
  hi3660 and hi3670 SoCs.

properties:
  compatible:
    oneOf:
      - items:
          - const: hisilicon,hi3660-reset
      - items:
          - const: hisilicon,hi3670-reset
          - const: hisilicon,hi3660-reset

  hisi,rst-syscon:
    deprecated: true
    description: phandle of the reset's syscon, use hisilicon,rst-syscon instead
    $ref: /schemas/types.yaml#/definitions/phandle

  hisilicon,rst-syscon:
    description: phandle of the reset's syscon.
    $ref: /schemas/types.yaml#/definitions/phandle

  '#reset-cells':
    description: |
      Specifies the number of cells needed to encode a reset source.
      Cell #1 : offset of the reset assert control register from the syscon
                register base
                offset + 4: deassert control register
                offset + 8: status control register
      Cell #2 : bit position of the reset in the reset control register
    const: 2

required:
  - compatible

additionalProperties: false

examples:
  - |
    #include <dt-bindings/interrupt-controller/irq.h>
    #include <dt-bindings/interrupt-controller/arm-gic.h>
    #include <dt-bindings/clock/hi3660-clock.h>

    iomcu: iomcu@ffd7e000 {
        compatible = "hisilicon,hi3660-iomcu", "syscon";
        reg = <0xffd7e000 0x1000>;
    };

    iomcu_rst: iomcu_rst_controller {
        compatible = "hisilicon,hi3660-reset";
        hisilicon,rst-syscon = <&iomcu>;
        #reset-cells = <2>;
    };

    /* Specifying reset lines connected to IP modules */
    i2c@ffd71000 {
        compatible = "snps,designware-i2c";
        reg = <0xffd71000 0x1000>;
        interrupts = <GIC_SPI 118 IRQ_TYPE_LEVEL_HIGH>;
        #address-cells = <1>;
        #size-cells = <0>;
        clock-frequency = <400000>;
        clocks = <&crg_ctrl HI3660_CLK_GATE_I2C0>;
        resets = <&iomcu_rst 0x20 3>;
        pinctrl-names = "default";
        pinctrl-0 = <&i2c0_pmx_func &i2c0_cfg_func>;
    };
...
```

## Documentation/devicetree/bindings/reset/hisilicon,hi6220-reset.txt
```
Hisilicon System Reset Controller
======================================

Please also refer to reset.txt in this directory for common reset
controller binding usage.

The reset controller registers are part of the system-ctl block on
hi6220 SoC.

Required properties:
- compatible: should be one of the following:
  - "hisilicon,hi6220-sysctrl", "syscon" : For peripheral reset controller.
  - "hisilicon,hi6220-mediactrl", "syscon" : For media reset controller.
  - "hisilicon,hi6220-aoctrl", "syscon" : For ao reset controller.
- reg: should be register base and length as documented in the
  datasheet
- #reset-cells: 1, see below

Example:
sys_ctrl: sys_ctrl@f7030000 {
	compatible = "hisilicon,hi6220-sysctrl", "syscon";
	reg = <0x0 0xf7030000 0x0 0x2000>;
	#clock-cells = <1>;
	#reset-cells = <1>;
};

Specifying reset lines connected to IP modules
==============================================
example:

        uart1: serial@..... {
                ...
                resets = <&sys_ctrl PERIPH_RSTEN3_UART1>;
                ...
        };

The index could be found in <dt-bindings/reset/hisi,hi6220-resets.h>.
```

## Documentation/devicetree/bindings/reset/img,pistachio-reset.txt
```
Pistachio Reset Controller
=============================================================================

This binding describes a reset controller device that is used to enable and
disable individual IP blocks within the Pistachio SoC using "soft reset"
control bits found in the Pistachio SoC top level registers.

The actual action taken when soft reset is asserted is hardware dependent.
However, when asserted it may not be possible to access the hardware's
registers, and following an assert/deassert sequence the hardware's previous
state may no longer be valid.

Please refer to Documentation/devicetree/bindings/reset/reset.txt
for common reset controller binding usage.

Required properties:

- compatible: Contains "img,pistachio-reset"

- #reset-cells: Contains 1

Example:

	cr_periph: clk@18148000 {
		compatible = "img,pistachio-cr-periph", "syscon", "simple-mfd";
		reg = <0x18148000 0x1000>;
		clocks = <&clk_periph PERIPH_CLK_SYS>;
		clock-names = "sys";
		#clock-cells = <1>;

		pistachio_reset: reset-controller {
			compatible = "img,pistachio-reset";
			#reset-cells = <1>;
		};
	};

Specifying reset control of devices
=======================================

Device nodes should specify the reset channel required in their "resets"
property, containing a phandle to the pistachio reset device node and an
index specifying which reset to use, as described in
Documentation/devicetree/bindings/reset/reset.txt.

Example:

	spdif_out: spdif-out@18100d00 {
		...
		resets = <&pistachio_reset PISTACHIO_RESET_SPDIF_OUT>;
		reset-names = "rst";
		...
	};

Macro definitions for the supported resets can be found in:
include/dt-bindings/reset/pistachio-resets.h
```

## Documentation/devicetree/bindings/reset/intel,rcu-gw.yaml
```yaml
# SPDX-License-Identifier: (GPL-2.0 OR BSD-2-Clause)
%YAML 1.2
---
$id: http://devicetree.org/schemas/reset/intel,rcu-gw.yaml#
$schema: http://devicetree.org/meta-schemas/core.yaml#

title: System Reset Controller on Intel Gateway SoCs

maintainers:
  - Dilip Kota <eswara.kota@linux.intel.com>

properties:
  compatible:
    enum:
      - intel,rcu-lgm
      - intel,rcu-xrx200

  reg:
    description: Reset controller registers.
    maxItems: 1

  intel,global-reset:
    description: Global reset register offset and bit offset.
    allOf:
      - $ref: /schemas/types.yaml#/definitions/uint32-array
      - maxItems: 2

  "#reset-cells":
    minimum: 2
    maximum: 3
    description: |
      First cell is reset request register offset.
      Second cell is bit offset in reset request register.
      Third cell is bit offset in reset status register.
      For LGM SoC, reset cell count is 2 as bit offset in
      reset request and reset status registers is same. Whereas
      3 for legacy SoCs as bit offset differs.

required:
  - compatible
  - reg
  - intel,global-reset
  - "#reset-cells"

additionalProperties: false

examples:
  - |
    rcu0: reset-controller@e0000000 {
        compatible = "intel,rcu-lgm";
        reg = <0xe0000000 0x20000>;
        intel,global-reset = <0x10 30>;
        #reset-cells = <2>;
    };

    pwm: pwm@e0d00000 {
        status = "disabled";
        compatible = "intel,lgm-pwm";
        reg = <0xe0d00000 0x30>;
        clocks = <&cgu0 1>;
        #pwm-cells = <2>;
        resets = <&rcu0 0x30 21>;
    };
```

## Documentation/devicetree/bindings/reset/lantiq,reset.txt
```
Lantiq XWAY SoC RCU reset controller binding
============================================

This binding describes a reset-controller found on the RCU module on Lantiq
XWAY SoCs.

This node has to be a sub node of the Lantiq RCU block.

-------------------------------------------------------------------------------
Required properties:
- compatible		: Should be one of
				"lantiq,danube-reset"
				"lantiq,xrx200-reset"
- reg			: Defines the following sets of registers in the parent
			  syscon device
			- Offset of the reset set register
			- Offset of the reset status register
- #reset-cells		: Specifies the number of cells needed to encode the
			  reset line, should be 2.
			  The first cell takes the reset set bit and the
			  second cell takes the status bit.

-------------------------------------------------------------------------------
Example for the reset-controllers on the xRX200 SoCs:
	reset0: reset-controller@10 {
		compatible = "lantiq,xrx200-reset";
		reg <0x10 0x04>, <0x14 0x04>;

		#reset-cells = <2>;
	};
```

## Documentation/devicetree/bindings/reset/lantiq,reset.yaml
```yaml
# SPDX-License-Identifier: (GPL-2.0-only OR BSD-2-Clause)
%YAML 1.2
---
$id: http://devicetree.org/schemas/reset/lantiq,reset.yaml#
$schema: http://devicetree.org/meta-schemas/core.yaml#

title: Lantiq XWAY SoC RCU reset controller

maintainers:
  - Martin Blumenstingl <martin.blumenstingl@googlemail.com>

description: |
  This binding describes a reset-controller found on the RCU module on Lantiq
  XWAY SoCs. This node has to be a sub node of the Lantiq RCU block.

properties:
  compatible:
    enum:
      - lantiq,danube-reset
      - lantiq,xrx200-reset

  reg:
    description: |
      Defines the following sets of registers in the parent syscon device
      Offset of the reset set register
      Offset of the reset status register
    maxItems: 2

  '#reset-cells':
    description: |
      The first cell takes the reset set bit and the second cell takes the
      status bit.
    const: 2

required:
  - compatible
  - reg
  - '#reset-cells'

additionalProperties: false

examples:
  - |
    // On the xRX200 SoCs:
    reset0: reset-controller@10 {
        compatible = "lantiq,xrx200-reset";
        reg = <0x10 0x04>, <0x14 0x04>;
        #reset-cells = <2>;
    };
```

## Documentation/devicetree/bindings/reset/marvell,berlin2-reset.yaml
```yaml
# SPDX-License-Identifier: (GPL-2.0 OR BSD-2-Clause)
# Copyright 2015 Antoine Tenart <atenart@kernel.org>
%YAML 1.2
---
$id: "http://devicetree.org/schemas/reset/marvell,berlin2-reset.yaml#"
$schema: "http://devicetree.org/meta-schemas/core.yaml#"

title: Marvell Berlin reset controller

maintainers:
  - Antoine Tenart <atenart@kernel.org>

description: The reset controller node must be a sub-node of the chip
  controller node on Berlin SoCs.

properties:
  compatible:
    const: marvell,berlin2-reset

  "#reset-cells":
    const: 2

required:
  - compatible
  - "#reset-cells"

additionalProperties: false

examples:
  - |
    chip: chip-control@ea0000 {
        reg = <0xea0000 0x400>;

        chip_rst: reset {
            compatible = "marvell,berlin2-reset";
            #reset-cells = <2>;
        };
    };
```

## Documentation/devicetree/bindings/reset/microchip,rst.yaml
```yaml
# SPDX-License-Identifier: (GPL-2.0-only OR BSD-2-Clause)
%YAML 1.2
---
$id: http://devicetree.org/schemas/reset/microchip,rst.yaml#
$schema: http://devicetree.org/meta-schemas/core.yaml#

title: Microchip Sparx5 Switch Reset Controller

maintainers:
  - Steen Hegelund <steen.hegelund@microchip.com>
  - Lars Povlsen <lars.povlsen@microchip.com>

description: |
  The Microchip Sparx5 Switch provides reset control and implements the following
  functions
    - One Time Switch Core Reset (Soft Reset)

properties:
  $nodename:
    pattern: "^reset-controller@[0-9a-f]+$"

  compatible:
    enum:
      - microchip,sparx5-switch-reset
      - microchip,lan966x-switch-reset

  reg:
    items:
      - description: global control block registers

  reg-names:
    items:
      - const: gcb

  "#reset-cells":
    const: 1

  cpu-syscon:
    $ref: /schemas/types.yaml#/definitions/phandle
    description: syscon used to access CPU reset

required:
  - compatible
  - reg
  - reg-names
  - "#reset-cells"
  - cpu-syscon

additionalProperties: false

examples:
  - |
    reset: reset-controller@11010008 {
        compatible = "microchip,sparx5-switch-reset";
        reg = <0x11010008 0x4>;
        reg-names = "gcb";
        #reset-cells = <1>;
        cpu-syscon = <&cpu_ctrl>;
    };
```

## Documentation/devicetree/bindings/reset/mobileye,eyeq5-reset.yaml
```yaml
# SPDX-License-Identifier: (GPL-2.0-only OR BSD-2-Clause)
%YAML 1.2
---
$id: http://devicetree.org/schemas/reset/mobileye,eyeq5-reset.yaml#
$schema: http://devicetree.org/meta-schemas/core.yaml#

title: Mobileye EyeQ5 reset controller

description:
  The EyeQ5 reset driver handles three reset domains. Its registers live in a
  shared region called OLB.

maintainers:
  - Grégory Clement <gregory.clement@bootlin.com>
  - Théo Lebrun <theo.lebrun@bootlin.com>
  - Vladimir Kondratiev <vladimir.kondratiev@mobileye.com>

properties:
  compatible:
    const: mobileye,eyeq5-reset

  reg:
    maxItems: 3

  reg-names:
    items:
      - const: d0
      - const: d1
      - const: d2

  "#reset-cells":
    const: 2
    description:
      The first cell is the domain (0 to 2 inclusive) and the second one is the
      reset index inside that domain.

required:
  - compatible
  - reg
  - reg-names
  - "#reset-cells"

additionalProperties: false
```

## Documentation/devicetree/bindings/reset/nuvoton,ma35d1-reset.yaml
```yaml
# SPDX-License-Identifier: (GPL-2.0-only OR BSD-2-Clause)
%YAML 1.2
---
$id: http://devicetree.org/schemas/reset/nuvoton,ma35d1-reset.yaml#
$schema: http://devicetree.org/meta-schemas/core.yaml#

title: Nuvoton MA35D1 Reset Controller

maintainers:
  - Chi-Fang Li <cfli0@nuvoton.com>
  - Jacky Huang <ychuang3@nuvoton.com>

description:
  The system reset controller can be used to reset various peripheral
  controllers in MA35D1 SoC.

properties:
  compatible:
    items:
      - const: nuvoton,ma35d1-reset

  reg:
    maxItems: 1

  '#reset-cells':
    const: 1

required:
  - compatible
  - reg
  - '#reset-cells'

additionalProperties: false

examples:
  # system reset controller node:
  - |

    system-management@40460000 {
        compatible = "nuvoton,ma35d1-reset";
        reg = <0x40460000 0x200>;
        #reset-cells = <1>;
    };
...
```

## Documentation/devicetree/bindings/reset/nuvoton,npcm-reset.txt
```
Nuvoton NPCM Reset controller

Required properties:
- compatible : "nuvoton,npcm750-reset" for NPCM7XX BMC
- reg : specifies physical base address and size of the register.
- #reset-cells: must be set to 2

Optional property:
- nuvoton,sw-reset-number - Contains the software reset number to restart the SoC.
  NPCM7xx contain four software reset that represent numbers 1 to 4.

  If 'nuvoton,sw-reset-number' is not specified software reset is disabled.

Example:
	rstc: rstc@f0801000 {
		compatible = "nuvoton,npcm750-reset";
		reg = <0xf0801000 0x70>;
		#reset-cells = <2>;
		nuvoton,sw-reset-number = <2>;
	};

Specifying reset lines connected to IP NPCM7XX modules
======================================================
example:

        spi0: spi@..... {
                ...
                resets = <&rstc NPCM7XX_RESET_IPSRST2 NPCM7XX_RESET_PSPI1>;
                ...
        };

The index could be found in <dt-bindings/reset/nuvoton,npcm7xx-reset.h>.
```
