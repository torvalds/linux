## Documentation/devicetree/bindings/csky/pmu.txt
```
===============================
C-SKY Performance Monitor Units
===============================

C-SKY Performance Monitor is designed for ck807/ck810/ck860 SMP soc and
it could count cpu's events for helping analysis performance issues.

============================
PMU node bindings definition
============================

	Description: Describes PMU

	PROPERTIES

	- compatible
		Usage: required
		Value type: <string>
		Definition: must be "csky,csky-pmu"
	- interrupts
		Usage: required
		Value type: <u32 IRQ_TYPE_XXX>
		Definition: must be pmu irq num defined by soc
	- count-width
		Usage: optional
		Value type: <u32>
		Definition: the width of pmu counter

Examples:
---------
#include <dt-bindings/interrupt-controller/irq.h>

	pmu: performace-monitor {
		compatible = "csky,csky-pmu";
		interrupts = <23 IRQ_TYPE_EDGE_RISING>;
		interrupt-parent = <&intc>;
		count-width = <48>;
        };
```

## Documentation/devicetree/bindings/ddr/lpddr2-timings.txt
```
* AC timing parameters of LPDDR2(JESD209-2) memories for a given speed-bin

Required properties:
- compatible : Should be "jedec,lpddr2-timings"
- min-freq : minimum DDR clock frequency for the speed-bin. Type is <u32>
- max-freq : maximum DDR clock frequency for the speed-bin. Type is <u32>

Optional properties:

The following properties represent AC timing parameters from the memory
data-sheet of the device for a given speed-bin. All these properties are
of type <u32> and the default unit is ps (pico seconds). Parameters with
a different unit have a suffix indicating the unit such as 'tRAS-max-ns'
- tRCD
- tWR
- tRAS-min
- tRRD
- tWTR
- tXP
- tRTP
- tDQSCK-max
- tFAW
- tZQCS
- tZQinit
- tRPab
- tZQCL
- tCKESR
- tRAS-max-ns
- tDQSCK-max-derated

Example:

timings_elpida_ECB240ABACN_400mhz: lpddr2-timings@0 {
	compatible	= "jedec,lpddr2-timings";
	min-freq	= <10000000>;
	max-freq	= <400000000>;
	tRPab		= <21000>;
	tRCD		= <18000>;
	tWR		= <15000>;
	tRAS-min	= <42000>;
	tRRD		= <10000>;
	tWTR		= <7500>;
	tXP		= <7500>;
	tRTP		= <7500>;
	tCKESR		= <15000>;
	tDQSCK-max	= <5500>;
	tFAW		= <50000>;
	tZQCS		= <90000>;
	tZQCL		= <360000>;
	tZQinit		= <1000000>;
	tRAS-max-ns	= <70000>;
};
```

## Documentation/devicetree/bindings/ddr/lpddr2.txt
```
* LPDDR2 SDRAM memories compliant to JEDEC JESD209-2

Required properties:
- compatible : Should be one of - "jedec,lpddr2-nvm", "jedec,lpddr2-s2",
  "jedec,lpddr2-s4"

  "ti,jedec-lpddr2-s2" should be listed if the memory part is LPDDR2-S2 type

  "ti,jedec-lpddr2-s4" should be listed if the memory part is LPDDR2-S4 type

  "ti,jedec-lpddr2-nvm" should be listed if the memory part is LPDDR2-NVM type

- density  : <u32> representing density in Mb (Mega bits)

- io-width : <u32> representing bus width. Possible values are 8, 16, and 32

Optional properties:

The following optional properties represent the minimum value of some AC
timing parameters of the DDR device in terms of number of clock cycles.
These values shall be obtained from the device data-sheet.
- tRRD-min-tck
- tWTR-min-tck
- tXP-min-tck
- tRTP-min-tck
- tCKE-min-tck
- tRPab-min-tck
- tRCD-min-tck
- tWR-min-tck
- tRASmin-min-tck
- tCKESR-min-tck
- tFAW-min-tck

Child nodes:
- The lpddr2 node may have one or more child nodes of type "lpddr2-timings".
  "lpddr2-timings" provides AC timing parameters of the device for
  a given speed-bin. The user may provide the timings for as many
  speed-bins as is required. Please see Documentation/devicetree/
  bindings/ddr/lpddr2-timings.txt for more information on "lpddr2-timings"

Example:

elpida_ECB240ABACN : lpddr2 {
	compatible	= "Elpida,ECB240ABACN","jedec,lpddr2-s4";
	density		= <2048>;
	io-width	= <32>;

	tRPab-min-tck	= <3>;
	tRCD-min-tck	= <3>;
	tWR-min-tck	= <3>;
	tRASmin-min-tck	= <3>;
	tRRD-min-tck	= <2>;
	tWTR-min-tck	= <2>;
	tXP-min-tck	= <2>;
	tRTP-min-tck	= <2>;
	tCKE-min-tck	= <3>;
	tCKESR-min-tck	= <3>;
	tFAW-min-tck	= <8>;

	timings_elpida_ECB240ABACN_400mhz: lpddr2-timings@0 {
		compatible	= "jedec,lpddr2-timings";
		min-freq	= <10000000>;
		max-freq	= <400000000>;
		tRPab		= <21000>;
		tRCD		= <18000>;
		tWR		= <15000>;
		tRAS-min	= <42000>;
		tRRD		= <10000>;
		tWTR		= <7500>;
		tXP		= <7500>;
		tRTP		= <7500>;
		tCKESR		= <15000>;
		tDQSCK-max	= <5500>;
		tFAW		= <50000>;
		tZQCS		= <90000>;
		tZQCL		= <360000>;
		tZQinit		= <1000000>;
		tRAS-max-ns	= <70000>;
	};

	timings_elpida_ECB240ABACN_200mhz: lpddr2-timings@1 {
		compatible	= "jedec,lpddr2-timings";
		min-freq	= <10000000>;
		max-freq	= <200000000>;
		tRPab		= <21000>;
		tRCD		= <18000>;
		tWR		= <15000>;
		tRAS-min	= <42000>;
		tRRD		= <10000>;
		tWTR		= <10000>;
		tXP		= <7500>;
		tRTP		= <7500>;
		tCKESR		= <15000>;
		tDQSCK-max	= <5500>;
		tFAW		= <50000>;
		tZQCS		= <90000>;
		tZQCL		= <360000>;
		tZQinit		= <1000000>;
		tRAS-max-ns	= <70000>;
	};

}
```

## Documentation/devicetree/bindings/devfreq/event/exynos-nocp.txt
```
* Samsung Exyyess NoC (Network on Chip) Probe device

The Samsung Exyyess542x SoC has NoC (Network on Chip) Probe for NoC bus.
NoC provides the primitive values to get the performance data. The packets
that the Network on Chip (NoC) probes detects are transported over
the network infrastructure to observer units. You can configure probes to
capture packets with header or data on the data request response network,
or as traffic debug or statistic collectors. Exyyess542x bus has multiple
NoC probes to provide bandwidth information about behavior of the SoC
that you can use while analyzing system performance.

Required properties:
- compatible: Should be "samsung,exyyess5420-yescp"
- reg: physical base address of each NoC Probe and length of memory mapped region.

Optional properties:
- clock-names : the name of clock used by the NoC Probe, "yescp"
- clocks : phandles for clock specified in "clock-names" property

Example : NoC Probe yesdes in Device Tree are listed below.

	yescp_mem0_0: yescp@10ca1000 {
		compatible = "samsung,exyyess5420-yescp";
		reg = <0x10CA1000 0x200>;
	};
```

## Documentation/devicetree/bindings/devfreq/event/exynos-ppmu.txt
```
* Samsung Exynos PPMU (Platform Performance Monitoring Unit) device

The Samsung Exynos SoC has PPMU (Platform Performance Monitoring Unit) for
each IP. PPMU provides the primitive values to get performance data. These
PPMU events provide information of the SoC's behaviors so that you may
use to analyze system performance, to make behaviors visible and to count
usages of each IP (DMC, CPU, RIGHTBUS, LEFTBUS, CAM interface, LCD, G3D, MFC).
The Exynos PPMU driver uses the devfreq-event class to provide event data
to various devfreq devices. The devfreq devices would use the event data when
derterming the current state of each IP.

Required properties:
- compatible: Should be "samsung,exynos-ppmu" or "samsung,exynos-ppmu-v2.
- reg: physical base address of each PPMU and length of memory mapped region.

Optional properties:
- clock-names : the name of clock used by the PPMU, "ppmu"
- clocks : phandles for clock specified in "clock-names" property

Example1 : PPMUv1 nodes in exynos3250.dtsi are listed below.

		ppmu_dmc0: ppmu_dmc0@106a0000 {
			compatible = "samsung,exynos-ppmu";
			reg = <0x106a0000 0x2000>;
			status = "disabled";
		};

		ppmu_dmc1: ppmu_dmc1@106b0000 {
			compatible = "samsung,exynos-ppmu";
			reg = <0x106b0000 0x2000>;
			status = "disabled";
		};

		ppmu_cpu: ppmu_cpu@106c0000 {
			compatible = "samsung,exynos-ppmu";
			reg = <0x106c0000 0x2000>;
			status = "disabled";
		};

		ppmu_rightbus: ppmu_rightbus@112a0000 {
			compatible = "samsung,exynos-ppmu";
			reg = <0x112a0000 0x2000>;
			clocks = <&cmu CLK_PPMURIGHT>;
			clock-names = "ppmu";
			status = "disabled";
		};

		ppmu_leftbus: ppmu_leftbus0@116a0000 {
			compatible = "samsung,exynos-ppmu";
			reg = <0x116a0000 0x2000>;
			clocks = <&cmu CLK_PPMULEFT>;
			clock-names = "ppmu";
			status = "disabled";
		};

Example2 : Events of each PPMU node in exynos3250-rinato.dts are listed below.

	&ppmu_dmc0 {
		status = "okay";

		events {
			ppmu_dmc0_3: ppmu-event3-dmc0 {
				event-name = "ppmu-event3-dmc0";
			};

			ppmu_dmc0_2: ppmu-event2-dmc0 {
				event-name = "ppmu-event2-dmc0";
			};

			ppmu_dmc0_1: ppmu-event1-dmc0 {
				event-name = "ppmu-event1-dmc0";
			};

			ppmu_dmc0_0: ppmu-event0-dmc0 {
				event-name = "ppmu-event0-dmc0";
			};
		};
	};

	&ppmu_dmc1 {
		status = "okay";

		events {
			ppmu_dmc1_3: ppmu-event3-dmc1 {
				event-name = "ppmu-event3-dmc1";
			};
		};
	};

	&ppmu_leftbus {
		status = "okay";

		events {
			ppmu_leftbus_3: ppmu-event3-leftbus {
				event-name = "ppmu-event3-leftbus";
			};
		};
	};

	&ppmu_rightbus {
		status = "okay";

		events {
			ppmu_rightbus_3: ppmu-event3-rightbus {
				event-name = "ppmu-event3-rightbus";
			};
		};
	};

Example3 : PPMUv2 nodes in exynos5433.dtsi are listed below.

		ppmu_d0_cpu: ppmu_d0_cpu@10480000 {
			compatible = "samsung,exynos-ppmu-v2";
			reg = <0x10480000 0x2000>;
			status = "disabled";
		};

		ppmu_d0_general: ppmu_d0_general@10490000 {
			compatible = "samsung,exynos-ppmu-v2";
			reg = <0x10490000 0x2000>;
			status = "disabled";
		};

		ppmu_d0_rt: ppmu_d0_rt@104a0000 {
			compatible = "samsung,exynos-ppmu-v2";
			reg = <0x104a0000 0x2000>;
			status = "disabled";
		};

		ppmu_d1_cpu: ppmu_d1_cpu@104b0000 {
			compatible = "samsung,exynos-ppmu-v2";
			reg = <0x104b0000 0x2000>;
			status = "disabled";
		};

		ppmu_d1_general: ppmu_d1_general@104c0000 {
			compatible = "samsung,exynos-ppmu-v2";
			reg = <0x104c0000 0x2000>;
			status = "disabled";
		};

		ppmu_d1_rt: ppmu_d1_rt@104d0000 {
			compatible = "samsung,exynos-ppmu-v2";
			reg = <0x104d0000 0x2000>;
			status = "disabled";
		};
```

## Documentation/devicetree/bindings/devfreq/event/rockchip,dfi.yaml
```yaml
# SPDX-License-Identifier: (GPL-2.0-only OR BSD-2-Clause)
%YAML 1.2
---
$id: http://devicetree.org/schemas/devfreq/event/rockchip,dfi.yaml#
$schema: http://devicetree.org/meta-schemas/core.yaml#

title: Rockchip DFI

maintainers:
  - Sascha Hauer <s.hauer@pengutronix.de>

properties:
  compatible:
    enum:
      - rockchip,rk3399-dfi
      - rockchip,rk3568-dfi
      - rockchip,rk3588-dfi

  clocks:
    maxItems: 1

  clock-names:
    items:
      - const: pclk_ddr_mon

  interrupts:
    minItems: 1
    maxItems: 4

  reg:
    maxItems: 1

  rockchip,pmu:
    $ref: /schemas/types.yaml#/definitions/phandle
    description:
      Phandle to the syscon managing the "PMU general register files".

required:
  - compatible
  - interrupts
  - reg

if:
  properties:
    compatible:
      contains:
        enum:
          - rockchip,rk3399-dfi

then:
  required:
    - clocks
    - clock-names

additionalProperties: false

examples:
  - |
    #include <dt-bindings/interrupt-controller/arm-gic.h>
    #include <dt-bindings/clock/rk3308-cru.h>

    bus {
      #address-cells = <2>;
      #size-cells = <2>;

      dfi: dfi@ff630000 {
        compatible = "rockchip,rk3399-dfi";
        reg = <0x00 0xff630000 0x00 0x4000>;
        interrupts = <GIC_SPI 131 IRQ_TYPE_LEVEL_HIGH 0>;
        rockchip,pmu = <&pmugrf>;
        clocks = <&cru PCLK_DDR_MON>;
        clock-names = "pclk_ddr_mon";
      };
    };
```

## Documentation/devicetree/bindings/devfreq/event/rockchip-dfi.txt
```
* Rockchip DFI device

Required properties:
- compatible: Should be one of the following.
  - "rockchip,px30-dfi" - for PX30 SoCs.
  - "rockchip,rk1808-dfi" - for RK1808 SoCs.
  - "rockchip,rk3128-dfi" - for RK3128 SoCs.
  - "rockchip,rk3288-dfi" - for RK3288 SoCs.
  - "rockchip,rk3328-dfi" - for RK3328 SoCs.
  - "rockchip,rk3368-dfi" - for RK3368 SoCs.
  - "rockchip,rk3399-dfi" - for RK3399 SoCs.
  - "rockchip,rk3568-dfi" - for RK3568 SoCs.
  - "rockchip,rv1126-dfi" - for RV1126 SoCs.

Required properties for RK3368:
- rockchip,grf: phandle to the syscon managing the "general register files"

Required properties for RK3399:
- reg: physical base address of each DFI and length of memory mapped region
- rockchip,pmu: phandle to the syscon managing the "pmu general register files"
- clocks: phandles for clock specified in "clock-names" property
- clock-names : the name of clock used by the DFI, must be "pclk_ddr_mon";

Example:
	dfi: dfi@ff630000 {
		compatible = "rockchip,rk3399-dfi";
		reg = <0x00 0xff630000 0x00 0x4000>;
		rockchip,pmu = <&pmugrf>;
		clocks = <&cru PCLK_DDR_MON>;
		clock-names = "pclk_ddr_mon";
	};
```

## Documentation/devicetree/bindings/devfreq/event/rockchip-nocp.txt
```
* Rockchip NoC (Network on Chip) Probe device

The Rockchip SoCs have NoC (Network on Chip) Probe for NoC bus.
NoC provides the primitive values to get the performance data, The
packets that the Network on Chip (NoC) probes detects are transported
over the network infrastructure to observer units. For example, RK3399
has multiple NoC probes to monitor traffic statistics for analyzing the
transaction flow.

Required properties:
- compatible: Should be one of the following.
  - "rockchip,rk3288-nocp" - for RK3288 SoC.
  - "rockchip,rk3368-nocp" - for RK3368 SoC.
  - "rockchip,rk3399-nocp" - for RK3399 SoC.
- reg: physical base address of each NoC Probe and length of memory mapped region.

Example : NoC Probe nodes in Device Tree are listed below.

	nocp_cci_msch0: nocp-cci-msch0@ffa86000 {
		compatible = "rockchip,rk3399-nocp";
		reg = <0xffa86000 0x400>;
	};
```

## Documentation/devicetree/bindings/devfreq/event/samsung,exynos-nocp.yaml
```yaml
# SPDX-License-Identifier: GPL-2.0
%YAML 1.2
---
$id: http://devicetree.org/schemas/devfreq/event/samsung,exyanals-analcp.yaml#
$schema: http://devicetree.org/meta-schemas/core.yaml#

title: Samsung Exyanals AnalC (Network on Chip) Probe

maintainers:
  - Chanwoo Choi <cw00.choi@samsung.com>
  - Krzysztof Kozlowski <krzk@kernel.org>

description: |
  The Samsung Exyanals542x SoC has a AnalC (Network on Chip) Probe for AnalC bus.
  AnalC provides the primitive values to get the performance data. The packets
  that the Network on Chip (AnalC) probes detects are transported over the
  network infrastructure to observer units. You can configure probes to capture
  packets with header or data on the data request response network, or as
  traffic debug or statistic collectors. Exyanals542x bus has multiple AnalC probes
  to provide bandwidth information about behavior of the SoC that you can use
  while analyzing system performance.

properties:
  compatible:
    const: samsung,exyanals5420-analcp

  clock-names:
    items:
      - const: analcp

  clocks:
    maxItems: 1

  reg:
    maxItems: 1

required:
  - compatible
  - reg

additionalProperties: false

examples:
  - |
    analcp_mem0_0: analcp@10ca1000 {
        compatible = "samsung,exyanals5420-analcp";
        reg = <0x10ca1000 0x200>;
    };
```
