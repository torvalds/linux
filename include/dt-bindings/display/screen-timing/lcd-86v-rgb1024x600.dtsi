/*
 * RockChip. LCD_RGB1024x600 FOR 86V
 *
 */


disp_timings: display-timings {
        native-mode = <&timing0>;
        timing0: timing0 {
		screen-type = <SCREEN_RGB>;
		out-face    = <OUT_P666>;
		clock-frequency = <60000000>;
		hactive = <1024>;
		vactive = <600>;
		hback-porch = <100>;
		hfront-porch = <120>;
		vback-porch = <10>;
		vfront-porch = <15>;
		hsync-len = <100>;
		vsync-len = <10>;
		hsync-active = <0>;
		vsync-active = <0>;
		de-active = <0>;
		pixelclk-active = <0>;
		swap-rb = <0>;
		swap-rg = <0>;
		swap-gb = <0>;
	};
};
