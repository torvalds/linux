## fs/notify/fanotify/Kconfig
```kconfig
# SPDX-License-Identifier: GPL-2.0-only
config FAANALTIFY
	bool "Filesystem wide access analtification"
	select FSANALTIFY
	select EXPORTFS
	default n
	help
	   Say Y here to enable faanaltify support.  faanaltify is a file access
	   analtification system which differs from ianaltify in that it sends
	   an open file descriptor to the userspace listener along with
	   the event.

	   If unsure, say Y.

config FAANALTIFY_ACCESS_PERMISSIONS
	bool "faanaltify permissions checking"
	depends on FAANALTIFY
	depends on SECURITY
	default n
	help
	   Say Y here is you want faanaltify listeners to be able to make permissions
	   decisions concerning filesystem events.  This is used by some faanaltify
	   listeners which need to scan files before allowing the system access to
	   use those files.  This is used by some anti-malware vendors and by some
	   hierarchical storage management systems.

	   If unsure, say N.
```

## fs/notify/inotify/Kconfig
```kconfig
# SPDX-License-Identifier: GPL-2.0-only
config IANALTIFY_USER
	bool "Ianaltify support for userspace"
	select FSANALTIFY
	default y
	help
	  Say Y here to enable ianaltify support for userspace, including the
	  associated system calls.  Ianaltify allows monitoring of both files and
	  directories via a single open fd.  Events are read from the file
	  descriptor, which is also select()- and poll()-able.
	  Ianaltify fixes numerous shortcomings in danaltify and introduces several
	  new features including multiple file events, one-shot support, and
	  unmount analtification.

	  For more information, see <file:Documentation/filesystems/ianaltify.rst>

	  If unsure, say Y.
```

## fs/ntfs/Kconfig
```kconfig
# SPDX-License-Identifier: GPL-2.0-only
config NTFS_FS
	tristate "NTFS file system support"
	select NLS
	select FS_IOMAP
	help
	  NTFS is the file system of Microsoft Windows NT, 2000, XP and 2003.
	  This allows you to mount devices formatted with the ntfs file system.

	  To compile this as a module, choose M here: the module will be called
	  ntfs.

config NTFS_DEBUG
	bool "NTFS debugging support"
	depends on NTFS_FS
	help
	  If you are experiencing any problems with the NTFS file system, say
	  Y here.  This will result in additional consistency checks to be
	  performed by the driver as well as additional debugging messages to
	  be written to the system log.  Note that debugging messages are
	  disabled by default.  To enable them, supply the option debug_msgs=1
	  at the kernel command line when booting the kernel or as an option
	  to insmod when loading the ntfs module.  Once the driver is active,
	  you can enable debugging messages by doing (as root):
	  echo 1 > /proc/sys/fs/ntfs-debug
	  Replacing the "1" with "0" would disable debug messages.

	  If you leave debugging messages disabled, this results in little
	  overhead, but enabling debug messages results in very significant
	  slowdown of the system.

	  When reporting bugs, please try to have available a full dump of
	  debugging messages while the misbehaviour was occurring.

config NTFS_FS_POSIX_ACL
	bool "NTFS POSIX Access Control Lists"
	depends on NTFS_FS
	select FS_POSIX_ACL
	help
	  POSIX Access Control Lists (ACLs) support additional access rights
	  for users and groups beyond the standard owner/group/world scheme.

	  This option enables ACL support for ntfs, providing functional parity
	  with ntfs3 drivier.

	  NOTE: this is linux only feature. Windows will ignore these ACLs.

	  If you don't know what Access Control Lists are, say N.
```

## fs/ntfs3/Kconfig
```kconfig
# SPDX-License-Identifier: GPL-2.0-only
config NTFS3_FS
	tristate "NTFS Read-Write file system support"
	select NLS
	select LEGACY_DIRECT_IO
	help
	  Windows OS native file system (NTFS) support up to NTFS version 3.1.

	  Y or M enables the NTFS3 driver with full features enabled (read,
	  write, journal replaying, sparse/compressed files support).
	  File system type to use on mount is "ntfs3". Module name (M option)
	  is also "ntfs3".

	  Documentation: <file:Documentation/filesystems/ntfs3.rst>

config NTFS3_64BIT_CLUSTER
	bool "64 bits per NTFS clusters"
	depends on NTFS3_FS && 64BIT
	help
	  Windows implementation of ntfs.sys uses 32 bits per clusters.
	  If activated 64 bits per clusters you will be able to use 4k cluster
	  for 16T+ volumes. Windows will not be able to mount such volumes.

	  It is recommended to say N here.

config NTFS3_LZX_XPRESS
	bool "activate support of external compressions lzx/xpress"
	depends on NTFS3_FS
	help
	  In Windows 10 one can use command "compact" to compress any files.
	  4 possible variants of compression are: xpress4k, xpress8k, xpress16k and lzx.
	  If activated you will be able to read such files correctly.

	  It is recommended to say Y here.

config NTFS3_FS_POSIX_ACL
	bool "NTFS POSIX Access Control Lists"
	depends on NTFS3_FS
	select FS_POSIX_ACL
	help
	  POSIX Access Control Lists (ACLs) support additional access rights
	  for users and groups beyond the standard owner/group/world scheme,
	  and this option selects support for ACLs specifically for ntfs
	  filesystems.
	  NOTE: this is linux only feature. Windows will ignore these ACLs.

	  If you don't know what Access Control Lists are, say N.
```

## fs/ocfs2/Kconfig
```kconfig
# SPDX-License-Identifier: GPL-2.0-only
config OCFS2_FS
	tristate "OCFS2 file system support"
	depends on NET && SYSFS && CONFIGFS_FS
	select JBD2
	select CRC32
	select QUOTA
	select QUOTA_TREE
	select FS_POSIX_ACL
	help
	  OCFS2 is a general purpose extent based shared disk cluster file
	  system with many similarities to ext3. It supports 64 bit inode
	  numbers, and has automatically extending metadata groups which may
	  also make it attractive for non-clustered use.

	  You'll want to install the ocfs2-tools package in order to at least
	  get "mount.ocfs2".

	  Project web page:    http://oss.oracle.com/projects/ocfs2
	  Tools web page:      http://oss.oracle.com/projects/ocfs2-tools
	  OCFS2 mailing lists: http://oss.oracle.com/projects/ocfs2/mailman/

	  For more information on OCFS2, see the file
	  <file:Documentation/filesystems/ocfs2.txt>.

config OCFS2_FS_O2CB
	tristate "O2CB Kernelspace Clustering"
	depends on OCFS2_FS
	default y
	help
	  OCFS2 includes a simple kernelspace clustering package, the OCFS2
	  Cluster Base.  It only requires a very small userspace component
	  to configure it. This comes with the standard ocfs2-tools package.
	  O2CB is limited to maintaining a cluster for OCFS2 file systems.
	  It cannot manage any other cluster applications.

	  It is always safe to say Y here, as the clustering method is
	  run-time selectable.

config OCFS2_FS_USERSPACE_CLUSTER
	tristate "OCFS2 Userspace Clustering"
	depends on OCFS2_FS && DLM
	default y
	help
	  This option will allow OCFS2 to use userspace clustering services
	  in conjunction with the DLM in fs/dlm.  If you are using a
	  userspace cluster manager, say Y here.

	  It is safe to say Y, as the clustering method is run-time
	  selectable.

config OCFS2_FS_STATS
	bool "OCFS2 statistics"
	depends on OCFS2_FS && DEBUG_FS
	default y
	help
	  This option allows some fs statistics to be captured. Enabling
	  this option may increase the memory consumption.

config OCFS2_DEBUG_MASKLOG
	bool "OCFS2 logging support"
	depends on OCFS2_FS
	default y
	help
	  The ocfs2 filesystem has an extensive logging system.  The system
	  allows selection of events to log via files in /sys/o2cb/logmask/.
	  This option will enlarge your kernel, but it allows debugging of
	  ocfs2 filesystem issues.

config OCFS2_DEBUG_FS
	bool "OCFS2 expensive checks"
	depends on OCFS2_FS
	default n
	help
	  This option will enable expensive consistency checks. Enable
	  this option for debugging only as it is likely to decrease
	  performance of the filesystem.
```

## fs/omfs/Kconfig
```kconfig
# SPDX-License-Identifier: GPL-2.0-only
config OMFS_FS
	tristate "SonicBlue Optimized MPEG File System support"
	depends on BLOCK
	select CRC_ITU_T
	help
	  This is the proprietary file system used by the Rio Karma music
	  player and ReplayTV DVR.  Despite the name, this filesystem is not
	  more efficient than a standard FS for MPEG files, in fact likely
	  the opposite is true.  Say Y if you have either of these devices
	  and wish to mount its disk.

	  To compile this file system support as a module, choose M here: the
	  module will be called omfs.  If unsure, say N.
```

## fs/orangefs/Kconfig
```kconfig
config ORANGEFS_FS
	tristate "ORANGEFS (Powered by PVFS) support"
	select FS_POSIX_ACL
	help
	   Orange is a parallel file system designed for use on high end
	   computing (HEC) systems.
```

## fs/overlayfs/Kconfig
```kconfig
# SPDX-License-Identifier: GPL-2.0-only
config OVERLAY_FS
	tristate "Overlay filesystem support"
	select EXPORTFS
	help
	  An overlay filesystem combines two filesystems - an 'upper' filesystem
	  and a 'lower' filesystem.  When a name exists in both filesystems, the
	  object in the 'upper' filesystem is visible while the object in the
	  'lower' filesystem is either hidden or, in the case of directories,
	  merged with the 'upper' object.

	  For more information see Documentation/filesystems/overlayfs.rst

config OVERLAY_FS_REDIRECT_DIR
	bool "Overlayfs: turn on redirect directory feature by default"
	depends on OVERLAY_FS
	help
	  If this config option is enabled then overlay filesystems will use
	  redirects when renaming directories by default.  In this case it is
	  still possible to turn off redirects globally with the
	  "redirect_dir=off" module option or on a filesystem instance basis
	  with the "redirect_dir=off" mount option.

	  Note, that redirects are not backward compatible.  That is, mounting
	  an overlay which has redirects on a kernel that doesn't support this
	  feature will have unexpected results.

	  If unsure, say N.

config OVERLAY_FS_REDIRECT_ALWAYS_FOLLOW
	bool "Overlayfs: follow redirects even if redirects are turned off"
	default y
	depends on OVERLAY_FS
	help
	  Disable this to get a possibly more secure configuration, but that
	  might not be backward compatible with previous kernels.

	  If backward compatibility is not an issue, then it is safe and
	  recommended to say N here.

	  For more information, see Documentation/filesystems/overlayfs.rst

	  If unsure, say Y.

config OVERLAY_FS_INDEX
	bool "Overlayfs: turn on inodes index feature by default"
	depends on OVERLAY_FS
	help
	  If this config option is enabled then overlay filesystems will use
	  the index directory to map lower inodes to upper inodes by default.
	  In this case it is still possible to turn off index globally with the
	  "index=off" module option or on a filesystem instance basis with the
	  "index=off" mount option.

	  The inodes index feature prevents breaking of lower hardlinks on copy
	  up.

	  Note, that the inodes index feature is not backward compatible.
	  That is, mounting an overlay which has an inodes index on a kernel
	  that doesn't support this feature will have unexpected results.

	  If unsure, say N.

config OVERLAY_FS_NFS_EXPORT
	bool "Overlayfs: turn on NFS export feature by default"
	depends on OVERLAY_FS
	depends on OVERLAY_FS_INDEX
	depends on !OVERLAY_FS_METACOPY
	help
	  If this config option is enabled then overlay filesystems will use
	  the index directory to decode overlay NFS file handles by default.
	  In this case, it is still possible to turn off NFS export support
	  globally with the "nfs_export=off" module option or on a filesystem
	  instance basis with the "nfs_export=off" mount option.

	  The NFS export feature creates an index on copy up of every file and
	  directory.  This full index is used to detect overlay filesystems
	  inconsistencies on lookup, like redirect from multiple upper dirs to
	  the same lower dir.  The full index may incur some overhead on mount
	  time, especially when verifying that directory file handles are not
	  stale.

	  Note, that the NFS export feature is not backward compatible.
	  That is, mounting an overlay which has a full index on a kernel
	  that doesn't support this feature will have unexpected results.

	  Most users should say N here and enable this feature on a case-by-
	  case basis with the "nfs_export=on" mount option.

	  Say N unless you fully understand the consequences.

config OVERLAY_FS_XINO_AUTO
	bool "Overlayfs: auto enable inode number mapping"
	default n
	depends on OVERLAY_FS
	depends on 64BIT
	help
	  If this config option is enabled then overlay filesystems will use
	  unused high bits in undelying filesystem inode numbers to map all
	  inodes to a unified address space.  The mapped 64bit inode numbers
	  might not be compatible with applications that expect 32bit inodes.

	  If compatibility with applications that expect 32bit inodes is not an
	  issue, then it is safe and recommended to say Y here.

	  For more information, see Documentation/filesystems/overlayfs.rst

	  If unsure, say N.

config OVERLAY_FS_METACOPY
	bool "Overlayfs: turn on metadata only copy up feature by default"
	depends on OVERLAY_FS
	select OVERLAY_FS_REDIRECT_DIR
	help
	  If this config option is enabled then overlay filesystems will
	  copy up only metadata where appropriate and data copy up will
	  happen when a file is opened for WRITE operation. It is still
	  possible to turn off this feature globally with the "metacopy=off"
	  module option or on a filesystem instance basis with the
	  "metacopy=off" mount option.

	  Note, that this feature is not backward compatible.  That is,
	  mounting an overlay which has metacopy only inodes on a kernel
	  that doesn't support this feature will have unexpected results.

	  If unsure, say N.
```
