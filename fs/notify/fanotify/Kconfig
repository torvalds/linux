## fs/romfs/Kconfig
```kconfig
# SPDX-License-Identifier: GPL-2.0-only
config ROMFS_FS
	tristate "ROM file system support"
	depends on BLOCK || MTD
	---help---
	  This is a very small read-only file system mainly intended for
	  initial ram disks of installation disks, but it could be used for
	  other read-only media as well.  Read
	  <file:Documentation/filesystems/romfs.txt> for details.

	  To compile this file system support as a module, choose M here: the
	  module will be called romfs.  Note that the file system of your
	  root partition (the one containing the directory /) cannot be a
	  module.

	  If you don't know whether you need it, then you don't need it:
	  answer N.

#
# Select the backing stores to be supported
#
choice
	prompt "RomFS backing stores"
	depends on ROMFS_FS
	default ROMFS_BACKED_BY_BLOCK
	help
	  Select the backing stores to be supported.

config ROMFS_BACKED_BY_BLOCK
	bool "Block device-backed ROM file system support"
	depends on BLOCK
	help
	  This permits ROMFS to use block devices buffered through the page
	  cache as the medium from which to retrieve data.  It does not allow
	  direct mapping of the medium.

	  If unsure, answer Y.

config ROMFS_BACKED_BY_MTD
	bool "MTD-backed ROM file system support"
	depends on MTD=y || (ROMFS_FS=m && MTD)
	help
	  This permits ROMFS to use MTD based devices directly, without the
	  intercession of the block layer (which may have been disabled).  It
	  also allows direct mapping of MTD devices through romfs files under
	  NOMMU conditions if the underlying device is directly addressable by
	  the CPU.

	  If unsure, answer Y.

config ROMFS_BACKED_BY_BOTH
	bool "Both the above"
	depends on BLOCK && (MTD=y || (ROMFS_FS=m && MTD))
endchoice


config ROMFS_ON_BLOCK
	bool
	default y if ROMFS_BACKED_BY_BLOCK || ROMFS_BACKED_BY_BOTH

config ROMFS_ON_MTD
	bool
	default y if ROMFS_BACKED_BY_MTD || ROMFS_BACKED_BY_BOTH
```

## fs/sdcardfs/Kconfig
```kconfig
config SDCARD_FS
	tristate "sdcard file system"
	depends on EXPERIMENTAL
	default n
	help
	  Sdcardfs is based on Wrapfs file system.

config SDCARD_FS_FADV_NOACTIVE
	bool "sdcardfs fadvise noactive support"
	depends on FADV_NOACTIVE
	default y
	help
	  Sdcardfs supports fadvise noactive mode.

config SDCARD_FS_CI_SEARCH
	tristate "sdcardfs case-insensitive search support"
	depends on SDCARD_FS
	default y
```

## fs/smb/Kconfig
```kconfig
# SPDX-License-Identifier: GPL-2.0-only
#
# smbfs configuration

source "fs/smb/client/Kconfig"
source "fs/smb/server/Kconfig"

config SMBFS
	tristate
	default y if CIFS=y || SMB_SERVER=y
	default m if CIFS=m || SMB_SERVER=m

config SMB_KUNIT_TESTS
	tristate "KUnit tests for SMB" if !KUNIT_ALL_TESTS
	depends on SMBFS && KUNIT
	default KUNIT_ALL_TESTS
	help
	  This builds the SMB KUnit tests.

	  KUnit tests run during boot and output the results to the debug log
	  in TAP format (https://testanything.org/). Only useful for kernel devs
	  running KUnit test harness and are not for inclusion into a production
	  build.

	  For more information on KUnit and unit tests in general please refer
	  to the KUnit documentation in Documentation/dev-tools/kunit/.

	  If unsure, say N.
```

## fs/smb/common/smbdirect/Kconfig
```kconfig
# SPDX-License-Identifier: GPL-2.0-or-later
#
# smbdirect configuration

config SMB_COMMON_SMBDIRECT
	def_tristate n
	depends on INFINIBAND && INFINIBAND_ADDR_TRANS
	depends on m || INFINIBAND=y
	select SG_POOL
```

## fs/smb/server/Kconfig
```kconfig
config SMB_SERVER
	tristate "SMB3 server support"
	depends on INET
	depends on MULTIUSER
	depends on FILE_LOCKING
	select NLS
	select NLS_UTF8
	select CRYPTO
	select CRYPTO_MD5
	select CRYPTO_HMAC
	select CRYPTO_ECB
	select CRYPTO_LIB_DES
	select CRYPTO_SHA256
	select CRYPTO_CMAC
	select CRYPTO_SHA512
	select CRYPTO_AEAD2
	select CRYPTO_CCM
	select CRYPTO_GCM
	select ASN1
	select OID_REGISTRY
	select CRC32
	default n
	help
	  Choose Y here if you want to allow SMB3 compliant clients
	  to access files residing on this system using SMB3 protocol.
	  To compile the SMB3 server support as a module,
	  choose M here: the module will be called ksmbd.

	  You may choose to use a samba server instead, in which
	  case you can choose N here.

	  You also need to install user space programs which can be found
	  in ksmbd-tools, available from
	  https://github.com/cifsd-team/ksmbd-tools.
	  More detail about how to run the ksmbd kernel server is
	  available via the README file
	  (https://github.com/cifsd-team/ksmbd-tools/blob/master/README).

	  ksmbd kernel server includes support for auto-negotiation,
	  Secure negotiate, Pre-authentication integrity, oplock/lease,
	  compound requests, multi-credit, packet signing, RDMA(smbdirect),
	  smb3 encryption, copy-offload, secure per-user session
	  establishment via Kerberos or NTLMv2.

if SMB_SERVER

config SMB_SERVER_SMBDIRECT
	bool "Support for SMB Direct protocol"
	depends on SMB_SERVER=m && INFINIBAND && INFINIBAND_ADDR_TRANS || SMB_SERVER=y && INFINIBAND=y && INFINIBAND_ADDR_TRANS=y
	select SG_POOL
	default n

	help
	  Enables SMB Direct support for SMB 3.0, 3.02 and 3.1.1.

	  SMB Direct allows transferring SMB packets over RDMA. If unsure,
	  say N.

endif

config SMB_SERVER_CHECK_CAP_NET_ADMIN
	bool "Enable check network administration capability"
	depends on SMB_SERVER
	default y

	help
	  Prevent unprivileged processes to start the ksmbd kernel server.

config SMB_SERVER_KERBEROS5
	bool "Support for Kerberos 5"
	depends on SMB_SERVER
	default n
```

## fs/smbfs/Kconfig
```kconfig
config SMB_FS
	tristate "SMB file system support (OBSOLETE, please use CIFS)"
	depends on BKL # probably unfixable
	depends on INET
	select NLS
	help
	  SMB (Server Message Block) is the protocol Windows for Workgroups
	  (WfW), Windows 95/98, Windows NT and OS/2 Lan Manager use to share
	  files and printers over local networks.  Saying Y here allows you to
	  mount their file systems (often called "shares" in this context) and
	  access them just like any other Unix directory.  Currently, this
	  works only if the Windows machines use TCP/IP as the underlying
	  transport protocol, and not NetBEUI.  For details, read
	  <file:Documentation/filesystems/smbfs.txt> and the SMB-HOWTO,
	  available from <http://www.tldp.org/docs.html#howto>.

	  Note: if you just want your box to act as an SMB *server* and make
	  files and printing services available to Windows clients (which need
	  to have a TCP/IP stack), you don't need to say Y here; you can use
	  the program SAMBA (available from <ftp://ftp.samba.org/pub/samba/>)
	  for that.

	  General information about how to connect Linux, Windows machines and
	  Macs is on the WWW at <http://www.eats.com/linux_mac_win.html>.

	  To compile the SMB support as a module, choose M here:
	  the module will be called smbfs.  Most people say N, however.

config SMB_NLS_DEFAULT
	bool "Use a default NLS"
	depends on SMB_FS
	help
	  Enabling this will make smbfs use nls translations by default. You
	  need to specify the local charset (CONFIG_NLS_DEFAULT) in the nls
	  settings and you need to give the default nls for the SMB server as
	  CONFIG_SMB_NLS_REMOTE.

	  The nls settings can be changed at mount time, if your smbmount
	  supports that, using the codepage and iocharset parameters.

	  smbmount from samba 2.2.0 or later supports this.

config SMB_NLS_REMOTE
	string "Default Remote NLS Option"
	depends on SMB_NLS_DEFAULT
	default "cp437"
	help
	  This setting allows you to specify a default value for which
	  codepage the server uses. If this field is left blank no
	  translations will be done by default. The local codepage/charset
	  default to CONFIG_NLS_DEFAULT.

	  The nls settings can be changed at mount time, if your smbmount
	  supports that, using the codepage and iocharset parameters.

	  smbmount from samba 2.2.0 or later supports this.
```

## fs/squashfs/Kconfig
```kconfig
config SQUASHFS
	tristate "SquashFS 4.0 - Squashed file system support"
	depends on BLOCK
	help
	  Saying Y here includes support for SquashFS 4.0 (a Compressed
	  Read-Only File System).  Squashfs is a highly compressed read-only
	  filesystem for Linux.  It uses zlib, lzo or xz compression to
	  compress both files, inodes and directories.  Inodes in the system
	  are very small and all blocks are packed to minimise data overhead.
	  Block sizes greater than 4K are supported up to a maximum of 1 Mbytes
	  (default block size 128K).  SquashFS 4.0 supports 64 bit filesystems
	  and files (larger than 4GB), full uid/gid information, hard links and
	  timestamps.

	  Squashfs is intended for general read-only filesystem use, for
	  archival use (i.e. in cases where a .tar.gz file may be used), and in
	  embedded systems where low overhead is needed.  Further information
	  and tools are available from http://squashfs.sourceforge.net.

	  If you want to compile this as a module ( = code which can be
	  inserted in and removed from the running kernel whenever you want),
	  say M here.  The module will be called squashfs.  Note that the root
	  file system (the one containing the directory /) cannot be compiled
	  as a module.

	  If unsure, say N.

choice
	prompt "Decompressor parallelisation options"
	depends on SQUASHFS
	help
	  Squashfs now supports three parallelisation options for
	  decompression.  Each one exhibits various trade-offs between
	  decompression performance and CPU and memory usage.

	  If in doubt, select "Single threaded compression"

config SQUASHFS_DECOMP_SINGLE
	bool "Single threaded compression"
	help
	  Traditionally Squashfs has used single-threaded decompression.
	  Only one block (data or metadata) can be decompressed at any
	  one time.  This limits CPU and memory usage to a minimum.

config SQUASHFS_DECOMP_MULTI
	bool "Use multiple decompressors for parallel I/O"
	help
	  By default Squashfs uses a single decompressor but it gives
	  poor performance on parallel I/O workloads when using multiple CPU
	  machines due to waiting on decompressor availability.

	  If you have a parallel I/O workload and your system has enough memory,
	  using this option may improve overall I/O performance.

	  This decompressor implementation uses up to two parallel
	  decompressors per core.  It dynamically allocates decompressors
	  on a demand basis.

config SQUASHFS_DECOMP_MULTI_PERCPU
	bool "Use percpu multiple decompressors for parallel I/O"
	help
	  By default Squashfs uses a single decompressor but it gives
	  poor performance on parallel I/O workloads when using multiple CPU
	  machines due to waiting on decompressor availability.

	  This decompressor implementation uses a maximum of one
	  decompressor per core.  It uses percpu variables to ensure
	  decompression is load-balanced across the cores.

endchoice

config SQUASHFS_XATTR
	bool "Squashfs XATTR support"
	depends on SQUASHFS
	help
	  Saying Y here includes support for extended attributes (xattrs).
	  Xattrs are name:value pairs associated with inodes by
	  the kernel or by users (see the attr(5) manual page).

	  If unsure, say N.

config SQUASHFS_ZLIB
	bool "Include support for ZLIB compressed file systems"
	depends on SQUASHFS
	select ZLIB_INFLATE
	default y
	help
	  ZLIB compression is the standard compression used by Squashfs
	  file systems.  It offers a good trade-off between compression
	  achieved and the amount of CPU time and memory necessary to
	  compress and decompress.

	  If unsure, say Y.

config SQUASHFS_LZ4
	bool "Include support for LZ4 compressed file systems"
	depends on SQUASHFS
	select LZ4_DECOMPRESS
	help
	  Saying Y here includes support for reading Squashfs file systems
	  compressed with LZ4 compression.  LZ4 compression is mainly
	  aimed at embedded systems with slower CPUs where the overheads
	  of zlib are too high.

	  LZ4 is not the standard compression used in Squashfs and so most
	  file systems will be readable without selecting this option.

	  If unsure, say N.

config SQUASHFS_LZO
	bool "Include support for LZO compressed file systems"
	depends on SQUASHFS
	select LZO_DECOMPRESS
	help
	  Saying Y here includes support for reading Squashfs file systems
	  compressed with LZO compression.  LZO compression is mainly
	  aimed at embedded systems with slower CPUs where the overheads
	  of zlib are too high.

	  LZO is not the standard compression used in Squashfs and so most
	  file systems will be readable without selecting this option.

	  If unsure, say N.

config SQUASHFS_XZ
	bool "Include support for XZ compressed file systems"
	depends on SQUASHFS
	select XZ_DEC
	help
	  Saying Y here includes support for reading Squashfs file systems
	  compressed with XZ compression.  XZ gives better compression than
	  the default zlib compression, at the expense of greater CPU and
	  memory overhead.

	  XZ is not the standard compression used in Squashfs and so most
	  file systems will be readable without selecting this option.

	  If unsure, say N.

config SQUASHFS_4K_DEVBLK_SIZE
	bool "Use 4K device block size?"
	depends on SQUASHFS
	help
	  By default Squashfs sets the dev block size (sb_min_blocksize)
	  to 1K or the smallest block size supported by the block device
	  (if larger).  This, because blocks are packed together and
	  unaligned in Squashfs, should reduce latency.

	  This, however, gives poor performance on MTD NAND devices where
	  the optimal I/O size is 4K (even though the devices can support
	  smaller block sizes).

	  Using a 4K device block size may also improve overall I/O
	  performance for some file access patterns (e.g. sequential
	  accesses of files in filesystem order) on all media.

	  Setting this option will force Squashfs to use a 4K device block
	  size by default.

	  If unsure, say N.

config SQUASHFS_EMBEDDED
	bool "Additional option for memory-constrained systems"
	depends on SQUASHFS
	help
	  Saying Y here allows you to specify cache size.

	  If unsure, say N.

config SQUASHFS_FRAGMENT_CACHE_SIZE
	int "Number of fragments cached" if SQUASHFS_EMBEDDED
	depends on SQUASHFS
	default "3"
	help
	  By default SquashFS caches the last 3 fragments read from
	  the filesystem.  Increasing this amount may mean SquashFS
	  has to re-read fragments less often from disk, at the expense
	  of extra system memory.  Decreasing this amount will mean
	  SquashFS uses less memory at the expense of extra reads from disk.

	  Note there must be at least one cached fragment.  Anything
	  much more than three will probably not make much difference.
```

## fs/sysfs/Kconfig
```kconfig
config SYSFS
	bool "sysfs file system support" if EXPERT
	default y
	select KERNFS
	help
	The sysfs filesystem is a virtual filesystem that the kernel uses to
	export internal kernel objects, their attributes, and their
	relationships to one another.

	Users can use sysfs to ascertain useful information about the running
	kernel, such as the devices the kernel has discovered on each bus and
	which driver each is bound to. sysfs can also be used to tune devices
	and other kernel subsystems.

	Some system agents rely on the information in sysfs to operate.
	/sbin/hotplug uses device and object attributes in sysfs to assist in
	delegating policy decisions, like persistently naming devices.

	sysfs is currently used by the block subsystem to mount the root
	partition.  If sysfs is disabled you must specify the boot device on
	the kernel boot command line via its major and minor numbers.  For
	example, "root=03:01" for /dev/hda1.

	Designers of embedded systems may wish to say N here to conserve space.
```
