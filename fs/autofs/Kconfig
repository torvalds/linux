## fs/crypto/Kconfig
```kconfig
# SPDX-License-Identifier: GPL-2.0-only
config FS_ENCRYPTION
	bool "FS Encryption (Per-file encryption)"
	select CRYPTO
	select CRYPTO_HASH
	select CRYPTO_SKCIPHER
	select CRYPTO_LIB_SHA256
	select KEYS
	help
	  Enable encryption of files and directories.  This
	  feature is similar to ecryptfs, but it is more memory
	  efficient since it avoids caching the encrypted and
	  decrypted pages in the page cache.  Currently Ext4,
	  F2FS, UBIFS, and CephFS make use of this feature.

# Filesystems supporting encryption must select this if FS_ENCRYPTION.  This
# allows the algorithms to be built as modules when all the filesystems are,
# whereas selecting them from FS_ENCRYPTION would force them to be built-in.
#
# Note: this option only pulls in the algorithms that filesystem encryption
# needs "by default".  If userspace will use "non-default" encryption modes such
# as Adiantum encryption, then those other modes need to be explicitly enabled
# in the crypto API; see Documentation/filesystems/fscrypt.rst for details.
#
# Also note that this option only pulls in the generic implementations of the
# algorithms, not any per-architecture optimized implementations.  It is
# strongly recommended to enable optimized implementations too.  It is safe to
# disable these generic implementations if corresponding optimized
# implementations will always be available too; for this reason, these are soft
# dependencies ('imply' rather than 'select').  Only disable these generic
# implementations if you're sure they will never be needed, though.
config FS_ENCRYPTION_ALGS
	tristate
	imply CRYPTO_AES
	imply CRYPTO_CBC
	imply CRYPTO_CTS
	imply CRYPTO_ECB
	imply CRYPTO_HMAC
	imply CRYPTO_SHA512
	imply CRYPTO_XTS

config FS_ENCRYPTION_INLINE_CRYPT
	bool "Enable fscrypt to use inline crypto"
	depends on FS_ENCRYPTION && BLK_INLINE_ENCRYPTION
	help
	  Enable fscrypt to use inline encryption hardware if available.
```

## fs/dlm/Kconfig
```kconfig
# SPDX-License-Identifier: GPL-2.0-only
menuconfig DLM
	tristate "Distributed Lock Manager (DLM)"
	depends on INET
	depends on SYSFS && CONFIGFS_FS && (IPV6 || IPV6=n)
	help
	A general purpose distributed lock manager for kernel or userspace
	applications.

config DLM_DEBUG
	bool "DLM debugging"
	depends on DLM
	help
	Under the debugfs mount point, the name of each lockspace will
	appear as a file in the "dlm" directory.  The output is the
	list of resource and locks the local node knows about.
```

## fs/ecryptfs/Kconfig
```kconfig
# SPDX-License-Identifier: GPL-2.0-only
config ECRYPT_FS
	tristate "eCrypt filesystem layer support"
	depends on KEYS && CRYPTO && (ENCRYPTED_KEYS || ENCRYPTED_KEYS=n)
	select CRYPTO_ECB
	select CRYPTO_CBC
	select CRYPTO_MD5
	help
	  Encrypted filesystem that operates on the VFS layer.  See
	  <file:Documentation/filesystems/ecryptfs.txt> to learn more about
	  eCryptfs.  Userspace components are required and can be
	  obtained from <http://ecryptfs.sf.net>.

	  To compile this file system support as a module, choose M here: the
	  module will be called ecryptfs.

config ECRYPT_FS_MESSAGING
	bool "Enable notifications for userspace key wrap/unwrap"
	depends on ECRYPT_FS
	help
	  Enables the /dev/ecryptfs entry for use by ecryptfsd. This allows
	  for userspace to wrap/unwrap file encryption keys by other
	  backends, like OpenSSL.
```

## fs/efivarfs/Kconfig
```kconfig
config EFIVAR_FS
	tristate "EFI Variable filesystem"
	depends on EFI
	help
	  efivarfs is a replacement filesystem for the old EFI
	  variable support via sysfs, as it doesn't suffer from the
	  same 1024-byte variable size limit.

	  To compile this file system support as a module, choose M
	  here. The module will be called efivarfs.

	  If unsure, say N.
```

## fs/efs/Kconfig
```kconfig
config EFS_FS
	tristate "EFS file system support (read only)"
	depends on BLOCK
	help
	  EFS is an older file system used for non-ISO9660 CD-ROMs and hard
	  disk partitions by SGI's IRIX operating system (IRIX 6.0 and newer
	  uses the XFS file system for hard disk partitions however).

	  This implementation only offers read-only access. If you don't know
	  what all this is about, it's safe to say N. For more information
	  about EFS see its home page at <http://aeschi.ch.eu.org/efs/>.

	  To compile the EFS file system support as a module, choose M here: the
	  module will be called efs.
```

## fs/erofs/Kconfig
```kconfig
# SPDX-License-Identifier: GPL-2.0-only

config EROFS_FS
	tristate "EROFS filesystem support"
	depends on BLOCK
	select CACHEFILES if EROFS_FS_ONDEMAND
	select CRC32
	select CRYPTO if EROFS_FS_ZIP_ACCEL
	select CRYPTO_DEFLATE if EROFS_FS_ZIP_ACCEL
	select FS_IOMAP
	select LZ4_DECOMPRESS if EROFS_FS_ZIP
	select NETFS_SUPPORT if EROFS_FS_ONDEMAND
	select XXHASH if EROFS_FS_XATTR
	select XZ_DEC if EROFS_FS_ZIP_LZMA
	select XZ_DEC_MICROLZMA if EROFS_FS_ZIP_LZMA
	select ZLIB_INFLATE if EROFS_FS_ZIP_DEFLATE
	select ZSTD_DECOMPRESS if EROFS_FS_ZIP_ZSTD
	help
	  EROFS (Enhanced Read-Only File System) is a modern, lightweight,
	  secure read-only filesystem for various use cases, such as immutable
	  system images, container images, application sandboxes, and datasets.

	  EROFS uses a flexible, hierarchical on-disk design so that features
	  can be enabled on demand: the core on-disk format is block-aligned in
	  order to perform optimally on all kinds of devices, including block
	  and memory-backed devices; the format is easy to parse and has zero
	  metadata redundancy, unlike generic filesystems, making it ideal for
	  filesystem auditing and remote access; inline data, random-access
	  friendly directory data, inline/shared extended attributes and
	  chunk-based deduplication ensure space efficiency while maintaining
	  high performance.

	  Optionally, it supports multiple devices to reference external data,
	  enabling data sharing for container images.

	  It also has advanced encoded on-disk layouts, particularly for data
	  compression and fine-grained deduplication. It utilizes fixed-size
	  output compression to improve storage density while keeping relatively
	  high compression ratios. Furthermore, it implements in-place
	  decompression to reuse file pages to keep compressed data temporarily
	  with proper strategies, which ensures guaranteed end-to-end runtime
	  performance under extreme memory pressure without extra cost.

	  For more details, see the web pages at <https://erofs.docs.kernel.org>
	  and the documentation at <file:Documentation/filesystems/erofs.rst>.

	  To compile EROFS filesystem support as a module, choose M here. The
	  module will be called erofs.

	  If unsure, say N.

config EROFS_FS_DEBUG
	bool "EROFS debugging feature"
	depends on EROFS_FS
	help
	  Print debugging messages and enable more BUG_ONs which check
	  filesystem consistency and find potential issues aggressively,
	  which can be used for Android eng build, for example.

	  For daily use, say N.

config EROFS_FS_XATTR
	bool "EROFS extended attributes"
	depends on EROFS_FS
	default y
	help
	  Extended attributes are name:value pairs associated with inodes by
	  the kernel or by users (see the attr(5) manual page, or visit
	  <http://acl.bestbits.at/> for details).

	  If unsure, say N.

config EROFS_FS_POSIX_ACL
	bool "EROFS Access Control Lists"
	depends on EROFS_FS_XATTR
	select FS_POSIX_ACL
	default y
	help
	  Posix Access Control Lists (ACLs) support permissions for users and
	  groups beyond the owner/group/world scheme.

	  To learn more about Access Control Lists, visit the POSIX ACLs for
	  Linux website <http://acl.bestbits.at/>.

	  If you don't know what Access Control Lists are, say N.

config EROFS_FS_SECURITY
	bool "EROFS Security Labels"
	depends on EROFS_FS_XATTR
	default y
	help
	  Security labels provide an access control facility to support Linux
	  Security Models (LSMs) accepted by AppArmor, SELinux, Smack and TOMOYO
	  Linux. This option enables an extended attribute handler for file
	  security labels in the erofs filesystem, so that it requires enabling
	  the extended attribute support in advance.

	  If you are not using a security module, say N.

config EROFS_FS_BACKED_BY_FILE
	bool "File-backed EROFS filesystem support"
	depends on EROFS_FS
	default y
	help
	  This allows EROFS to use filesystem image files directly, without
	  the intercession of loopback block devices or likewise. It is
	  particularly useful for container images with numerous blobs and
	  other sandboxes, where loop devices behave intricately.  It can also
	  be used to simplify error-prone lifetime management of unnecessary
	  virtual block devices.

	  Note that this feature, along with ongoing fanotify pre-content
	  hooks, will eventually replace "EROFS over fscache."

	  If you don't want to enable this feature, say N.

config EROFS_FS_ZIP
	bool "EROFS Data Compression Support"
	depends on EROFS_FS
	default y
	help
	  Enable EROFS compression layouts so that filesystems containing
	  compressed files can be parsed by the kernel.

	  If you don't want to enable compression feature, say N.

config EROFS_FS_ZIP_LZMA
	bool "EROFS LZMA compressed data support"
	depends on EROFS_FS_ZIP
	default y
	help
	  Saying Y here includes support for reading EROFS file systems
	  containing LZMA compressed data, specifically called microLZMA. It
	  gives better compression ratios than the default LZ4 format, at the
	  expense of more CPU overhead.

	  Say N if you want to disable LZMA compression support.

config EROFS_FS_ZIP_DEFLATE
	bool "EROFS DEFLATE compressed data support"
	depends on EROFS_FS_ZIP
	help
	  Saying Y here includes support for reading EROFS file systems
	  containing DEFLATE compressed data.  It gives better compression
	  ratios than the default LZ4 format, while it costs more CPU
	  overhead.

	  If unsure, say N.

config EROFS_FS_ZIP_ZSTD
	bool "EROFS Zstandard compressed data support"
	depends on EROFS_FS_ZIP
	help
	  Saying Y here includes support for reading EROFS file systems
	  containing Zstandard compressed data.  It gives better compression
	  ratios than the default LZ4 format, while it costs more CPU
	  overhead and memory footprint.

	  If unsure, say N.

config EROFS_FS_ZIP_ACCEL
	bool "EROFS hardware decompression support"
	depends on EROFS_FS_ZIP
	help
	  Saying Y here includes hardware accelerator support for reading
	  EROFS file systems containing compressed data.  It gives better
	  decompression speed than the software-implemented decompression, and
	  it costs lower CPU overhead.

	  Hardware accelerator support is an experimental feature for now and
	  file systems are still readable without selecting this option.

	  If unsure, say N.

config EROFS_FS_ONDEMAND
	bool "EROFS fscache-based on-demand read support (deprecated)"
	depends on EROFS_FS
	select FSCACHE
	select CACHEFILES_ONDEMAND
	help
	  This permits EROFS to use fscache-backed data blobs with on-demand
	  read support.

	  It is now deprecated and scheduled to be removed from the kernel
	  after fanotify pre-content hooks are landed.

	  If unsure, say N.

config EROFS_FS_PCPU_KTHREAD
	bool "EROFS per-cpu decompression kthread workers"
	depends on EROFS_FS_ZIP
	help
	  Saying Y here enables per-CPU kthread workers pool to carry out
	  async decompression for low latencies on some architectures.

	  If unsure, say N.

config EROFS_FS_PCPU_KTHREAD_HIPRI
	bool "EROFS high priority per-CPU kthread workers"
	depends on EROFS_FS_ZIP && EROFS_FS_PCPU_KTHREAD
	default y
	help
	  This permits EROFS to configure per-CPU kthread workers to run
	  at higher priority.

	  If unsure, say N.

config EROFS_FS_PAGE_CACHE_SHARE
	bool "EROFS page cache share support (experimental)"
	depends on EROFS_FS && EROFS_FS_XATTR && !EROFS_FS_ONDEMAND
	help
	  This enables page cache sharing among inodes with identical
	  content fingerprints on the same machine.

	  If unsure, say N.
```

## fs/exfat/Kconfig
```kconfig
# SPDX-License-Identifier: GPL-2.0-or-later

config EXFAT_FS
	tristate "exFAT filesystem support"
	select NLS
	help
	  This allows you to mount devices formatted with the exFAT file system.
	  exFAT is typically used on SD-Cards or USB sticks.

	  To compile this as a module, choose M here: the module will be called
	  exfat.

config EXFAT_DEFAULT_IOCHARSET
	string "Default iocharset for exFAT"
	default "utf8"
	depends on EXFAT_FS
	help
	  Set this to the default input/output character set to use for
	  converting between the encoding is used for user visible filename and
	  UTF-16 character that exfat filesystem use, and can be overridden with
	  the "iocharset" mount option for exFAT filesystems.
```

## fs/exofs/Kconfig
```kconfig
# Note ORE needs to "select ASYNC_XOR". So Not to force multiple selects
# for every ORE user we do it like this. Any user should add itself here
# at the "depends on EXOFS_FS || ..." with an ||. The dependencies are
# selected here, and we default to "ON". So in effect it is like been
# selected by any of the users.
config ORE
	tristate
	depends on EXOFS_FS || PNFS_OBJLAYOUT
	select ASYNC_XOR
	default SCSI_OSD_ULD

config EXOFS_FS
	tristate "exofs: OSD based file system support"
	depends on SCSI_OSD_ULD
	help
	  EXOFS is a file system that uses an OSD storage device,
	  as its backing storage.

# Debugging-related stuff
config EXOFS_DEBUG
	bool "Enable debugging"
	depends on EXOFS_FS
	help
	  This option enables EXOFS debug prints.
```

## fs/exofs/Kconfig.ore
```kconfig
# ORE - Objects Raid Engine (libore.ko)
#
# Note ORE needs to "select ASYNC_XOR". So Not to force multiple selects
# for every ORE user we do it like this. Any user should add itself here
# at the "depends on EXOFS_FS || ..." with an ||. The dependencies are
# selected here, and we default to "ON". So in effect it is like been
# selected by any of the users.
config ORE
	tristate
	depends on EXOFS_FS || PNFS_OBJLAYOUT
	select ASYNC_XOR
	select RAID6_PQ
	select ASYNC_PQ
	default SCSI_OSD_ULD
```

## fs/ext2/Kconfig
```kconfig
# SPDX-License-Identifier: GPL-2.0-only
config EXT2_FS
	tristate "Second extended fs support (DEPRECATED)"
	select BUFFER_HEAD
	select FS_IOMAP
	select LEGACY_DIRECT_IO
	help
	  Ext2 is a standard Linux file system for hard disks.

	  This filesystem driver is deprecated because it does not properly
	  support inode time stamps beyond 03:14:07 UTC on 19 January 2038.

	  Ext2 users are advised to use ext4 driver to access their filesystem.
	  The driver is fully compatible, supports filesystems without journal
          or extents, and also supports larger time stamps if the filesystem
          is created with at least 256 byte inodes.

	  This code is kept as a simple reference for filesystem developers.

	  If unsure, say N.

config EXT2_FS_XATTR
	bool "Ext2 extended attributes"
	depends on EXT2_FS
	help
	  Extended attributes are name:value pairs associated with inodes by
	  the kernel or by users (see the attr(5) manual page for details).

	  If unsure, say N.

config EXT2_FS_POSIX_ACL
	bool "Ext2 POSIX Access Control Lists"
	depends on EXT2_FS_XATTR
	select FS_POSIX_ACL
	help
	  Posix Access Control Lists (ACLs) support permissions for users and
	  groups beyond the owner/group/world scheme.

	  If you don't know what Access Control Lists are, say N

config EXT2_FS_SECURITY
	bool "Ext2 Security Labels"
	depends on EXT2_FS_XATTR
	help
	  Security labels support alternative access control models
	  implemented by security modules like SELinux.  This option
	  enables an extended attribute handler for file security
	  labels in the ext2 filesystem.

	  If you are not using a security module that requires using
	  extended attributes for file security labels, say N.
```
