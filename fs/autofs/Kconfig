## fs/autofs/Kconfig
```kconfig
# SPDX-License-Identifier: GPL-2.0-only
config AUTOFS4_FS
	tristate "Old Kconfig name for Kernel automounter support"
	select AUTOFS_FS
	help
	   This name exists for people to just automatically pick up the
	   new name of the autofs Kconfig option. All it does is select
	   the new option name.

	   It will go away in a release or two as people have
	   transitioned to just plain AUTOFS_FS.

config AUTOFS_FS
	tristate "Kernel automounter support (supports v3, v4 and v5)"
	default n
	help
	   The automounter is a tool to automatically mount remote file systems
	   on demand. This implementation is partially kernel-based to reduce
	   overhead in the already-mounted case; this is unlike the BSD
	   automounter (amd), which is a pure user space daemon.

	   To use the automounter you need the user-space tools from
	   <https://www.kernel.org/pub/linux/daemons/autofs/>; you also want
	   to answer Y to "NFS file system support", below.

	   To compile this support as a module, choose M here: the module will be
	   called autofs.

	   If you are not a part of a fairly large, distributed network or
	   don't have a laptop which needs to dynamically reconfigure to the
	   local network, you probably do not need an automounter, and can say
	   N here.
```

## fs/autofs4/Kconfig
```kconfig
config AUTOFS4_FS
	tristate "Kernel automounter version 4 support (also supports v3 and v5)"
	default n
	depends on AUTOFS_FS = n
	help
	  The automounter is a tool to automatically mount remote file systems
	  on demand. This implementation is partially kernel-based to reduce
	  overhead in the already-mounted case; this is unlike the BSD
	  automounter (amd), which is a pure user space daemon.

	  To use the automounter you need the user-space tools from
	  <https://www.kernel.org/pub/linux/daemons/autofs/>; you also want
	  to answer Y to "NFS file system support", below.

	  This module is in the process of being renamed from autofs4 to
	  autofs. Since autofs is now the only module that provides the
	  autofs file system the module is not version 4 specific.

	  The autofs4 module is now built from the source located in
	  fs/autofs. The autofs4 directory and its configuration entry
	  will be removed two kernel versions from the inclusion of this
	  change.

	  Changes that will need to be made should be limited to:
	  - source include statments should be changed from autofs_fs4.h to
	    autofs_fs.h since these two header files have been merged.
	  - user space scripts that manually load autofs4.ko should be
	    changed to load autofs.ko. But since the module directory name
	    and the module name are the same as the file system name there
	    is no need to manually load module.
	  - any "alias autofs autofs4" will need to be removed.
	  - due to the autofs4 module directory name not being the same as
	    its file system name autoloading didn't work properly. Because
	    of this kernel configurations would often build the module into
	    the kernel. This may have resulted in selinux policies that will
	    prevent the autofs module from autoloading and will need to be
	    updated.

	  Please configure AUTOFS_FS instead of AUTOFS4_FS from now on.

	  NOTE: Since the modules autofs and autofs4 use the same file system
		type name of "autofs" only one can be built. The "depends"
		above will result in AUTOFS4_FS not appearing in .config for
		any setting of AUTOFS_FS other than n and AUTOFS4_FS will
		appear under the AUTOFS_FS entry otherwise which is intended
		to draw attention to the module rename change.
```

## fs/bcachefs/Kconfig
```kconfig
config BCACHEFS_FS
	tristate "bcachefs filesystem support (EXPERIMENTAL)"
	depends on BLOCK
	select EXPORTFS
	select CLOSURES
	select LIBCRC32C
	select CRC64
	select FS_POSIX_ACL
	select LZ4_COMPRESS
	select LZ4_DECOMPRESS
	select LZ4HC_COMPRESS
	select LZ4HC_DECOMPRESS
	select ZLIB_DEFLATE
	select ZLIB_INFLATE
	select ZSTD_COMPRESS
	select ZSTD_DECOMPRESS
	select CRYPTO
	select CRYPTO_SHA256
	select CRYPTO_CHACHA20
	select CRYPTO_POLY1305
	select KEYS
	select RAID6_PQ
	select XOR_BLOCKS
	select XXHASH
	select SRCU
	select SYMBOLIC_ERRNAME
	select MIN_HEAP
	help
	The bcachefs filesystem - a modern, copy on write filesystem, with
	support for multiple devices, compression, checksumming, etc.

config BCACHEFS_QUOTA
	bool "bcachefs quota support"
	depends on BCACHEFS_FS
	select QUOTACTL

config BCACHEFS_ERASURE_CODING
	bool "bcachefs erasure coding (RAID5/6) support (EXPERIMENTAL)"
	depends on BCACHEFS_FS
	select QUOTACTL
	help
	This enables the "erasure_code" filesysystem and inode option, which
	organizes data into reed-solomon stripes instead of ordinary
	replication.

	WARNING: this feature is still undergoing on disk format changes, and
	should only be enabled for testing purposes.

config BCACHEFS_POSIX_ACL
	bool "bcachefs POSIX ACL support"
	depends on BCACHEFS_FS
	select FS_POSIX_ACL

config BCACHEFS_DEBUG
	bool "bcachefs debugging"
	depends on BCACHEFS_FS
	help
	Enables many extra debugging checks and assertions.

	The resulting code will be significantly slower than normal; you
	probably shouldn't select this option unless you're a developer.

config BCACHEFS_INJECT_TRANSACTION_RESTARTS
	bool "Randomly inject transaction restarts"
	depends on BCACHEFS_DEBUG
	help
	Randomly inject transaction restarts in a few core paths - may have a
	significant performance penalty

config BCACHEFS_TESTS
	bool "bcachefs unit and performance tests"
	depends on BCACHEFS_FS
	help
	Include some unit and performance tests for the core btree code

config BCACHEFS_LOCK_TIME_STATS
       bool "bcachefs lock time statistics"
       depends on BCACHEFS_FS
       help
       Expose statistics for how long we held a lock in debugfs

config BCACHEFS_NO_LATENCY_ACCT
	bool "disable latency accounting and time stats"
	depends on BCACHEFS_FS
	help
	This disables device latency tracking and time stats, only for performance testing

config BCACHEFS_SIX_OPTIMISTIC_SPIN
	bool "Optimistic spinning for six locks"
	depends on BCACHEFS_FS
	depends on SMP
	default y
	help
	Instead of immediately sleeping when attempting to take a six lock that
	is held by another thread, spin for a short while, as long as the
	thread owning the lock is running.

config BCACHEFS_PATH_TRACEPOINTS
	bool "Extra btree_path tracepoints"
	depends on BCACHEFS_FS && TRACING
	help
	Enable extra tracepoints for debugging btree_path operations; we don't
	normally want these enabled because they happen at very high rates.

config MEAN_AND_VARIANCE_UNIT_TEST
	tristate "mean_and_variance unit tests" if !KUNIT_ALL_TESTS
	depends on KUNIT
	depends on BCACHEFS_FS
	default KUNIT_ALL_TESTS
	help
	  This option enables the kunit tests for mean_and_variance module.
	  If unsure, say N.
```

## fs/befs/Kconfig
```kconfig
config BEFS_FS
	tristate "BeOS file system (BeFS) support (read only)"
	depends on BLOCK
	select NLS
	help
	  The BeOS File System (BeFS) is the native file system of Be, Inc's
	  BeOS. Notable features include support for arbitrary attributes
	  on files and directories, and database-like indices on selected
	  attributes. (Also note that this driver doesn't make those features
	  available at this time). It is a 64 bit filesystem, so it supports
	  extremely large volumes and files.

	  If you use this filesystem, you should also say Y to at least one
	  of the NLS (native language support) options below.

	  If you don't know what this is about, say N.

	  To compile this as a module, choose M here: the module will be
	  called befs.

config BEFS_DE
	bool "De BeFS"
	depends on BEFS_FS
	help
	  If you say Y here, you can use the 'de' mount option to enable
	  deging output from the driver.
```

## fs/bfs/Kconfig
```kconfig
config BFS_FS
	tristate "BFS file system support"
	depends on BLOCK
	help
	  Boot File System (BFS) is a file system used under SCO UnixWare to
	  allow the bootloader access to the kernel image and other important
	  files during the boot process.  It is usually mounted under /stand
	  and corresponds to the slice marked as "STAND" in the UnixWare
	  partition.  You should say Y if you want to read or write the files
	  on your /stand slice from within Linux.  You then also need to say Y
	  to "UnixWare slices support", below.  More information about the BFS
	  file system is contained in the file
	  <file:Documentation/filesystems/bfs.txt>.

	  If you don't know what this is about, say N.

	  To compile this as a module, choose M here: the module will be called
	  bfs.  Note that the file system of your root partition (the one
	  containing the directory /) cannot be compiled as a module.
```

## fs/btrfs/Kconfig
```kconfig
# SPDX-License-Identifier: GPL-2.0

config BTRFS_FS
	tristate "Btrfs filesystem support"
	select BLK_CGROUP_PUNT_BIO
	select CRC32
	select CRYPTO
	select CRYPTO_CRC32C
	select CRYPTO_XXHASH
	select CRYPTO_SHA256
	select CRYPTO_BLAKE2B
	select ZLIB_INFLATE
	select ZLIB_DEFLATE
	select LZO_COMPRESS
	select LZO_DECOMPRESS
	select ZSTD_COMPRESS
	select ZSTD_DECOMPRESS
	select FS_IOMAP
	select RAID6_PQ
	select XOR_BLOCKS
	depends on PAGE_SIZE_LESS_THAN_256KB

	help
	  Btrfs is a general purpose copy-on-write filesystem with extents,
	  writable snapshotting, support for multiple devices and many more
	  features focused on fault tolerance, repair and easy administration.

	  The filesystem disk format is no longer unstable, and it's not
	  expected to change unless there are strong reasons to do so. If there
	  is a format change, file systems with a unchanged format will
	  continue to be mountable and usable by newer kernels.

	  For more information, please see the web pages at
	  https://btrfs.readthedocs.io

	  To compile this file system support as a module, choose M here. The
	  module will be called btrfs.

	  If unsure, say N.

config BTRFS_FS_POSIX_ACL
	bool "Btrfs POSIX Access Control Lists"
	depends on BTRFS_FS
	select FS_POSIX_ACL
	help
	  POSIX Access Control Lists (ACLs) support permissions for users and
	  groups beyond the owner/group/world scheme.

	  If you don't know what Access Control Lists are, say N

config BTRFS_FS_RUN_SANITY_TESTS
	bool "Btrfs will run sanity tests upon loading"
	depends on BTRFS_FS
	help
	  This will run sanity tests for core functionality like free space,
	  extent maps, extent io, extent buffers, inodes, qgroups and others,
	  at module load time.  These are mostly regression tests and are only
	  interesting to developers.

	  If unsure, say N.

config BTRFS_DEBUG
	bool "Btrfs debugging support"
	depends on BTRFS_FS
	select REF_TRACKER if STACKTRACE_SUPPORT
	help
	  Enable run-time debugging support for the btrfs filesystem.

	  Additional potentially expensive checks, debugging functionality or
	  sysfs exported information is enabled, like leak checks of internal
	  objects, optional forced space fragmentation and /sys/fs/btrfs/debug .
	  This has negative impact on performance.

	  If unsure, say N.

config BTRFS_ASSERT
	bool "Btrfs assert support"
	depends on BTRFS_FS
	help
	  Enable run-time assertion checking. Additional safety checks are
	  done, simple enough not to affect performance but verify invariants
	  and assumptions of code to run properly. This may result in panics,
	  and is meant for developers but can be enabled in general.

	  If unsure, say N.

config BTRFS_EXPERIMENTAL
	bool "Btrfs experimental features"
	depends on BTRFS_FS
	default n
	help
	  Enable experimental features.  These features may not be stable enough
	  for end users.  This is meant for btrfs developers or users who wish
	  to test the functionality and report problems.

	  Current list:

	  - COW fixup worker warning - last warning before removing the
				       functionality catching out-of-band page
				       dirtying, not necessary since 5.8

	  - RAID mirror read policy - additional read policies for balancing
				      reading from redundant block group
				      profiles (currently: pid, round-robin,
				      fixed devid)

	  - send stream protocol v3 - fs-verity support

	  - checksum offload mode - sysfs knob to affect when checksums are
	                            calculated (at IO time, or in a thread)

	  - raid-stripe-tree - additional mapping of extents to devices to
			       support RAID1* profiles on zoned devices,
			       RAID56 not yet supported

	  - extent tree v2 - complex rework of extent tracking

	  - large folio support

	  If unsure, say N.
```

## fs/cachefiles/Kconfig
```kconfig
# SPDX-License-Identifier: GPL-2.0-only

config CACHEFILES
	tristate "Filesystem caching on files"
	depends on NETFS_SUPPORT && FSCACHE && BLOCK
	help
	  This permits use of a mounted filesystem as a cache for other
	  filesystems - primarily networking filesystems - thus allowing fast
	  local disk to enhance the speed of slower devices.

	  See Documentation/filesystems/caching/cachefiles.rst for more
	  information.

config CACHEFILES_DEBUG
	bool "Debug CacheFiles"
	depends on CACHEFILES
	help
	  This permits debugging to be dynamically enabled in the filesystem
	  caching on files module.  If this is set, the debugging output may be
	  enabled by setting bits in /sys/modules/cachefiles/parameter/debug or
	  by including a debugging specifier in /etc/cachefilesd.conf.

config CACHEFILES_ERROR_INJECTION
	bool "Provide error injection for cachefiles"
	depends on CACHEFILES && SYSCTL
	help
	  This permits error injection to be enabled in cachefiles whilst a
	  cache is in service.

config CACHEFILES_ONDEMAND
	bool "Support for on-demand read"
	depends on CACHEFILES
	default n
	help
	  This permits userspace to enable the cachefiles on-demand read mode.
	  In this mode, when a cache miss occurs, responsibility for fetching
	  the data lies with the cachefiles backend instead of with the netfs
	  and is delegated to userspace.

	  If unsure, say N.
```
