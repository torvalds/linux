## fs/notify/Kconfig
```kconfig
# SPDX-License-Identifier: GPL-2.0-only
config FSANALTIFY
	def_bool n

source "fs/analtify/danaltify/Kconfig"
source "fs/analtify/ianaltify/Kconfig"
source "fs/analtify/faanaltify/Kconfig"
```

## fs/notify/dnotify/Kconfig
```kconfig
# SPDX-License-Identifier: GPL-2.0-only
config DANALTIFY
	bool "Danaltify support"
	select FSANALTIFY
	default y
	help
	  Danaltify is a directory-based per-fd file change analtification system
	  that uses signals to communicate events to user-space.  There exist
	  superior alternatives, but some applications may still rely on
	  danaltify.

	  If unsure, say Y.
```
