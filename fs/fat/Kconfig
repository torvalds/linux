## fs/fat/Kconfig
```kconfig
# SPDX-License-Identifier: GPL-2.0-only
config FAT_FS
	tristate
	select NLS
	help
	  If you want to use one of the FAT-based file systems (the MS-DOS and
	  VFAT (Windows 95) file systems), then you must say Y or M here
	  to include FAT support. You will then be able to mount partitions or
	  diskettes with FAT-based file systems and transparently access the
	  files on them, i.e. MSDOS files will look and behave just like all
	  other Unix files.

	  This FAT support is not a file system in itself, it only provides
	  the foundation for the other file systems. You will have to say Y or
	  M to at least one of "MSDOS fs support" or "VFAT fs support" in
	  order to make use of it.

	  Another way to read and write MSDOS floppies and hard drive
	  partitions from within Linux (but not transparently) is with the
	  mtools ("man mtools") program suite. You don't need to say Y here in
	  order to do that.

	  If you need to move large files on floppies between a DOS and a
	  Linux box, say Y here, mount the floppy under Linux with an MSDOS
	  file system and use GNU tar's M option. GNU tar is a program
	  available for Unix and DOS ("man tar" or "info tar").

	  The FAT support will enlarge your kernel by about 37 KB. If unsure,
	  say Y.

	  To compile this as a module, choose M here: the module will be called
	  fat.  Note that if you compile the FAT support as a module, you
	  cannot compile any of the FAT-based file systems into the kernel
	  -- they will have to be modules as well.

config MSDOS_FS
	tristate "MSDOS fs support"
	select FAT_FS
	help
	  This allows you to mount MSDOS partitions of your hard drive (unless
	  they are compressed; to access compressed MSDOS partitions under
	  Linux, you can either use the DOS emulator DOSEMU, described in the
	  DOSEMU-HOWTO, available from
	  <https://www.tldp.org/docs.html#howto>, or try dmsdosfs in
	  <ftp://ibiblio.org/pub/Linux/system/filesystems/dosfs/>. If you
	  intend to use dosemu with a non-compressed MSDOS partition, say Y
	  here) and MSDOS floppies. This means that file access becomes
	  transparent, i.e. the MSDOS files look and behave just like all
	  other Unix files.

	  If you have Windows 95 or Windows NT installed on your MSDOS
	  partitions, you should use the VFAT file system (say Y to "VFAT fs
	  support" below), or you will not be able to see the long filenames
	  generated by Windows 95 / Windows NT.

	  This option will enlarge your kernel by about 7 KB. If unsure,
	  answer Y. This will only work if you said Y to "DOS FAT fs support"
	  as well. To compile this as a module, choose M here: the module will
	  be called msdos.

config VFAT_FS
	tristate "VFAT (Windows-95) fs support"
	select FAT_FS
	help
	  This option provides support for normal Windows file systems with
	  long filenames.  That includes non-compressed FAT-based file systems
	  used by Windows 95, Windows 98, Windows NT 4.0, and the Unix
	  programs from the mtools package.

	  The VFAT support enlarges your kernel by about 10 KB and it only
	  works if you said Y to the "DOS FAT fs support" above.  Please read
	  the file <file:Documentation/filesystems/vfat.rst> for details.  If
	  unsure, say Y.

	  To compile this as a module, choose M here: the module will be called
	  vfat.

config FAT_DEFAULT_CODEPAGE
	int "Default codepage for FAT"
	depends on FAT_FS
	default 437
	help
	  This option should be set to the codepage of your FAT filesystems.
	  It can be overridden with the "codepage" mount option.
	  See <file:Documentation/filesystems/vfat.rst> for more information.

config FAT_DEFAULT_IOCHARSET
	string "Default iocharset for FAT"
	depends on VFAT_FS
	default "iso8859-1"
	help
	  Set this to the default input/output character set you'd
	  like FAT to use. It should probably match the character set
	  that most of your FAT filesystems use, and can be overridden
	  with the "iocharset" mount option for FAT filesystems.
	  Note that "utf8" is not recommended for FAT filesystems.
	  If unsure, you shouldn't set "utf8" here - select the next option
	  instead if you would like to use UTF-8 encoded file names by default.
	  See <file:Documentation/filesystems/vfat.rst> for more information.

	  Enable any character sets you need in File Systems/Native Language
	  Support.

config FAT_DEFAULT_UTF8
	bool "Enable FAT UTF-8 option by default"
	depends on VFAT_FS
	default n
	help
	  Set this if you would like to have "utf8" mount option set
	  by default when mounting FAT filesystems.

	  Even if you say Y here can always disable UTF-8 for
	  particular mount by adding "utf8=0" to mount options.

	  Say Y if you use UTF-8 encoding for file names, N otherwise.

	  See <file:Documentation/filesystems/vfat.rst> for more information.

config FAT_KUNIT_TEST
	tristate "Unit Tests for FAT filesystems" if !KUNIT_ALL_TESTS
	depends on KUNIT && FAT_FS
	default KUNIT_ALL_TESTS
	help
	  This builds the FAT KUnit tests

	  For more information on KUnit and unit tests in general, please refer
	  to the KUnit documentation in Documentation/dev-tools/kunit

	  If unsure, say N
```

## fs/freevxfs/Kconfig
```kconfig
config VXFS_FS
	tristate "FreeVxFS file system support (VERITAS VxFS(TM) compatible)"
	depends on BLOCK
	help
	  FreeVxFS is a file system driver that support the VERITAS VxFS(TM)
	  file system format.  VERITAS VxFS(TM) is the standard file system
	  of SCO UnixWare (and possibly others) and optionally available
	  for Sunsoft Solaris, HP-UX and many other operating systems. However
	  these particular OS implementations of vxfs may differ in on-disk
	  data endianess and/or superblock offset. The vxfs module has been
	  tested with SCO UnixWare and HP-UX B.10.20 (pa-risc 1.1 arch.)
	  Currently only readonly access is supported and VxFX versions
	  2, 3 and 4. Tests were performed with HP-UX VxFS version 3.

	  NOTE: the file system type as used by mount(1), mount(2) and
	  fstab(5) is 'vxfs' as it describes the file system format, not
	  the actual driver.

	  There is a userspace utility for HP-UX logical volumes which makes
	  creating HP-UX logical volumes easy from HP-UX disk block device file
	  or regular file with image of the disk. See:
	         https://sourceforge.net/projects/linux-vxfs/

	  To compile this as a module, choose M here: the module will be
	  called freevxfs.  If unsure, say N.
```

## fs/fuse/Kconfig
```kconfig
# SPDX-License-Identifier: GPL-2.0-only
config FUSE_FS
	tristate "FUSE (Filesystem in Userspace) support"
	select FS_POSIX_ACL
	help
	  With FUSE it is possible to implement a fully functional filesystem
	  in a userspace program.

	  There's also a companion library: libfuse2.  This library is available
	  from the FUSE homepage:
	  <https://github.com/libfuse/>
	  although chances are your distribution already has that library
	  installed if you've installed the "fuse" package itself.

	  See <file:Documentation/filesystems/fuse.rst> for more information.
	  See <file:Documentation/Changes> for needed library/utility version.

	  If you want to develop a userspace FS, or if you want to use
	  a filesystem based on FUSE, answer Y or M.

config CUSE
	tristate "Character device in Userspace support"
	depends on FUSE_FS
	help
	  This FUSE extension allows character devices to be
	  implemented in userspace.

	  If you want to develop or use a userspace character device
	  based on CUSE, answer Y or M.

config VIRTIO_FS
	tristate "Virtio Filesystem"
	depends on FUSE_FS
	select VIRTIO
	help
	  The Virtio Filesystem allows guests to mount file systems from the
	  host.

	  If you want to share files between guests or with the host, answer Y
	  or M.

config FUSE_DAX
	bool "Virtio Filesystem Direct Host Memory Access support"
	default y
	select INTERVAL_TREE
	depends on VIRTIO_FS
	depends on FS_DAX
	depends on DAX
	help
	  This allows bypassing guest page cache and allows mapping host page
	  cache directly in guest address space.

	  If you want to allow mounting a Virtio Filesystem with the "dax"
	  option, answer Y.

config FUSE_PASSTHROUGH
	bool "FUSE passthrough operations support"
	default y
	depends on FUSE_FS
	select FS_STACK
	help
	  This allows bypassing FUSE server by mapping specific FUSE operations
	  to be performed directly on a backing file.

	  If you want to allow passthrough operations, answer Y.
```

## fs/gfs2/Kconfig
```kconfig
# SPDX-License-Identifier: GPL-2.0-only
config GFS2_FS
	tristate "GFS2 file system support"
	select FS_POSIX_ACL
	select CRC32
	select LIBCRC32C
	select QUOTACTL
	select FS_IOMAP
	help
	  A cluster filesystem.

	  Allows a cluster of computers to simultaneously use a block device
	  that is shared between them (with FC, iSCSI, NBD, etc...).  GFS reads
	  and writes to the block device like a local filesystem, but also uses
	  a lock module to allow the computers coordinate their I/O so
	  filesystem consistency is maintained.  One of the nifty features of
	  GFS is perfect consistency -- changes made to the filesystem on one
	  machine show up immediately on all other machines in the cluster.

	  To use the GFS2 filesystem in a cluster, you will need to enable
	  the locking module below. Documentation and utilities for GFS2 can
	  be found here: http://sources.redhat.com/cluster

	  The "nolock" lock module is now built in to GFS2 by default. If
	  you want to use the DLM, be sure to enable IPv4/6 networking.

config GFS2_FS_LOCKING_DLM
	bool "GFS2 DLM locking"
	depends on (GFS2_FS!=n) && NET && INET && (IPV6 || IPV6=n) && \
		CONFIGFS_FS && SYSFS && (DLM=y || DLM=GFS2_FS)
	help
	  Multiple node locking module for GFS2

	  Most users of GFS2 will require this. It provides the locking
	  interface between GFS2 and the DLM, which is required to use GFS2
	  in a cluster environment.
```

## fs/hfs/Kconfig
```kconfig
# SPDX-License-Identifier: GPL-2.0-only
config HFS_FS
	tristate "Apple Macintosh file system support"
	depends on BLOCK
	select BUFFER_HEAD
	select NLS
	select LEGACY_DIRECT_IO
	help
	  If you say Y here, you will be able to mount Macintosh-formatted
	  floppy disks and hard drive partitions with full read-write access.
	  Please read <file:Documentation/filesystems/hfs.rst> to learn about
	  the available mount options.

	  To compile this file system support as a module, choose M here: the
	  module will be called hfs.

config HFS_KUNIT_TEST
	tristate "KUnit tests for HFS filesystem" if !KUNIT_ALL_TESTS
	depends on HFS_FS && KUNIT
	default KUNIT_ALL_TESTS
	help
	  This builds KUnit tests for the HFS filesystem.

	  KUnit tests run during boot and output the results to the debug
	  log in TAP format (https://testanything.org/). Only useful for
	  kernel devs running KUnit test harness and are not for inclusion
	  into a production build.

	  For more information on KUnit and unit tests in general please
	  refer to the KUnit documentation in Documentation/dev-tools/kunit/.
```

## fs/hfsplus/Kconfig
```kconfig
# SPDX-License-Identifier: GPL-2.0-only
config HFSPLUS_FS
	tristate "Apple Extended HFS file system support"
	depends on BLOCK
	select BUFFER_HEAD
	select NLS
	select NLS_UTF8
	select LEGACY_DIRECT_IO
	help
	  If you say Y here, you will be able to mount extended format
	  Macintosh-formatted hard drive partitions with full read-write access.

	  This file system is often called HFS+ and was introduced with
	  MacOS 8. It includes all Mac specific filesystem data such as
	  data forks and creator codes, but it also has several UNIX
	  style features such as file ownership and permissions.

config HFSPLUS_KUNIT_TEST
	tristate "KUnit tests for HFS+ filesystem" if !KUNIT_ALL_TESTS
	depends on HFSPLUS_FS && KUNIT
	default KUNIT_ALL_TESTS
	help
	  This builds KUnit tests for the HFS+ filesystem.

	  KUnit tests run during boot and output the results to the debug
	  log in TAP format (https://testanything.org/). Only useful for
	  kernel devs running KUnit test harness and are not for inclusion
	  into a production build.

	  For more information on KUnit and unit tests in general please
	  refer to the KUnit documentation in Documentation/dev-tools/kunit/.
```

## fs/hpfs/Kconfig
```kconfig
# SPDX-License-Identifier: GPL-2.0-only
config HPFS_FS
	tristate "OS/2 HPFS file system support"
	depends on BLOCK
	select FS_IOMAP
	help
	  OS/2 is IBM's operating system for PC's, the same as Warp, and HPFS
	  is the file system used for organizing files on OS/2 hard disk
	  partitions. Say Y if you want to be able to read files from and
	  write files to an OS/2 HPFS partition on your hard drive. OS/2
	  floppies however are in regular MSDOS format, so you don't need this
	  option in order to be able to read them. Read
	  <file:Documentation/filesystems/hpfs.rst>.

	  To compile this file system support as a module, choose M here: the
	  module will be called hpfs.  If unsure, say N.
```

## fs/incfs/Kconfig
```kconfig
config INCREMENTAL_FS
	tristate "Incremental file system support"
	depends on BLOCK
	select DECOMPRESS_LZ4
	select DECOMPRESS_ZSTD
	select CRYPTO_ZSTD
	select CRYPTO_SHA256
	help
	  Incremental FS is a read-only virtual file system that facilitates execution
	  of programs while their binaries are still being lazily downloaded over the
	  network, USB or pigeon post.

	  To compile this file system support as a module, choose M here: the
	  module will be called incrementalfs.
```

## fs/isofs/Kconfig
```kconfig
config ISO9660_FS
	tristate "ISO 9660 CDROM file system support"
	help
	  This is the standard file system used on CD-ROMs.  It was previously
	  known as "High Sierra File System" and is called "hsfs" on other
	  Unix systems.  The so-called Rock-Ridge extensions which allow for
	  long Unix filenames and symbolic links are also supported by this
	  driver.  If you have a CD-ROM drive and want to do more with it than
	  just listen to audio CDs and watch its LEDs, say Y (and read
	  <file:Documentation/filesystems/isofs.txt> and the CD-ROM-HOWTO,
	  available from <http://www.tldp.org/docs.html#howto>), thereby
	  enlarging your kernel by about 27 KB; otherwise say N.

	  To compile this file system support as a module, choose M here: the
	  module will be called isofs.

config JOLIET
	bool "Microsoft Joliet CDROM extensions"
	depends on ISO9660_FS
	select NLS
	help
	  Joliet is a Microsoft extension for the ISO 9660 CD-ROM file system
	  which allows for long filenames in unicode format (unicode is the
	  new 16 bit character code, successor to ASCII, which encodes the
	  characters of almost all languages of the world; see
	  <http://www.unicode.org/> for more information).  Say Y here if you
	  want to be able to read Joliet CD-ROMs under Linux.

config ZISOFS
	bool "Transparent decompression extension"
	depends on ISO9660_FS
	select ZLIB_INFLATE
	help
	  This is a Linux-specific extension to RockRidge which lets you store
	  data in compressed form on a CD-ROM and have it transparently
	  decompressed when the CD-ROM is accessed.  See
	  <http://www.kernel.org/pub/linux/utils/fs/zisofs/> for the tools
	  necessary to create such a filesystem.  Say Y here if you want to be
	  able to read such compressed CD-ROMs.
```
