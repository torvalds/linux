## fs/jbd/Kconfig
```kconfig
config JBD
	tristate
	help
	  This is a generic journalling layer for block devices.  It is
	  currently used by the ext3 file system, but it could also be
	  used to add journal support to other file systems or block
	  devices such as RAID or LVM.

	  If you are using the ext3 file system, you need to say Y here.
	  If you are not using ext3 then you will probably want to say N.

	  To compile this device as a module, choose M here: the module will be
	  called jbd.  If you are compiling ext3 into the kernel, you
	  cannot compile this code as a module.

config JBD_DEBUG
	bool "JBD (ext3) debugging support"
	depends on JBD && DEBUG_FS
	help
	  If you are using the ext3 journaled file system (or potentially any
	  other file system/device using JBD), this option allows you to
	  enable debugging output while the system is running, in order to
	  help track down any problems you are having.  By default the
	  debugging output will be turned off.

	  If you select Y here, then you will be able to turn on debugging
	  with "echo N > /sys/kernel/debug/jbd/jbd-debug", where N is a
	  number between 1 and 5, the higher the number, the more debugging
	  output is generated.  To turn debugging off again, do
	  "echo 0 > /sys/kernel/debug/jbd/jbd-debug".
```

## fs/jbd2/Kconfig
```kconfig
# SPDX-License-Identifier: GPL-2.0-only
config JBD2
	tristate
	select CRC32
	select CRYPTO
	select CRYPTO_CRC32C
	help
	  This is a generic journaling layer for block devices that support
	  both 32-bit and 64-bit block numbers.  It is currently used by
	  the ext4 and OCFS2 filesystems, but it could also be used to add
	  journal support to other file systems or block devices such
	  as RAID or LVM.

	  If you are using ext4 or OCFS2, you need to say Y here.
	  If you are not using ext4 or OCFS2 then you will
	  probably want to say N.

	  To compile this device as a module, choose M here. The module will be
	  called jbd2.  If you are compiling ext4 or OCFS2 into the kernel,
	  you cannot compile this code as a module.

config JBD2_DEBUG
	bool "JBD2 (ext4) debugging support"
	depends on JBD2
	help
	  If you are using the ext4 journaled file system (or
	  potentially any other filesystem/device using JBD2), this option
	  allows you to enable debugging output while the system is running,
	  in order to help track down any problems you are having.
	  By default, the debugging output will be turned off.

	  If you select Y here, then you will be able to turn on debugging
	  with "echo N > /sys/module/jbd2/parameters/jbd2_debug", where N is a
	  number between 1 and 5. The higher the number, the more debugging
	  output is generated.  To turn debugging off again, do
	  "echo 0 > /sys/module/jbd2/parameters/jbd2_debug".
```

## fs/jffs2/Kconfig
```kconfig
config JFFS2_FS
	tristate "Journalling Flash File System v2 (JFFS2) support"
	select CRC32
	depends on MTD
	help
	  JFFS2 is the second generation of the Journalling Flash File System
	  for use on diskless embedded devices. It provides improved wear
	  levelling, compression and support for hard links. You cannot use
	  this on normal block devices, only on 'MTD' devices.

	  Further information on the design and implementation of JFFS2 is
	  available at <http://sources.redhat.com/jffs2/>.

config JFFS2_FS_DEBUG
	int "JFFS2 debugging verbosity (0 = quiet, 2 = noisy)"
	depends on JFFS2_FS
	default "0"
	help
	  This controls the amount of debugging messages produced by the JFFS2
	  code. Set it to zero for use in production systems. For evaluation,
	  testing and debugging, it's advisable to set it to one. This will
	  enable a few assertions and will print debugging messages at the
	  KERN_DEBUG loglevel, where they won't normally be visible. Level 2
	  is unlikely to be useful - it enables extra debugging in certain
	  areas which at one point needed debugging, but when the bugs were
	  located and fixed, the detailed messages were relegated to level 2.

	  If reporting bugs, please try to have available a full dump of the
	  messages at debug level 1 while the misbehaviour was occurring.

config JFFS2_FS_WRITEBUFFER
	bool "JFFS2 write-buffering support"
	depends on JFFS2_FS
	default y
	help
	  This enables the write-buffering support in JFFS2.

	  This functionality is required to support JFFS2 on the following
	  types of flash devices:
	    - NAND flash
	    - NOR flash with transparent ECC
	    - DataFlash

config JFFS2_FS_WBUF_VERIFY
	bool "Verify JFFS2 write-buffer reads"
	depends on JFFS2_FS_WRITEBUFFER
	default n
	help
	  This causes JFFS2 to read back every page written through the
	  write-buffer, and check for errors.

config JFFS2_SUMMARY
	bool "JFFS2 summary support (EXPERIMENTAL)"
	depends on JFFS2_FS && EXPERIMENTAL
	default n
	help
	  This feature makes it possible to use summary information
	  for faster filesystem mount.

	  The summary information can be inserted into a filesystem image
	  by the utility 'sumtool'.

	  If unsure, say 'N'.

config JFFS2_FS_XATTR
	bool "JFFS2 XATTR support (EXPERIMENTAL)"
	depends on JFFS2_FS && EXPERIMENTAL
	default n
	help
	  Extended attributes are name:value pairs associated with inodes by
	  the kernel or by users (see the attr(5) manual page, or visit
	  <http://acl.bestbits.at/> for details).

	  If unsure, say N.

config JFFS2_FS_POSIX_ACL
	bool "JFFS2 POSIX Access Control Lists"
	depends on JFFS2_FS_XATTR
	default y
	select FS_POSIX_ACL
	help
	  Posix Access Control Lists (ACLs) support permissions for users and
	  groups beyond the owner/group/world scheme.

	  To learn more about Access Control Lists, visit the Posix ACLs for
	  Linux website <http://acl.bestbits.at/>.

	  If you don't know what Access Control Lists are, say N

config JFFS2_FS_SECURITY
	bool "JFFS2 Security Labels"
	depends on JFFS2_FS_XATTR
	default y
	help
	  Security labels support alternative access control models
	  implemented by security modules like SELinux.  This option
	  enables an extended attribute handler for file security
	  labels in the jffs2 filesystem.

	  If you are not using a security module that requires using
	  extended attributes for file security labels, say N.

config JFFS2_COMPRESSION_OPTIONS
	bool "Advanced compression options for JFFS2"
	depends on JFFS2_FS
	default n
	help
	  Enabling this option allows you to explicitly choose which
	  compression modules, if any, are enabled in JFFS2. Removing
	  compressors can mean you cannot read existing file systems,
	  and enabling experimental compressors can mean that you
	  write a file system which cannot be read by a standard kernel.

	  If unsure, you should _definitely_ say 'N'.

config JFFS2_ZLIB
	bool "JFFS2 ZLIB compression support" if JFFS2_COMPRESSION_OPTIONS
	select ZLIB_INFLATE
	select ZLIB_DEFLATE
	depends on JFFS2_FS
	default y
	help
	  Zlib is designed to be a free, general-purpose, legally unencumbered,
	  lossless data-compression library for use on virtually any computer
	  hardware and operating system. See <http://www.gzip.org/zlib/> for
	  further information.

	  Say 'Y' if unsure.

config JFFS2_LZO
	bool "JFFS2 LZO compression support" if JFFS2_COMPRESSION_OPTIONS
	select LZO_COMPRESS
	select LZO_DECOMPRESS
	depends on JFFS2_FS
	default n
	help
	  minilzo-based compression. Generally works better than Zlib.

	  This feature was added in July, 2007. Say 'N' if you need
	  compatibility with older bootloaders or kernels.

config JFFS2_RTIME
	bool "JFFS2 RTIME compression support" if JFFS2_COMPRESSION_OPTIONS
	depends on JFFS2_FS
	default y
	help
	  Rtime does manage to recompress already-compressed data. Say 'Y' if unsure.

config JFFS2_RUBIN
	bool "JFFS2 RUBIN compression support" if JFFS2_COMPRESSION_OPTIONS
	depends on JFFS2_FS
	default n
	help
	  RUBINMIPS and DYNRUBIN compressors. Say 'N' if unsure.

choice
	prompt "JFFS2 default compression mode" if JFFS2_COMPRESSION_OPTIONS
	default JFFS2_CMODE_PRIORITY
	depends on JFFS2_FS
	help
	  You can set here the default compression mode of JFFS2 from
	  the available compression modes. Don't touch if unsure.

config JFFS2_CMODE_NONE
	bool "no compression"
	help
	  Uses no compression.

config JFFS2_CMODE_PRIORITY
	bool "priority"
	help
	  Tries the compressors in a predefined order and chooses the first
	  successful one.

config JFFS2_CMODE_SIZE
	bool "size (EXPERIMENTAL)"
	help
	  Tries all compressors and chooses the one which has the smallest
	  result.

config JFFS2_CMODE_FAVOURLZO
	bool "Favour LZO"
	help
	  Tries all compressors and chooses the one which has the smallest
	  result but gives some preference to LZO (which has faster
	  decompression) at the expense of size.

endchoice
```

## fs/jfs/Kconfig
```kconfig
config JFS_FS
	tristate "JFS filesystem support"
	select NLS
	select CRC32
	help
	  This is a port of IBM's Journaled Filesystem .  More information is
	  available in the file <file:Documentation/filesystems/jfs.txt>.

	  If you do not intend to use the JFS filesystem, say N.

config JFS_POSIX_ACL
	bool "JFS POSIX Access Control Lists"
	depends on JFS_FS
	select FS_POSIX_ACL
	help
	  Posix Access Control Lists (ACLs) support permissions for users and
	  groups beyond the owner/group/world scheme.

	  To learn more about Access Control Lists, visit the Posix ACLs for
	  Linux website <http://acl.bestbits.at/>.

	  If you don't know what Access Control Lists are, say N

config JFS_SECURITY
	bool "JFS Security Labels"
	depends on JFS_FS
	help
	  Security labels support alternative access control models
	  implemented by security modules like SELinux.  This option
	  enables an extended attribute handler for file security
	  labels in the jfs filesystem.

	  If you are not using a security module that requires using
	  extended attributes for file security labels, say N.

config JFS_DEBUG
	bool "JFS debugging"
	depends on JFS_FS
	help
	  If you are experiencing any problems with the JFS filesystem, say
	  Y here.  This will result in additional debugging messages to be
	  written to the system log.  Under normal circumstances, this
	  results in very little overhead.

config JFS_STATISTICS
	bool "JFS statistics"
	depends on JFS_FS
	help
	  Enabling this option will cause statistics from the JFS file system
	  to be made available to the user in the /proc/fs/jfs/ directory.
```

## fs/kernfs/Kconfig
```kconfig
# SPDX-License-Identifier: GPL-2.0-only
#
# KERNFS should be selected by its users
#

config KERNFS
	bool
	default n
```

## fs/logfs/Kconfig
```kconfig
config LOGFS
	tristate "LogFS file system (EXPERIMENTAL)"
	depends on (MTD || BLOCK) && EXPERIMENTAL
	select ZLIB_INFLATE
	select ZLIB_DEFLATE
	select CRC32
	select BTREE
	help
	  Flash filesystem aimed to scale efficiently to large devices.
	  In comparison to JFFS2 it offers significantly faster mount
	  times and potentially less RAM usage, although the latter has
	  not been measured yet.

	  In its current state it is still very experimental and should
	  not be used for other than testing purposes.

	  If unsure, say N.
```

## fs/minix/Kconfig
```kconfig
# SPDX-License-Identifier: GPL-2.0-only
config MINIX_FS
	tristate "Minix file system support"
	depends on BLOCK
	help
	  Minix is a simple operating system used in many classes about OS's.
	  The minix file system (method to organize files on a hard disk
	  partition or a floppy disk) was the original file system for Linux,
	  but has been superseded by the second extended file system ext2fs.
	  You don't want to use the minix file system on your hard disk
	  because of certain built-in restrictions, but it is sometimes found
	  on older Linux floppy disks.  This option will enlarge your kernel
	  by about 28 KB. If unsure, say N.

	  To compile this file system support as a module, choose M here: the
	  module will be called minix.  Note that the file system of your root
	  partition (the one containing the directory /) cannot be compiled as
	  a module.

config MINIX_FS_NATIVE_ENDIAN
	def_bool MINIX_FS
	depends on MICROBLAZE || MIPS || S390 || SUPERH || SPARC || XTENSA || (M68K && !MMU)

config MINIX_FS_BIG_ENDIAN_16BIT_INDEXED
	def_bool MINIX_FS
	depends on M68K && MMU
```

## fs/ncpfs/Kconfig
```kconfig
#
# NCP Filesystem configuration
#
config NCPFS_PACKET_SIGNING
	bool "Packet signatures"
	depends on NCP_FS
	help
	  NCP allows packets to be signed for stronger security. If you want
	  security, say Y.  Normal users can leave it off.  To be able to use
	  packet signing you must use ncpfs > 2.0.12.

config NCPFS_IOCTL_LOCKING
	bool "Proprietary file locking"
	depends on NCP_FS
	help
	  Allows locking of records on remote volumes.  Say N unless you have
	  special applications which are able to utilize this locking scheme.

config NCPFS_STRONG
	bool "Clear remove/delete inhibit when needed"
	depends on NCP_FS
	help
	  Allows manipulation of files flagged as Delete or Rename Inhibit.
	  To use this feature you must mount volumes with the ncpmount
	  parameter "-s" (ncpfs-2.0.12 and newer).  Say Y unless you are not
	  mounting volumes with -f 444.

config NCPFS_NFS_NS
	bool "Use NFS namespace if available"
	depends on NCP_FS
	help
	  Allows you to utilize NFS namespace on NetWare servers.  It brings
	  you case sensitive filenames.  Say Y.  You can disable it at
	  mount-time with the `-N nfs' parameter of ncpmount.

config NCPFS_OS2_NS
	bool "Use LONG (OS/2) namespace if available"
	depends on NCP_FS
	help
	  Allows you to utilize OS2/LONG namespace on NetWare servers.
	  Filenames in this namespace are limited to 255 characters, they are
	  case insensitive, and case in names is preserved.  Say Y.  You can
	  disable it at mount time with the -N os2 parameter of ncpmount.

config NCPFS_SMALLDOS
	bool "Lowercase DOS filenames"
	depends on NCP_FS
	---help---
	  If you say Y here, every filename on a NetWare server volume using
	  the OS2/LONG namespace and created under DOS or on a volume using
	  DOS namespace will be converted to lowercase characters.
	  Saying N here will give you these filenames in uppercase.

	  This is only a cosmetic option since the OS2/LONG namespace is case
	  insensitive. The only major reason for this option is backward
	  compatibility when moving from DOS to OS2/LONG namespace support.
	  Long filenames (created by Win95) will not be affected.

	  This option does not solve the problem that filenames appear
	  differently under Linux and under Windows, since Windows does an
	  additional conversions on the client side. You can achieve similar
	  effects by saying Y to "Allow using of Native Language Support"
	  below.

config NCPFS_NLS
	bool "Use Native Language Support"
	depends on NCP_FS
	select NLS
	help
	  Allows you to use codepages and I/O charsets for file name
	  translation between the server file system and input/output. This
	  may be useful, if you want to access the server with other operating
	  systems, e.g. Windows 95. See also NLS for more Information.

	  To select codepages and I/O charsets use ncpfs-2.2.0.13 or newer.

config NCPFS_EXTRAS
	bool "Enable symbolic links and execute flags"
	depends on NCP_FS
	help
	  This enables the use of symbolic links and an execute permission
	  bit on NCPFS. The file server need not have long name space or NFS
	  name space loaded for these to work.

	  To use the new attributes, it is recommended to use the flags
	  '-f 600 -d 755' on the ncpmount command line.
```
