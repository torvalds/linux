## tools/verification/rvgen/tests/golden/da_pertask_desc/Kconfig
```kconfig
# SPDX-License-Identifier: GPL-2.0-only
#
config RV_MON_DA_PERTASK_DESC
	depends on RV
	# XXX: add dependencies if there
	select DA_MON_EVENTS_ID
	bool "da_pertask_desc monitor"
	help
	  Custom description for testing
```

## tools/verification/rvgen/tests/golden/ha_percpu/Kconfig
```kconfig
# SPDX-License-Identifier: GPL-2.0-only
#
config RV_MON_HA_PERCPU
	depends on RV
	# XXX: add dependencies if there
	select HA_MON_EVENTS_IMPLICIT
	bool "ha_percpu monitor"
	help
	  auto-generated
```

## tools/verification/rvgen/tests/golden/ltl_pertask/Kconfig
```kconfig
# SPDX-License-Identifier: GPL-2.0-only
#
config RV_MON_LTL_PERTASK
	depends on RV
	# XXX: add dependencies if there
	select LTL_MON_EVENTS_ID
	bool "ltl_pertask monitor"
	help
	  auto-generated
```

## tools/verification/rvgen/tests/golden/test_container/Kconfig
```kconfig
config RV_MON_TEST_CONTAINER
	depends on RV
	bool "test_container monitor"
	help
	  Test container for grouping monitors
```

## tools/verification/rvgen/tests/golden/test_da/Kconfig
```kconfig
# SPDX-License-Identifier: GPL-2.0-only
#
config RV_MON_TEST_DA
	depends on RV
	# XXX: add dependencies if there
	select DA_MON_EVENTS_IMPLICIT
	bool "test_da monitor"
	help
	  auto-generated
```

## tools/verification/rvgen/tests/golden/test_da_kunit/Kconfig
```kconfig
# SPDX-License-Identifier: GPL-2.0-only
#
config RV_MON_TEST_DA_KUNIT
	depends on RV
	# XXX: add dependencies if there
	select DA_MON_EVENTS_IMPLICIT
	bool "test_da_kunit monitor"
	help
	  auto-generated
```

## tools/verification/rvgen/tests/golden/test_ha/Kconfig
```kconfig
# SPDX-License-Identifier: GPL-2.0-only
#
config RV_MON_TEST_HA
	depends on RV
	# XXX: add dependencies if there
	select HA_MON_EVENTS_ID
	bool "test_ha monitor"
	help
	  auto-generated
```

## tools/verification/rvgen/tests/golden/test_ha_kunit/Kconfig
```kconfig
# SPDX-License-Identifier: GPL-2.0-only
#
config RV_MON_TEST_HA_KUNIT
	depends on RV
	# XXX: add dependencies if there
	select HA_MON_EVENTS_ID
	bool "test_ha_kunit monitor"
	help
	  auto-generated
```

## tools/verification/rvgen/tests/golden/test_ltl/Kconfig
```kconfig
# SPDX-License-Identifier: GPL-2.0-only
#
config RV_MON_TEST_LTL
	depends on RV
	# XXX: add dependencies if there
	depends on RV_MON_LTL_PARENT
	default y
	select LTL_MON_EVENTS_ID
	bool "test_ltl monitor"
	help
	  Simple description
```

## tools/verification/rvgen/tests/golden/test_ltl_kunit/Kconfig
```kconfig
# SPDX-License-Identifier: GPL-2.0-only
#
config RV_MON_TEST_LTL_KUNIT
	depends on RV
	# XXX: add dependencies if there
	select LTL_MON_EVENTS_ID
	bool "test_ltl_kunit monitor"
	help
	  auto-generated
```
