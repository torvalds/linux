## Documentation/devicetree/bindings/arm/altera.yaml
```yaml
# SPDX-License-Identifier: GPL-2.0
%YAML 1.2
---
$id: http://devicetree.org/schemas/arm/altera.yaml#
$schema: http://devicetree.org/meta-schemas/core.yaml#

title: Altera's SoCFPGA platform

maintainers:
  - Dinh Nguyen <dinguyen@kernel.org>

properties:
  $nodename:
    const: "/"
  compatible:
    oneOf:
      - description: Arria 5 boards
        items:
          - enum:
              - altr,socfpga-arria5-socdk
          - const: altr,socfpga-arria5
          - const: altr,socfpga

      - description: Arria 10 boards
        items:
          - enum:
              - altr,socfpga-arria10-socdk
          - const: altr,socfpga-arria10
          - const: altr,socfpga

      - description: Mercury+ AA1 boards
        items:
          - enum:
              - enclustra,mercury-pe1
              - google,chameleon-v3
          - const: enclustra,mercury-aa1
          - const: altr,socfpga-arria10
          - const: altr,socfpga

      - description: Cyclone 5 boards
        items:
          - enum:
              - altr,socfpga-cyclone5-socdk
              - denx,mcvevk
              - ebv,socrates
              - macnica,sodia
              - novtech,chameleon96
              - samtec,vining
              - terasic,de0-atlas
              - terasic,socfpga-cyclone5-sockit
          - const: altr,socfpga-cyclone5
          - const: altr,socfpga

      - description: Stratix 10 boards
        items:
          - enum:
              - altr,socfpga-stratix10-socdk
              - altr,socfpga-stratix10-swvp
          - const: altr,socfpga-stratix10

      - description: SoCFPGA VT
        items:
          - const: altr,socfpga-vt
          - const: altr,socfpga

additionalProperties: true

...
```

## Documentation/devicetree/bindings/arm/altera/fpga-dma.txt
```
Altera FPGA DMA FIFO driver

Required properties:
- compatible : "altr,fpga-dma";

- reg : CSR and DATA register resource definitions (address and length).

- reg-names : Names of the register resources.  Should be "csr", "data".

- dmas : DMA request lines.  Should be <&pdma 0 &pdma 1>

- dma-names : Names of DMA request lines. Should be "tx", "rx".

Example:

	fpgadma: fifo {
		#address-cells = <1>;
		#size-cells = <1>;
		compatible = "altr,fpga-dma";
		reg = <0xff230000 0x20>, <0xc0011000 0x400>;
		reg-names = "csr", "data";
		dmas = <&pdma 0 &pdma 1>;
		dma-names = "tx", "rx";
	};
```

## Documentation/devicetree/bindings/arm/altera/mm-debug-link.txt
```
Altera MM Debug Link driver

Required properties:

- #address-cells, #size-cells : Both #address-cells
  and #size-cells must be equal to 1.

- compatible : "altr,mm-debug-link-1.0";

- reg : Base address and size of register space in MM Debug Link.

Example:

        sldhub_link: debugger {
                #address-cells = <1>;
                #size-cells = <1>;
                compatible = "altr,mm-debug-link-1.0";
                reg = <0xFF240000 0x80>;
        };
```

## Documentation/devicetree/bindings/arm/altera/sld-hub.txt
```
Altera SLD HUB driver

Required properties:

- #address-cells, #size-cells : Both #address-cells
  and #size-cells must be equal to 1.

- compatible : "altr,sld-hub";

- reg : Base address and size of register space in SLD HUB controller

Example:

	sldhub: debugger {
		#address-cells = <1>;
		#size-cells = <1>;
		compatible = "altr,sld-hub";
		reg = <0xFF240000 0x80>;
	};
```

## Documentation/devicetree/bindings/arm/altera/socfpga-clk-manager.txt
```
Altera SOCFPGA Clock Manager

Required properties:
- compatible : "altr,clk-mgr"
- reg : Should contain base address and length for Clock Manager

Example:
	 clkmgr@ffd04000 {
		compatible = "altr,clk-mgr";
		reg = <0xffd04000 0x1000>;
	};
```
