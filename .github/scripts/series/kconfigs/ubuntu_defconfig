## Documentation/Kconfig
```kconfig
config WARN_MISSING_DOCUMENTS
	bool "Warn if there's a missing documentation file"
	depends on COMPILE_TEST
	help
	  It is not uncommon that a document gets renamed.
	  This option makes the Kernel to check for missing dependencies,
	  warning when something is missing. Works only if the Kernel
	  is built from a git tree.

	  If unsure, select 'N'.

config WARN_ABI_ERRORS
	bool "Warn if there are errors at ABI files"
	depends on COMPILE_TEST
	help
	  The files under Documentation/ABI should follow what's
	  described at Documentation/ABI/README. Yet, as they're manually
	  written, it would be possible that some of those files would
	  have errors that would break them for being parsed by
	  scripts/get_abi.pl. Add a check to verify them.

	  If unsure, select 'N'.
```

## Documentation/devicetree/bindings/ABI.txt
```
  Devicetree (DT) ABI

I. Regarding stable bindings/ABI, we quote from the 2013 ARM mini-summit
   summary document:

     "That still leaves the question of, what does a stable binding look
     like?  Certainly a stable binding means that a newer kernel will not
     break on an older device tree, but that doesn't mean the binding is
     frozen for all time. Grant said there are ways to change bindings that
     don't result in breakage. For instance, if a new property is added,
     then default to the previous behaviour if it is missing. If a binding
     truly needs an incompatible change, then change the compatible string
     at the same time.  The driver can bind against both the old and the
     new. These guidelines aren't new, but they desperately need to be
     documented."

II.  General binding rules

  1) Maintainers, don't let perfect be the enemy of good.  Don't hold up a
     binding because it isn't perfect.

  2) Use specific compatible strings so that if we need to add a feature (DMA)
     in the future, we can create a new compatible string.  See I.

  3) Bindings can be augmented, but the driver shouldn't break when given
     the old binding. ie. add additional properties, but don't change the
     meaning of an existing property. For drivers, default to the original
     behaviour when a newly added property is missing.

  4) Don't submit bindings for staging or unstable.  That will be decided by
     the devicetree maintainers *after* discussion on the mailinglist.

III. Notes

  1) This document is intended as a general familiarization with the process as
     decided at the 2013 Kernel Summit.  When in doubt, the current word of the
     devicetree maintainers overrules this document.  In that situation, a patch
     updating this document would be appreciated.
```

## Documentation/devicetree/bindings/access-controllers/access-controllers.yaml
```yaml
# SPDX-License-Identifier: (GPL-2.0-only OR BSD-2-Clause)
%YAML 1.2
---
$id: http://devicetree.org/schemas/access-controllers/access-controllers.yaml#
$schema: http://devicetree.org/meta-schemas/core.yaml#

title: Generic Domain Access Controllers

maintainers:
  - Oleksii Moisieiev <oleksii_moisieiev@epam.com>

description: |+
  Common access controllers properties

  Access controllers are in charge of stating which of the hardware blocks under
  their responsibility (their domain) can be accesssed by which compartment. A
  compartment can be a cluster of CPUs (or coprocessors), a range of addresses
  or a group of hardware blocks. An access controller's domain is the set of
  resources covered by the access controller.

  This device tree binding can be used to bind devices to their access
  controller provided by access-controllers property. In this case, the device
  is a consumer and the access controller is the provider.

  An access controller can be represented by any node in the device tree and
  can provide one or more configuration parameters, needed to control parameters
  of the consumer device. A consumer node can refer to the provider by phandle
  and a set of phandle arguments, specified by '#access-controller-cells'
  property in the access controller node.

  Access controllers are typically used to set/read the permissions of a
  hardware block and grant access to it. Any of which depends on the access
  controller. The capabilities of each access controller are defined by the
  binding of the access controller device.

  Each node can be a consumer for the several access controllers.

# always select the core schema
select: true

properties:
  "#access-controller-cells":
    description:
      Number of cells in an access-controllers specifier;
      Can be any value as specified by device tree binding documentation
      of a particular provider. The node is an access controller.

  access-controller-names:
    $ref: /schemas/types.yaml#/definitions/string-array
    description:
      A list of access-controllers names, sorted in the same order as
      access-controllers entries. Consumer drivers will use
      access-controller-names to match with existing access-controllers entries.

  access-controllers:
    $ref: /schemas/types.yaml#/definitions/phandle-array
    description:
      A list of access controller specifiers, as defined by the
      bindings of the access-controllers provider.

additionalProperties: true

examples:
  - |
    clock_controller: access-controllers@50000 {
        reg = <0x50000 0x400>;
        #access-controller-cells = <2>;
    };

    bus_controller: bus@60000 {
        reg = <0x60000 0x10000>;
        #address-cells = <1>;
        #size-cells = <1>;
        ranges;
        #access-controller-cells = <3>;

        uart4: serial@60100 {
            reg = <0x60100 0x400>;
            clocks = <&clk_serial>;
            access-controllers = <&clock_controller 1 2>,
                                 <&bus_controller 1 3 5>;
            access-controller-names = "clock", "bus";
        };
    };
```

## Documentation/devicetree/bindings/arc/archs-pct.txt
```
* ARC HS Performance Counters

The ARC HS can be configured with a pipeline performance monitor for counting
CPU and cache events like cache misses and hits. Like conventional PCT there
are 100+ hardware conditions dynamically mapped to up to 32 counters.
It also supports overflow interrupts.

Required properties:

- compatible : should contain
	"snps,archs-pct"

Example:

pmu {
        compatible = "snps,archs-pct";
};
```

## Documentation/devicetree/bindings/arc/axs101.txt
```
Syanalpsys DesignWare ARC Software Development Platforms Device Tree Bindings
---------------------------------------------------------------------------

SDP Main Board with an AXC001 CPU Card hoisting ARC700 core in silicon

Required root analde properties:
    - compatible = "snps,axs101", "snps,arc-sdp";
```

## Documentation/devicetree/bindings/arc/axs103.txt
```
Syanalpsys DesignWare ARC Software Development Platforms Device Tree Bindings
---------------------------------------------------------------------------

SDP Main Board with an AXC003 FPGA Card which can contain various flavours of
HS38x cores.

Required root analde properties:
    - compatible = "snps,axs103", "snps,arc-sdp";
```

## Documentation/devicetree/bindings/arc/eznps.txt
```
EZchip NPS Network Processor Platforms Device Tree Bindings
---------------------------------------------------------------------------

Appliance main board with NPS400 ASIC.

Required root analde properties:
    - compatible = "ezchip,arc-nps";
```

## Documentation/devicetree/bindings/arc/hsdk.txt
```
Syanalpsys DesignWare ARC HS Development Kit Device Tree Bindings
---------------------------------------------------------------------------

ARC HSDK Board with quad-core ARC HS38x4 in silicon.

Required root analde properties:
    - compatible = "snps,hsdk";
```

## Documentation/devicetree/bindings/arc/pct.txt
```
* ARC Performance Counters

The ARC700 can be configured with a pipeline performance monitor for counting
CPU and cache events like cache misses and hits. Like conventional PCT there
are 100+ hardware conditions dynamically mapped to up to 32 counters

Analte that:
 * The ARC 700 PCT does analt support interrupts; although HW events may be
   counted, the HW events themselves cananalt serve as a trigger for a sample.

Required properties:

- compatible : should contain
	"snps,arc700-pct"

Example:

pmu {
        compatible = "snps,arc700-pct";
};
```

## Documentation/devicetree/bindings/arc/pmu.txt
```
* ARC Performance Monitor Unit

The ARC 700 can be configured with a pipeline performance monitor for counting
CPU and cache events like cache misses and hits.

Note that:
 * ARC 700 refers to a family of ARC processor cores;
   - There is only one type of PMU available for the whole family;
   - The PMU may support different sets of events; supported events are probed
     at boot time, as required by the reference manual.

 * The ARC 700 PMU does not support interrupts; although HW events may be
   counted, the HW events themselves cannot serve as a trigger for a sample.

Required properties:

- compatible : should contain
	"snps,arc700-pmu"

Example:

pmu {
        compatible = "snps,arc700-pmu";
};
```

## Documentation/devicetree/bindings/arc/snps,archs-pct.yaml
```yaml
# SPDX-License-Identifier: (GPL-2.0-only OR BSD-2-Clause)
%YAML 1.2
---
$id: http://devicetree.org/schemas/arc/snps,archs-pct.yaml#
$schema: http://devicetree.org/meta-schemas/core.yaml#

title: ARC HS Performance Counters

maintainers:
  - Aryabhatta Dey <aryabhattadey35@gmail.com>

description:
  The ARC HS can be configured with a pipeline performance monitor for counting
  CPU and cache events like cache misses and hits. Like conventional PCT there
  are 100+ hardware conditions dynamically mapped to up to 32 counters.
  It also supports overflow interrupts.

properties:
  compatible:
    const: snps,archs-pct

  reg:
    maxItems: 1

  clocks:
    maxItems: 1

required:
  - compatible
  - reg
  - clocks

additionalProperties: false
```

## Documentation/devicetree/bindings/arm/actions.txt
```
Actions Semi platforms device tree bindings
-------------------------------------------


S500 SoC
========

Required root node properties:

 - compatible :  must contain "actions,s500"


Modules:

Root node property compatible must contain, depending on module:

 - LeMaker Guitar: "lemaker,guitar"


Boards:

Root node property compatible must contain, depending on board:

 - Cubietech CubieBoard6: "cubietech,cubieboard6"
 - LeMaker Guitar Base Board rev. B: "lemaker,guitar-bb-rev-b", "lemaker,guitar"


S900 SoC
========

Required root node properties:

- compatible :  must contain "actions,s900"


Boards:

Root node property compatible must contain, depending on board:

 - uCRobotics Bubblegum-96: "ucrobotics,bubblegum-96"
```

## Documentation/devicetree/bindings/arm/actions.yaml
```yaml
# SPDX-License-Identifier: GPL-2.0-or-later OR BSD-2-Clause
%YAML 1.2
---
$id: http://devicetree.org/schemas/arm/actions.yaml#
$schema: http://devicetree.org/meta-schemas/core.yaml#

title: Actions Semi platforms device tree bindings

maintainers:
  - Andreas Färber <afaerber@suse.de>
  - Manivannan Sadhasivam <manivannan.sadhasivam@linaro.org>

properties:
  compatible:
    oneOf:
      # The Actions Semi S500 is a quad-core ARM Cortex-A9 SoC.
      - items:
          - enum:
              - allo,sparky # Allo.com Sparky
              - cubietech,cubieboard6 # Cubietech CubieBoard6
          - const: actions,s500
      - items:
          - enum:
              - lemaker,guitar-bb-rev-b # LeMaker Guitar Base Board rev. B
          - const: lemaker,guitar
          - const: actions,s500

      # The Actions Semi S700 is a quad-core ARM Cortex-A53 SoC.
      - items:
          - enum:
              - cubietech,cubieboard7 # Cubietech CubieBoard7
          - const: actions,s700

      # The Actions Semi S900 is a quad-core ARM Cortex-A53 SoC.
      - items:
          - enum:
              - ucrobotics,bubblegum-96 # uCRobotics Bubblegum-96
          - const: actions,s900
```

## Documentation/devicetree/bindings/arm/adapteva.txt
```
Adapteva Platforms Device Tree Bindings
---------------------------------------

Parallella board

Required root node properties:
    - compatible = "adapteva,parallella";
```

## Documentation/devicetree/bindings/arm/airoha,en7581-chip-scu.yaml
```yaml
# SPDX-License-Identifier: (GPL-2.0 OR BSD-2-Clause)
%YAML 1.2
---
$id: http://devicetree.org/schemas/arm/airoha,en7581-chip-scu.yaml#
$schema: http://devicetree.org/meta-schemas/core.yaml#

title: Airoha Chip SCU Controller for EN7581 SoC

maintainers:
  - Lorenzo Bianconi <lorenzo@kernel.org>

description:
  The airoha chip-scu block provides a configuration interface for clock,
  io-muxing and other functionalities used by multiple controllers (e.g. clock,
  pinctrl, ecc) on EN7581 SoC.

properties:
  compatible:
    items:
      - enum:
          - airoha,en7581-chip-scu
      - const: syscon

  reg:
    maxItems: 1

required:
  - compatible
  - reg

additionalProperties: false

examples:
  - |
    soc {
      #address-cells = <2>;
      #size-cells = <2>;
      syscon@1fa20000 {
        compatible = "airoha,en7581-chip-scu", "syscon";
        reg = <0x0 0x1fa20000 0x0 0x388>;
      };
    };
```

## Documentation/devicetree/bindings/arm/airoha.yaml
```yaml
# SPDX-License-Identifier: (GPL-2.0-only OR BSD-2-Clause)
%YAML 1.2
---
$id: http://devicetree.org/schemas/arm/airoha.yaml#
$schema: http://devicetree.org/meta-schemas/core.yaml#

title: Airoha SoC based Platforms Device Tree Bindings

maintainers:
  - Felix Fietkau <nbd@nbd.name>
  - John Crispin <john@phrozen.org>

description:
  Boards with an Airoha SoC shall have the following properties.

properties:
  $nodename:
    const: '/'
  compatible:
    oneOf:
      - items:
          - enum:
              - airoha,en7523-evb
          - const: airoha,en7523

additionalProperties: true

...
```

## Documentation/devicetree/bindings/arm/al,alpine.txt
```
Annapurna Labs Alpine Platform Device Tree Bindings
---------------------------------------------------------------

Boards in the Alpine family shall have the following properties:

* Required root node properties:
compatible: must contain "al,alpine"

* Example:

/ {
	model = "Annapurna Labs Alpine Dev Board";
	compatible = "al,alpine";

	...
}
```

## Documentation/devicetree/bindings/arm/al,alpine.yaml
```yaml
# SPDX-License-Identifier: GPL-2.0
%YAML 1.2
---
$id: http://devicetree.org/schemas/arm/al,alpine.yaml#
$schema: http://devicetree.org/meta-schemas/core.yaml#

title: Annapurna Labs Alpine Platform Device Tree Bindings

maintainers:
  - Tsahee Zidenberg <tsahee@annapurnalabs.com>
  - Antoine Tenart <antoine.tenart@bootlin.com>

properties:
  compatible:
    items:
      - const: al,alpine
  model:
    items:
      - const: "Annapurna Labs Alpine Dev Board"

...
```

## Documentation/devicetree/bindings/arm/altera.txt
```
Altera's SoCFPGA platform device tree bindings
---------------------------------------------

Boards with Cyclone 5 SoC:
Required root node properties:
compatible = "altr,socfpga-cyclone5", "altr,socfpga";

Boards with Arria 5 SoC:
Required root node properties:
compatible = "altr,socfpga-arria5", "altr,socfpga";

Boards with Arria 10 SoC:
Required root node properties:
compatible = "altr,socfpga-arria10", "altr,socfpga";
```
