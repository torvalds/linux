## sound/oss/dmasound/Kconfig
```kconfig
config DMASOUND_ATARI
	tristate "Atari DMA sound support"
	depends on ATARI && SOUND
	select DMASOUND
	help
	  If you want to use the internal audio of your Atari in Linux, answer
	  Y to this question. This will provide a Sun-like /dev/audio,
	  compatible with the Linux/i386 sound system. Otherwise, say N.

	  This driver is also available as a module ( = code which can be
	  inserted in and removed from the running kernel whenever you
	  want). If you want to compile it as a module, say M here and read
	  <file:Documentation/kbuild/modules.txt>.

config DMASOUND_PMAC
	tristate "PowerMac DMA sound support"
	depends on PPC32 && PPC_PMAC && SOUND && I2C && OBSOLETE_OSS
 	select DMASOUND
	help
	  If you want to use the internal audio of your PowerMac in Linux,
	  answer Y to this question. This will provide a Sun-like /dev/audio,
	  compatible with the Linux/i386 sound system. Otherwise, say N.

	  This driver is also available as a module ( = code which can be
	  inserted in and removed from the running kernel whenever you
	  want). If you want to compile it as a module, say M here and read
	  <file:Documentation/kbuild/modules.txt>.

config DMASOUND_PAULA
	tristate "Amiga DMA sound support"
	depends on (AMIGA || APUS) && SOUND
	select DMASOUND
	help
	  If you want to use the internal audio of your Amiga in Linux, answer
	  Y to this question. This will provide a Sun-like /dev/audio,
	  compatible with the Linux/i386 sound system. Otherwise, say N.

	  This driver is also available as a module ( = code which can be
	  inserted in and removed from the running kernel whenever you
	  want). If you want to compile it as a module, say M here and read
	  <file:Documentation/kbuild/modules.txt>.

config DMASOUND_Q40
	tristate "Q40 sound support"
	depends on Q40 && SOUND
	select DMASOUND
	help
	  If you want to use the internal audio of your Q40 in Linux, answer
	  Y to this question. This will provide a Sun-like /dev/audio,
	  compatible with the Linux/i386 sound system. Otherwise, say N.

	  This driver is also available as a module ( = code which can be
	  inserted in and removed from the running kernel whenever you
	  want). If you want to compile it as a module, say M here and read
	  <file:Documentation/kbuild/modules.txt>.

config DMASOUND
	tristate
```

## sound/parisc/Kconfig
```kconfig
# SPDX-License-Identifier: GPL-2.0-only
# ALSA PA-RISC drivers

menuconfig SND_GSC
	bool "GSC sound devices"
	depends on GSC
	default y
	help
	  Support for GSC sound devices on PA-RISC architectures.

if SND_GSC

config SND_HARMONY
	tristate "Harmony/Vivace sound chip"
	select SND_PCM
	help
	  Say 'Y' or 'M' to include support for the Harmony/Vivace sound
	  chip found in most GSC-based PA-RISC workstations.  It's frequently
	  provided as part of the Lasi multi-function IC.

endif	# SND_GSC
```
