## sound/soc/Kconfig
```kconfig
# SPDX-License-Identifier: GPL-2.0-only
#
# SoC audio configuration
#

menuconfig SND_SOC
	tristate "ALSA for SoC audio support"
	select SND_PCM
	select AC97_BUS if SND_SOC_AC97_BUS
	select SND_JACK
	select REGMAP_I2C if I2C
	select REGMAP_SPI if SPI_MASTER
	help

	  If you want ASoC support, you should say Y here and also to the
	  specific driver for your SoC platform below.

	  ASoC provides power efficient ALSA support for embedded battery powered
	  SoC based systems like PDA's, Phones and Personal Media Players.

	  This ASoC audio support can also be built as a module.  If so, the module
	  will be called snd-soc-core.

if SND_SOC

config SND_SOC_AC97_BUS
	bool

config SND_SOC_GENERIC_DMAENGINE_PCM
	bool
	select SND_DMAENGINE_PCM

config SND_SOC_COMPRESS
	bool
	select SND_COMPRESS_OFFLOAD

config SND_SOC_TOPOLOGY
	bool
	select SND_DYNAMIC_MINORS

config SND_SOC_TOPOLOGY_BUILD
	bool "Build topology core"
	select SND_SOC_TOPOLOGY
	depends on KUNIT
	help
	  This option exists to facilitate running the KUnit tests for
	  the topology core, KUnit is frequently tested in virtual
	  environments with minimal drivers enabled but the topology
	  core is usually selected by drivers.  There is little reason
	  to enable it if not doing a KUnit build.

config SND_SOC_TOPOLOGY_KUNIT_TEST
	tristate "KUnit tests for SoC topology"
	depends on KUNIT
	depends on SND_SOC_TOPOLOGY
	default KUNIT_ALL_TESTS
	help
	  If you want to perform tests on ALSA SoC topology support say Y here.

	  This builds a module which can be later manually loaded to run KUNIT
	  test cases against soc-topology.c API. This should be primarily used
	  by developers to test their changes to ASoC.

	  Do note that it creates fake playback devices which do not interact
	  well with userspace. When running tests one may want to disable
	  userspace applications such as pulseaudio, to prevent unnecessary
	  problems.

config SND_SOC_CARD_KUNIT_TEST
	tristate "KUnit tests for SoC card"
	depends on KUNIT
	default KUNIT_ALL_TESTS
	help
	  If you want to perform tests on ALSA SoC card functions say Y here.
	  If unsure, say N.

config SND_SOC_UTILS_KUNIT_TEST
	tristate "KUnit tests for SoC utils"
	depends on KUNIT
	default KUNIT_ALL_TESTS
	help
	  If you want to perform tests on ALSA SoC utils library say Y here.

config SND_SOC_ACPI
	tristate

# All the supported SoCs
source "sound/soc/adi/Kconfig"
source "sound/soc/amd/Kconfig"
source "sound/soc/apple/Kconfig"
source "sound/soc/atmel/Kconfig"
source "sound/soc/au1x/Kconfig"
source "sound/soc/bcm/Kconfig"
source "sound/soc/cirrus/Kconfig"
source "sound/soc/dwc/Kconfig"
source "sound/soc/fsl/Kconfig"
source "sound/soc/google/Kconfig"
source "sound/soc/hisilicon/Kconfig"
source "sound/soc/jz4740/Kconfig"
source "sound/soc/kirkwood/Kconfig"
source "sound/soc/loongson/Kconfig"
source "sound/soc/img/Kconfig"
source "sound/soc/intel/Kconfig"
source "sound/soc/mediatek/Kconfig"
source "sound/soc/meson/Kconfig"
source "sound/soc/mxs/Kconfig"
source "sound/soc/pxa/Kconfig"
source "sound/soc/qcom/Kconfig"
source "sound/soc/renesas/Kconfig"
source "sound/soc/rockchip/Kconfig"
source "sound/soc/samsung/Kconfig"
source "sound/soc/sdca/Kconfig"
source "sound/soc/sof/Kconfig"
source "sound/soc/spear/Kconfig"
source "sound/soc/sprd/Kconfig"
source "sound/soc/starfive/Kconfig"
source "sound/soc/sti/Kconfig"
source "sound/soc/stm/Kconfig"
source "sound/soc/sunxi/Kconfig"
source "sound/soc/tegra/Kconfig"
source "sound/soc/ti/Kconfig"
source "sound/soc/uniphier/Kconfig"
source "sound/soc/ux500/Kconfig"
source "sound/soc/xilinx/Kconfig"
source "sound/soc/xtensa/Kconfig"

# Supported codecs
source "sound/soc/codecs/Kconfig"

source "sound/soc/sdw_utils/Kconfig"

# generic frame-work
source "sound/soc/generic/Kconfig"

endif	# SND_SOC
```

## sound/soc/adi/Kconfig
```kconfig
# SPDX-License-Identifier: GPL-2.0-only
menu "Analog Devices"

config SND_SOC_ADI_AXI_I2S
	tristate "AXI-I2S support"
	select SND_SOC_GENERIC_DMAENGINE_PCM
	select REGMAP_MMIO
	help
	  ASoC driver for the Analog Devices AXI-I2S softcore peripheral.

config SND_SOC_ADI_AXI_SPDIF
	tristate "AXI-SPDIF support"
	select SND_SOC_GENERIC_DMAENGINE_PCM
	select REGMAP_MMIO
	help
	  ASoC driver for the Analog Devices AXI-SPDIF softcore peripheral.

endmenu
```

## sound/soc/amd/Kconfig
```kconfig
# SPDX-License-Identifier: GPL-2.0-only
config SND_SOC_AMD_ACP
	tristate "AMD Audio Coprocessor support"
	help
	 This option enables ACP DMA support on AMD platform.

config SND_SOC_AMD_CZ_DA7219MX98357_MACH
	tristate "AMD CZ support for DA7219, RT5682 and MAX9835"
	select CLK_FIXED_FCH
	select SND_SOC_DA7219
	select SND_SOC_RT5682_I2C
	select SND_SOC_MAX98357A
	select SND_SOC_ADAU7002
	select REGULATOR
	depends on SND_SOC_AMD_ACP && I2C && GPIOLIB && ACPI
	help
	 This option enables machine driver for DA7219, RT5682 and MAX9835.

config SND_SOC_AMD_CZ_RT5645_MACH
	tristate "AMD CZ support for RT5645"
	select SND_SOC_RT5645
	depends on SND_SOC_AMD_ACP && I2C
	help
	 This option enables machine driver for rt5645.

config SND_SOC_AMD_ST_ES8336_MACH
	tristate "AMD ST support for ES8336"
	select SND_SOC_ACPI if ACPI
	select SND_SOC_ES8316
	depends on SND_SOC_AMD_ACP && ACPI
	depends on I2C
	help
	 This option enables machine driver for Jadeite platform
	 using es8336 codec.
	 Say m if you have such a device.
	 If unsure select "N".

config SND_SOC_AMD_ACP3x
	tristate "AMD Audio Coprocessor-v3.x support"
	depends on X86 && PCI
	help
	 This option enables ACP v3.x I2S support on AMD platform

config SND_SOC_AMD_RV_RT5682_MACH
	tristate "AMD RV support for RT5682"
	select CLK_FIXED_FCH
	select SND_SOC_RT5682_I2C
	select SND_SOC_MAX98357A
	select SND_SOC_CROS_EC_CODEC
	select I2C_CROS_EC_TUNNEL
	select SND_SOC_RT1015
	select SND_SOC_RT1015P
	depends on SND_SOC_AMD_ACP3x && I2C && CROS_EC && GPIOLIB
	help
	 This option enables machine driver for RT5682 and MAX9835.

config SND_SOC_AMD_RENOIR
	tristate "AMD Audio Coprocessor - Renoir support"
	select SND_AMD_ACP_CONFIG
	depends on X86 && PCI
	help
	 This option enables ACP support for Renoir platform

config SND_SOC_AMD_RENOIR_MACH
	tristate "AMD Renoir support for DMIC"
	select SND_SOC_DMIC
	depends on SND_SOC_AMD_RENOIR && GPIOLIB
	help
	 This option enables machine driver for DMIC

config SND_SOC_AMD_ACP5x
	tristate "AMD Audio Coprocessor-v5.x I2S support"
	depends on X86 && PCI
	help
	 This option enables ACP v5.x support on AMD platform

	 By enabling this flag build will trigger for ACP PCI driver,
	 ACP DMA driver, CPU DAI driver.

config SND_SOC_AMD_VANGOGH_MACH
	tristate "AMD Vangogh support for NAU8821 CS35L41"
	select SND_SOC_NAU8821
	select SND_SOC_CS35L41_SPI
	depends on SND_SOC_AMD_ACP5x && I2C && SPI_MASTER
	help
	  This option enables machine driver for Vangogh platform
	  using NAU8821 and CS35L41 codecs.
	  Say m if you have such a device.
	  If unsure select "N".

config SND_SOC_AMD_ACP6x
	tristate "AMD Audio Coprocessor-v6.x Yellow Carp support"
	depends on X86 && PCI
	help
	  This option enables Audio Coprocessor i.e ACP v6.x support on
	  AMD Yellow Carp platform. By enabling this flag build will be
	  triggered for ACP PCI driver, ACP PDM DMA driver.
	  Say m if you have such a device.
	  If unsure select "N".

config SND_SOC_AMD_YC_MACH
	tristate "AMD YC support for DMIC"
	select SND_SOC_DMIC
	depends on SND_SOC_AMD_ACP6x
	help
	  This option enables machine driver for Yellow Carp platform
	  using dmic. ACP IP has PDM Decoder block with DMA controller.
	  DMIC can be connected directly to ACP IP.
	  Say m if you have such a device.
	  If unsure select "N".

config SND_AMD_ACP_CONFIG
	tristate "AMD ACP configuration selection"
	select SND_SOC_ACPI if ACPI
	help
	 This option adds an auto detection to determine which ACP
	 driver modules to use

source "sound/soc/amd/acp/Kconfig"

config SND_SOC_AMD_RPL_ACP6x
        tristate "AMD Audio Coprocessor-v6.2 RPL support"
        depends on X86 && PCI
        help
          This option enables Audio Coprocessor i.e. ACP v6.2 support on
          AMD RPL platform. By enabling this flag build will be
          triggered for ACP PCI driver.
          Say m if you have such a device.
          If unsure select "N".

config SND_SOC_AMD_PS
        tristate "AMD Audio Coprocessor-v6.3 Pink Sardine support"
        depends on X86 && PCI && ACPI
        help
          This option enables Audio Coprocessor i.e ACP v6.3 support on
          AMD Pink sardine platform. By enabling this flag build will be
          triggered for ACP PCI driver, ACP PDM DMA driver.
          Say m if you have such a device.
          If unsure select "N".

config SND_SOC_AMD_PS_MACH
        tristate "AMD PINK SARDINE support for DMIC"
        select SND_SOC_DMIC
        depends on SND_SOC_AMD_PS
        help
          This option enables machine driver for Pink Sardine platform
          using dmic. ACP IP has PDM Decoder block with DMA controller.
          DMIC can be connected directly to ACP IP.
          Say m if you have such a device.
          If unsure select "N".
```

## sound/soc/amd/acp/Kconfig
```kconfig
# SPDX-License-Identifier: (GPL-2.0-only OR BSD-3-Clause)
# This file is provided under a dual BSD/GPLv2 license. When using or
# redistributing this file, you may do so under either license.
#
# Copyright(c) 2021 Advanced Micro Devices, Inc. All rights reserved.
#

config SND_SOC_AMD_ACP_COMMON
	tristate "AMD Audio ACP Common support"
	select SND_AMD_ACP_CONFIG
	depends on X86 && PCI
	help
	  This option enables common modules for Audio-Coprocessor i.e. ACP
	  IP block on AMD platforms.

config SND_SOC_ACPI_AMD_MATCH
	tristate
	select SND_SOC_ACPI if ACPI

if SND_SOC_AMD_ACP_COMMON

config SND_SOC_AMD_ACP_PDM
	tristate

config SND_SOC_AMD_ACP_LEGACY_COMMON
	tristate

config SND_SOC_AMD_ACP_I2S
	tristate

config SND_SOC_AMD_ACPI_MACH
	tristate

config SND_SOC_AMD_ACP_PCM
	tristate
	select SND_SOC_ACPI if ACPI

config SND_SOC_AMD_ACP_PCI
	tristate "AMD ACP PCI Driver Support"
	depends on X86 && PCI
	depends on ACPI
	select SND_SOC_AMD_ACP_LEGACY_COMMON
	select SND_SOC_AMD_ACPI_MACH
	help
	  This options enables generic PCI driver for ACP device.

config SND_AMD_ASOC_RENOIR
	tristate "AMD ACP ASOC Renoir Support"
	depends on ACPI
	select SND_SOC_AMD_ACP_PCM
	select SND_SOC_AMD_ACP_I2S
	select SND_SOC_AMD_ACP_PDM
	select SND_SOC_AMD_ACP_LEGACY_COMMON
	select SND_SOC_AMD_ACPI_MACH
	depends on X86 && PCI
	help
	  This option enables Renoir I2S support on AMD platform.

config SND_AMD_ASOC_REMBRANDT
	tristate "AMD ACP ASOC Rembrandt Support"
	depends on ACPI
	select SND_SOC_AMD_ACP_PCM
	select SND_SOC_AMD_ACP_I2S
	select SND_SOC_AMD_ACP_PDM
	select SND_SOC_AMD_ACP_LEGACY_COMMON
	select SND_SOC_AMD_ACPI_MACH
	depends on AMD_NODE
	depends on X86 && PCI
	help
	  This option enables Rembrandt I2S support on AMD platform.
	  Say Y if you want to enable AUDIO on Rembrandt
	  If unsure select "N".

config SND_AMD_ASOC_ACP63
	tristate "AMD ACP ASOC ACP6.3 Support"
	depends on X86 && PCI
	depends on ACPI
	depends on AMD_NODE
	select SND_SOC_AMD_ACP_PCM
	select SND_SOC_AMD_ACP_I2S
	select SND_SOC_AMD_ACP_PDM
	select SND_SOC_AMD_ACP_LEGACY_COMMON
	select SND_SOC_AMD_ACPI_MACH
	help
	  This option enables Acp6.3 I2S support on AMD platform.
	  Say Y if you want to enable AUDIO on ACP6.3
	  If unsure select "N".

config SND_AMD_ASOC_ACP70
	tristate "AMD ACP ASOC Acp7.0 Support"
	depends on X86 && PCI
	depends on ACPI
	depends on AMD_NODE
	select SND_SOC_AMD_ACP_PCM
	select SND_SOC_AMD_ACP_I2S
	select SND_SOC_AMD_ACP_PDM
	select SND_SOC_AMD_ACP_LEGACY_COMMON
	select SND_SOC_AMD_ACPI_MACH
	help
	This option enables Acp7.0 PDM support on AMD platform.
	Say Y if you want to enable AUDIO on ACP7.0
          If unsure select "N".

config SND_SOC_AMD_MACH_COMMON
	tristate
	depends on X86 && PCI && I2C
	select CLK_FIXED_FCH
	select SND_SOC_RT5682_I2C
	select SND_SOC_DMIC
	select SND_SOC_RT1019
	select SND_SOC_MAX98357A
	select SND_SOC_RT5682S
	select SND_SOC_NAU8825
	select SND_SOC_NAU8821
	select SND_SOC_MAX98388
	help
	  This option enables common Machine driver module for ACP.

config SND_SOC_AMD_LEGACY_MACH
	tristate "AMD Legacy Machine Driver Support"
	depends on X86 && PCI && I2C
	select SND_SOC_AMD_MACH_COMMON
	help
	  This option enables legacy sound card support for ACP audio.

config SND_SOC_AMD_SOF_MACH
	tristate "AMD SOF Machine Driver Support"
	depends on X86 && PCI && I2C
	select SND_SOC_AMD_MACH_COMMON
	help
	  This option enables SOF sound card support for ACP audio.

config SND_SOC_AMD_SDW_MACH_COMMON
	tristate
	help
	  This option enables common SoundWire Machine driver module for
	  AMD platforms.

config SND_SOC_AMD_SOF_SDW_MACH
	tristate "AMD SOF Soundwire Machine Driver Support"
	depends on X86 && PCI && ACPI
	depends on SOUNDWIRE
	select SND_SOC_AMD_SDW_MACH_COMMON
	select SND_SOC_SDW_UTILS
	select SND_SOC_DMIC
	select SND_SOC_RT711_SDW
	select SND_SOC_RT711_SDCA_SDW
	select SND_SOC_RT1316_SDW
	select SND_SOC_RT715_SDW
	select SND_SOC_RT715_SDCA_SDW
	select SND_SOC_RT722_SDCA_SDW
	help
	  This option enables SOF sound card support for SoundWire enabled
	  AMD platforms along with ACP PDM controller.
	  Say Y if you want to enable SoundWire based machine driver support
	  on AMD platform.
	  If unsure select "N".

config SND_SOC_AMD_LEGACY_SDW_MACH
	tristate "AMD Legacy(No DSP) Soundwire Machine Driver Support"
	depends on X86 && PCI && ACPI
	depends on SOUNDWIRE
	select SND_SOC_AMD_SDW_MACH_COMMON
	select SND_SOC_SDW_UTILS
	select SND_SOC_DMIC
	select SND_SOC_RT711_SDW
	select SND_SOC_RT711_SDCA_SDW
	select SND_SOC_RT712_SDCA_SDW
	select SND_SOC_RT712_SDCA_DMIC_SDW
	select SND_SOC_RT1316_SDW
	select SND_SOC_RT1320_SDW
	select SND_SOC_RT715_SDW
	select SND_SOC_RT715_SDCA_SDW
	select SND_SOC_RT722_SDCA_SDW
	help
	  This option enables Legacy(No DSP) sound card support for SoundWire
	  enabled AMD platforms along with ACP PDM controller.
	  Say Y if you want to enable SoundWire based machine driver support
	  on AMD platform.
	  If unsure select "N".

endif # SND_SOC_AMD_ACP_COMMON

config SND_AMD_SOUNDWIRE_ACPI
	tristate
	depends on ACPI
	help
	  This options enables ACPI helper functions for SoundWire
	  interface for AMD platforms.
```

## sound/soc/aml/Kconfig
```kconfig
menuconfig SND_AML_M6_SOC
	tristate "Audio for Amlogic Meson6 SoC"
	depends on PLAT_MESON
	help
	  Say Y or M if you want to add support for codecs attached to
	  the Amlogic I2S interface. You will also need
	  to select the audio interfaces to support below.

menuconfig SND_AML_M8_SOC
	tristate "Audio for Amlogic Meson8 SoC"
	depends on PLAT_MESON
	help
	  Say Y or M if you want to add support for codecs attached to
	  the Amlogic I2S interface. You will also need
	  to select the audio interfaces to support below.

if SND_AML_M6_SOC

# for Amlogic m6 SoC
source "sound/soc/aml/m6/Kconfig"

endif  # SND_AML_M6_SOC

if SND_AML_M8_SOC

source "sound/soc/aml/m8/Kconfig"

endif # SND_AML_M8_SOC
```
