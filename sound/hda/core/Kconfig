## sound/pci/hda/Kconfig
```kconfig
# SPDX-License-Identifier: GPL-2.0-only
menu "HD-Audio"

config SND_HDA_GENERIC_LEDS
       bool

if SND_HDA

config SND_HDA_CIRRUS_SCODEC
	tristate

config SND_HDA_CIRRUS_SCODEC_KUNIT_TEST
	tristate "KUnit test for Cirrus side-codec library" if !KUNIT_ALL_TESTS
	depends on SND_HDA_CIRRUS_SCODEC && GPIOLIB && KUNIT
	default KUNIT_ALL_TESTS
	help
	  This builds KUnit tests for the cirrus side-codec library.
	  For more information on KUnit and unit tests in general,
	  please refer to the KUnit documentation in
	  Documentation/dev-tools/kunit/.
	  If in doubt, say "N".

config SND_HDA_SCODEC_CS35L41
	tristate
	select SND_HDA_GENERIC
	select REGMAP_IRQ
	select FW_CS_DSP

config SND_HDA_SCODEC_COMPONENT
	tristate

config SND_HDA_SCODEC_CS35L41_I2C
	tristate "Build CS35L41 HD-audio side codec support for I2C Bus"
	depends on I2C
	depends on ACPI
	depends on EFI
	depends on SND_SOC
	select SND_SOC_CS35L41_LIB
	select SND_HDA_SCODEC_CS35L41
	select SND_SOC_CS_AMP_LIB
	help
	  Say Y or M here to include CS35L41 I2C HD-audio side codec support
	  in snd-hda-intel driver, such as ALC287.

comment "Set to Y if you want auto-loading the side codec driver"
	depends on SND_HDA=y && SND_HDA_SCODEC_CS35L41_I2C=m

config SND_HDA_SCODEC_CS35L41_SPI
	tristate "Build CS35L41 HD-audio codec support for SPI Bus"
	depends on SPI_MASTER
	depends on ACPI
	depends on EFI
	depends on SND_SOC
	select SND_SOC_CS35L41_LIB
	select SND_HDA_SCODEC_CS35L41
	select SND_SOC_CS_AMP_LIB
	help
	  Say Y or M here to include CS35L41 SPI HD-audio side codec support
	  in snd-hda-intel driver, such as ALC287.

comment "Set to Y if you want auto-loading the side codec driver"
	depends on SND_HDA=y && SND_HDA_SCODEC_CS35L41_SPI=m

config SND_HDA_SCODEC_CS35L56
	tristate

config SND_HDA_SCODEC_CS35L56_I2C
	tristate "Build CS35L56 HD-audio side codec support for I2C Bus"
	depends on I2C
	depends on ACPI
	depends on SND_SOC
	select FW_CS_DSP
	imply SERIAL_MULTI_INSTANTIATE
	select SND_HDA_GENERIC
	select SND_SOC_CS35L56_SHARED
	select SND_HDA_SCODEC_CS35L56
	select SND_HDA_CIRRUS_SCODEC
	select SND_SOC_CS_AMP_LIB
	help
	  Say Y or M here to include CS35L56 amplifier support with
	  I2C control.

config SND_HDA_SCODEC_CS35L56_SPI
	tristate "Build CS35L56 HD-audio side codec support for SPI Bus"
	depends on SPI_MASTER
	depends on ACPI
	depends on SND_SOC
	select FW_CS_DSP
	imply SERIAL_MULTI_INSTANTIATE
	select SND_HDA_GENERIC
	select SND_SOC_CS35L56_SHARED
	select SND_HDA_SCODEC_CS35L56
	select SND_HDA_CIRRUS_SCODEC
	select SND_SOC_CS_AMP_LIB
	help
	  Say Y or M here to include CS35L56 amplifier support with
	  SPI control.

config SND_HDA_SCODEC_TAS2781
	tristate
	select SND_HDA_GENERIC

config SND_HDA_SCODEC_TAS2781_I2C
	tristate "Build TAS2781 HD-audio side codec support for I2C Bus"
	depends on I2C
	depends on ACPI
	depends on EFI
	depends on SND_SOC
	select SND_HDA_SCODEC_TAS2781
	select SND_SOC_TAS2781_COMLIB_I2C
	select SND_SOC_TAS2781_FMWLIB
	select CRC32
	help
	  Say Y or M here to include TAS2781 I2C HD-audio side codec support
	  in snd-hda-intel driver, such as ALC287.

comment "Set to Y if you want auto-loading the side codec driver"
	depends on SND_HDA=y && SND_HDA_SCODEC_TAS2781_I2C=m

config SND_HDA_SCODEC_TAS2781_SPI
	tristate "Build TAS2781 HD-audio side codec support for SPI Bus"
	depends on SPI_MASTER
	depends on ACPI
	depends on EFI
	depends on SND_SOC
	select SND_HDA_SCODEC_TAS2781
	select SND_SOC_TAS2781_COMLIB
	select SND_SOC_TAS2781_FMWLIB
	select CRC8
	select CRC32
	help
	  Say Y or M here to include TAS2781 SPI HD-audio side codec support
	  in snd-hda-intel driver, such as ALC287.

comment "Set to Y if you want auto-loading the side codec driver"
	depends on SND_HDA=y && SND_HDA_SCODEC_TAS2781_SPI=m

config SND_HDA_CODEC_REALTEK
	tristate "Build Realtek HD-audio codec support"
	depends on INPUT
	select SND_HDA_GENERIC
	select SND_HDA_GENERIC_LEDS
	select SND_HDA_SCODEC_COMPONENT
	help
	  Say Y or M here to include Realtek HD-audio codec support in
	  snd-hda-intel driver, such as ALC880.

comment "Set to Y if you want auto-loading the codec driver"
	depends on SND_HDA=y && SND_HDA_CODEC_REALTEK=m

config SND_HDA_CODEC_ANALOG
	tristate "Build Analog Devices HD-audio codec support"
	select SND_HDA_GENERIC
	help
	  Say Y or M here to include Analog Devices HD-audio codec support in
	  snd-hda-intel driver, such as AD1986A.

comment "Set to Y if you want auto-loading the codec driver"
	depends on SND_HDA=y && SND_HDA_CODEC_ANALOG=m

config SND_HDA_CODEC_SIGMATEL
	tristate "Build IDT/Sigmatel HD-audio codec support"
	select SND_HDA_GENERIC
	select SND_HDA_GENERIC_LEDS
	help
	  Say Y or M here to include IDT (Sigmatel) HD-audio codec support in
	  snd-hda-intel driver, such as STAC9200.

comment "Set to Y if you want auto-loading the codec driver"
	depends on SND_HDA=y && SND_HDA_CODEC_SIGMATEL=m

config SND_HDA_CODEC_VIA
	tristate "Build VIA HD-audio codec support"
	select SND_HDA_GENERIC
	help
	  Say Y or M here to include VIA HD-audio codec support in
	  snd-hda-intel driver, such as VT1708.

comment "Set to Y if you want auto-loading the codec driver"
	depends on SND_HDA=y && SND_HDA_CODEC_VIA=m

config SND_HDA_CODEC_HDMI
	tristate "Build HDMI/DisplayPort HD-audio codec support"
	select SND_DYNAMIC_MINORS
	select SND_PCM_ELD
	help
	  Say Y or M here to include HDMI and DisplayPort HD-audio codec
	  support in snd-hda-intel driver.  This includes all AMD/ATI,
	  Intel and Nvidia HDMI/DisplayPort codecs.

	  Note that this option mandatorily enables CONFIG_SND_DYNAMIC_MINORS
	  to assure the multiple streams for DP-MST support.

comment "Set to Y if you want auto-loading the codec driver"
	depends on SND_HDA=y && SND_HDA_CODEC_HDMI=m

config SND_HDA_CODEC_CIRRUS
	tristate "Build Cirrus Logic codec support"
	select SND_HDA_GENERIC
	help
	  Say Y or M here to include Cirrus Logic codec support in
	  snd-hda-intel driver, such as CS4206.

comment "Set to Y if you want auto-loading the codec driver"
	depends on SND_HDA=y && SND_HDA_CODEC_CIRRUS=m

config SND_HDA_CODEC_CS8409
	tristate "Build Cirrus Logic HDA bridge support"
	select SND_HDA_GENERIC
	help
	  Say Y or M here to include Cirrus Logic HDA bridge support in
	  snd-hda-intel driver, such as CS8409.

comment "Set to Y if you want auto-loading the codec driver"
	depends on SND_HDA=y && SND_HDA_CODEC_CS8409=m

config SND_HDA_CODEC_CONEXANT
	tristate "Build Conexant HD-audio codec support"
	select SND_HDA_GENERIC
	select SND_HDA_GENERIC_LEDS
	help
	  Say Y or M here to include Conexant HD-audio codec support in
	  snd-hda-intel driver, such as CX20549.

comment "Set to Y if you want auto-loading the codec driver"
	depends on SND_HDA=y && SND_HDA_CODEC_CONEXANT=m

config SND_HDA_CODEC_SENARYTECH
	tristate "Build Senarytech HD-audio codec support"
	select SND_HDA_GENERIC
	select SND_HDA_GENERIC_LEDS
	help
	  Say Y or M here to include Senarytech HD-audio codec support in
	  snd-hda-intel driver, such as SN6186.

comment "Set to Y if you want auto-loading the codec driver"
	depends on SND_HDA=y && SND_HDA_CODEC_SENARYTECH=m

config SND_HDA_CODEC_CA0110
	tristate "Build Creative CA0110-IBG codec support"
	select SND_HDA_GENERIC
	help
	  Say Y or M here to include Creative CA0110-IBG codec support in
	  snd-hda-intel driver, found on some Creative X-Fi cards.

comment "Set to Y if you want auto-loading the codec driver"
	depends on SND_HDA=y && SND_HDA_CODEC_CA0110=m

config SND_HDA_CODEC_CA0132
	tristate "Build Creative CA0132 codec support"
	help
	  Say Y or M here to include Creative CA0132 codec support in
	  snd-hda-intel driver.

comment "Set to Y if you want auto-loading the codec driver"
	depends on SND_HDA=y && SND_HDA_CODEC_CA0132=m

config SND_HDA_CODEC_CA0132_DSP
	bool "Support new DSP code for CA0132 codec"
	depends on SND_HDA_CODEC_CA0132
	default y
	select SND_HDA_DSP_LOADER
	select FW_LOADER
	help
	  Say Y here to enable the DSP for Creative CA0132 for extended
	  features like equalizer or echo cancellation.

	  Note that this option requires the external firmware file
	  (ctefx.bin).

config SND_HDA_CODEC_CMEDIA
	tristate "Build C-Media HD-audio codec support"
	select SND_HDA_GENERIC
	help
	  Say Y or M here to include C-Media HD-audio codec support in
	  snd-hda-intel driver, such as CMI9880.

comment "Set to Y if you want auto-loading the codec driver"
	depends on SND_HDA=y && SND_HDA_CODEC_CMEDIA=m

config SND_HDA_CODEC_SI3054
	tristate "Build Silicon Labs 3054 HD-modem codec support"
	help
	  Say Y or M here to include Silicon Labs 3054 HD-modem codec
	  (and compatibles) support in snd-hda-intel driver.

comment "Set to Y if you want auto-loading the codec driver"
	depends on SND_HDA=y && SND_HDA_CODEC_SI3054=m

config SND_HDA_GENERIC
	tristate "Enable generic HD-audio codec parser"
	select SND_CTL_LED if SND_HDA_GENERIC_LEDS
	select LEDS_CLASS if SND_HDA_GENERIC_LEDS
	help
	  Say Y or M here to enable the generic HD-audio codec parser
	  in snd-hda-intel driver.

comment "Set to Y if you want auto-loading the codec driver"
	depends on SND_HDA=y && SND_HDA_GENERIC=m

config SND_HDA_INTEL_HDMI_SILENT_STREAM
	bool "Enable Silent Stream always for HDMI"
	depends on SND_HDA_INTEL
	help
	  Say Y to enable HD-Audio Keep Alive (KAE) aka Silent Stream
	  for HDMI on hardware that supports the feature.

	  When enabled, the HDMI/DisplayPort codec will continue to provide
	  a continuous clock and a valid but silent data stream to
	  any connected external receiver. This allows to avoid gaps
	  at start of playback. Many receivers require multiple seconds
	  to start playing audio after the clock has been stopped.
	  This feature can impact power consumption as resources
	  are kept reserved both at transmitter and receiver.

endif

endmenu
```

## sound/pcmcia/Kconfig
```kconfig
# SPDX-License-Identifier: GPL-2.0-only
# ALSA PCMCIA drivers

menuconfig SND_PCMCIA
	bool "PCMCIA sound devices"
	depends on PCMCIA
	depends on HAS_IOPORT
	default y
	help
	  Support for sound devices connected via the PCMCIA bus.

if SND_PCMCIA && PCMCIA

config SND_VXPOCKET
	tristate "Digigram VXpocket"
	select SND_VX_LIB
	help
	  Say Y here to include support for Digigram VXpocket and
	  VXpocket 440 soundcards.

	  To compile this driver as a module, choose M here: the module
	  will be called snd-vxpocket.

config SND_PDAUDIOCF
	tristate "Sound Core PDAudioCF"
	select SND_PCM
	help
	  Say Y here to include support for Sound Core PDAudioCF
	  soundcards.

	  To compile this driver as a module, choose M here: the module
	  will be called snd-pdaudiocf.

endif	# SND_PCMCIA
```

## sound/ppc/Kconfig
```kconfig
# ALSA PowerMac drivers

menu "ALSA PowerMac devices"
	depends on SND!=n && PPC

comment "ALSA PowerMac requires I2C"
	depends on SND && I2C=n

comment "ALSA PowerMac requires INPUT"
	depends on SND && INPUT=n

config SND_POWERMAC
	tristate "PowerMac (AWACS, DACA, Burgundy, Tumbler, Keywest)"
	depends on SND && I2C && INPUT && PPC_PMAC
	select SND_PCM
	help
	  Say Y here to include support for the integrated sound device.

	  To compile this driver as a module, choose M here: the module
	  will be called snd-powermac.

config SND_POWERMAC_AUTO_DRC
	bool "Toggle DRC automatically at headphone/line plug-in"
	depends on SND_POWERMAC
	default y
	help
	  Say Y here to enable the automatic toggle of DRC (dynamic
	  range compression) on Tumbler/Snapper.
	  If this feature is enabled, DRC is turned off when the
	  headphone/line jack is plugged, and turned on when unplugged.

	  Note that you can turn on/off DRC manually even without this
	  option.

endmenu

menu "ALSA PowerPC devices"
	depends on SND!=n && ( PPC64 || PPC32 )

config SND_PS3
	tristate "PS3 Audio support"
	depends on SND && PS3_PS3AV
	select SND_PCM
	default m
	help
	  Say Y here to include support for audio on the PS3

	  To compile this driver as a module, choose M here: the module
	  will be called snd_ps3.

config SND_PS3_DEFAULT_START_DELAY
	int "Startup delay time in ms"
	depends on SND_PS3
	default "2000"
endmenu
```

## sound/sh/Kconfig
```kconfig
# SPDX-License-Identifier: GPL-2.0-only
# ALSA SH drivers

menuconfig SND_SUPERH
	bool "SUPERH sound devices"
	depends on SUPERH
	default y
	help
	  Support for sound devices specific to SUPERH architectures.
	  Drivers that are implemented on ASoC can be found in
	  "ALSA for SoC audio support" section.

if SND_SUPERH

config SND_AICA
	tristate "Dreamcast Yamaha AICA sound"
	depends on SH_DREAMCAST && SH_DMA_API
	select SND_PCM
	select G2_DMA
	help
	  ALSA Sound driver for the SEGA Dreamcast console.

config SND_SH_DAC_AUDIO
	tristate "SuperH DAC audio support"
	depends on SND
	depends on CPU_SH3 && HIGH_RES_TIMERS
	select SND_PCM
	help
	  Say Y here to include support for the on-chip DAC.

endif	# SND_SUPERH
```
