## sound/soc/aml/m6/Kconfig
```kconfig
config SND_AML_M6_RT5631
	tristate "M6 evaluation board with RT5631"
	depends on SND_AML_M6_SOC
	select SND_SOC_RT5631 if SND_AML_M6_RT5631

config SND_AML_M6_RT5616
	tristate "M6 evaluation board with RT5616"
	depends on SND_AML_M6_SOC
	select SND_SOC_RT5616 if SND_AML_M6_RT5616

config SND_AML_M6_RT3261
	tristate "M6 evaluation board with RT3261"
	depends on SND_AML_M6_SOC
	select SND_SOC_RT3261 if SND_AML_M6_RT3261
	select SND_HWDEP
config SND_AML_M6_WM8960
	tristate "M6 evaluation board with WM8960"
	depends on SND_AML_M6_SOC
	select SND_SOC_WM8960 if SND_AML_M6_WM8960
config SND_AML_M6_PCM2BT
	tristate "M6 evaluation board with PCM2BT"
	depends on SND_AML_M6_SOC
	select SND_SOC_PCM2BT

config SND_AML_M_DUMMY_CODEC
    tristate "AML M series board with DUMMY_CODEC"
    depends on SND_AML_M6_SOC
    select SND_SOC_DUMMY_CODEC if SND_AML_M_DUMMY_CODEC
config SND_AML_M6TV_AUDIO_CODEC
	tristate "AML M6TV evaluation board,this must be selected for all m6tv board"
	depends on SND_AML_M6_SOC
	select SND_AML_M6TV_SYNOPSYS9629_CODEC
	select SND_SOC_TAS5711
	select SND_SOC_TAS5707
config SND_AML_M6TV_SYNOPSYS9629_CODEC
	tristate "AML M6TV  board with internal syno9629 codec"
	depends on SND_AML_M6TV_AUDIO_CODEC
```

## sound/soc/aml/m8/Kconfig
```kconfig
#config  SND_AML_SPDIF
#	tristate "Amlogic S/PDIF codec support"
#	depends on SND_AML_M8_SOC
#	select SND_SOC_AML_SPDIF_CODEC if SND_AML_SPDIF
config SND_AML_M8
	tristate "AML-SND-M8 Board"
	depends on SND_AML_M8_SOC && SWITCH
	select SND_SOC_AML_M8_CODEC if SND_AML_M8
    select SND_SOC_DUMMY_CODEC

config SND_ODROID_HIFI1
	tristate "ODROID HiFi-Shield1(pcm5102) Support"
	depends on SND_AML_M8_SOC && MACH_MESON8B_ODROIDC
	select SND_SOC_PCM5102

config SND_AML_M8_PCM
	tristate "M8 evaluation board with PCM2BT"
	depends on SND_AML_M8_SOC
	select SND_SOC_PCM2BT if SND_AML_M8_PCM
	
config SND_AML_M_DUMMY_CODEC
    tristate "AML M series board with DUMMY_CODEC"
    select SND_SOC_DUMMY_CODEC
```

## sound/soc/apple/Kconfig
```kconfig
config SND_SOC_APPLE_MCA
	tristate "Apple Silicon MCA driver"
	depends on ARCH_APPLE || COMPILE_TEST
	select SND_DMAENGINE_PCM
	help
	  This option enables an ASoC platform driver for MCA peripherals found
	  on Apple Silicon SoCs.
```

## sound/soc/at32/Kconfig
```kconfig
config SND_AT32_SOC
        tristate "SoC Audio for the Atmel AT32 System-on-a-Chip"
        depends on AVR32 && SND_SOC
        help
          Say Y or M if you want to add support for codecs attached to 
          the AT32 SSC interface.  You will also need to
          to select the audio interfaces to support below.


config SND_AT32_SOC_SSC
        tristate



config SND_AT32_SOC_PLAYPAQ
        tristate "SoC Audio support for PlayPaq with WM8510"
        depends on SND_AT32_SOC && BOARD_PLAYPAQ
        select SND_AT32_SOC_SSC
        select SND_SOC_WM8510
        help
          Say Y or M here if you want to add support for SoC audio
          on the LRS PlayPaq.



config SND_AT32_SOC_PLAYPAQ_SLAVE
        bool "Run CODEC on PlayPaq in slave mode"
        depends on SND_AT32_SOC_PLAYPAQ
        default n
        help
          Say Y if you want to run with the AT32 SSC generating the BCLK
          and FRAME signals on the PlayPaq.  Unless you want to play
          with the AT32 as the SSC master, you probably want to say N here,
          as this will give you better sound quality.
```

## sound/soc/at91/Kconfig
```kconfig
config SND_AT91_SOC
	tristate "SoC Audio for the Atmel AT91 System-on-Chip"
	depends on ARCH_AT91
	help
	  Say Y or M if you want to add support for codecs attached to
	  the AT91 SSC interface. You will also need
	  to select the audio interfaces to support below.

config SND_AT91_SOC_SSC
	tristate
```

## sound/soc/atmel/Kconfig
```kconfig
# SPDX-License-Identifier: GPL-2.0-only
config SND_ATMEL_SOC
	tristate "SoC Audio for the Atmel System-on-Chip"
	depends on HAS_IOMEM
	help
	  Say Y or M if you want to add support for codecs attached to
	  the ATMEL SSC interface. You will also need
	  to select the audio interfaces to support below.

if SND_ATMEL_SOC

config SND_ATMEL_SOC_PDC
	bool
	depends on HAS_DMA

config SND_ATMEL_SOC_DMA
	bool
	select SND_SOC_GENERIC_DMAENGINE_PCM

config SND_ATMEL_SOC_SSC
	tristate
	select SND_ATMEL_SOC_DMA
	select SND_ATMEL_SOC_PDC

config SND_ATMEL_SOC_SSC_PDC
	tristate "SoC PCM DAI support for AT91 SSC controller using PDC"
	depends on ATMEL_SSC
	select SND_ATMEL_SOC_PDC
	select SND_ATMEL_SOC_SSC
	help
	  Say Y or M if you want to add support for Atmel SSC interface
	  in PDC mode configured using audio-graph-card in device-tree.

config SND_ATMEL_SOC_SSC_DMA
	tristate "SoC PCM DAI support for AT91 SSC controller using DMA"
	depends on ATMEL_SSC
	select SND_ATMEL_SOC_DMA
	select SND_ATMEL_SOC_SSC
	help
	  Say Y or M if you want to add support for Atmel SSC interface
	  in DMA mode configured using audio-graph-card in device-tree.

config SND_AT91_SOC_SAM9G20_WM8731
	tristate "SoC Audio support for WM8731-based At91sam9g20 evaluation board"
	depends on ARCH_AT91 || COMPILE_TEST
	depends on ATMEL_SSC && SND_SOC_I2C_AND_SPI
	select SND_ATMEL_SOC_SSC_PDC
	select SND_SOC_WM8731
	help
	  Say Y if you want to add support for SoC audio on WM8731-based
	  AT91sam9g20 evaluation board.

config SND_ATMEL_SOC_WM8904
	tristate "Atmel ASoC driver for boards using WM8904 codec"
	depends on ARCH_AT91 || COMPILE_TEST
	depends on ATMEL_SSC && I2C
	select SND_ATMEL_SOC_SSC_DMA
	select SND_SOC_WM8904
	help
	  Say Y if you want to add support for Atmel ASoC driver for boards using
	  WM8904 codec.

config SND_AT91_SOC_SAM9X5_WM8731
	tristate "SoC Audio support for WM8731-based at91sam9x5 board"
	depends on ARCH_AT91 || COMPILE_TEST
	depends on ATMEL_SSC && SND_SOC_I2C_AND_SPI
	select SND_ATMEL_SOC_SSC_DMA
	select SND_SOC_WM8731
	help
	  Say Y if you want to add support for audio SoC on an
	  at91sam9x5 based board that is using WM8731 codec.

config SND_ATMEL_SOC_CLASSD
	tristate "Atmel ASoC driver for boards using CLASSD"
	depends on ARCH_AT91 || COMPILE_TEST
	select SND_SOC_GENERIC_DMAENGINE_PCM
	select REGMAP_MMIO
	help
	  Say Y if you want to add support for Atmel ASoC driver for boards using
	  CLASSD.

config SND_ATMEL_SOC_PDMIC
	tristate "Atmel ASoC driver for boards using PDMIC"
	depends on OF && (ARCH_AT91 || COMPILE_TEST)
	select SND_SOC_GENERIC_DMAENGINE_PCM
	select REGMAP_MMIO
	help
	  Say Y if you want to add support for Atmel ASoC driver for boards using
	  PDMIC.

config SND_ATMEL_SOC_TSE850_PCM5142
	tristate "ASoC driver for the Axentia TSE-850"
	depends on ARCH_AT91 && OF
	depends on ATMEL_SSC && I2C
	select SND_ATMEL_SOC_SSC_DMA
	select SND_SOC_PCM512x_I2C
	help
	  Say Y if you want to add support for the ASoC driver for the
	  Axentia TSE-850 with a PCM5142 codec.

config SND_ATMEL_SOC_I2S
	tristate "Atmel ASoC driver for boards using I2S"
	depends on OF && (ARCH_AT91 || COMPILE_TEST)
	select SND_SOC_GENERIC_DMAENGINE_PCM
	select REGMAP_MMIO
	help
	  Say Y or M if you want to add support for Atmel ASoc driver for boards
	  using I2S.

config SND_SOC_MIKROE_PROTO
	tristate "Support for Mikroe-PROTO board"
	depends on OF
	depends on SND_SOC_I2C_AND_SPI
	select SND_SOC_WM8731
	help
	  Say Y or M if you want to add support for MikroElektronika PROTO Audio
	  Board. This board contains the WM8731 codec, which can be configured
	  using I2C over SDA (MPU Data Input) and SCL (MPU Clock Input) pins.
	  Both playback and capture are supported.

config SND_MCHP_SOC_I2S_MCC
	tristate "Microchip ASoC driver for boards using I2S MCC"
	depends on OF && (ARCH_AT91 || COMPILE_TEST)
	select SND_SOC_GENERIC_DMAENGINE_PCM
	select REGMAP_MMIO
	help
	  Say Y or M if you want to add support for I2S Multi-Channel ASoC
	  driver on the following Microchip platforms:
	  - sam9x60

	  The I2SMCC complies with the Inter-IC Sound (I2S) bus specification
	  and supports a Time Division Multiplexed (TDM) interface with
	  external multi-channel audio codecs.

config SND_MCHP_SOC_SPDIFTX
	tristate "Microchip ASoC driver for boards using S/PDIF TX"
	depends on OF && (ARCH_AT91 || COMPILE_TEST)
	select SND_SOC_GENERIC_DMAENGINE_PCM
	select REGMAP_MMIO
	help
	  Say Y or M if you want to add support for Microchip S/PDIF TX ASoc
	  driver on the following Microchip platforms:
	  - sama7g5

	  This S/PDIF TX driver is compliant with IEC-60958 standard and
	  includes programable User Data and Channel Status fields.

config SND_MCHP_SOC_SPDIFRX
	tristate "Microchip ASoC driver for boards using S/PDIF RX"
	depends on OF && (ARCH_AT91 || COMPILE_TEST)
	depends on COMMON_CLK
	select SND_SOC_GENERIC_DMAENGINE_PCM
	select REGMAP_MMIO
	help
	  Say Y or M if you want to add support for Microchip S/PDIF RX ASoc
	  driver on the following Microchip platforms:
	  - sama7g5

	  This S/PDIF RX driver is compliant with IEC-60958 standard and
	  includes programable User Data and Channel Status fields.
endif
```

## sound/soc/au1x/Kconfig
```kconfig
# SPDX-License-Identifier: GPL-2.0-only
##
## Au1200/Au1550/Au1300 PSC + DBDMA
##
menu "Au1x"

config SND_SOC_AU1XPSC
	tristate "SoC Audio for Au12xx/Au13xx/Au1550"
	depends on MIPS_ALCHEMY
	help
	  This option enables support for the Programmable Serial
	  Controllers in AC97 and I2S mode, and the Descriptor-Based DMA
	  Controller (DBDMA) as found on the Au12xx/Au13xx/Au1550 SoC.

config SND_SOC_AU1XPSC_I2S
	tristate

config SND_SOC_AU1XPSC_AC97
	tristate
	select AC97_BUS
	select SND_AC97_CODEC
	select SND_SOC_AC97_BUS

##
## Au1000/1500/1100 DMA + AC97C/I2SC
##
config SND_SOC_AU1XAUDIO
	tristate "SoC Audio for Au1000/Au1500/Au1100"
	depends on MIPS_ALCHEMY
	help
	  This is a driver set for the AC97 unit and the
	  old DMA controller as found on the Au1000/Au1500/Au1100 chips.

config SND_SOC_AU1XAC97C
	tristate
	select AC97_BUS
	select SND_AC97_CODEC
	select SND_SOC_AC97_BUS

config SND_SOC_AU1XI2SC
	tristate


##
## Boards
##
config SND_SOC_DB1000
	tristate "DB1000 Audio support"
	depends on SND_SOC_AU1XAUDIO
	select SND_SOC_AU1XAC97C
	select SND_SOC_AC97_CODEC
	help
	  Select this option to enable AC97 audio on the early DB1x00 series
	  of boards (DB1000/DB1500/DB1100).

config SND_SOC_DB1200
	tristate "DB1200/DB1300/DB1550 Audio support"
	depends on SND_SOC_AU1XPSC
	select SND_SOC_AU1XPSC_AC97
	select SND_SOC_AC97_CODEC
	select SND_SOC_WM9712
	select SND_SOC_AU1XPSC_I2S
	select SND_SOC_WM8731_I2C
	help
	  Select this option to enable audio (AC97 and I2S) on the
	  Alchemy/AMD/RMI/NetLogic Db1200, Db1550 and Db1300 evaluation boards.
	  If you need Db1300 touchscreen support, you definitely want to say Y.

endmenu
```

## sound/soc/bcm/Kconfig
```kconfig
config SND_BCM2835_SOC_I2S
	tristate "SoC Audio support for the Broadcom BCM2835 I2S module"
	depends on ARCH_BCM2835 || COMPILE_TEST
	select SND_SOC_GENERIC_DMAENGINE_PCM
	select REGMAP_MMIO
	help
	  Say Y or M if you want to add support for codecs attached to
	  the BCM2835 I2S interface. You will also need
	  to select the audio interfaces to support below.

config SND_SOC_CYGNUS
	tristate "SoC platform audio for Broadcom Cygnus chips"
	depends on ARCH_BCM_CYGNUS || COMPILE_TEST
	help
	  Say Y if you want to add support for ASoC audio on Broadcom
	  Cygnus chips (bcm958300, bcm958305, bcm911360)

	  If you don't know what to do here, say N.
```

## sound/soc/blackfin/Kconfig
```kconfig
config SND_BF5XX_I2S
	tristate "SoC I2S Audio for the ADI BF5xx chip"
	depends on BLACKFIN
	help
	  Say Y or M if you want to add support for codecs attached to
	  the Blackfin SPORT (synchronous serial ports) interface in I2S
	  mode (supports single stereo In/Out).
	  You will also need to select the audio interfaces to support below.

config SND_BF5XX_SOC_SSM2602
	tristate "SoC SSM2602 Audio support for BF52x ezkit"
	depends on SND_BF5XX_I2S
	select SND_BF5XX_SOC_I2S
	select SND_SOC_SSM2602
	select I2C
	help
	  Say Y if you want to add support for SoC audio on BF527-EZKIT.

config SND_BF5XX_SOC_AD73311
	tristate "SoC AD73311 Audio support for Blackfin"
	depends on SND_BF5XX_I2S
	select SND_BF5XX_SOC_I2S
	select SND_SOC_AD73311
	help
	  Say Y if you want to add support for AD73311 codec on Blackfin.

config SND_BFIN_AD73311_SE
	int "PF pin for AD73311L Chip Select"
	depends on SND_BF5XX_SOC_AD73311
	default 4
	help
	  Enter the GPIO used to control AD73311's SE pin. Acceptable
	  values are 0 to 7

config SND_BF5XX_TDM
	tristate "SoC I2S(TDM mode) Audio for the ADI BF5xx chip"
	depends on (BLACKFIN && SND_SOC)
	help
	  Say Y or M if you want to add support for codecs attached to
	  the Blackfin SPORT (synchronous serial ports) interface in TDM
	  mode.
	  You will also need to select the audio interfaces to support below.

config SND_BF5XX_SOC_AD1836
	tristate "SoC AD1836 Audio support for BF5xx"
	depends on SND_BF5XX_TDM
	select SND_BF5XX_SOC_TDM
	select SND_SOC_AD1836
	help
	  Say Y if you want to add support for SoC audio on BF5xx STAMP/EZKIT.

config SND_BF5XX_SOC_AD193X
	tristate "SoC AD193X Audio support for Blackfin"
	depends on SND_BF5XX_TDM
	select SND_BF5XX_SOC_TDM
	select SND_SOC_AD193X
	help
	  Say Y if you want to add support for AD193X codec on Blackfin.
	  This driver supports AD1936, AD1937, AD1938 and AD1939.

config SND_BF5XX_AC97
	tristate "SoC AC97 Audio for the ADI BF5xx chip"
	depends on BLACKFIN
	help
	  Say Y or M if you want to add support for codecs attached to
	  the Blackfin SPORT (synchronous serial ports) interface in slot 16
	  mode (pseudo AC97 interface).
	  You will also need to select the audio interfaces to support below.

	  Note:
	  AC97 codecs which do not implement the slot-16 mode will not function
	  properly with this driver. This driver is known to work with the
	  Analog Devices line of AC97 codecs.

config SND_BF5XX_MMAP_SUPPORT
	bool "Enable MMAP Support"
	depends on SND_BF5XX_AC97
	default y
	help
	  Say y if you want AC97 driver to support mmap mode.
	  We introduce an intermediate buffer to simulate mmap.

config SND_BF5XX_MULTICHAN_SUPPORT
	bool "Enable Multichannel Support"
	depends on SND_BF5XX_AC97
	default n
	help
	  Say y if you want AC97 driver to support up to 5.1 channel audio.
	  this mode will consume much more memory for DMA.

config SND_BF5XX_HAVE_COLD_RESET
	bool "BOARD has COLD Reset GPIO"
	depends on SND_BF5XX_AC97
	default y if BFIN548_EZKIT
	default n if !BFIN548_EZKIT

config SND_BF5XX_RESET_GPIO_NUM
	int "Set a GPIO for cold reset"
	depends on SND_BF5XX_HAVE_COLD_RESET
	range 0 159
	default 19 if BFIN548_EZKIT
	default 5 if BFIN537_STAMP
	default 0
	help
	  Set the correct GPIO for RESET the sound chip.

config SND_BF5XX_SOC_AD1980
	tristate "SoC AD1980/1 Audio support for BF5xx (Obsolete)"
	depends on SND_BF5XX_AC97
	select SND_BF5XX_SOC_AC97
	select SND_SOC_AD1980
	help
	  Say Y if you want to add support for SoC audio on BF5xx STAMP/EZKIT.

	  Warning:
	  Because Analog Devices Inc. discontinued the ad1980 sound chip since
	  Sep. 2009, this ad1980 driver is not maintained, tested and supported
	  by ADI now.

config SND_BF5XX_SOC_SPORT
	tristate

config SND_BF5XX_SOC_I2S
	tristate
	select SND_BF5XX_SOC_SPORT

config SND_BF5XX_SOC_TDM
	tristate
	select SND_BF5XX_SOC_SPORT

config SND_BF5XX_SOC_AC97
	tristate
	select AC97_BUS
	select SND_SOC_AC97_BUS
	select SND_BF5XX_SOC_SPORT

config SND_BF5XX_SPORT_NUM
	int "Set a SPORT for Sound chip"
	depends on (SND_BF5XX_I2S || SND_BF5XX_AC97 || SND_BF5XX_TDM)
	range 0 3 if BF54x
	range 0 1 if !BF54x
	default 0
	help
	  Set the correct SPORT for sound chip.
```
