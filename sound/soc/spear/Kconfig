## sound/soc/spear/Kconfig
```kconfig
# SPDX-License-Identifier: GPL-2.0-only
config SND_SPEAR_SOC
	tristate
	select SND_SOC_GENERIC_DMAENGINE_PCM

config SND_SPEAR_SPDIF_OUT
	tristate

config SND_SPEAR_SPDIF_IN
	tristate
```

## sound/soc/sprd/Kconfig
```kconfig
# SPDX-License-Identifier: GPL-2.0-only
config SND_SOC_SPRD
	tristate "SoC Audio for the Spreadtrum SoC chips"
	depends on ARCH_SPRD || COMPILE_TEST
	select SND_SOC_COMPRESS
	help
	  Say Y or M if you want to add support for codecs attached to
	  the Spreadtrum SoCs' Audio interfaces.

config SND_SOC_SPRD_MCDT
	tristate "Spreadtrum multi-channel data transfer support"
	depends on SND_SOC_SPRD
	help
	  Say y here to enable multi-channel data transfer support. It
	  is used for sound stream transmission between audio subsystem
	  and other AP/CP subsystem.
```

## sound/soc/starfive/Kconfig
```kconfig
# SPDX-License-Identifier: GPL-2.0-only
menu "StarFive"
	depends on COMPILE_TEST || ARCH_STARFIVE
	depends on HAVE_CLK

config SND_SOC_JH7110_PWMDAC
	tristate "JH7110 PWM-DAC device driver"
	select SND_SOC_GENERIC_DMAENGINE_PCM
	select SND_SOC_SPDIF
	help
	 Say Y or M if you want to add support for StarFive JH7110
	 PWM-DAC driver.

config SND_SOC_JH7110_TDM
	tristate "JH7110 TDM device driver"
	select SND_SOC_GENERIC_DMAENGINE_PCM
	help
	  Say Y or M if you want to add support for StarFive TDM driver.

endmenu
```

## sound/soc/sti/Kconfig
```kconfig
#
# STM SoC audio configuration
#
menuconfig SND_SOC_STI
	tristate "SoC Audio support for STI System-On-Chip"
	depends on SND_SOC
	depends on ARCH_STI || COMPILE_TEST
	select SND_SOC_GENERIC_DMAENGINE_PCM
	help
		Say Y if you want to enable ASoC-support for
		any of the STI platforms (e.g. STIH416).
```

## sound/soc/stm/Kconfig
```kconfig
menu "STMicroelectronics STM32 SOC audio support"

config SND_SOC_STM32_SAI
	tristate "STM32 SAI interface (Serial Audio Interface) support"
	depends on (ARCH_STM32 && OF) || COMPILE_TEST
	depends on SND_SOC
	select SND_SOC_GENERIC_DMAENGINE_PCM
	select REGMAP_MMIO
	select SND_PCM_IEC958
	help
	  Say Y if you want to enable SAI for STM32

config SND_SOC_STM32_I2S
	tristate "STM32 I2S interface (SPI/I2S block) support"
	depends on (ARCH_STM32 && OF) || COMPILE_TEST
	depends on SND_SOC
	select SND_SOC_GENERIC_DMAENGINE_PCM
	select REGMAP_MMIO
	help
	  Say Y if you want to enable I2S for STM32

config SND_SOC_STM32_SPDIFRX
	tristate "STM32 S/PDIF receiver (SPDIFRX) support"
	depends on (ARCH_STM32 && OF) || COMPILE_TEST
	depends on SND_SOC
	select SND_SOC_GENERIC_DMAENGINE_PCM
	select REGMAP_MMIO
	select SND_SOC_SPDIF
	help
	  Say Y if you want to enable S/PDIF capture for STM32

config SND_SOC_STM32_DFSDM
	tristate "SoC Audio support for STM32 DFSDM"
	depends on ARCH_STM32 || COMPILE_TEST
	depends on SND_SOC
	depends on STM32_DFSDM_ADC
	select SND_SOC_GENERIC_DMAENGINE_PCM
	select SND_SOC_DMIC
	select IIO_BUFFER_CB
	help
	  Select this option to enable the STM32 Digital Filter
	  for Sigma Delta Modulators (DFSDM) driver used
	  in various STM32 series for digital microphone capture.
endmenu
```

## sound/soc/sun4i/hdmiaudio/Kconfig
```kconfig
config SND_SUN4I_SOC_HDMIAUDIO
	tristate "HDMI Audio for the AllWinner SUN4I chips"
	default n
	help
	  Say Y or M if you want to add support for hdmi audio
```

## sound/soc/sun5i/hdmiaudio/Kconfig
```kconfig
config SND_SUN5I_SOC_HDMIAUDIO
	tristate "HDMI Audio for the AllWinner SUN5I chips"
	default n
	help
	  Say Y or M if you want to add support for hdmi audio
```

## sound/soc/sun5i/i2s/Kconfig
```kconfig
config SND_SUN5I_SOC_I2S_INTERFACE
	tristate "SoC i2s interface for the AllWinner SUN5I chips"
	default n
	help
	  Say Y or M if you want to add support for codecs attached to
	  the SUN4I AC97, I2S or PCM interface. You will also need
	  to select the audio interfaces to support below.
```

## sound/soc/sunxi/Kconfig
```kconfig
# SPDX-License-Identifier: GPL-2.0-only
menu "Allwinner SoC Audio support"
	depends on ARCH_SUNXI || COMPILE_TEST

config SND_SUN4I_CODEC
	tristate "Allwinner A10 Codec Support"
	select SND_SOC_GENERIC_DMAENGINE_PCM
	select REGMAP_MMIO
	help
	  Select Y or M to add support for the Codec embedded in the Allwinner
	  A10 and affiliated SoCs.

config SND_SUN8I_CODEC
	tristate "Allwinner SUN8I audio codec"
	depends on OF
	depends on MACH_SUN8I || (ARM64 && ARCH_SUNXI) || COMPILE_TEST
	depends on COMMON_CLK
	select REGMAP_MMIO
	help
	  This option enables the digital part of the internal audio codec for
	  Allwinner sun8i SoC (and particularly A33).

	  Say Y or M if you want to add sun8i digital audio codec support.

config SND_SUN8I_CODEC_ANALOG
	tristate "Allwinner sun8i Codec Analog Controls Support"
	depends on MACH_SUN8I || (ARM64 && ARCH_SUNXI) || COMPILE_TEST
	select SND_SUN8I_ADDA_PR_REGMAP
	help
	  Say Y or M if you want to add support for the analog controls for
	  the codec embedded in newer Allwinner SoCs.

config SND_SUN50I_CODEC_ANALOG
	tristate "Allwinner sun50i Codec Analog Controls Support"
	depends on (ARM64 && ARCH_SUNXI) || COMPILE_TEST
	select SND_SUN8I_ADDA_PR_REGMAP
	help
	  Say Y or M if you want to add support for the analog controls for
	  the codec embedded in Allwinner A64 SoC.

config SND_SUN4I_I2S
	tristate "Allwinner A10 I2S Support"
	select SND_SOC_GENERIC_DMAENGINE_PCM
	select REGMAP_MMIO
	help
	  Say Y or M if you want to add support for codecs attached to
	  the Allwinner A10 I2S. You will also need to select the
	  individual machine drivers to support below.

config SND_SUN4I_SPDIF
	tristate "Allwinner A10 SPDIF Support"
	depends on OF
	select SND_SOC_GENERIC_DMAENGINE_PCM
	select REGMAP_MMIO
	help
	  Say Y or M to add support for the S/PDIF audio block in the Allwinner
	  A10 and affiliated SoCs.

config SND_SUN50I_DMIC
	tristate "Allwinner H6 DMIC Support"
	select SND_SOC_GENERIC_DMAENGINE_PCM
	help
	  Say Y or M to add support for the DMIC audio block in the Allwinner
	  H6 and affiliated SoCs.

config SND_SUN8I_ADDA_PR_REGMAP
	tristate
	select REGMAP

endmenu
```

## sound/soc/sunxi/hdmiaudio/Kconfig
```kconfig
config SND_SUNXI_SOC_HDMIAUDIO
	tristate "HDMI Audio for the AllWinner sun4i and sun5i chips"
	default y
	help
	  Say Y or M if you want to add support for hdmi audio
```

## sound/soc/sunxi/i2s/Kconfig
```kconfig
config SND_SUNXI_SOC_I2S_INTERFACE
	tristate "SoC i2s interface for the AllWinner sun4i and sun5i chips"
	default m
	help
	  Say Y or M if you want to add support for codecs attached to
	  the SUNXI AC97, I2S or PCM interface. You will also need
	  to select the audio interfaces to support below.
```

## sound/soc/tegra/Kconfig
```kconfig
# SPDX-License-Identifier: GPL-2.0-only
config SND_SOC_TEGRA
	tristate "SoC Audio for the Tegra System-on-Chip"
	depends on (ARCH_TEGRA && TEGRA20_APB_DMA) || COMPILE_TEST
	depends on COMMON_CLK
	depends on RESET_CONTROLLER
	select REGMAP_MMIO
	select SND_SOC_GENERIC_DMAENGINE_PCM
	help
	  Say Y or M here if you want support for SoC audio on Tegra.

if SND_SOC_TEGRA

config SND_SOC_TEGRA20_AC97
	tristate "Tegra20 AC97 interface"
	select SND_SOC_AC97_BUS
	select SND_SOC_TEGRA20_DAS
	help
	  Say Y or M if you want to add support for codecs attached to the
	  Tegra20 AC97 interface. You will also need to select the individual
	  machine drivers to support below.

config SND_SOC_TEGRA20_DAS
	tristate "Tegra20 DAS module"
	help
	  Say Y or M if you want to add support for the Tegra20 DAS module.
	  You will also need to select the individual machine drivers to
	  support below.

config SND_SOC_TEGRA20_I2S
	tristate "Tegra20 I2S interface"
	select SND_SOC_TEGRA20_DAS
	help
	  Say Y or M if you want to add support for codecs attached to the
	  Tegra20 I2S interface. You will also need to select the individual
	  machine drivers to support below.

config SND_SOC_TEGRA20_SPDIF
	tristate "Tegra20 SPDIF interface"
	help
	  Say Y or M if you want to add support for the Tegra20 SPDIF interface.
	  You will also need to select the individual machine drivers to support
	  below.

config SND_SOC_TEGRA30_AHUB
	tristate "Tegra30 AHUB module"
	help
	  Say Y or M if you want to add support for the Tegra30 AHUB module.
	  You will also need to select the individual machine drivers to
	  support below.

config SND_SOC_TEGRA30_I2S
	tristate "Tegra30 I2S interface"
	select SND_SOC_TEGRA30_AHUB
	help
	  Say Y or M if you want to add support for codecs attached to the
	  Tegra30 I2S interface. You will also need to select the individual
	  machine drivers to support below.

config SND_SOC_TEGRA210_AHUB
	tristate "Tegra210 AHUB module"
	help
	  Config to enable Audio Hub (AHUB) module, which comprises of a
	  switch called Audio Crossbar (AXBAR) used to configure or modify
	  the audio routing path between various HW accelerators present in
	  AHUB.
	  Say Y or M if you want to add support for Tegra210 AHUB module.

config SND_SOC_TEGRA210_DMIC
	tristate "Tegra210 DMIC module"
	help
	  Config to enable the Digital MIC (DMIC) controller which is used
	  to interface with Pulse Density Modulation (PDM) input devices.
	  The DMIC controller implements a converter to convert PDM signals
	  to Pulse Code Modulation (PCM) signals. This can be viewed as a
	  PDM receiver.
	  Say Y or M if you want to add support for Tegra210 DMIC module.

config SND_SOC_TEGRA210_I2S
	tristate "Tegra210 I2S module"
	help
	  Config to enable the Inter-IC Sound (I2S) Controller which
	  implements full-duplex and bidirectional and single direction
	  point-to-point serial interfaces. It can interface with I2S
	  compatible devices.
	  Say Y or M if you want to add support for Tegra210 I2S module.

config SND_SOC_TEGRA186_DSPK
	tristate "Tegra186 DSPK module"
	help
	  Config to enable the Digital Speaker Controller (DSPK) which
	  converts the multi-bit Pulse Code Modulation (PCM) audio input to
	  oversampled 1-bit Pulse Density Modulation (PDM) output. From the
	  signal flow perspective DSPK can be viewed as a PDM transmitter
	  that up-samples the input to the desired sampling rate by
	  interpolation and then converts the oversampled PCM input to
	  the desired 1-bit output via Delta Sigma Modulation (DSM).
	  Say Y or M if you want to add support for Tegra186 DSPK module.

config SND_SOC_TEGRA210_ADMAIF
	tristate "Tegra210 ADMAIF module"
	help
	  Config to enable ADMAIF which is the interface between ADMA and
	  Audio Hub (AHUB). Each ADMA channel that sends/receives data to/
	  from AHUB must interface through an ADMAIF channel. ADMA channel
	  sending data to AHUB pairs with an ADMAIF Tx channel, where as
	  ADMA channel receiving data from AHUB pairs with an ADMAIF Rx
	  channel. Buffer size is configurable for each ADMAIIF channel.
	  Say Y or M if you want to add support for Tegra210 ADMAIF module.

config SND_SOC_TEGRA210_MVC
	tristate "Tegra210 MVC module"
	help
	  Config to enable the digital Master Volume Controller (MVC) which
	  provides gain or attenuation to a digital signal path. It can be
	  used in input or output signal path. It can be used either for
	  per-stream volume control or for master volume control.
	  Say Y or M if you want to add support for Tegra210 MVC module.

config SND_SOC_TEGRA210_SFC
	tristate "Tegra210 SFC module"
	help
	  Config to enable the Sampling Frequency Converter (SFC) which
	  converts the sampling frequency of input signal to another
	  frequency. It supports sampling frequency conversion of streams
	  upto 2 channels (stereo).
	  Say Y or M if you want to add support for Tegra210 SFC module.

config SND_SOC_TEGRA_AUDIO_GRAPH_CARD
	tristate "Audio Graph Card based Tegra driver"
	depends on SND_AUDIO_GRAPH_CARD
	help
	  Config to enable Tegra audio machine driver based on generic
	  audio graph driver. It is a thin driver written to customize
	  few things for Tegra audio. Most of the code is re-used from
	  audio graph driver and the same DT bindings are used.

config SND_SOC_TEGRA_MACHINE_DRV
	tristate

config SND_SOC_TEGRA_RT5640
	tristate "SoC Audio support for Tegra boards using an RT5640 codec"
	depends on I2C && GPIOLIB
	select SND_SOC_TEGRA_MACHINE_DRV
	select SND_SOC_RT5640
	help
	  Say Y or M here if you want to add support for SoC audio on Tegra
	  boards using the RT5640 codec, such as Dalmore.

config SND_SOC_TEGRA_WM8753
	tristate "SoC Audio support for Tegra boards using a WM8753 codec"
	depends on I2C && GPIOLIB
	select SND_SOC_TEGRA_MACHINE_DRV
	select SND_SOC_WM8753
	help
	  Say Y or M here if you want to add support for SoC audio on Tegra
	  boards using the WM8753 codec, such as Whistler.

config SND_SOC_TEGRA_WM8903
	tristate "SoC Audio support for Tegra boards using a WM8903 codec"
	depends on I2C && GPIOLIB
	select SND_SOC_TEGRA_MACHINE_DRV
	select SND_SOC_WM8903
	help
	  Say Y or M here if you want to add support for SoC audio on Tegra
	  boards using the WM8093 codec. Currently, the supported boards are
	  Harmony, Ventana, Seaboard, Kaen, and Aebl.

config SND_SOC_TEGRA_WM9712
	tristate "SoC Audio support for Tegra boards using a WM9712 codec"
	depends on GPIOLIB
	select SND_SOC_TEGRA_MACHINE_DRV
	select SND_SOC_TEGRA20_AC97
	select SND_SOC_WM9712
	help
	  Say Y or M here if you want to add support for SoC audio on Tegra
	  boards using the WM9712 (or compatible) codec.

config SND_SOC_TEGRA_TRIMSLICE
	tristate "SoC Audio support for TrimSlice board"
	depends on I2C
	select SND_SOC_TEGRA_MACHINE_DRV
	select SND_SOC_TLV320AIC23_I2C
	help
	  Say Y or M here if you want to add support for SoC audio on the
	  TrimSlice platform.

config SND_SOC_TEGRA_ALC5632
	tristate "SoC Audio support for Tegra boards using an ALC5632 codec"
	depends on I2C && GPIOLIB
	select SND_SOC_TEGRA_MACHINE_DRV
	select SND_SOC_ALC5632
	help
	  Say Y or M here if you want to add support for SoC audio on the
	  Toshiba AC100 netbook.

config SND_SOC_TEGRA_MAX98090
	tristate "SoC Audio support for Tegra boards using a MAX98090 codec"
	depends on I2C && GPIOLIB
	select SND_SOC_TEGRA_MACHINE_DRV
	select SND_SOC_MAX98090
	help
	  Say Y or M here if you want to add support for SoC audio on Tegra
	  boards using the MAX98090 codec, such as Venice2.

config SND_SOC_TEGRA_RT5677
	tristate "SoC Audio support for Tegra boards using a RT5677 codec"
	depends on I2C && GPIOLIB
	select SND_SOC_TEGRA_MACHINE_DRV
	select SND_SOC_RT5677
	help
	  Say Y or M here if you want to add support for SoC audio on Tegra
	  boards using the RT5677 codec, such as Ryu.

config SND_SOC_TEGRA_SGTL5000
	tristate "SoC Audio support for Tegra boards using a SGTL5000 codec"
	depends on I2C && GPIOLIB
	select SND_SOC_TEGRA_MACHINE_DRV
	select SND_SOC_SGTL5000
	help
	  Say Y or M here if you want to add support for SoC audio on Tegra
	  boards using the SGTL5000 codec, such as Apalis T30, Apalis TK1 or
	  Colibri T30.

endif
```
