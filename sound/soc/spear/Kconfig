## sound/soc/ti/Kconfig
```kconfig
# SPDX-License-Identifier: GPL-2.0-only
menu "Audio support for Texas Instruments SoCs"
depends on DMA_OMAP || TI_EDMA || COMPILE_TEST

config SND_SOC_TI_EDMA_PCM
	tristate
	select SND_SOC_GENERIC_DMAENGINE_PCM

config SND_SOC_TI_SDMA_PCM
	tristate
	select SND_SOC_GENERIC_DMAENGINE_PCM

comment "Texas Instruments DAI support for:"
config SND_SOC_DAVINCI_ASP
	tristate "daVinci Audio Serial Port (ASP) or McBSP support"
	depends on ARCH_DAVINCI || COMPILE_TEST
	select SND_SOC_TI_EDMA_PCM
	help
	  Say Y or M here if you want audio support via daVinci ASP or McBSP.
	  The driver only implements the ASP support which is a subset of
	  daVinci McBSP (w/o the multichannel support).

config SND_SOC_DAVINCI_MCASP
	tristate "Multichannel Audio Serial Port (McASP) support"
	select SND_SOC_TI_EDMA_PCM
	select SND_SOC_TI_SDMA_PCM
	help
	  Say Y or M here if you want to have support for McASP IP found in
	  various Texas Instruments SoCs like:
	  - daVinci devices
	  - Sitara line of SoCs (AM335x, AM438x, etc)
	  - DRA7x devices
	  - Keystone devices

config SND_SOC_DAVINCI_VCIF
	tristate "daVinci Voice Interface (VCIF) support"
	depends on ARCH_DAVINCI || COMPILE_TEST
	select SND_SOC_TI_EDMA_PCM
	help
	  Say Y or M here if you want audio support via daVinci VCIF.

config SND_SOC_OMAP_DMIC
	tristate "Digital Microphone Module (DMIC) support"
	depends on ARCH_OMAP4 || SOC_OMAP5 || COMPILE_TEST
	select SND_SOC_TI_SDMA_PCM
	help
	  Say Y or M here if you want to have support for DMIC IP found in
	  OMAP4 and OMAP5.

config SND_SOC_OMAP_MCBSP
	tristate "Multichannel Buffered Serial Port (McBSP) support"
	depends on ARCH_OMAP || ARCH_OMAP1 || COMPILE_TEST
	select SND_SOC_TI_SDMA_PCM
	help
	  Say Y or M here if you want to have support for McBSP IP found in
	  Texas Instruments OMAP1/2/3/4/5 SoCs.

config SND_SOC_OMAP_MCPDM
	tristate "Multichannel PDM Controller (McPDM) support"
	depends on ARCH_OMAP4 || SOC_OMAP5 || COMPILE_TEST
	select SND_SOC_TI_SDMA_PCM
	help
	  Say Y or M here if you want to have support for McPDM IP found in
	  OMAP4 and OMAP5.

comment "Audio support for boards with Texas Instruments SoCs"
config SND_SOC_NOKIA_N810
	tristate "SoC Audio support for Nokia N810"
	depends on MACH_NOKIA_N810 && I2C
	select SND_SOC_OMAP_MCBSP
	select SND_SOC_TLV320AIC3X
	help
	  Say Y or M if you want to add support for SoC audio on Nokia N810.

config SND_SOC_NOKIA_RX51
	tristate "SoC Audio support for Nokia RX-51"
	depends on ARCH_OMAP3 && I2C && GPIOLIB
	select SND_SOC_OMAP_MCBSP
	select SND_SOC_TLV320AIC3X
	select SND_SOC_TPA6130A2
	help
	  Say Y or M if you want to add support for SoC audio on Nokia RX-51
	  hardware. This is also known as Nokia N900 product.

config SND_SOC_OMAP3_PANDORA
	tristate "SoC Audio support for OMAP3 Pandora"
	depends on ARCH_OMAP3
	depends on TWL4030_CORE
	select SND_SOC_OMAP_MCBSP
	select SND_SOC_TWL4030
	help
	  Say Y or M if you want to add support for SoC audio on the OMAP3 Pandora.

config SND_SOC_OMAP3_TWL4030
	tristate "SoC Audio support for OMAP3 based boards with twl4030 codec"
	depends on ARCH_OMAP3 || COMPILE_TEST
	depends on TWL4030_CORE
	select SND_SOC_OMAP_MCBSP
	select SND_SOC_TWL4030
	help
	  Say Y or M if you want to add support for SoC audio on OMAP3 based
	  boards using twl4030 as codec. This driver currently supports:
	  - Beagleboard or Devkit8000
	  - Gumstix Overo or CompuLab CM-T35/CM-T3730
	  - IGEP v2
	  - OMAP3EVM
	  - SDP3430
	  - Zoom2

config SND_SOC_OMAP_ABE_TWL6040
	tristate "SoC Audio support for OMAP boards using ABE and twl6040 codec"
	depends on TWL6040_CORE && COMMON_CLK
	depends on ARCH_OMAP4 || (SOC_OMAP5 && MFD_PALMAS) || COMPILE_TEST
	select SND_SOC_OMAP_DMIC
	select SND_SOC_OMAP_MCPDM
	select SND_SOC_TWL6040
	help
	  Say Y or M if you want to add support for SoC audio on OMAP boards
	  using ABE and twl6040 codec. This driver currently supports:
	  - SDP4430/Blaze boards
	  - PandaBoard (4430)
	  - PandaBoardES (4460)
	  - OMAP5 uEVM

config SND_SOC_OMAP_AMS_DELTA
	tristate "SoC Audio support for Amstrad E3 (Delta) videophone"
	depends on MACH_AMS_DELTA && TTY
	select SND_SOC_OMAP_MCBSP
	select SND_SOC_CX20442
	help
	  Say Y  or M if you want to add support  for SoC audio device
	  connected to a handset and a speakerphone found on Amstrad E3 (Delta)
	  videophone.

	  Note that in order to get those devices fully supported,  you have to
	  build  the kernel  with  standard  serial port  driver  included  and
	  configured for at least 4 ports.  Then, from userspace, you must load
	  a line discipline #19 on the modem (ttyS3) serial line.  The simplest
	  way to achieve this is to install util-linux-ng  and use the included
	  ldattach  utility.  This  can be  started  automatically  from  udev,
	  a simple rule like this one should do the trick (it does for me):
		ACTION=="add", KERNEL=="controlC0", \
				RUN+="/usr/sbin/ldattach 19 /dev/ttyS3"

config SND_SOC_OMAP_HDMI
	tristate "OMAP4/5 HDMI audio support"
	depends on OMAP4_DSS_HDMI || OMAP5_DSS_HDMI || COMPILE_TEST
	select SND_SOC_TI_SDMA_PCM
	help
	  For HDMI audio to work OMAPDSS HDMI support should be
	  enabled.
	  The hdmi audio driver implements cpu-dai component using the
	  callbacks provided by OMAPDSS and registers the component
	  under DSS HDMI device. Omap-pcm is registered for platform
	  component also under DSS HDMI device. Dummy codec is used as
	  as codec component. The hdmi audio driver implements also
	  the card and registers it under its own platform device.
	  The device for the driver is registered by OMAPDSS hdmi
	  driver.

config SND_SOC_OMAP_OSK5912
	tristate "SoC Audio support for omap osk5912"
	depends on MACH_OMAP_OSK && I2C
	select SND_SOC_OMAP_MCBSP
	select SND_SOC_TLV320AIC23_I2C
	help
	  Say Y or M if you want to add support for SoC audio on osk5912.

config SND_SOC_DAVINCI_EVM
	tristate "SoC Audio support for DaVinci EVMs"
	depends on ARCH_DAVINCI && I2C
	select SND_SOC_DAVINCI_ASP if MACH_DAVINCI_DM355_EVM
	select SND_SOC_DAVINCI_ASP if SND_SOC_DM365_AIC3X_CODEC
	select SND_SOC_DAVINCI_VCIF if SND_SOC_DM365_VOICE_CODEC
	select SND_SOC_DAVINCI_ASP if MACH_DAVINCI_EVM # DM6446
	select SND_SOC_DAVINCI_MCASP if MACH_DAVINCI_DM6467_EVM
	select SND_SOC_SPDIF if MACH_DAVINCI_DM6467_EVM
	select SND_SOC_DAVINCI_MCASP if MACH_DAVINCI_DA830_EVM
	select SND_SOC_DAVINCI_MCASP if MACH_DAVINCI_DA850_EVM
	select SND_SOC_TLV320AIC3X
	help
	  Say Y if you want to add support for SoC audio on the following TI
	  DaVinci EVM platforms:
	  - DM355
	  - DM365
	  - DM6446
	  - DM6447
	  - DM830
	  - DM850

choice
	prompt "DM365 codec select"
	depends on SND_SOC_DAVINCI_EVM
	depends on MACH_DAVINCI_DM365_EVM

config SND_SOC_DM365_AIC3X_CODEC
	bool "Audio Codec - AIC3101"
	help
	  Say Y if you want to add support for AIC3101 audio codec

config SND_SOC_DM365_VOICE_CODEC
	bool "Voice Codec - CQ93VC"
	help
	  Say Y if you want to add support for SoC On-chip voice codec
endchoice

config SND_SOC_DM365_VOICE_CODEC_MODULE
	def_tristate y
	depends on SND_SOC_DM365_VOICE_CODEC && SND_SOC
	select MFD_DAVINCI_VOICECODEC
	select SND_SOC_CQ0093VC
	help
	  The is an internal symbol needed to ensure that the codec
	  and MFD driver can be built as loadable modules if necessary.

endmenu
```

## sound/soc/txx9/Kconfig
```kconfig
# SPDX-License-Identifier: GPL-2.0-only
##
## TXx9 ACLC
##
config SND_SOC_TXX9ACLC
	tristate "SoC Audio for TXx9"
	depends on HAS_TXX9_ACLC && TXX9_DMAC
	help
	  This option enables support for the AC Link Controllers in TXx9 SoC.

config HAS_TXX9_ACLC
	bool

config SND_SOC_TXX9ACLC_AC97
	tristate
	select AC97_BUS
	select SND_AC97_CODEC
	select SND_SOC_AC97_BUS


##
## Boards
##
config SND_SOC_TXX9ACLC_GENERIC
	tristate "Generic TXx9 ACLC sound machine"
	depends on SND_SOC_TXX9ACLC
	select SND_SOC_TXX9ACLC_AC97
	select SND_SOC_AC97_CODEC
	help
	  This is a generic AC97 sound machine for use in TXx9 based systems.
```

## sound/soc/uniphier/Kconfig
```kconfig
# SPDX-License-Identifier: GPL-2.0
menu "UniPhier"
	depends on (ARCH_UNIPHIER || COMPILE_TEST)

config SND_SOC_UNIPHIER_AIO
	tristate "UniPhier AIO DAI Driver"
	select REGMAP_MMIO
	select SND_SOC_COMPRESS
	help
	  This adds ASoC driver support for Socionext UniPhier
	  'AIO' Audio Input/Output subsystem.
	  Select Y if you use such device.
	  If unsure select "N".

config SND_SOC_UNIPHIER_LD11
	tristate "UniPhier LD11/LD20 Device Driver"
	select SND_SOC_UNIPHIER_AIO
	help
	  This adds ASoC driver for Socionext UniPhier LD11/LD20
	  input and output that can be used with other codecs.
	  Select Y if you use such device.
	  If unsure select "N".

config SND_SOC_UNIPHIER_PXS2
	tristate "UniPhier PXs2 Device Driver"
	select SND_SOC_UNIPHIER_AIO
	help
	  This adds ASoC driver for Socionext UniPhier PXs2
	  input and output that can be used with other codecs.
	  Select Y if you use such device.
	  If unsure select "N".

config SND_SOC_UNIPHIER_EVEA_CODEC
	tristate "UniPhier SoC internal audio codec"
	select REGMAP_MMIO
	help
	  This adds Codec driver for Socionext UniPhier LD11/20 SoC
	  internal DAC. This driver supports Line In / Out and HeadPhone.
	  Select Y if you use such device.
	  If unsure select "N".

endmenu
```

## sound/soc/xilinx/Kconfig
```kconfig
# SPDX-License-Identifier: GPL-2.0-only
config SND_SOC_XILINX_I2S
	tristate "Audio support for the Xilinx I2S"
	help
	  Select this option to enable Xilinx I2S Audio. This enables
	  I2S playback and capture using xilinx soft IP. In transmitter
	  mode, IP receives audio in AES format, extracts PCM and sends
	  PCM data. In receiver mode, IP receives PCM audio and
	  encapsulates PCM in AES format and sends AES data.

config SND_SOC_XILINX_AUDIO_FORMATTER
	tristate "Audio support for the the Xilinx audio formatter"
	help
	  Select this option to enable Xilinx audio formatter
	  support. This provides DMA platform device support for
	  audio functionality.

config SND_SOC_XILINX_SPDIF
	tristate "Audio support for the the Xilinx SPDIF"
	help
	  Select this option to enable Xilinx SPDIF Audio.
	  This provides playback and capture of SPDIF audio in
	  AES format.
```

## sound/soc/xtensa/Kconfig
```kconfig
config SND_SOC_XTFPGA_I2S
	tristate "XTFPGA I2S master"
	select REGMAP_MMIO
	help
	  Say Y or M if you want to add support for codecs attached to the
	  I2S interface on XTFPGA daughter board. You will also need to select
	  the drivers for the rest of XTFPGA audio subsystem.
```

## sound/soc/zte/Kconfig
```kconfig
# SPDX-License-Identifier: GPL-2.0-only
config ZX_SPDIF
	tristate "ZTE ZX SPDIF Driver Support"
	depends on ARCH_ZX || COMPILE_TEST
	depends on COMMON_CLK
	select SND_SOC_GENERIC_DMAENGINE_PCM
	help
	  Say Y or M if you want to add support for codecs attached to the
	  ZTE ZX SPDIF interface

config ZX_I2S
	tristate "ZTE ZX I2S Driver Support"
	depends on ARCH_ZX || COMPILE_TEST
	depends on COMMON_CLK
	select SND_SOC_GENERIC_DMAENGINE_PCM
	help
	  Say Y or M if you want to add support for codecs attached to the
	  ZTE ZX I2S interface

config ZX_TDM
	tristate "ZTE ZX TDM Driver Support"
	depends on COMMON_CLK
	select SND_SOC_GENERIC_DMAENGINE_PCM
	help
	  Say Y or M if you want to add support for codecs attached to the
	  ZTE ZX TDM interface
```

## sound/sparc/Kconfig
```kconfig
# SPDX-License-Identifier: GPL-2.0-only
# ALSA Sparc drivers

menuconfig SND_SPARC
	bool "Sparc sound devices"
	depends on SPARC
	default y
	help
	  Support for sound devices specific to Sun SPARC architectures.

if SND_SPARC

config SND_SUN_AMD7930
	tristate "Sun AMD7930"
	depends on SBUS
	select SND_PCM
	help
	  Say Y here to include support for AMD7930 sound device on Sun.

	  To compile this driver as a module, choose M here: the module
	  will be called snd-sun-amd7930.

config SND_SUN_CS4231
	tristate "Sun CS4231"
	select SND_PCM
	select SND_TIMER
	help
	  Say Y here to include support for CS4231 sound device on Sun.

	  To compile this driver as a module, choose M here: the module
	  will be called snd-sun-cs4231.

config SND_SUN_DBRI
	tristate "Sun DBRI"
	depends on SBUS
	select SND_PCM
	help
	  Say Y here to include support for DBRI sound device on Sun.

	  To compile this driver as a module, choose M here: the module
	  will be called snd-sun-dbri.

endif	# SND_SPARC
```

## sound/spi/Kconfig
```kconfig
# SPDX-License-Identifier: GPL-2.0-only
#SPI drivers

menuconfig SND_SPI
	bool "SPI sound devices"
	depends on SPI
	default y
	help
	  Support for sound devices connected via the SPI bus.

if SND_SPI

config SND_AT73C213
	tristate "Atmel AT73C213 DAC driver"
	depends on ATMEL_SSC
	select SND_PCM
	help
	  Say Y here if you want to use the Atmel AT73C213 external DAC. This
	  DAC can be found on Atmel development boards.

	  This driver requires the Atmel SSC driver for sound sink, a
	  peripheral found on most AT91 microprocessors.

	  To compile this driver as a module, choose M here: the module will be
	  called snd-at73c213.

config SND_AT73C213_TARGET_BITRATE
	int "Target bitrate for AT73C213"
	depends on SND_AT73C213
	default "48000"
	range 8000 50000
	help
	  Sets the target bitrate for the bitrate calculator in the driver.
	  Limited by hardware to be between 8000 Hz and 50000 Hz.

	  Set to 48000 Hz by default.

endif	# SND_SPI
```
