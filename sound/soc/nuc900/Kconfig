## sound/soc/rk29/Kconfig
```kconfig
config SND_RK29_SOC
	tristate "SoC Audio for the Rockchip System-on-Chip"
	depends on PLAT_RK && SND_SOC
	help
	  Say Y or M if you want to add support for codecs attached to
	  the ROCKCHIP IIS interface. You will also need
	  to select the audio interfaces to support below.

config SND_RK29_SOC_I2S
	tristate

config SND_RK_SOC_SPDIF
	tristate

config SND_RK29_SOC_I2S_8CH
	bool "Soc RK29 I2S 8 Channel support(I2S0)"
	default y
	depends on SND_RK29_SOC_I2S && !ARCH_RK3066B && !ARCH_RK3188
	help
       This supports the use of the 8 Channel I2S interface on rk29 processors.
				
if SND_RK29_SOC_I2S_8CH
choice
  bool "Set I2S0 using the number of channels"
  default SND_I2SO_USE_DOUBLE_CHANNELS
	config SND_I2SO_USE_EIGHT_CHANNELS
		tristate  "I2S0 use 8 channels"

	config SND_I2SO_USE_DOUBLE_CHANNELS
		tristate  "I2S0 use 2 channels"
endchoice
endif

config SND_RK29_SOC_I2S_2CH
	bool "Soc RK29 I2S 2 Channel support(I2S1)"
	depends on SND_RK29_SOC_I2S && !ARCH_RK2928	
	default y if (ARCH_RK3066B || ARCH_RK3188)
	help
         This supports the use of the 2 Channel I2S interface on rk29 processors.
		 
choice
	bool "Set I2S GRF Output Voltage"
	depends on (ARCH_RK3066B || ARCH_RK3188) && SND_RK29_SOC_I2S_2CH
	default SND_I2S_USE_33V

	config SND_I2S_USE_33V
		bool "I2S use 3.3V"

	config SND_I2S_USE_18V
		bool "I2S use 1.8V"
endchoice

config SND_RK_SOC_I2S2_2CH
	bool "Soc RK29 I2S 2 Channel support(I2S2)"
	default n
	depends on SND_RK29_SOC_I2S && ARCH_RK30 && !ARCH_RK2928 && !ARCH_RK3066B
	help
		This supports the use of the 2 Channel I2S2 interface on rk30 processors.

if 	SND_RK29_SOC_I2S_2CH || SND_RK29_SOC_I2S_8CH || SND_RK_SOC_I2S2_2CH
choice
  bool "Set i2s on DMA event mode"
  default SND_I2S_DMA_EVENT_STATIC
	config SND_I2S_DMA_EVENT_DYNAMIC
		tristate  "dynamic mode"

	config SND_I2S_DMA_EVENT_STATIC
		tristate  "static mode"
endchoice
endif

if SND_RK29_SOC && RK_HDMI
choice
  bool "Set audio support for HDMI"
  default SND_RK_SOC_HDMI_I2S
	config SND_RK_SOC_HDMI_I2S
		select SND_RK29_SOC_I2S
		select SND_SOC_HDMI_I2S
		tristate  "HDMI use I2S"

	config SND_RK_SOC_HDMI_SPDIF
		depends on SND_RK_SOC_RK616
		select SND_RK_SOC_SPDIF
		select SND_SOC_HDMI_SPDIF
		tristate  "HDMI use SPDIF"
endchoice
endif

config SND_RK29_SOC_ES8323
	tristate "SoC I2S Audio support for rockchip - ES8323"
	depends on SND_RK29_SOC
	select SND_RK29_SOC_I2S
	select SND_SOC_ES8323
	help
	  Say Y if you want to add support for SoC audio on rockchip
	  with the ES8323.

config SND_RK29_SOC_WM8988
	tristate "SoC I2S Audio support for rockchip - WM8988"
	depends on SND_RK29_SOC
	select SND_RK29_SOC_I2S
	select SND_SOC_WM8988
	help
	  Say Y if you want to add support for SoC audio on rockchip
	  with the WM8988.

config SND_RK29_SOC_WM8900
	tristate "SoC I2S Audio support for rockchip - WM8900"
	depends on SND_RK29_SOC
	select SND_RK29_SOC_I2S
	select SND_SOC_WM8900
	help
	  Say Y if you want to add support for SoC audio on rockchip
	  with the WM8900.
config SND_RK29_SOC_RT5621
	tristate "SoC I2S Audio support for rockchip - rt5621"
	depends on SND_RK29_SOC
	select SND_RK29_SOC_I2S
	select SND_SOC_RT5621
	help
	  Say Y if you want to add support for SoC audio on rockchip
	  with the rt5621.
config SND_RK29_SOC_RT5623
	tristate "SoC I2S Audio support for rockchip - rt5623"
	depends on SND_RK29_SOC
	select SND_RK29_SOC_I2S
	select SND_SOC_RT5623
	help
	  Say Y if you want to add support for SoC audio on rockchip
	  with the rt5623.
config SND_RK29_SOC_RT5631
	tristate "SoC I2S Audio support for rockchip - RT5631"
	depends on SND_RK29_SOC
	select SND_RK29_SOC_I2S
	select SND_SOC_RT5631
	help
	  Say Y if you want to add support for SoC audio on rockchip
	  with the RT5631.
	  
config SND_RK29_SOC_RT5631_PHONE
	tristate "SoC I2S Audio support for rockchip(phone) - RT5631"
	depends on SND_RK29_SOC
	select SND_RK29_SOC_I2S
	select SND_SOC_RT5631_PHONE
	help
	  Say Y if you want to add support for SoC audio on rockchip
	  with the RT5631.
	  Driver code to use on the phone or voice Tablet.
	  
config SND_RK29_SOC_RT5625
	tristate "SoC I2S Audio support for rockchip - RT5625"
	depends on SND_RK29_SOC
	select SND_RK29_SOC_I2S
	help
	  Say Y if you want to add support for SoC audio on rockchip
	  with the RT5625.

choice
	depends on SND_RK29_SOC_RT5625
	prompt  "RT5625 hardware select"

	config SND_SOC_RT5625_SPK_FORM_SPKOUT
	bool "spk from spkout"
	select SND_SOC_RT5625
	help
	  if your codec output hardware connect is spk from spkout, choose it

	config SND_SOC_RT5625_SPK_FORM_HPOUT
	bool "spk from hpout"
	select SND_SOC_RT5625
	help
	  if your codec output hardware connect is spk from spkout, choose it
endchoice

config SND_RK29_SOC_RT5640
	tristate "SoC I2S Audio support for rockchip - RT5640(RT5642)"
	depends on SND_RK29_SOC
	select SND_RK29_SOC_I2S
	select SND_SOC_RT5640
	help
	   RT5640 is pin to pin as RT5642, but not have dsp function.
	  
config SND_RK29_SOC_RT3224
	tristate "SoC I2S Audio support for rockchip - RT3224"
	depends on SND_RK29_SOC
	select SND_RK29_SOC_I2S
	select SND_SOC_RT3224
	help
	  RT3224 is pin to pin as RT3261, but not have dsp function.
	  
config SND_RK29_SOC_RT5639
	tristate "SoC I2S Audio support for rockchip - RT5639"
	depends on SND_RK29_SOC
	select SND_RK29_SOC_I2S
	select SND_SOC_RT5639
	help
	  rt5639
	  
config SND_RK29_SOC_RT5616
	tristate "SoC I2S Audio support for rockchip - RT5616"
	depends on SND_RK29_SOC
	select SND_RK29_SOC_I2S
	select SND_SOC_RT5616
	help
	  Say Y if you want to add support for SoC audio on rockchip
	  with the RT5616.
	  
config SND_RK29_SOC_RT3261
	tristate "SoC I2S Audio support for rockchip - RT3261"
	depends on SND_RK29_SOC
	select SND_RK29_SOC_I2S
	select SND_SOC_RT3261
	help
	  Say Y if you want to add support for SoC audio on rockchip
	  with the RT3261.

config SND_RK29_SOC_WM8994
	tristate "SoC I2S Audio support for rockchip - WM8994"
	depends on SND_RK29_SOC && MFD_WM8994
	select SND_RK29_SOC_I2S
	select SND_SOC_WM8994
	help
	  Say Y if you want to add support for SoC audio on rockchip
	  with the WM8994.

config SND_RK29_SOC_CS42L52
	tristate "SoC I2S Audio support for rockchip - CS42L52"
	depends on SND_RK29_SOC
	select SND_RK29_SOC_I2S
	select SND_SOC_CS42L52
	help
	  Say Y if you want to add support for SoC audio on rockchip
	  with the CS42L52.

config SND_RK29_SOC_AIC3111
	tristate "SoC I2S Audio support for rockchip - AIC3111"
	depends on SND_RK29_SOC
	select SND_RK29_SOC_I2S
	select SND_SOC_TLV320AIC3111
	help
	  Say Y if you want to add support for SoC audio on rockchip
	  with the AIC3111.

config SND_RK29_SOC_AIC3262
	tristate "SoC I2S Audio support for rockchip - AIC3262"
	depends on SND_RK29_SOC
	select SND_RK29_SOC_I2S
	select SND_SOC_TLV320AIC326X
	help
	  Say Y if you want to add support for SoC audio on rockchip
	  with the AIC3262.

config SND_RK29_SOC_RK1000
	tristate "SoC I2S Audio support for rockchip - RK1000"
	depends on SND_RK29_SOC
	select SND_RK29_SOC_I2S
	select SND_SOC_RK1000
	help
	  Say Y if you want to add support for SoC audio on rockchip
	  with the RK1000.

config SND_RK29_SOC_RK610
	tristate "SoC I2S Audio support for rockchip - RK610"
	depends on SND_RK29_SOC && MFD_RK610
	select SND_RK29_SOC_I2S
	select SND_SOC_RK610
	help
	  Say Y if you want to add support for SoC audio on rockchip
	  with the RK610(JETTA).

config SND_RK_SOC_RK616
	tristate "SoC I2S Audio support for rockchip - RK616"
	depends on SND_RK29_SOC && MFD_RK616
	select SND_RK29_SOC_I2S
	select SND_SOC_RK616
	help
	  Say Y if you want to add support for SoC audio on rockchip
	  with the RK616(JETTA).

config SND_RK_SOC_RK2928
	tristate "SoC I2S Audio support for rockchip - RK2928"
	depends on SND_RK29_SOC && ARCH_RK2928
	select SND_RK29_SOC_I2S
	select SND_SOC_RK2928
	select SND_RK29_CODEC_SOC_SLAVE
	help
	  Say Y if you want to add support for SoC audio on rockchip
	  with the RK2928 internal codec.

if SND_RK29_SOC_I2S_2CH || SND_RK29_SOC_I2S_8CH || SND_RK_SOC_I2S2_2CH  
choice
  bool "Set i2s type"
  default SND_RK29_CODEC_SOC_SLAVE
	config SND_RK29_CODEC_SOC_MASTER
		tristate  "Codec run in Master"

	config SND_RK29_CODEC_SOC_SLAVE
		tristate  "Codec run in Slave"
endchoice

config ADJUST_VOL_BY_CODEC
	bool "Adjust volume by codec"
    default n
    help
    	  adjust volume by codec

config PHONE_INCALL_IS_SUSPEND
	bool "Incalling Whether suspend codec"
    default n
    help
		set "y" phone incall status cannot into suspend codec

endif
```

## sound/soc/rockchip/Kconfig
```kconfig
# SPDX-License-Identifier: GPL-2.0-only
config SND_SOC_ROCKCHIP
	tristate "ASoC support for Rockchip"
	depends on COMPILE_TEST || ARCH_ROCKCHIP
	help
	  Say Y or M if you want to add support for codecs attached to
	  the Rockchip SoCs' Audio interfaces. You will also need to
	  select the audio interfaces to support below.

config SND_SOC_ROCKCHIP_I2S
	tristate "Rockchip I2S Device Driver"
	depends on CLKDEV_LOOKUP && SND_SOC_ROCKCHIP
	select SND_SOC_GENERIC_DMAENGINE_PCM
	help
	  Say Y or M if you want to add support for I2S driver for
	  Rockchip I2S device. The device supports upto maximum of
	  8 channels each for play and record.

config SND_SOC_ROCKCHIP_I2S_TDM
	tristate "Rockchip I2S/TDM Device Driver"
	depends on CLKDEV_LOOKUP && SND_SOC_ROCKCHIP
	select SND_SOC_GENERIC_DMAENGINE_PCM
	help
	  Say Y or M if you want to add support for I2S/TDM driver for
	  Rockchip I2S/TDM device. The device supports up to maximum of
	  8 channels each for play and record.

config SND_SOC_ROCKCHIP_PDM
	tristate "Rockchip PDM Controller Driver"
	depends on CLKDEV_LOOKUP && SND_SOC_ROCKCHIP
	select SND_SOC_GENERIC_DMAENGINE_PCM
	select RATIONAL
	help
	  Say Y or M if you want to add support for PDM driver for
	  Rockchip PDM Controller. The Controller supports up to maximum of
	  8 channels record.

config SND_SOC_ROCKCHIP_SPDIF
	tristate "Rockchip SPDIF Device Driver"
	depends on CLKDEV_LOOKUP && SND_SOC_ROCKCHIP
	select SND_SOC_GENERIC_DMAENGINE_PCM
	help
	  Say Y or M if you want to add support for SPDIF driver for
	  Rockchip SPDIF transceiver device.

config SND_SOC_ROCKCHIP_SPDIFRX
	tristate "Rockchip SPDIFRX Device Driver"
	depends on CLKDEV_LOOKUP && SND_SOC_ROCKCHIP
	select SND_SOC_GENERIC_DMAENGINE_PCM
	help
	  Say Y or M if you want to add support for SPDIFRX driver for
	  Rockchip SPDIF receiver device.

config SND_SOC_ROCKCHIP_VAD
	tristate "Rockchip Voice Activity Detection Driver"
	depends on CLKDEV_LOOKUP && SND_SOC_ROCKCHIP
	help
	  Say Y or M if you want to add support for VAD driver for
	  Rockchip VAD device.

config SND_SOC_ROCKCHIP_MAX98090
	tristate "ASoC support for Rockchip boards using a MAX98090 codec"
	depends on SND_SOC_ROCKCHIP && I2C && GPIOLIB && CLKDEV_LOOKUP
	select SND_SOC_ROCKCHIP_I2S
	select SND_SOC_MAX98090
	select SND_SOC_TS3A227E
	select SND_SOC_HDMI_CODEC
	help
	  Say Y or M here if you want to add support for SoC audio on Rockchip
	  boards using the MAX98090 codec and HDMI codec, such as Veyron.

config SND_SOC_ROCKCHIP_MULTICODECS
	tristate "ASoC support for Rockchip multicodecs"
	depends on SND_SOC_ROCKCHIP && CLKDEV_LOOKUP
	help
	  Say Y or M here if you want to add support for SoC audio on Rockchip
	  boards using multicodecs, such as RK3308 boards.

config SND_SOC_ROCKCHIP_RT5645
	tristate "ASoC support for Rockchip boards using a RT5645/RT5650 codec"
	depends on SND_SOC_ROCKCHIP && I2C && GPIOLIB && CLKDEV_LOOKUP
	select SND_SOC_ROCKCHIP_I2S
	select SND_SOC_RT5645
	help
	  Say Y or M here if you want to add support for SoC audio on Rockchip
	  boards using the RT5645/RT5650 codec, such as Veyron.

config SND_SOC_ROCKCHIP_HDMI
	tristate "ASoC support for Rockchip HDMI audio"
	depends on SND_SOC_ROCKCHIP && CLKDEV_LOOKUP
	select SND_SOC_HDMI_CODEC
	help
	  Say Y or M here if you want to add support for SoC audio on Rockchip
	  boards using built-in HDMI or external HDMI.

config SND_SOC_RK3288_HDMI_ANALOG
	tristate "ASoC support multiple codecs for Rockchip RK3288 boards"
	depends on SND_SOC_ROCKCHIP && I2C && GPIOLIB && CLKDEV_LOOKUP
	select SND_SOC_ROCKCHIP_I2S
	select SND_SOC_HDMI_CODEC
	select SND_SOC_ES8328_I2C
	select SND_SOC_ES8328_SPI if SPI_MASTER
	select DRM_DW_HDMI_I2S_AUDIO if DRM_DW_HDMI
	help
	  Say Y or M here if you want to add support for SoC audio on Rockchip
	  RK3288 boards using an analog output and the built-in HDMI audio.

config SND_SOC_RK3399_GRU_SOUND
	tristate "ASoC support multiple codecs for Rockchip RK3399 GRU boards"
	depends on SND_SOC_ROCKCHIP && I2C && GPIOLIB && CLKDEV_LOOKUP && SPI
	select SND_SOC_ROCKCHIP_I2S
	select SND_SOC_MAX98357A
	select SND_SOC_RT5514
	select SND_SOC_DA7219
	select SND_SOC_RT5514_SPI
	select SND_SOC_HDMI_CODEC
	select SND_SOC_DMIC
	help
	  Say Y or M here if you want to add support multiple codecs for SoC
	  audio on Rockchip RK3399 GRU boards.
```
