## sound/soc/s3c24xx/Kconfig
```kconfig
config SND_S3C24XX_SOC
	tristate "SoC Audio for the Samsung S3CXXXX chips"
	depends on ARCH_S3C2410 || ARCH_S3C64XX || ARCH_S5PC100 || ARCH_S5PV210
	select S3C64XX_DMA if ARCH_S3C64XX
	help
	  Say Y or M if you want to add support for codecs attached to
	  the S3C24XX AC97 or I2S interfaces. You will also need to
	  select the audio interfaces to support below.

config SND_S3C24XX_SOC_I2S
	tristate
	select S3C2410_DMA

config SND_S3C_I2SV2_SOC
	tristate

config SND_S3C2412_SOC_I2S
	tristate
	select SND_S3C_I2SV2_SOC
	select S3C2410_DMA

config SND_S3C64XX_SOC_I2S
	tristate
	select SND_S3C_I2SV2_SOC
	select S3C64XX_DMA

config SND_S3C64XX_SOC_I2S_V4
	tristate
	select SND_S3C_I2SV2_SOC
	select S3C64XX_DMA

config SND_S3C_SOC_PCM
	tristate

config SND_S3C_SOC_AC97
	tristate
	select SND_SOC_AC97_BUS

config SND_S3C24XX_SOC_NEO1973_WM8753
	tristate "SoC I2S Audio support for NEO1973 - WM8753"
	depends on SND_S3C24XX_SOC && MACH_NEO1973_GTA01
	select SND_S3C24XX_SOC_I2S
	select SND_SOC_WM8753
	help
	  Say Y if you want to add support for SoC audio on smdk2440
	  with the WM8753.

config SND_S3C24XX_SOC_NEO1973_GTA02_WM8753
	tristate "Audio support for the Openmoko Neo FreeRunner (GTA02)"
	depends on SND_S3C24XX_SOC && MACH_NEO1973_GTA02
	select SND_S3C24XX_SOC_I2S
	select SND_SOC_WM8753
	help
	  This driver provides audio support for the Openmoko Neo FreeRunner
	  smartphone.
	  
config SND_S3C24XX_SOC_JIVE_WM8750
	tristate "SoC I2S Audio support for Jive"
	depends on SND_S3C24XX_SOC && MACH_JIVE
	select SND_SOC_WM8750
	select SND_S3C2412_SOC_I2S
	help
	  Sat Y if you want to add support for SoC audio on the Jive.

config SND_S3C64XX_SOC_WM8580
	tristate "SoC I2S Audio support for WM8580 on SMDK64XX"
	depends on SND_S3C24XX_SOC && MACH_SMDK6410
	select SND_SOC_WM8580
	select SND_S3C64XX_SOC_I2S_V4
	help
	  Say Y if you want to add support for SoC audio on the SMDK6410.

config SND_S3C24XX_SOC_SMDK2443_WM9710
	tristate "SoC AC97 Audio support for SMDK2443 - WM9710"
	depends on SND_S3C24XX_SOC && MACH_SMDK2443
	select S3C2410_DMA
	select AC97_BUS
	select SND_SOC_AC97_CODEC
	select SND_S3C_SOC_AC97
	help
	  Say Y if you want to add support for SoC audio on smdk2443
	  with the WM9710.

config SND_S3C24XX_SOC_LN2440SBC_ALC650
	tristate "SoC AC97 Audio support for LN2440SBC - ALC650"
	depends on SND_S3C24XX_SOC && ARCH_S3C2410
	select S3C2410_DMA
	select AC97_BUS
	select SND_SOC_AC97_CODEC
	select SND_S3C_SOC_AC97
	help
	  Say Y if you want to add support for SoC audio on ln2440sbc
	  with the ALC650.

config SND_S3C24XX_SOC_S3C24XX_UDA134X
	tristate "SoC I2S Audio support UDA134X wired to a S3C24XX"
       	depends on SND_S3C24XX_SOC && ARCH_S3C2410
       	select SND_S3C24XX_SOC_I2S
	select SND_SOC_L3
       	select SND_SOC_UDA134X

config SND_S3C24XX_SOC_SIMTEC
	tristate
	help
	  Internal node for common S3C24XX/Simtec suppor

config SND_S3C24XX_SOC_SIMTEC_TLV320AIC23
	tristate "SoC I2S Audio support for TLV320AIC23 on Simtec boards"
	depends on SND_S3C24XX_SOC && ARCH_S3C2410
	select SND_S3C24XX_SOC_I2S
	select SND_SOC_TLV320AIC23
	select SND_S3C24XX_SOC_SIMTEC

config SND_S3C24XX_SOC_SIMTEC_HERMES
	tristate "SoC I2S Audio support for Simtec Hermes board"
	depends on SND_S3C24XX_SOC && ARCH_S3C2410
	select SND_S3C24XX_SOC_I2S
	select SND_SOC_TLV320AIC3X
	select SND_S3C24XX_SOC_SIMTEC

config SND_S3C24XX_SOC_RX1950_UDA1380
	tristate "Audio support for the HP iPAQ RX1950"
	depends on SND_S3C24XX_SOC && MACH_RX1950
	select SND_S3C24XX_SOC_I2S
	select SND_SOC_UDA1380
	help
	  This driver provides audio support for HP iPAQ RX1950 PDA.

config SND_SOC_SMDK_WM9713
	tristate "SoC AC97 Audio support for SMDK with WM9713"
	depends on SND_S3C24XX_SOC && (MACH_SMDK6410 || MACH_SMDKC100 || MACH_SMDKV210 || MACH_SMDKC110)
	select SND_SOC_WM9713
	select SND_S3C_SOC_AC97
	help
	  Sat Y if you want to add support for SoC audio on the SMDK.

config SND_S3C64XX_SOC_SMARTQ
	tristate "SoC I2S Audio support for SmartQ board"
	depends on SND_S3C24XX_SOC && MACH_SMARTQ
	select SND_S3C64XX_SOC_I2S
	select SND_SOC_WM8750

config SND_S5PC110_SOC_AQUILA_WM8994
	tristate "SoC I2S Audio support for AQUILA - WM8994"
	depends on SND_S3C24XX_SOC && MACH_AQUILA
	select SND_S3C64XX_SOC_I2S_V4
	select SND_SOC_WM8994
	help
	  Say Y if you want to add support for SoC audio on aquila
	  with the WM8994.

config SND_S5PV210_SOC_GONI_WM8994
	tristate "SoC I2S Audio support for GONI - WM8994"
	depends on SND_S3C24XX_SOC && MACH_GONI
	select SND_S3C64XX_SOC_I2S_V4
	select SND_SOC_WM8994
	help
	  Say Y if you want to add support for SoC audio on goni
	  with the WM8994.
```

## sound/soc/s6000/Kconfig
```kconfig
config SND_S6000_SOC
	tristate "SoC Audio for the Stretch s6000 family"
	depends on XTENSA_VARIANT_S6000 || COMPILE_TEST
	depends on HAS_IOMEM
	select SND_S6000_SOC_PCM if XTENSA_VARIANT_S6000
	help
	  Say Y or M if you want to add support for codecs attached to
	  s6000 family chips. You will also need to select the platform
	  to support below.

config SND_S6000_SOC_PCM
	tristate

config SND_S6000_SOC_I2S
	tristate

config SND_S6000_SOC_S6IPCAM
	bool "SoC Audio support for Stretch 6105 IP Camera"
	depends on SND_S6000_SOC=y
	depends on I2C=y
	depends on XTENSA_PLATFORM_S6105 || COMPILE_TEST
	select SND_S6000_SOC_I2S
	select SND_SOC_TLV320AIC3X
	help
	  Say Y if you want to add support for SoC audio on the
	  Stretch s6105 IP Camera Reference Design.
```

## sound/soc/samsung/Kconfig
```kconfig
# SPDX-License-Identifier: GPL-2.0-only
menuconfig SND_SOC_SAMSUNG
	tristate "ASoC support for Samsung"
	depends on PLAT_SAMSUNG || ARCH_S5PV210 || ARCH_EXYNOS || COMPILE_TEST
	depends on COMMON_CLK
	select SND_SOC_GENERIC_DMAENGINE_PCM
	help
	  Say Y or M if you want to add support for codecs attached to
	  the Samsung SoCs' Audio interfaces. You will also need to
	  select the audio interfaces to support below.

if SND_SOC_SAMSUNG

config SND_SAMSUNG_PCM
	tristate "Samsung PCM interface support"

config SND_SAMSUNG_SPDIF
	tristate "Samsung SPDIF transmitter support"
	select SND_SOC_SPDIF

config SND_SAMSUNG_I2S
	tristate "Samsung I2S interface support"

config SND_SOC_SAMSUNG_SMDK_WM8994
	tristate "SoC I2S Audio support for WM8994 on SMDK"
	depends on I2C=y
	select MFD_WM8994
	select SND_SOC_WM8994
	select SND_SAMSUNG_I2S
	help
		Say Y if you want to add support for SoC audio on the SMDKs.

config SND_SOC_SAMSUNG_SMDK_SPDIF
	tristate "SoC S/PDIF Audio support for SMDK"
	select SND_SAMSUNG_SPDIF
	help
	  Say Y if you want to add support for SoC S/PDIF audio on the SMDK.

config SND_SOC_SMDK_WM8994_PCM
	tristate "SoC PCM Audio support for WM8994 on SMDK"
	depends on I2C=y
	select MFD_WM8994
	select SND_SOC_WM8994
	select SND_SAMSUNG_PCM
	help
	  Say Y if you want to add support for SoC audio on the SMDK

config SND_SOC_SPEYSIDE
	tristate "Audio support for Wolfson Speyside"
	depends on I2C && SPI_MASTER
	depends on MACH_WLF_CRAGG_6410 || COMPILE_TEST
	select SND_SAMSUNG_I2S
	select SND_SOC_WM8996
	select SND_SOC_WM9081
	select SND_SOC_WM0010
	select SND_SOC_WM1250_EV1

config SND_SOC_TOBERMORY
	tristate "Audio support for Wolfson Tobermory"
	depends on INPUT && I2C
	depends on MACH_WLF_CRAGG_6410 || COMPILE_TEST
	select SND_SAMSUNG_I2S
	select SND_SOC_WM8962

config SND_SOC_BELLS
	tristate "Audio support for Wolfson Bells"
	depends on MFD_ARIZONA && MFD_WM5102 && MFD_WM5110 && I2C && SPI_MASTER
	depends on MACH_WLF_CRAGG_6410 || COMPILE_TEST
	select SND_SAMSUNG_I2S
	select SND_SOC_WM5102
	select SND_SOC_WM5110
	select SND_SOC_WM9081
	select SND_SOC_WM0010
	select SND_SOC_WM1250_EV1

config SND_SOC_LOWLAND
	tristate "Audio support for Wolfson Lowland"
	depends on I2C
	depends on MACH_WLF_CRAGG_6410 || COMPILE_TEST
	select SND_SAMSUNG_I2S
	select SND_SOC_WM5100
	select SND_SOC_WM9081

config SND_SOC_LITTLEMILL
	tristate "Audio support for Wolfson Littlemill"
	depends on I2C
	depends on MACH_WLF_CRAGG_6410 || COMPILE_TEST
	select SND_SAMSUNG_I2S
	select MFD_WM8994
	select SND_SOC_WM8994

config SND_SOC_SNOW
	tristate "Audio support for Google Snow boards"
	depends on I2C
	select SND_SOC_MAX98090
	select SND_SOC_MAX98095
	select SND_SAMSUNG_I2S
	help
	  Say Y if you want to add audio support for various Snow
	  boards based on Exynos5 series of SoCs.

config SND_SOC_ODROID
	tristate "Audio support for Odroid XU3/XU4"
	depends on SND_SOC_SAMSUNG && I2C
	select SND_SOC_MAX98090
	select SND_SAMSUNG_I2S
	help
	  Say Y here to enable audio support for the Odroid XU3/XU4.

config SND_SOC_ARNDALE
	tristate "Audio support for Arndale Board"
	depends on I2C
	select SND_SAMSUNG_I2S
	select SND_SOC_RT5631
	select MFD_WM8994
	select SND_SOC_WM8994

config SND_SOC_SAMSUNG_TM2_WM5110
	tristate "SoC I2S Audio support for WM5110 on TM2 board"
	depends on SND_SOC_SAMSUNG && MFD_ARIZONA && MFD_WM5110 && I2C && SPI_MASTER
	depends on GPIOLIB || COMPILE_TEST
	select SND_SOC_MAX98504
	select SND_SOC_WM5110
	select SND_SAMSUNG_I2S
	help
	  Say Y if you want to add support for SoC audio on the TM2 board.

config SND_SOC_SAMSUNG_ARIES_WM8994
	tristate "SoC I2S Audio support for WM8994 on Aries"
	depends on SND_SOC_SAMSUNG && I2C && IIO && EXTCON
	select SND_SOC_BT_SCO
	select MFD_WM8994
	select SND_SOC_WM8994
	select SND_SAMSUNG_I2S
	help
	  Say Y if you want to add support for SoC audio on Aries boards,
	  which has a WM8994 codec connected to a BT codec, a cellular
	  modem, and the Samsung I2S controller.  Jack detection is done
	  via ADC, GPIOs, and an extcon device.  Switching between the Mic
	  and TV-Out path is also handled.

config SND_SOC_SAMSUNG_MIDAS_WM1811
	tristate "SoC I2S Audio support for Midas boards"
	depends on SND_SOC_SAMSUNG && I2C && IIO
	select SND_SAMSUNG_I2S
	select MFD_WM8994
	select SND_SOC_WM8994
	help
	  Say Y if you want to add support for SoC audio on the Midas boards.

endif #SND_SOC_SAMSUNG
```

## sound/soc/samsung/srp_alp/Kconfig
```kconfig
config SND_SAMSUNG_RP_DEBUG
	bool "Enable debug message for ALP Audio"
	depends on SND_SAMSUNG_ALP
	default y
	help
	  Say Y if you want to add debug message for ALP Audio.
```

## sound/soc/samsung/srp_ulp/Kconfig
```kconfig
config SND_SAMSUNG_RP
	depends on ARCH_EXYNOS4
	bool "ULP Audio support"
	help
	  Say Y if you want to support ULP audio.
```

## sound/soc/sdca/Kconfig
```kconfig
# SPDX-License-Identifier: GPL-2.0-only
menu "SoundWire (SDCA)"

config SND_SOC_SDCA
	tristate
	depends on ACPI
	select AUXILIARY_BUS
	help
	  This option enables support for the MIPI SoundWire Device
	  Class for Audio (SDCA).

config SND_SOC_SDCA_HID
	bool "SDCA HID support"
	depends on SND_SOC_SDCA
	depends on HID=y || HID=SND_SOC_SDCA
	default y
	help
	  This option enables support for audio jack button reporting using HID.

config SND_SOC_SDCA_IRQ
	bool "SDCA IRQ support"
	select REGMAP
	select REGMAP_IRQ
	depends on SND_SOC_SDCA
	default y
	help
	  This option enables support for SDCA IRQs.

config SND_SOC_SDCA_FDL
	bool "SDCA FDL (File DownLoad) support"
	depends on SND_SOC_SDCA
	default y
	help
	  This option enables support for the File Download using UMP,
	  typically used for downloading firmware to devices.

config SND_SOC_SDCA_OPTIONAL
	def_tristate SND_SOC_SDCA || !SND_SOC_SDCA

config SND_SOC_SDCA_CLASS
	tristate "SDCA Class Driver"
	depends on SOUNDWIRE
	depends on HID=y || HID=SND_SOC_SDCA
	depends on SND_SOC_SDCA
	select SND_SOC_SDCA_CLASS_FUNCTION
	select SND_SOC_SDCA_FDL
	select SND_SOC_SDCA_HID
	select SND_SOC_SDCA_IRQ
	select REGMAP_SOUNDWIRE
	help
	  This option enables support for the SDCA Class driver which should
	  support any class compliant SDCA part.

config SND_SOC_SDCA_CLASS_FUNCTION
	tristate
	select REGMAP_SOUNDWIRE_MBQ
	help
	  This option enables support for the SDCA Class Function drivers,
	  these implement the individual functions of the SDCA Class driver.

endmenu
```

## sound/soc/sdw_utils/Kconfig
```kconfig
# SPDX-License-Identifier: GPL-2.0-only
config SND_SOC_SDW_UTILS
	tristate
	help
	  This option enables to use SoundWire common helper functions and
	  SoundWire codec helper functions in machine driver.
```

## sound/soc/sh/Kconfig
```kconfig
# SPDX-License-Identifier: GPL-2.0
menu "SoC Audio support for Renesas SoCs"
	depends on SUPERH || ARCH_RENESAS || COMPILE_TEST

config SND_SOC_PCM_SH7760
	tristate "SoC Audio support for Renesas SH7760"
	depends on CPU_SUBTYPE_SH7760 && SH_DMABRG
	help
	  Enable this option for SH7760 AC97/I2S audio support.


##
## Audio unit modules
##

config SND_SOC_SH4_HAC
	tristate
	select AC97_BUS
	select SND_SOC_AC97_BUS

config SND_SOC_SH4_SSI
	tristate

config SND_SOC_SH4_FSI
	tristate "SH4 FSI support"
	depends on SUPERH || COMMON_CLK
	select SND_SIMPLE_CARD
	help
	  This option enables FSI sound support

config SND_SOC_SH4_SIU
	tristate
	depends on ARCH_SHMOBILE && HAVE_CLK
	depends on DMADEVICES
	select DMA_ENGINE
	select SH_DMAE
	select FW_LOADER

config SND_SOC_RCAR
	tristate "R-Car series SRU/SCU/SSIU/SSI support"
	depends on COMMON_CLK
	depends on OF
	select SND_SIMPLE_CARD_UTILS
	select SND_DMAENGINE_PCM
	select REGMAP_MMIO
	help
	  This option enables R-Car SRU/SCU/SSIU/SSI sound support

config SND_SOC_RZ
	tristate "RZ/G2L series SSIF-2 support"
	depends on ARCH_RZG2L || COMPILE_TEST
	help
	  This option enables RZ/G2L SSIF-2 sound support.

##
## Boards
##

config SND_SH7760_AC97
	tristate "SH7760 AC97 sound support"
	depends on CPU_SUBTYPE_SH7760 && SND_SOC_PCM_SH7760
	select SND_SOC_SH4_HAC
	select SND_SOC_AC97_CODEC
	help
	  This option enables generic sound support for the first
	  AC97 unit of the SH7760.

config SND_SIU_MIGOR
	tristate "SIU sound support on Migo-R"
	depends on SH_MIGOR && I2C
	select SND_SOC_SH4_SIU
	select SND_SOC_WM8978
	help
	  This option enables sound support for the SH7722 Migo-R board

endmenu
```

## sound/soc/sirf/Kconfig
```kconfig
# SPDX-License-Identifier: GPL-2.0-only
config SND_SOC_SIRF
	tristate "SoC Audio for the SiRF SoC chips"
	depends on ARCH_SIRF || COMPILE_TEST
	select SND_SOC_GENERIC_DMAENGINE_PCM

config SND_SOC_SIRF_AUDIO
	tristate "SoC Audio support for SiRF internal audio codec"
	depends on SND_SOC_SIRF
	select SND_SOC_SIRF_AUDIO_CODEC
	select SND_SOC_SIRF_AUDIO_PORT

config SND_SOC_SIRF_AUDIO_PORT
	select REGMAP_MMIO
	tristate

config SND_SOC_SIRF_USP
	tristate "SoC Audio (I2S protocol) for SiRF SoC USP interface"
	depends on SND_SOC_SIRF
	select REGMAP_MMIO
	tristate
```
