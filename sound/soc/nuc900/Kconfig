## sound/soc/nuc900/Kconfig
```kconfig
# SPDX-License-Identifier: GPL-2.0-only
##
## NUC900 series AC97 API
##
config SND_SOC_NUC900
	tristate "SoC Audio for NUC900 series"
	depends on ARCH_W90X900
	select SND_SOC_NUC900_AC97
	help
	  This option enables support for AC97 mode on the NUC900 SoC.

config SND_SOC_NUC900_AC97
	tristate
	select AC97_BUS
	select SND_AC97_CODEC
	select SND_SOC_AC97_BUS


##
## Boards
##
config SND_SOC_NUC900EVB
	tristate "NUC900 AC97 support for demo board"
	depends on SND_SOC_NUC900
	select SND_SOC_NUC900_AC97
	select SND_SOC_AC97_CODEC
	help
	  Select this option to enable audio (AC97) on the
	  NUC900 demoboard.
```

## sound/soc/omap/Kconfig
```kconfig
config SND_OMAP_SOC
	tristate "SoC Audio for the Texas Instruments OMAP chips"
	depends on (ARCH_OMAP && DMA_OMAP) || (ARM && COMPILE_TEST)
	select SND_DMAENGINE_PCM

config SND_OMAP_SOC_DMIC
	tristate

config SND_OMAP_SOC_MCBSP
	tristate

config SND_OMAP_SOC_MCPDM
	tristate

config SND_OMAP_SOC_HDMI_AUDIO
	tristate "HDMI audio support for OMAP4+ based SoCs"
	depends on SND_OMAP_SOC
	help
	  For HDMI audio to work OMAPDSS HDMI support should be
	  enabled.
	  The hdmi audio driver implements cpu-dai component using the
	  callbacks provided by OMAPDSS and registers the component
	  under DSS HDMI device. Omap-pcm is registered for platform
	  component also under DSS HDMI device. Dummy codec is used as
	  as codec component. The hdmi audio driver implements also
	  the card and registers it under its own platform device.
	  The device for the dirver is registered by OMAPDSS hdmi
	  driver.

config SND_OMAP_SOC_N810
	tristate "SoC Audio support for Nokia N810"
	depends on SND_OMAP_SOC && MACH_NOKIA_N810 && I2C
	depends on OMAP_MUX
	select SND_OMAP_SOC_MCBSP
	select SND_SOC_TLV320AIC3X
	help
	  Say Y if you want to add support for SoC audio on Nokia N810.

config SND_OMAP_SOC_RX51
	tristate "SoC Audio support for Nokia N900 (RX-51)"
	depends on SND_OMAP_SOC && ARM && I2C
	select SND_OMAP_SOC_MCBSP
	select SND_SOC_TLV320AIC3X
	select SND_SOC_TPA6130A2
	depends on GPIOLIB
	help
	  Say Y if you want to add support for SoC audio on Nokia N900
	  cellphone.

config SND_OMAP_SOC_AMS_DELTA
	tristate "SoC Audio support for Amstrad E3 (Delta) videophone"
	depends on SND_OMAP_SOC && MACH_AMS_DELTA && TTY
	select SND_OMAP_SOC_MCBSP
	select SND_SOC_CX20442
	help
	  Say Y  if you want to add support  for SoC audio device  connected to
	  a handset and a speakerphone found on Amstrad E3 (Delta) videophone.

	  Note that in order to get those devices fully supported,  you have to
	  build  the kernel  with  standard  serial port  driver  included  and
	  configured for at least 4 ports.  Then, from userspace, you must load
	  a line discipline #19 on the modem (ttyS3) serial line.  The simplest
	  way to achieve this is to install util-linux-ng  and use the included
	  ldattach  utility.  This  can be  started  automatically  from  udev,
	  a simple rule like this one should do the trick (it does for me):
	  	ACTION=="add", KERNEL=="controlC0", \
				RUN+="/usr/sbin/ldattach 19 /dev/ttyS3"

config SND_OMAP_SOC_OSK5912
	tristate "SoC Audio support for omap osk5912"
	depends on SND_OMAP_SOC && MACH_OMAP_OSK && I2C
	select SND_OMAP_SOC_MCBSP
	select SND_SOC_TLV320AIC23_I2C
	help
	  Say Y if you want to add support for SoC audio on osk5912.

config SND_OMAP_SOC_AM3517EVM
	tristate "SoC Audio support for OMAP3517 / AM3517 EVM"
	depends on SND_OMAP_SOC && MACH_OMAP3517EVM && I2C
	select SND_OMAP_SOC_MCBSP
	select SND_SOC_TLV320AIC23_I2C
	help
	  Say Y if you want to add support for SoC audio on the OMAP3517 / AM3517
	  EVM.

config SND_OMAP_SOC_OMAP_TWL4030
	tristate "SoC Audio support for TI SoC based boards with twl4030 codec"
	depends on TWL4030_CORE && SND_OMAP_SOC
	select SND_OMAP_SOC_MCBSP
	select SND_SOC_TWL4030
	help
	  Say Y if you want to add support for SoC audio on TI SoC based boards
	  using twl4030 as c codec. This driver currently supports:
	  - Beagleboard or Devkit8000
	  - Gumstix Overo or CompuLab CM-T35/CM-T3730
	  - IGEP v2
	  - OMAP3EVM
	  - SDP3430
	  - Zoom2

config SND_OMAP_SOC_OMAP_ABE_TWL6040
	tristate "SoC Audio support for OMAP boards using ABE and twl6040 codec"
	depends on TWL6040_CORE && SND_OMAP_SOC && (ARCH_OMAP4 || COMPILE_TEST)
	select SND_OMAP_SOC_DMIC
	select SND_OMAP_SOC_MCPDM
	select SND_SOC_TWL6040
	select SND_SOC_DMIC
	help
	  Say Y if you want to add support for SoC audio on OMAP boards using
	  ABE and twl6040 codec. This driver currently supports:
	  - SDP4430/Blaze boards
	  - PandaBoard (4430)
	  - PandaBoardES (4460)

config SND_OMAP_SOC_OMAP3_PANDORA
	tristate "SoC Audio support for OMAP3 Pandora"
	depends on TWL4030_CORE && SND_OMAP_SOC && MACH_OMAP3_PANDORA
	select SND_OMAP_SOC_MCBSP
	select SND_SOC_TWL4030
	help
	  Say Y if you want to add support for SoC audio on the OMAP3 Pandora.
```

## sound/soc/pxa/Kconfig
```kconfig
# SPDX-License-Identifier: GPL-2.0-only
config SND_PXA2XX_SOC
	tristate "SoC Audio for the Intel PXA2xx chip"
	depends on ARCH_PXA || COMPILE_TEST
	select SND_PXA2XX_LIB
	help
	  Say Y or M if you want to add support for codecs attached to
	  the PXA2xx AC97, I2S or SSP interface. You will also need
	  to select the audio interfaces to support below.

config SND_PXA2XX_AC97
	tristate

config SND_PXA2XX_SOC_AC97
	tristate
	select AC97_BUS_NEW
	select SND_PXA2XX_LIB
	select SND_PXA2XX_LIB_AC97
	select SND_SOC_AC97_BUS_NEW

config SND_PXA2XX_SOC_I2S
	select SND_PXA2XX_LIB
	tristate

config SND_PXA_SOC_SSP
	tristate "Soc Audio via PXA2xx/PXA3xx SSP ports"
	depends on PLAT_PXA
	select PXA_SSP
	select SND_PXA2XX_LIB

config SND_MMP_SOC_SSPA
	tristate "SoC Audio via MMP SSPA ports"
	depends on ARCH_MMP
	select SND_SOC_GENERIC_DMAENGINE_PCM
	select SND_ARM
	help
	  Say Y if you want to add support for codecs attached to
	  the MMP SSPA interface.

config SND_PXA2XX_SOC_SPITZ
	tristate "SoC Audio support for Sharp Zaurus SL-Cxx00"
	depends on SND_PXA2XX_SOC && PXA_SHARP_Cxx00 && I2C
	select SND_PXA2XX_SOC_I2S
	select SND_SOC_WM8750
	help
	  Say Y if you want to add support for SoC audio on Sharp
	  Zaurus SL-Cxx00 models (Spitz, Borzoi and Akita).

config SND_PXA910_SOC
	tristate "SoC Audio for Marvell PXA910 chip"
	depends on ARCH_MMP && SND
	select SND_PCM
	help
	  Say Y if you want to add support for SoC audio on the
	  Marvell PXA910 reference platform.
```

## sound/soc/qcom/Kconfig
```kconfig
# SPDX-License-Identifier: GPL-2.0-only
menuconfig SND_SOC_QCOM
	tristate "ASoC support for QCOM platforms"
	depends on ARCH_QCOM || COMPILE_TEST
	help
	  Say Y or M if you want to add support to use audio devices
	  in Qualcomm Technologies SOC-based platforms.

if SND_SOC_QCOM

config SND_SOC_LPASS_CPU
	tristate
	select REGMAP_MMIO

config SND_SOC_LPASS_HDMI
	tristate
	select REGMAP_MMIO

config SND_SOC_LPASS_PLATFORM
	tristate
	select REGMAP_MMIO

config SND_SOC_LPASS_CDC_DMA
	tristate
	select REGMAP_MMIO

config SND_SOC_LPASS_IPQ806X
	tristate
	select SND_SOC_LPASS_CPU
	select SND_SOC_LPASS_PLATFORM

config SND_SOC_LPASS_APQ8016
	tristate
	select SND_SOC_LPASS_CPU
	select SND_SOC_LPASS_PLATFORM

config SND_SOC_LPASS_SC7180
	tristate
	select SND_SOC_LPASS_CPU
	select SND_SOC_LPASS_PLATFORM
	select SND_SOC_LPASS_HDMI

config SND_SOC_LPASS_SC7280
	tristate
	select SND_SOC_LPASS_CPU
	select SND_SOC_LPASS_PLATFORM
	select SND_SOC_LPASS_HDMI
	select SND_SOC_LPASS_CDC_DMA

config SND_SOC_STORM
	tristate "ASoC I2S support for Storm boards"
	depends on GPIOLIB
	select SND_SOC_LPASS_IPQ806X
	select SND_SOC_MAX98357A
	help
	  Say Y or M if you want add support for SoC audio on the
	  Qualcomm Technologies IPQ806X-based Storm board.

config SND_SOC_APQ8016_SBC
	tristate "SoC Audio support for APQ8016 SBC platforms"
	select SND_SOC_LPASS_APQ8016
	select SND_SOC_QCOM_COMMON
	help
	  Support for Qualcomm Technologies LPASS audio block in
	  APQ8016 SOC-based systems.
	  Say Y if you want to use audio devices on MI2S.

config SND_SOC_QCOM_COMMON
	tristate

config SND_SOC_QDSP6_COMMON
	tristate

config SND_SOC_QDSP6_CORE
	tristate

config SND_SOC_QDSP6_AFE
	tristate

config SND_SOC_QDSP6_AFE_DAI
	tristate

config SND_SOC_QDSP6_AFE_CLOCKS
	tristate

config SND_SOC_QDSP6_ADM
	tristate

config SND_SOC_QDSP6_ROUTING
	tristate

config SND_SOC_QDSP6_ASM
	tristate

config SND_SOC_QDSP6_ASM_DAI
	select SND_SOC_COMPRESS
	tristate

config SND_SOC_QDSP6_APM_DAI
	tristate
	select SND_SOC_COMPRESS

config SND_SOC_QDSP6_APM_LPASS_DAI
	tristate

config SND_SOC_QDSP6_APM
	tristate
	select SND_SOC_QDSP6_APM_DAI
	select SND_SOC_QDSP6_APM_LPASS_DAI

config SND_SOC_QDSP6_PRM_LPASS_CLOCKS
	tristate

config SND_SOC_QDSP6_PRM
	tristate
	select SND_SOC_QDSP6_PRM_LPASS_CLOCKS

config SND_SOC_QDSP6
	tristate "SoC ALSA audio driver for QDSP6"
	depends on QCOM_APR
	depends on COMMON_CLK
	select SND_SOC_QDSP6_COMMON
	select SND_SOC_QDSP6_CORE
	select SND_SOC_QDSP6_AFE
	select SND_SOC_QDSP6_AFE_DAI
	select SND_SOC_QDSP6_AFE_CLOCKS
	select SND_SOC_QDSP6_ADM
	select SND_SOC_QDSP6_ROUTING
	select SND_SOC_QDSP6_ASM
	select SND_SOC_QDSP6_ASM_DAI
	select SND_SOC_TOPOLOGY
	select SND_SOC_QDSP6_APM
	select SND_SOC_QDSP6_PRM
	help
	 To add support for MSM QDSP6 Soc Audio.
	 This will enable sound soc platform specific
	 audio drivers. This includes q6asm, q6adm,
	 q6afe interfaces to DSP using apr.

config SND_SOC_MSM8996
	tristate "SoC Machine driver for MSM8996 and APQ8096 boards"
	depends on QCOM_APR
	depends on COMMON_CLK
	select SND_SOC_QDSP6
	select SND_SOC_QCOM_COMMON
	help
	  Support for Qualcomm Technologies LPASS audio block in
	  APQ8096 SoC-based systems.
	  Say Y if you want to use audio device on this SoCs

config SND_SOC_SDM845
	tristate "SoC Machine driver for SDM845 boards"
	depends on QCOM_APR && I2C && SOUNDWIRE
	depends on COMMON_CLK
	select SND_SOC_QDSP6
	select SND_SOC_QCOM_COMMON
	select SND_SOC_RT5663
	select SND_SOC_MAX98927
	imply SND_SOC_CROS_EC_CODEC
	help
	  To add support for audio on Qualcomm Technologies Inc.
	  SDM845 SoC-based systems.
	  Say Y if you want to use audio device on this SoCs.

config SND_SOC_SM8250
	tristate "SoC Machine driver for SM8250 boards"
	depends on QCOM_APR && SOUNDWIRE
	depends on COMMON_CLK
	select SND_SOC_QDSP6
	select SND_SOC_QCOM_COMMON
	help
	  To add support for audio on Qualcomm Technologies Inc.
	  SM8250 SoC-based systems.
	  Say Y if you want to use audio device on this SoCs.

config SND_SOC_SC7180
	tristate "SoC Machine driver for SC7180 boards"
	depends on I2C && GPIOLIB
	select SND_SOC_QCOM_COMMON
	select SND_SOC_LPASS_SC7180
	select SND_SOC_MAX98357A
	select SND_SOC_RT5682_I2C
	select SND_SOC_RT5682S
	select SND_SOC_ADAU7002
	help
	  To add support for audio on Qualcomm Technologies Inc.
	  SC7180 SoC-based systems.
	  Say Y if you want to use audio device on this SoCs.

config SND_SOC_SC7280
	tristate "SoC Machine driver for SC7280 boards"
	depends on I2C && SOUNDWIRE
	select SND_SOC_QCOM_COMMON
	select SND_SOC_LPASS_SC7280
	select SND_SOC_MAX98357A
	select SND_SOC_WCD938X_SDW
	select SND_SOC_LPASS_MACRO_COMMON
	imply SND_SOC_LPASS_RX_MACRO
	imply SND_SOC_LPASS_TX_MACRO
	help
	  Add support for audio on Qualcomm Technologies Inc.
	  SC7280 SoC-based systems.
	  Say Y or M if you want to use audio device on this SoCs.

endif #SND_SOC_QCOM
```

## sound/soc/rk2818/Kconfig
```kconfig
config SND_ROCKCHIP_SOC
	tristate "SoC Audio for the rockchip RK2818 System-on-Chip"
	depends on ARCH_RK2818 && SND_SOC
	help
	  Say Y or M if you want to add support for codecs attached to
	  the ROCKCHIP IIS interface. You will also need
	  to select the audio interfaces to support below.

config SND_ROCKCHIP_SOC_I2S
	tristate 

config SND_ROCKCHIP_SOC_WM8988
	tristate "SoC I2S Audio support for rockchip - WM8988"
	depends on SND_ROCKCHIP_SOC 
	select SND_ROCKCHIP_SOC_I2S
	select SND_SOC_WM8988
	help
	  Say Y if you want to add support for SoC audio on rockchip
	  with the WM8988.

config SND_ROCKCHIP_SOC_WM8994
	tristate "SoC I2S Audio support for rockchip - WM8994"
	depends on SND_ROCKCHIP_SOC 
	select SND_ROCKCHIP_SOC_I2S
	select SND_SOC_WM8994
	help
	  Say Y if you want to add support for SoC audio on rockchip
	  with the WM8994.

if SND_ROCKCHIP_SOC_WM8994
choice
  prompt "Chose earpiece type"

	config SND_INSIDE_EARPIECE
		tristate  "Inside earpiece"

	config SND_OUTSIDE_EARPIECE
		tristate  "Outside earpiece"

	config SND_NO_EARPIECE
		tristate  "No earpiece"
endchoice

choice
  prompt "Chose BB input signal type"

	config SND_BB_NORMAL_INPUT
		tristate  "BB normal singnal input"

	config SND_BB_DIFFERENTIAL_INPUT
		tristate  "BB differential singnal input"

endchoice

config WM8994_SPEAKER_INCALL_VOL  
	default 0
	int "Setting the wm8994 speaker incall vol"
	help
	  -21dB to 12dB

config WM8994_SPEAKER_INCALL_MIC_VOL  
	default -9
	int "Setting the wm8994 speaker incall mic vol"
	help
	  -22dB to 30dB

config WM8994_SPEAKER_NORMAL_VOL  
	default 6
	int "Setting the wm8994 speaker normal vol"
	help
	  -57dB to 18dB

if SND_INSIDE_EARPIECE||SND_OUTSIDE_EARPIECE
config WM8994_EARPIECE_INCALL_VOL  
	default 0
	int "Setting the wm8994 earpiece incall vol(normal)"
	help
	  -27dB to 30dB
endif

config WM8994_HEADSET_INCALL_VOL
	default -9
	int "Setting the wm8994 headset incall vol"
	help
	  -21dB to 0dB

config WM8994_HEADSET_INCALL_MIC_VOL  
	default -6
	int "Setting the wm8994 headset incall mic vol"
	help
	  -22dB to 30dB

config WM8994_HEADSET_NORMAL_VOL  
	default 6
	int "Setting the wm8994 headset normal vol"
	help
	  -57dB to 6dB

config WM8994_BT_INCALL_VOL  
	default 0
	int "Setting the wm8994 BT incall vol"
	help
	  0dB or 30dB

config WM8994_BT_INCALL_MIC_VOL  
	default 0
	int "Setting the wm8994 BT incall mic vol"
	help
	  -57dB to 6dB

config WM8994_RECORDER_VOL  
	default 50
	int "Setting the wm8994 recorder vol"
	help
	  -16dB to 60dB
endif

config SND_ROCKCHIP_SOC_RK1000
	tristate "SoC I2S Audio support for rockchip - RK1000"
	depends on SND_ROCKCHIP_SOC && RK1000_CONTROL
	select SND_ROCKCHIP_SOC_I2S
	select SND_SOC_RK1000
	help
	  Say Y if you want to add support for SoC audio on rockchip
	  with the RK1000.	 
	   
if SND_ROCKCHIP_SOC_WM8988 || SND_ROCKCHIP_SOC_RK1000 || SND_ROCKCHIP_SOC_WM8994
choice
  prompt "Set i2s type"

	config SND_CODEC_SOC_MASTER
		tristate  "Codec run in Master"

	config SND_CODEC_SOC_SLAVE
		tristate  "Codec run in Slave"
endchoice
endif
```
