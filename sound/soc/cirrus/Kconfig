## sound/soc/imx/Kconfig
```kconfig
menuconfig SND_IMX_SOC
	tristate "SoC Audio for Freescale i.MX CPUs"
	depends on ARCH_MXC
	select SND_PCM
	select FIQ
	select SND_SOC_AC97_BUS
	help
	  Say Y or M if you want to add support for codecs attached to
	  the i.MX SSI interface.


if SND_IMX_SOC

config SND_MXC_SOC_SSI
	tristate

config SND_MXC_SOC_FIQ
	tristate

config SND_MXC_SOC_MX2
	tristate

config SND_MXC_SOC_WM1133_EV1
	tristate "Audio on the the i.MX31ADS with WM1133-EV1 fitted"
	depends on MACH_MX31ADS_WM1133_EV1 && EXPERIMENTAL
	select SND_SOC_WM8350
	select SND_MXC_SOC_SSI
	select SND_MXC_SOC_FIQ
	help
	  Enable support for audio on the i.MX31ADS with the WM1133-EV1
	  PMIC board with WM8835x fitted.

config SND_SOC_PHYCORE_AC97
	tristate "SoC Audio support for Phytec phyCORE (and phyCARD) boards"
	depends on MACH_PCM043 || MACH_PCA100
	select SND_SOC_WM9712
	select SND_MXC_SOC_SSI
	select SND_MXC_SOC_FIQ
	help
	  Say Y if you want to add support for SoC audio on Phytec phyCORE
	  and phyCARD boards in AC97 mode

config SND_SOC_EUKREA_TLV320
	tristate "Eukrea TLV320"
	depends on MACH_EUKREA_MBIMX27_BASEBOARD \
		|| MACH_EUKREA_MBIMXSD25_BASEBOARD \
		|| MACH_EUKREA_MBIMXSD35_BASEBOARD \
		|| MACH_EUKREA_MBIMXSD51_BASEBOARD
	select SND_SOC_TLV320AIC23
	select SND_MXC_SOC_SSI
	select SND_MXC_SOC_FIQ
	help
	  Enable I2S based access to the TLV320AIC23B codec attached
	  to the SSI interface

endif	# SND_IMX_SOC
```

## sound/soc/intel/Kconfig
```kconfig
# SPDX-License-Identifier: GPL-2.0-only
config SND_SOC_INTEL_SST_TOPLEVEL
	bool "Intel ASoC SST drivers"
	default y
	depends on X86 || COMPILE_TEST
	select SND_SOC_INTEL_MACH
	help
	  Intel ASoC SST Platform Drivers. If you have a Intel machine that
	  has an audio controller with a DSP and I2S or DMIC port, then
	  enable this option by saying Y

	  Note that the answer to this question doesn't directly affect the
	  kernel: saying N will just cause the configurator to skip all
	  the questions about Intel SST drivers.

if SND_SOC_INTEL_SST_TOPLEVEL

config SND_SOC_INTEL_CATPT
	tristate "Haswell and Broadwell"
	depends on ACPI || COMPILE_TEST
	depends on DMADEVICES && SND_DMA_SGBUF
	select DW_DMAC_CORE
	select SND_SOC_ACPI if ACPI
	select WANT_DEV_COREDUMP
	select SND_INTEL_DSP_CONFIG
	help
	  Enable support for Intel(R) Haswell and Broadwell platforms
	  with I2S codec present. This is a recommended option.
	  Say Y or m if you have such device.
	  If unsure, say N.

config SND_SOC_INTEL_HASWELL
	tristate
	select SND_SOC_INTEL_CATPT

config SND_SST_ATOM_HIFI2_PLATFORM
	tristate
	select SND_SOC_COMPRESS

config SND_SST_ATOM_HIFI2_PLATFORM_PCI
	tristate "PCI HiFi2 (Merrifield) Platforms"
	depends on X86 && PCI
	select SND_SST_ATOM_HIFI2_PLATFORM
	help
	  If you have a Intel Merrifield/Edison platform, then
	  enable this option by saying Y or m. Distros will typically not
	  enable this option: while Merrifield/Edison can run a mainline
	  kernel with limited functionality it will require a firmware file
	  which is not in the standard firmware tree

config SND_SST_ATOM_HIFI2_PLATFORM_ACPI
	tristate "ACPI HiFi2 (Baytrail, Cherrytrail) Platforms"
	default ACPI
	depends on X86 && ACPI && PCI
	select SND_SST_ATOM_HIFI2_PLATFORM
	select SND_SOC_ACPI_INTEL_MATCH
	select SND_INTEL_DSP_CONFIG
	select IOSF_MBI
	help
	  If you have a Intel Baytrail or Cherrytrail platform with an I2S
	  codec, then enable this option by saying Y or m. This is a
	  recommended option
	  This option is mutually exclusive with the SOF support on
	  Baytrail/Cherrytrail. If you want to enable SOF on
	  Baytrail/Cherrytrail, you need to deselect this option first.

endif ## SND_SOC_INTEL_SST_TOPLEVEL

if SND_SOC_INTEL_SST_TOPLEVEL || SND_SOC_SOF_INTEL_TOPLEVEL

config SND_SOC_ACPI_INTEL_MATCH
	tristate
	select SND_SOC_ACPI if ACPI
	select SND_SOC_ACPI_INTEL_SDCA_QUIRKS
	# this option controls the compilation of ACPI matching tables and
	# helpers and is not meant to be selected by the user.

config SND_SOC_ACPI_INTEL_SDCA_QUIRKS
	tristate
	select SND_SOC_SDCA if ACPI

endif ## SND_SOC_INTEL_SST_TOPLEVEL || SND_SOC_SOF_INTEL_TOPLEVEL

config SND_SOC_INTEL_KEEMBAY
	tristate "Keembay Platforms"
	depends on ARCH_KEEMBAY || COMPILE_TEST
	depends on COMMON_CLK
	select SND_DMAENGINE_PCM
	select SND_SOC_GENERIC_DMAENGINE_PCM
	help
	  If you have a Intel Keembay platform then enable this option
	  by saying Y or m.

config SND_SOC_INTEL_AVS
	tristate "Intel AVS driver"
	depends on X86 || COMPILE_TEST
	depends on PCI
	depends on COMMON_CLK
	select ACPI_NHLT if ACPI
	select SND_SOC_ACPI if ACPI
	select SND_SOC_TOPOLOGY
	select SND_SOC_HDA
	select SND_SOC_COMPRESS if DEBUG_FS
	select SND_HDA_EXT_CORE
	select SND_HDA_DSP_LOADER
	select SND_INTEL_DSP_CONFIG
	select WANT_DEV_COREDUMP
	help
	  Enable support for Intel(R) cAVS 1.5 platforms with DSP
	  capabilities. This includes Skylake, Kabylake, Amberlake and
	  Apollolake.

# Machine board drivers
source "sound/soc/intel/avs/boards/Kconfig"

# ASoC codec drivers
source "sound/soc/intel/boards/Kconfig"
```

## sound/soc/intel/avs/boards/Kconfig
```kconfig
# SPDX-License-Identifier: GPL-2.0-only
menu "Intel AVS Machine drivers"
	depends on SND_SOC_INTEL_AVS

comment "Available DSP configurations"

config SND_SOC_INTEL_AVS_CARDNAME_OBSOLETE
	bool "Use obsolete card names"
	default n
	help
	  Use obsolete names for some of avs cards. This option should be
	  used if your system depends on old card names, for example having
	  not up to date UCM files.

config SND_SOC_INTEL_AVS_MACH_DA7219
	tristate "da7219 I2S board"
	depends on I2C
	depends on MFD_INTEL_LPSS || COMPILE_TEST
	select SND_SOC_DA7219
	help
	  This adds support for AVS with DA7219 I2S codec configuration.
	  Say Y or m if you have such a device. This is a recommended option.
	  If unsure select "N".

config SND_SOC_INTEL_AVS_MACH_DMIC
	tristate "DMIC generic board"
	select SND_SOC_DMIC
	help
	  This adds support for AVS with Digital Mic array configuration.
	  Say Y or m if you have such a device. This is a recommended option.
	  If unsure select "N".

config SND_SOC_INTEL_AVS_MACH_ES8336
	tristate "es8336 I2S board"
	depends on X86 && I2C
	depends on MFD_INTEL_LPSS || COMPILE_TEST
	select SND_SOC_ES8316
	help
	  This adds support for AVS with ES8336 I2S codec configuration.
	  Say Y or m if you have such a device. This is a recommended option.
	  If unsure select "N".

config SND_SOC_INTEL_AVS_MACH_HDAUDIO
	tristate "HD-Audio generic board"
	select SND_SOC_HDA
	help
	  This adds support for AVS with HDAudio codec configuration.
	  Say Y or m if you have such a device. This is a recommended option.
	  If unsure select "N".

config SND_SOC_INTEL_AVS_MACH_I2S_TEST
	tristate "I2S test board"
	help
	   This adds support for I2S test-board which can be used to verify
	   transfer over I2S interface with SSP loopback scenarios.

config SND_SOC_INTEL_AVS_MACH_MAX98927
	tristate "max98927 I2S board"
	depends on I2C
	depends on MFD_INTEL_LPSS || COMPILE_TEST
	select SND_SOC_MAX98927
	help
	  This adds support for AVS with MAX98927 I2S codec configuration.
	  Say Y or m if you have such a device. This is a recommended option.
	  If unsure select "N".

config SND_SOC_INTEL_AVS_MACH_MAX98357A
	tristate "max98357A I2S board"
	depends on I2C
	depends on MFD_INTEL_LPSS || COMPILE_TEST
	select SND_SOC_MAX98357A
	help
	  This adds support for AVS with MAX98357A I2S codec configuration.
	  Say Y or m if you have such a device. This is a recommended option.
	  If unsure select "N".

config SND_SOC_INTEL_AVS_MACH_MAX98373
	tristate "max98373 I2S board"
	depends on I2C
	depends on MFD_INTEL_LPSS || COMPILE_TEST
	select SND_SOC_MAX98373
	help
	  This adds support for AVS with MAX98373 I2S codec configuration.
	  Say Y or m if you have such a device. This is a recommended option.
	  If unsure select "N".

config SND_SOC_INTEL_AVS_MACH_NAU8825
	tristate "nau8825 I2S board"
	depends on I2C
	depends on MFD_INTEL_LPSS || COMPILE_TEST
	select SND_SOC_NAU8825
	help
	   This adds support for ASoC machine driver with NAU8825 I2S audio codec.
	   It is meant to be used with AVS driver.
	   Say Y or m if you have such a device. This is a recommended option.
	   If unsure select "N".

config SND_SOC_INTEL_AVS_MACH_PCM3168A
	tristate "pcm3168a I2S board"
	depends on I2C
	depends on MFD_INTEL_LPSS || COMPILE_TEST
	select SND_SOC_PCM3168A_I2C
	help
	  This adds support for AVS with PCM3168A I2C codec configuration.
	  Say Y or m if you have such a device. This is a recommended option.
	  If unsure select "N".

config SND_SOC_INTEL_AVS_MACH_PROBE
	tristate "Probing (data) board"
	depends on DEBUG_FS
	select SND_HWDEP
	help
	   This adds support for data probing board which can be used to
	   gather data from runtime stream over compress operations.

config SND_SOC_INTEL_AVS_MACH_RT274
	tristate "rt274 in I2S mode"
	depends on I2C
	depends on MFD_INTEL_LPSS || COMPILE_TEST
	select SND_SOC_RT274
	help
	   This adds support for ASoC machine driver with RT274 I2S audio codec.
	   Say Y or m if you have such a device. This is a recommended option.
	   If unsure select "N".

config SND_SOC_INTEL_AVS_MACH_RT286
	tristate "rt286 in I2S mode"
	depends on I2C
	depends on MFD_INTEL_LPSS || COMPILE_TEST
	select SND_SOC_RT286
	help
	   This adds support for ASoC machine driver with RT286 I2S audio codec.
	   Say Y or m if you have such a device. This is a recommended option.
	   If unsure select "N".

config SND_SOC_INTEL_AVS_MACH_RT298
	tristate "rt298 in I2S mode"
	depends on I2C
	depends on MFD_INTEL_LPSS || COMPILE_TEST
	select SND_SOC_RT298
	help
	   This adds support for ASoC machine driver with RT298 I2S audio codec.
	   Say Y or m if you have such a device. This is a recommended option.
	   If unsure select "N".

config SND_SOC_INTEL_AVS_MACH_RT5514
	tristate "rt5514 in I2S mode"
	depends on I2C
	depends on MFD_INTEL_LPSS || COMPILE_TEST
	select SND_SOC_RT5514
	help
	   This adds support for ASoC machine driver with RT5514 I2S audio codec.
	   Say Y or m if you have such a device. This is a recommended option.
	   If unsure select "N".

config SND_SOC_INTEL_AVS_MACH_RT5640
	tristate "rt5640 in I2S mode"
	depends on I2C
	depends on MFD_INTEL_LPSS || COMPILE_TEST
	select SND_SOC_RT5640
	help
	  This adds support for ASoC machine board connecting AVS with RT5640,
	  components representing Intel AudioDSP and Realtek 5640 codec respectively.
	  The codec chip is present on I2C bus and the streaming occurs over I2S
	  interface.
	  Say Y or m if you have such a device.

config SND_SOC_INTEL_AVS_MACH_RT5663
	tristate "rt5663 in I2S mode"
	depends on I2C
	depends on MFD_INTEL_LPSS || COMPILE_TEST
	select SND_SOC_RT5663
	help
	   This adds support for ASoC machine driver with RT5663 I2S audio codec.
	   Say Y or m if you have such a device. This is a recommended option.
	   If unsure select "N".

config SND_SOC_INTEL_AVS_MACH_RT5682
	tristate "rt5682 in I2S mode"
	depends on I2C
	depends on MFD_INTEL_LPSS || COMPILE_TEST
	select SND_SOC_RT5682_I2C
	help
	   This adds support for ASoC machine driver with RT5682 I2S audio codec.
	   Say Y or m if you have such a device. This is a recommended option.
	   If unsure select "N".

config SND_SOC_INTEL_AVS_MACH_SSM4567
	tristate "ssm4567 I2S board"
	depends on I2C
	depends on MFD_INTEL_LPSS || COMPILE_TEST
	select SND_SOC_SSM4567
	help
	   This adds support for ASoC machine driver with SSM4567 I2S audio codec.
	   It is meant to be used with AVS driver.
	   Say Y or m if you have such a device. This is a recommended option.
	   If unsure select "N".

endmenu
```
