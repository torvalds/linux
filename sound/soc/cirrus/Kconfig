## sound/soc/cirrus/Kconfig
```kconfig
# SPDX-License-Identifier: GPL-2.0-only
menu "Cirrus Logic"

config SND_EP93XX_SOC
	tristate "SoC Audio support for the Cirrus Logic EP93xx series"
	depends on ARCH_EP93XX || COMPILE_TEST
	select SND_SOC_GENERIC_DMAENGINE_PCM
	help
	  Say Y or M if you want to add support for codecs attached to
	  the EP93xx I2S or AC97 interfaces.

config SND_EP93XX_SOC_I2S
	tristate "I2S controller support for the Cirrus Logic EP93xx series"
	depends on SND_EP93XX_SOC
	help
	  Say Y or M if you want to add support for codecs attached to
	  the EP93xx I2S interface.

if SND_EP93XX_SOC_I2S

config SND_EP93XX_SOC_I2S_WATCHDOG
	bool "IRQ based underflow watchdog workaround"
	default y
	help
	  I2S controller on EP93xx seems to have undocumented HW issue.
	  Underflow of internal I2S controller FIFO could confuse the
	  state machine and the whole stream can be shifted by one byte
	  until I2S is disabled. This option enables IRQ based watchdog
	  which disables and re-enables I2S in case of underflow and
	  fills FIFO with zeroes.

	  If you are unsure how to answer this question, answer Y.

endif # if SND_EP93XX_SOC_I2S

endmenu
```

## sound/soc/codecs/Kconfig.rej
```kconfig
--- sound/soc/codecs/Kconfig
+++ sound/soc/codecs/Kconfig
@@ -44,6 +44,7 @@
 	select SND_SOC_LM4857 if I2C
 	select SND_SOC_LM49453 if I2C
 	select SND_SOC_MAX98088 if I2C
+	select SND_SOC_MAX98090 if I2C
 	select SND_SOC_MAX98095 if I2C
 	select SND_SOC_MAX9850 if I2C
 	select SND_SOC_MAX9768 if I2C
@@ -267,6 +268,9 @@
 config SND_SOC_MAX98088
        tristate
 
+config SND_SOC_MAX98090
+       tristate
+
 config SND_SOC_MAX98095
        tristate
 
```

## sound/soc/codecs/aw87xxx/Kconfig
```kconfig
config SND_SOC_AW87XXX
	tristate "SoC Audio for awinic AW87XXX Smart K PA"
	depends on I2C
	help
	  This option enables support for AW87XXX Smart K PA.
```

## sound/soc/codecs/aw883xx/Kconfig
```kconfig
config SND_SOC_AW883XX
	tristate "SoC Audio for awinic AW883XX series Smart PA"
	depends on I2C
	help
	  This option enables support for AW883XX series Smart PA.
```

## sound/soc/davinci/Kconfig
```kconfig
config SND_DAVINCI_SOC
	tristate
	depends on ARCH_DAVINCI
	select SND_EDMA_SOC

config SND_EDMA_SOC
	tristate "SoC Audio for Texas Instruments chips using eDMA"
	depends on TI_EDMA
	select SND_SOC_GENERIC_DMAENGINE_PCM
	help
	  Say Y or M here if you want audio support for TI SoC which uses eDMA.
	  The following line of SoCs are supported by this platform driver:
	  - daVinci devices
	  - AM335x
	  - AM437x/AM438x
	  - DRA7xx family

config SND_DAVINCI_SOC_I2S
	tristate "DaVinci Multichannel Buffered Serial Port (McBSP) support"
	depends on SND_EDMA_SOC
	help
	  Say Y or M here if you want to have support for McBSP IP found in
	  Texas Instruments DaVinci DA850 SoCs.

config SND_DAVINCI_SOC_MCASP
	tristate "Multichannel Audio Serial Port (McASP) support"
	depends on SND_SDMA_SOC || SND_EDMA_SOC
	help
	  Say Y or M here if you want to have support for McASP IP found in
	  various Texas Instruments SoCs like:
	  - daVinci devices
	  - Sitara line of SoCs (AM335x, AM438x, etc)
	  - DRA7x devices

config SND_DAVINCI_SOC_VCIF
	tristate

config SND_DAVINCI_SOC_GENERIC_EVM
	tristate
	select SND_SOC_TLV320AIC3X
	select SND_DAVINCI_SOC_MCASP

config SND_AM33XX_SOC_EVM
	tristate "SoC Audio for the AM33XX chip based boards"
	depends on SND_EDMA_SOC && SOC_AM33XX && I2C
	select SND_DAVINCI_SOC_GENERIC_EVM
	help
	  Say Y or M if you want to add support for SoC audio on AM33XX
	  boards using McASP and TLV320AIC3X codec. For example AM335X-EVM,
	  AM335X-EVMSK, and BeagelBone with AudioCape boards have this
	  setup.

config SND_DAVINCI_SOC_EVM
	tristate "SoC Audio support for DaVinci DM6446, DM355 or DM365 EVM"
	depends on SND_EDMA_SOC && I2C
	depends on MACH_DAVINCI_EVM || MACH_DAVINCI_DM355_EVM || MACH_DAVINCI_DM365_EVM
	select SND_DAVINCI_SOC_GENERIC_EVM
	help
	  Say Y if you want to add support for SoC audio on TI
	  DaVinci DM6446, DM355 or DM365 EVM platforms.

choice
	prompt "DM365 codec select"
	depends on SND_DAVINCI_SOC_EVM
	depends on MACH_DAVINCI_DM365_EVM

config SND_DM365_AIC3X_CODEC
	tristate "Audio Codec - AIC3101"
	help
	  Say Y if you want to add support for AIC3101 audio codec

config SND_DM365_VOICE_CODEC
	tristate "Voice Codec - CQ93VC"
	select MFD_DAVINCI_VOICECODEC
	select SND_DAVINCI_SOC_VCIF
	select SND_SOC_CQ0093VC
	help
	  Say Y if you want to add support for SoC On-chip voice codec
endchoice

config  SND_DM6467_SOC_EVM
	tristate "SoC Audio support for DaVinci DM6467 EVM"
	depends on SND_EDMA_SOC && MACH_DAVINCI_DM6467_EVM && I2C
	select SND_DAVINCI_SOC_GENERIC_EVM
	select SND_SOC_SPDIF

	help
	  Say Y if you want to add support for SoC audio on TI

config  SND_DA830_SOC_EVM
	tristate "SoC Audio support for DA830/OMAP-L137 EVM"
	depends on SND_EDMA_SOC && MACH_DAVINCI_DA830_EVM && I2C
	select SND_DAVINCI_SOC_GENERIC_EVM

	help
	  Say Y if you want to add support for SoC audio on TI
	  DA830/OMAP-L137 EVM

config  SND_DA850_SOC_EVM
	tristate "SoC Audio support for DA850/OMAP-L138 EVM"
	depends on SND_EDMA_SOC && MACH_DAVINCI_DA850_EVM && I2C
	select SND_DAVINCI_SOC_GENERIC_EVM
	help
	  Say Y if you want to add support for SoC audio on TI
	  DA850/OMAP-L138 EVM
```

## sound/soc/dwc/Kconfig
```kconfig
config SND_DESIGNWARE_I2S
	tristate "Synopsys I2S Device Driver"
	depends on CLKDEV_LOOKUP
	select SND_SOC_GENERIC_DMAENGINE_PCM
	help
	 Say Y or M if you want to add support for I2S driver for
	 Synopsys designware I2S device. The device supports up to
	 a maximum of 8 channels each for play and record.

config SND_DESIGNWARE_PCM
	bool "PCM PIO extension for I2S driver"
	depends on SND_DESIGNWARE_I2S
	help
	 Say Y or N if you want to add a custom ALSA extension that registers
	 a PCM and uses PIO to transfer data.

	 This functionality is specially suited for I2S devices that don't have
	 DMA support.
```

## sound/soc/ep93xx/Kconfig
```kconfig
config SND_EP93XX_SOC
	tristate "SoC Audio support for the Cirrus Logic EP93xx series"
	depends on ARCH_EP93XX && SND_SOC
	help
	  Say Y or M if you want to add support for codecs attached to
	  the EP93xx I2S interface.

config SND_EP93XX_SOC_I2S
	tristate

config SND_EP93XX_SOC_SNAPPERCL15
        tristate "SoC Audio support for Bluewater Systems Snapper CL15 module"
        depends on SND_EP93XX_SOC && MACH_SNAPPER_CL15
        select SND_EP93XX_SOC_I2S
        select SND_SOC_TLV320AIC23
        help
          Say Y or M here if you want to add support for I2S audio on the
          Bluewater Systems Snapper CL15 module.
```
