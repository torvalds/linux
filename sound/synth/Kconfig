## sound/usb/Kconfig
```kconfig
# SPDX-License-Identifier: GPL-2.0-only
# ALSA USB drivers

menuconfig SND_USB
	bool "USB sound devices"
	depends on USB
	default y
	help
	  Support for sound devices connected via the USB bus.

if SND_USB && USB

config SND_USB_AUDIO
	tristate "USB Audio/MIDI driver"
	select SND_HWDEP
	select SND_RAWMIDI
	select SND_PCM
	select BITREVERSE
	select SND_USB_AUDIO_USE_MEDIA_CONTROLLER if MEDIA_CONTROLLER && (MEDIA_SUPPORT=y || MEDIA_SUPPORT=SND_USB_AUDIO)
	help
	  Say Y here to include support for USB audio and USB MIDI
	  devices.

	  To compile this driver as a module, choose M here: the module
	  will be called snd-usb-audio.

config SND_USB_AUDIO_USE_MEDIA_CONTROLLER
	bool

config SND_USB_UA101
	tristate "Edirol UA-101/UA-1000 driver"
	select SND_PCM
	select SND_RAWMIDI
	help
	  Say Y here to include support for the Edirol UA-101 and UA-1000
	  audio/MIDI interfaces.

	  To compile this driver as a module, choose M here: the module
	  will be called snd-ua101.

config SND_USB_USX2Y
	tristate "Tascam US-122, US-224 and US-428 USB driver"
	depends on X86 || PPC || ALPHA
	select SND_HWDEP
	select SND_RAWMIDI
	select SND_PCM
	help
	  Say Y here to include support for Tascam USB Audio/MIDI
	  interfaces or controllers US-122, US-224 and US-428.

	  To compile this driver as a module, choose M here: the module
	  will be called snd-usb-usx2y.

config SND_USB_CAIAQ
	tristate "Native Instruments USB audio devices"
	select SND_HWDEP
	select SND_RAWMIDI
	select SND_PCM
	help
	   Say Y here to include support for caiaq USB audio interfaces,
	   namely:

	    * Native Instruments RigKontrol2
	    * Native Instruments RigKontrol3
	    * Native Instruments Kore Controller
	    * Native Instruments Kore Controller 2
	    * Native Instruments Audio Kontrol 1
	    * Native Instruments Audio 2 DJ
	    * Native Instruments Audio 4 DJ
	    * Native Instruments Audio 8 DJ
	    * Native Instruments Traktor Audio 2
	    * Native Instruments Guitar Rig Session I/O
	    * Native Instruments Guitar Rig mobile
	    * Native Instruments Traktor Kontrol X1
	    * Native Instruments Traktor Kontrol S4
	    * Native Instruments Maschine Controller

	   To compile this driver as a module, choose M here: the module
	   will be called snd-usb-caiaq.

config SND_USB_CAIAQ_INPUT
	bool "enable input device for controllers"
	depends on SND_USB_CAIAQ
	depends on INPUT=y || INPUT=SND_USB_CAIAQ
	help
	  Say Y here to support input controllers like buttons, knobs,
	  alpha dials and analog pedals on the following products:

	   * Native Instruments RigKontrol2
	   * Native Instruments RigKontrol3
	   * Native Instruments Kore Controller
	   * Native Instruments Kore Controller 2
	   * Native Instruments Audio Kontrol 1
	   * Native Instruments Traktor Kontrol S4
	   * Native Instruments Maschine Controller

config SND_USB_US122L
	tristate "Tascam US-122L USB driver"
	depends on X86 || COMPILE_TEST
	select SND_HWDEP
	select SND_RAWMIDI
	help
	  Say Y here to include support for Tascam US-122L USB Audio/MIDI
	  interfaces.

	  To compile this driver as a module, choose M here: the module
	  will be called snd-usb-us122l.

config SND_USB_6FIRE
        tristate "TerraTec DMX 6Fire USB"
        select FW_LOADER
        select BITREVERSE
        select SND_RAWMIDI
        select SND_PCM
        select SND_VMASTER
        help
          Say Y here to include support for TerraTec 6fire DMX USB interface.

          You will need firmware files in order to be able to use the device
          after it has been coldstarted. An install script for the firmware
          and further help can be found at
          http://sixfireusb.sourceforge.net

config SND_USB_HIFACE
        tristate "M2Tech hiFace USB-SPDIF driver"
        select SND_PCM
        help
	  Select this option to include support for M2Tech hiFace USB-SPDIF
	  interface.

	  This driver supports the original M2Tech hiFace and some other
	  compatible devices. The supported products are:

	    * M2Tech Young
	    * M2Tech hiFace
	    * M2Tech North Star
	    * M2Tech W4S Young
	    * M2Tech Corrson
	    * M2Tech AUDIA
	    * M2Tech SL Audio
	    * M2Tech Empirical
	    * M2Tech Rockna
	    * M2Tech Pathos
	    * M2Tech Metronome
	    * M2Tech CAD
	    * M2Tech Audio Esclusive
	    * M2Tech Rotel
	    * M2Tech Eeaudio
	    * The Chord Company CHORD
	    * AVA Group A/S Vitus

	  To compile this driver as a module, choose M here: the module
	  will be called snd-usb-hiface.

config SND_BCD2000
	tristate "Behringer BCD2000 MIDI driver"
	select SND_RAWMIDI
	help
	  Say Y here to include MIDI support for the Behringer BCD2000 DJ
	  controller.

	  Audio support is still work-in-progress at
	  https://github.com/anyc/snd-usb-bcd2000

	  To compile this driver as a module, choose M here: the module
	  will be called snd-bcd2000.

source "sound/usb/line6/Kconfig"

endif	# SND_USB
```

## sound/usb/line6/Kconfig
```kconfig
config SND_USB_LINE6
	tristate
	select SND_RAWMIDI
	select SND_PCM

config SND_USB_POD
	tristate "Line 6 POD USB support"
	select SND_USB_LINE6
	help
	  This is a driver for PODxt and other similar devices,
	  supporting the following features:
	    * Reading/writing individual parameters
	    * Reading/writing complete channel, effects setup, and amp
	      setup data
	    * Channel switching
	    * Virtual MIDI interface
	    * Tuner access
	    * Playback/capture/mixer device for any ALSA-compatible PCM
	      audio application
	    * Signal routing (record clean/processed guitar signal,
	      re-amping)

config SND_USB_PODHD
	tristate "Line 6 POD HD300/400/500 USB support"
	select SND_USB_LINE6
	help
	  This is a driver for POD HD300, 400 and 500 devices.

config SND_USB_TONEPORT
	tristate "TonePort GX, UX1 and UX2 USB support"
	select SND_USB_LINE6
	select NEW_LEDS
	select LEDS_CLASS
	help
	  This is a driver for TonePort GX, UX1 and UX2 devices.

config SND_USB_VARIAX
	tristate "Variax Workbench USB support"
	select SND_USB_LINE6
	help
	  This is a driver for Variax Workbench device.
```

## sound/virtio/Kconfig
```kconfig
# SPDX-License-Identifier: GPL-2.0+
# Sound card driver for virtio

config SND_VIRTIO
	tristate "Virtio sound driver"
	depends on VIRTIO
	select SND_PCM
	select SND_JACK
	help
          This is the virtual sound driver for virtio. Say Y or M.
```

## sound/x86/Kconfig
```kconfig
# SPDX-License-Identifier: GPL-2.0-only
menuconfig SND_X86
	bool "X86 sound devices"
	depends on X86
	default y
	help
	  X86 sound devices that don't fall under SoC or PCI categories

if SND_X86

config HDMI_LPE_AUDIO
	tristate "HDMI audio without HDAudio on Intel Atom platforms"
	depends on DRM_I915
	select SND_PCM
	help
	 Choose this option to support HDMI LPE Audio mode

endif	# SND_X86
```

## sound/xen/Kconfig
```kconfig
# ALSA Xen drivers

config SND_XEN_FRONTEND
	tristate "Xen para-virtualized sound frontend driver"
	depends on XEN
	select SND_PCM
	select XEN_XENBUS_FRONTEND
	help
	  Choose this option if you want to enable a para-virtualized
	  frontend sound driver for Xen guest OSes.
```

## stm_iio_configs/asm330lhh_defconfig
```kconfig
CONFIG_IIO_ST_ASM330LHH=m
CONFIG_IIO_ST_ASM330LHH_I2C=m
CONFIG_IIO_ST_ASM330LHH_SPI=m
CONFIG_IIO_ST_ASM330LHH_EN_TEMPERATURE=y
CONFIG_IIO_ST_ASM330LHH_EN_BASIC_FEATURES=y
CONFIG_IIO_ST_ASM330LHH_MAY_WAKEUP=y
CONFIG_IIO_ST_ASM330LHH_EN_REGULATOR=y
```

## stm_iio_configs/asm330lhhx_defconfig
```kconfig
CONFIG_IIO_ST_ASM330LHHX=m
CONFIG_IIO_ST_ASM330LHHX_I2C=m
CONFIG_IIO_ST_ASM330LHHX_SPI=m
CONFIG_IIO_ST_ASM330LHHX_EN_BASIC_FEATURES=y
CONFIG_IIO_ST_ASM330LHHX_MLC_PRELOAD=y
```

## stm_iio_configs/h3lis331dl_defconfig
```kconfig
CONFIG_IIO_ST_H3LIS331DL=m
CONFIG_IIO_ST_H3LIS331DL_I2C=m
CONFIG_IIO_ST_H3LIS331DL_SPI=m
```

## stm_iio_configs/ilps22qs_defconfig
```kconfig
CONFIG_ST_ILPS22QS_IIO=m
CONFIG_ST_ILPS22QS_I2C_IIO=m
CONFIG_ST_ILPS22QS_SPI_IIO=m
```

## stm_iio_configs/ism303dac_defconfig
```kconfig
CONFIG_IIO_ST_ISM303DAC_ACCEL=m
CONFIG_IIO_ST_ISM303DAC_ACCEL_I2C=m
CONFIG_IIO_ST_ISM303DAC_ACCEL_SPI=m
CONFIG_ST_ISM303DAC_ACCEL_IIO_LIMIT_FIFO=0
```

## stm_iio_configs/ism330dhcx_defconfig
```kconfig
CONFIG_IIO_ST_ISM330DHCX=m
CONFIG_IIO_ST_ISM330DHCX_I2C=m
CONFIG_IIO_ST_ISM330DHCX_SPI=m
```

## stm_iio_configs/ism330dlc_defconfig
```kconfig
CONFIG_ST_ISM330DLC_IIO=m
CONFIG_ST_ISM330DLC_I2C_IIO=m
CONFIG_ST_ISM330DLC_SPI_IIO=m
CONFIG_ST_ISM330DLC_IIO_LIMIT_FIFO=0
CONFIG_ST_ISM330DLC_IIO_MASTER_SUPPORT=y
CONFIG_ST_ISM330DLC_ENABLE_INTERNAL_PULLUP=y
CONFIG_ST_ISM330DLC_IIO_EXT0_LIS2MDL=y
CONFIG_ST_ISM330DLC_XL_DATA_INJECTION=y
```

## stm_iio_configs/ism330is_defconfig
```kconfig
CONFIG_IIO_ST_ISM330IS=m
CONFIG_IIO_ST_ISM330IS_I2C=m
CONFIG_IIO_ST_ISM330IS_SPI=m
```

## stm_iio_configs/lis2du12_defconfig
```kconfig
CONFIG_IIO_ST_LIS2DU12=m
CONFIG_IIO_ST_LIS2DU12_I2C=m
CONFIG_IIO_ST_LIS2DU12_SPI=m
CONFIG_IIO_ST_LIS2DU12_I3C=m
```

## stm_iio_configs/lis2duxs12_defconfig
```kconfig
CONFIG_IIO_ST_LIS2DUXS12=m
CONFIG_IIO_ST_LIS2DUXS12_I2C=m
CONFIG_IIO_ST_LIS2DUXS12_SPI=m
CONFIG_IIO_ST_LIS2DUXS12_I3C=m
CONFIG_IIO_ST_LIS2DUXS12_QVAR=y
```

## stm_iio_configs/lis2dw12_defconfig
```kconfig
CONFIG_IIO_ST_LIS2DW12=m
CONFIG_IIO_ST_LIS2DW12_I2C=m
CONFIG_IIO_ST_LIS2DW12_SPI=m
```

## stm_iio_configs/lis2hh12_defconfig
```kconfig
CONFIG_IIO_ST_LIS2HH12=m
CONFIG_IIO_ST_LIS2HH12_I2C=m
CONFIG_IIO_ST_LIS2HH12_SPI=m
```

## stm_iio_configs/lisds12_defconfig
```kconfig
CONFIG_IIO_ST_LIS2DS12=m
CONFIG_IIO_ST_LIS2DS12_I2C=m
CONFIG_IIO_ST_LIS2DS12_SPI=m
CONFIG_ST_LIS2DS12_IIO_LIMIT_FIFO=0
```
