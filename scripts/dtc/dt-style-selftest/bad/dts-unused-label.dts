// SPDX-License-Identifier: GPL-2.0-only OR BSD-2-Clause
/*
 * Test fixture: Unused label in DTS
 */

/dts-v1/;

/ {
	soc@0 {
		compatible = "simple-bus";
		ranges = <0 0 0 0xc0000000>;

		#address-cells = <1>;
		#size-cells = <1>;

		dev: device@1000 {
			compatible = "example,test-unused-label";
			reg = <0x1000 0x100>;
		};
	};
};
