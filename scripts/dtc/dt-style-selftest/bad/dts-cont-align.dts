// SPDX-License-Identifier: GPL-2.0-only OR BSD-2-Clause
/dts-v1/;

/ {
	compatible = "example,test-board";
	#address-cells = <1>;
	#size-cells = <1>;

	interrupt-controller@10000 {
		compatible = "example,intc";
		reg = <0x10000 0x1000>;
		clocks = <1 2 3>, /* comments with " < , should not matter */
						     <4 5 6>,
				/* but comments should be placed properly */
				<7 8 9>;
		interrupts = <1 2 3>, /* comments with " < , should not ... */
				<4 5 6>,
				<7 8 9>;
		pinmux = <0x01
			 0x02>,
			<0x03
			 0x04>;
		power-domain-names = "foo",
				"bar", /* comments with " < , should not */
							"baz";
	};
};
