// SPDX-License-Identifier: GPL-2.0-only OR BSD-2-Clause
/*
 * Test fixture: a properly formatted .dts using one-tab indent.
 */

/dts-v1/;

/ {
	compatible = "example,test-board";
	#address-cells = <1>;
	#size-cells = <1>;

	bus@10000 {
		compatible = "simple-bus";
		reg = <0x10000 0x1000>;
		#address-cells = <1>;
		#size-cells = <1>;

		device@100 {
			compatible = "example,test";
			reg = <0x100 0x10>;
		};

		device@200 {
			compatible = "example,test";
			reg = <0x200 0x10>;
		};
	};
};
