## security/keys/Kconfig
```kconfig
# SPDX-License-Identifier: GPL-2.0-only
#
# Key management configuration
#

config KEYS
	bool "Enable access key retention support"
	select ASSOCIATIVE_ARRAY
	help
	  This option provides support for retaining authentication tokens and
	  access keys in the kernel.

	  It also includes provision of methods by which such keys might be
	  associated with a process so that network filesystems, encryption
	  support and the like can find them.

	  Furthermore, a special type of key is available that acts as keyring:
	  a searchable sequence of keys. Each process is equipped with access
	  to five standard keyrings: UID-specific, GID-specific, session,
	  process and thread.

	  If you are unsure as to whether this is required, answer N.

config KEYS_REQUEST_CACHE
	bool "Enable temporary caching of the last request_key() result"
	depends on KEYS
	help
	  This option causes the result of the last successful request_key()
	  call that didn't upcall to the kernel to be cached temporarily in the
	  task_struct.  The cache is cleared by exit and just prior to the
	  resumption of userspace.

	  This allows the key used for multiple step processes where each step
	  wants to request a key that is likely the same as the one requested
	  by the last step to save on the searching.

	  An example of such a process is a pathwalk through a network
	  filesystem in which each method needs to request an authentication
	  key.  Pathwalk will call multiple methods for each dentry traversed
	  (permission, d_revalidate, lookup, getxattr, getacl, ...).

config PERSISTENT_KEYRINGS
	bool "Enable register of persistent per-UID keyrings"
	depends on KEYS
	help
	  This option provides a register of persistent per-UID keyrings,
	  primarily aimed at Kerberos key storage.  The keyrings are persistent
	  in the sense that they stay around after all processes of that UID
	  have exited, not that they survive the machine being rebooted.

	  A particular keyring may be accessed by either the user whose keyring
	  it is or by a process with administrative privileges.  The active
	  LSMs gets to rule on which admin-level processes get to access the
	  cache.

	  Keyrings are created and added into the register upon demand and get
	  removed if they expire (a default timeout is set upon creation).

config BIG_KEYS
	bool "Large payload keys"
	depends on KEYS
	depends on TMPFS
	depends on CRYPTO_LIB_CHACHA20POLY1305 = y
	help
	  This option provides support for holding large keys within the kernel
	  (for example Kerberos ticket caches).  The data may be stored out to
	  swapspace by tmpfs.

	  If you are unsure as to whether this is required, answer N.

config TRUSTED_KEYS
	tristate "TRUSTED KEYS"
	depends on KEYS && TCG_TPM
	select CRYPTO
	select CRYPTO_HMAC
	select CRYPTO_SHA1
	select CRYPTO_HASH_INFO
	help
	  This option provides support for creating, sealing, and unsealing
	  keys in the kernel. Trusted keys are random number symmetric keys,
	  generated and RSA-sealed by the TPM. The TPM only unseals the keys,
	  if the boot PCRs and other criteria match.  Userspace will only ever
	  see encrypted blobs.

	  If you are unsure as to whether this is required, answer N.

config ENCRYPTED_KEYS
	tristate "ENCRYPTED KEYS"
	depends on KEYS
	select CRYPTO
	select CRYPTO_HMAC
	select CRYPTO_AES
	select CRYPTO_CBC
	select CRYPTO_SHA256
	select CRYPTO_RNG
	help
	  This option provides support for create/encrypting/decrypting keys
	  in the kernel.  Encrypted keys are kernel generated random numbers,
	  which are encrypted/decrypted with a 'master' symmetric key. The
	  'master' key can be either a trusted-key or user-key type.
	  Userspace only ever sees/stores encrypted blobs.

	  If you are unsure as to whether this is required, answer N.

config KEY_DH_OPERATIONS
       bool "Diffie-Hellman operations on retained keys"
       depends on KEYS
       select CRYPTO
       select CRYPTO_HASH
       select CRYPTO_DH
       help
	 This option provides support for calculating Diffie-Hellman
	 public keys and shared secrets using values stored as keys
	 in the kernel.

	 If you are unsure as to whether this is required, answer N.

config KEY_NOTIFICATIONS
	bool "Provide key/keyring change notifications"
	depends on KEYS && WATCH_QUEUE
	help
	  This option provides support for getting change notifications on keys
	  and keyrings on which the caller has View permission.  This makes use
	  of the /dev/watch_queue misc device to handle the notification
	  buffer and provides KEYCTL_WATCH_KEY to enable/disable watches.
```

## security/keys/trusted-keys/Kconfig
```kconfig
config HAVE_TRUSTED_KEYS
	bool

config HAVE_TRUSTED_KEYS_DEBUG
	bool

config TRUSTED_KEYS_DEBUG
	bool "Debug trusted keys"
	depends on HAVE_TRUSTED_KEYS_DEBUG
	default n
	help
	  Trusted key backends and core code that support debug traces can
	  opt-in that feature here. Traces must only use debug level output, as
	  sensitive data may pass by. In the kernel-command line traces can be
	  enabled via trusted.dyndbg='+p'.

	  SAFETY: Debug dumps are inactive at runtime until trusted.debug is set
	  to a true value on the kernel command-line. Use at your utmost
	  consideration when enabling this feature on a production build. The
	  general advice is not to do this.

config TRUSTED_KEYS_TPM
	bool "TPM-based trusted keys"
	depends on TCG_TPM >= TRUSTED_KEYS
	default y
	select HAVE_TRUSTED_KEYS_DEBUG
	select CRYPTO_HASH_INFO
	select CRYPTO_LIB_SHA1
	select CRYPTO_LIB_UTILS
	select ASN1_ENCODER
	select OID_REGISTRY
	select ASN1
	select HAVE_TRUSTED_KEYS
	help
	  Enable use of the Trusted Platform Module (TPM) as trusted key
	  backend. Trusted keys are random number symmetric keys,
	  which will be generated and RSA-sealed by the TPM.
	  The TPM only unseals the keys, if the boot PCRs and other
	  criteria match.

config TRUSTED_KEYS_TEE
	bool "TEE-based trusted keys"
	depends on TEE >= TRUSTED_KEYS
	default y
	select HAVE_TRUSTED_KEYS_DEBUG
	select HAVE_TRUSTED_KEYS
	help
	  Enable use of the Trusted Execution Environment (TEE) as trusted
	  key backend.

config TRUSTED_KEYS_CAAM
	bool "CAAM-based trusted keys"
	depends on CRYPTO_DEV_FSL_CAAM_JR >= TRUSTED_KEYS
	select CRYPTO_DEV_FSL_CAAM_BLOB_GEN
	default y
	select HAVE_TRUSTED_KEYS_DEBUG
	select HAVE_TRUSTED_KEYS
	help
	  Enable use of NXP's Cryptographic Accelerator and Assurance Module
	  (CAAM) as trusted key backend.

config TRUSTED_KEYS_DCP
	bool "DCP-based trusted keys"
	depends on CRYPTO_DEV_MXS_DCP >= TRUSTED_KEYS
	default y
	select HAVE_TRUSTED_KEYS_DEBUG
	select HAVE_TRUSTED_KEYS
	help
	  Enable use of NXP's DCP (Data Co-Processor) as trusted key backend.

config TRUSTED_KEYS_PKWM
	bool "PKWM-based trusted keys"
	depends on PSERIES_PLPKS >= TRUSTED_KEYS
	default y
	select HAVE_TRUSTED_KEYS_DEBUG
	select HAVE_TRUSTED_KEYS
	help
	  Enable use of IBM PowerVM Key Wrapping Module (PKWM) as a trusted key backend.

if !HAVE_TRUSTED_KEYS
	comment "No trust source selected!"
endif
```

## security/landlock/Kconfig
```kconfig
# SPDX-License-Identifier: GPL-2.0-only

config SECURITY_LANDLOCK
	bool "Landlock support"
	depends on SECURITY
	select SECURITY_NETWORK
	select SECURITY_PATH
	help
	  Landlock is a sandboxing mechanism that enables processes to restrict
	  themselves (and their future children) by gradually enforcing
	  tailored access control policies.  A Landlock security policy is a
	  set of access rights (e.g. open a file in read-only, make a
	  directory, etc.) tied to a file hierarchy.  Such policy can be
	  configured and enforced by any processes for themselves using the
	  dedicated system calls: landlock_create_ruleset(),
	  landlock_add_rule(), and landlock_restrict_self().

	  See Documentation/userspace-api/landlock.rst for further information.

	  If you are unsure how to answer this question, answer N.  Otherwise,
	  you should also prepend "landlock," to the content of CONFIG_LSM to
	  enable Landlock at boot time.

config SECURITY_LANDLOCK_KUNIT_TEST
	bool "KUnit tests for Landlock" if !KUNIT_ALL_TESTS
	depends on KUNIT=y
	depends on SECURITY_LANDLOCK
	default KUNIT_ALL_TESTS
	help
	  Build KUnit tests for Landlock.

	  See the KUnit documentation in Documentation/dev-tools/kunit

	  Run all KUnit tests for Landlock with:
	  ./tools/testing/kunit/kunit.py run --kunitconfig security/landlock

	  If you are unsure how to answer this question, answer N.
```

## security/loadpin/Kconfig
```kconfig
# SPDX-License-Identifier: GPL-2.0-only
config SECURITY_LOADPIN
	bool "Pin load of kernel files (modules, fw, etc) to one filesystem"
	depends on SECURITY && BLOCK
	help
	  Any files read through the kernel file reading interface
	  (kernel modules, firmware, kexec images, security policy)
	  can be pinned to the first filesystem used for loading. When
	  enabled, any files that come from other filesystems will be
	  rejected. This is best used on systems without an initrd that
	  have a root filesystem backed by a read-only device such as
	  dm-verity or a CDROM.

config SECURITY_LOADPIN_ENFORCE
	bool "Enforce LoadPin at boot"
	depends on SECURITY_LOADPIN
	# Module compression breaks LoadPin unless modules are decompressed in
	# the kernel.
	depends on !MODULE_COMPRESS || MODULE_DECOMPRESS
	help
	  If selected, LoadPin will enforce pinning at boot. If not
	  selected, it can be enabled at boot with the kernel parameter
	  "loadpin.enforce=1".

config SECURITY_LOADPIN_VERITY
	bool "Allow reading files from certain other filesystems that use dm-verity"
	depends on SECURITY_LOADPIN && DM_VERITY=y && SECURITYFS
	help
	  If selected LoadPin can allow reading files from filesystems
	  that use dm-verity. LoadPin maintains a list of verity root
	  digests it considers trusted. A verity backed filesystem is
	  considered trusted if its root digest is found in the list
	  of trusted digests.

	  The list of trusted verity can be populated through an ioctl
	  on the LoadPin securityfs entry 'dm-verity'. The ioctl
	  expects a file descriptor of a file with verity digests as
	  parameter. The file must be located on the pinned root and
	  start with the line:

	  # LOADPIN_TRUSTED_VERITY_ROOT_DIGESTS

	  This is followed by the verity digests, with one digest per
	  line.
```

## security/lockdown/Kconfig
```kconfig
config SECURITY_LOCKDOWN_LSM
	bool "Basic module for enforcing kernel lockdown"
	depends on SECURITY
	select MODULE_SIG if MODULES
	help
	  Build support for an LSM that enforces a coarse kernel lockdown
	  behaviour.

config SECURITY_LOCKDOWN_LSM_EARLY
	bool "Enable lockdown LSM early in init"
	depends on SECURITY_LOCKDOWN_LSM
	help
	  Enable the lockdown LSM early in boot. This is necessary in order
	  to ensure that lockdown enforcement can be carried out on kernel
	  boot parameters that are otherwise parsed before the security
	  subsystem is fully initialised. If enabled, lockdown will
	  unconditionally be called before any other LSMs.

choice
	prompt "Kernel default lockdown mode"
	default LOCK_DOWN_KERNEL_FORCE_NONE
	depends on SECURITY_LOCKDOWN_LSM
	help
	  The kernel can be configured to default to differing levels of
	  lockdown.

config LOCK_DOWN_KERNEL_FORCE_NONE
	bool "None"
	help
	  No lockdown functionality is enabled by default. Lockdown may be
	  enabled via the kernel commandline or /sys/kernel/security/lockdown.

config LOCK_DOWN_KERNEL_FORCE_INTEGRITY
	bool "Integrity"
	help
	 The kernel runs in integrity mode by default. Features that allow
	 the kernel to be modified at runtime are disabled.

config LOCK_DOWN_KERNEL_FORCE_CONFIDENTIALITY
	bool "Confidentiality"
	help
	 The kernel runs in confidentiality mode by default. Features that
	 allow the kernel to be modified at runtime or that permit userland
	 code to read confidential material held inside the kernel are
	 disabled.

endchoice
```

## security/medusa/Config.in
```kconfig
#
# Medusa DS9 configuration
#

mainmenu_option next_comment
comment 'Medusa DS9'

bool 'Medusa DS9 security system support' CONFIG_MEDUSA

if [ "$CONFIG_MEDUSA" = "y" ]; then
	comment 'L1, L2 (i.e. core) options'
	int	'Number of virtual spaces (VS)'	CONFIG_MEDUSA_VS 32
#      bool            'Enable file hiding (Read HELP!)'       CONFIG_MEDUSA_FILE_HIDING
	bool	'Support for POSIX file capabilities (Read HELP!)'      CONFIG_MEDUSA_FILE_CAPABILITIES
	bool	'Medusa on NFS'			CONFIG_MEDUSA_ON_NFS
#	bool	'Enable direct task switch'	CONFIG_MEDUSA_TASKSWITCH
#	bool	'Medusa debugging'		CONFIG_MEDUSA_DEBUG
	if [ "$CONFIG_X86" = "y" ]; then
		bool 'Enable syscall trace'	CONFIG_MEDUSA_SYSCALL
		bool 'Enable code execution forcing' CONFIG_MEDUSA_FORCE
	fi
	#dep_tristate 'Enable userspace memory access' CONFIG_MEDUSA_MEMKOBJECT
	bool 'Enable userspace memory access' CONFIG_MEDUSA_MEMKOBJECT
	comment 'L3 options'
	bool	'Quiet Medusa' CONFIG_MEDUSA_QUIET
#	mainmenu_option next_comment
	comment 'L4 authorization servers'
	dep_tristate 'Userspace auth. server (/dev/medusa)' CONFIG_MEDUSA_CONSTABLE $CONFIG_MEDUSA
	if [ "$CONFIG_MEDUSA_CONSTABLE" = "y" ]; then
		bool 'Start Constable at boot time (Read HELP!)' CONFIG_MEDUSA_INIT_WRAPPER
	fi
	if [ "$CONFIG_MEDUSA_CONSTABLE" != "n" ]; then
	choice 'Action on exit of the authorization server' \
		"Ignore         CONFIG_MEDUSA_NONE \
		Reboot          CONFIG_MEDUSA_REBOOT \
		Halt            CONFIG_MEDUSA_HALT" Ignore
	fi
#	endmenu
fi
endmenu
```

## security/medusa/Kconfig
```kconfig
config SECURITY_MEDUSA
	bool "MEDUSA Support"
	depends on SECURITY
	select NETWORK_SECMARK
	default n
	help
	  This selects MEDUSA LSM.

config SECURITY_MEDUSA_L4_CONSTABLE
        tristate "MEDUSA L4 as MODULE"
        depends on SECURITY_MEDUSA
        default y
        help
          Compiles l4 on medusa as module. Good for debug purposes.
          
          If unsure do not touch.
```

## security/optee_linuxdriver/Kconfig
```kconfig
#
# Copyright (c) 2014, STMicroelectronics International N.V.
#
# This program is free software; you can redistribute it and/or modify
# it under the terms of the GNU General Public License Version 2 as
# published by the Free Software Foundation.
#
# This program is distributed in the hope that it will be useful,
# but WITHOUT ANY WARRANTY; without even the implied warranty of
# MERCHANTABILITY or FITNESS FOR A PARTICULAR PURPOSE. See the
# GNU General Public License for more details.
#

# Trursted Execution Environment Configuration
config TEE_SUPPORT
	bool "Trusted Execution Environment Support"
	default n
	help
	  This implements the Trusted Execution Environment (TEE) Client
	  API Specification from GlobalPlatform Device Technology.
```

## security/safesetid/Kconfig
```kconfig
# SPDX-License-Identifier: GPL-2.0-only
config SECURITY_SAFESETID
        bool "Gate setid transitions to limit CAP_SET{U/G}ID capabilities"
        depends on SECURITY
        select SECURITYFS
        default n
        help
          SafeSetID is an LSM module that gates the setid family of syscalls to
          restrict UID/GID transitions from a given UID/GID to only those
          approved by a system-wide whitelist. These restrictions also prohibit
          the given UIDs/GIDs from obtaining auxiliary privileges associated
          with CAP_SET{U/G}ID, such as allowing a user to set up user namespace
          UID mappings.

          If you are unsure how to answer this question, answer N.
```
