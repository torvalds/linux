## scripts/kconfig/tests/err_transitional/Kconfig
```kconfig
# SPDX-License-Identifier: GPL-2.0
# Test that transitional symbols cannot have properties other than help

config BAD_DEFAULT
	bool
	transitional
	default y
	help
	  This transitional symbol illegally has a default property.

config BAD_PROMPT
	bool
	transitional
	prompt "Bad prompt"
	help
	  This transitional symbol illegally has a prompt.

config BAD_SELECT
	bool
	transitional
	select OTHER_SYMBOL
	help
	  This transitional symbol illegally has a select.

config BAD_IMPLY
	bool
	transitional
	imply OTHER_SYMBOL
	help
	  This transitional symbol illegally has an imply.

config BAD_DEPENDS
	bool
	transitional
	depends on OTHER_SYMBOL
	help
	  This transitional symbol illegally has a depends.

config BAD_RANGE
	int
	transitional
	range 1 10
	help
	  This transitional symbol illegally has a range.

config BAD_NO_TYPE
	transitional
	help
	  This transitional symbol illegally has no type specified.

config OTHER_SYMBOL
	bool
```

## scripts/kconfig/tests/inter_choice/Kconfig
```kconfig
# SPDX-License-Identifier: GPL-2.0

config MODULES
	def_bool y
	modules

choice
	prompt "Choice"

config CHOICE_VAL0
	tristate "Choice 0"

config CHOIVE_VAL1
	tristate "Choice 1"

endchoice

choice
	prompt "Another choice"
	depends on CHOICE_VAL0

config DUMMY
	bool "dummy"

endchoice
```

## scripts/kconfig/tests/new_choice_with_dep/Kconfig
```kconfig
config A
	bool "A"
	help
	  This is a new symbol.

choice
	prompt "Choice ?"
	depends on A
	help
	  "depends on A" has been newly added.

config CHOICE_B
	bool "Choice B"

config CHOICE_C
	bool "Choice C"
	help
	  This is a new symbol, so should be asked.

endchoice

choice
	prompt "Choice2 ?"

config CHOICE_D
	bool "Choice D"

config CHOICE_E
	bool "Choice E"

config CHOICE_F
	bool "Choice F"
	depends on A
	help
	  This is a new symbol, so should be asked.

endchoice
```

## scripts/kconfig/tests/no_write_if_dep_unmet/Kconfig
```kconfig
# SPDX-License-Identifier: GPL-2.0

config A
	bool "A"

choice
	prompt "Choice ?"
	depends on A

config CHOICE_B
	bool "Choice B"

config CHOICE_C
	bool "Choice C"

endchoice
```
