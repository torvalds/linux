## net/hsr/Kconfig
```kconfig
# SPDX-License-Identifier: GPL-2.0-only
#
# IEC 62439-3 High-availability Seamless Redundancy
#

config HSR
	tristate "High-availability Seamless Redundancy (HSR & PRP)"
	help
	  This enables IEC 62439 defined High-availability Seamless
	  Redundancy (HSR) and Parallel Redundancy Protocol (PRP).

	  If you say Y here, then your Linux box will be able to act as a
	  DANH ("Doubly attached node implementing HSR") or DANP ("Doubly
	  attached node implementing PRP"). For this to work, your Linux box
	  needs (at least) two physical Ethernet interfaces.

	  For DANH, it must be connected as a node in a ring network together
	  with other HSR capable nodes. All Ethernet frames sent over the HSR
	  device will be sent in both directions on the ring (over both slave
	  ports), giving a redundant, instant fail-over network. Each HSR node
	  in the ring acts like a bridge for HSR frames, but filters frames
	  that have been forwarded earlier.

	  For DANP, it must be connected as a node connecting to two
	  separate networks over the two slave interfaces. Like HSR, Ethernet
	  frames sent over the PRP device will be sent to both networks giving
	  a redundant, instant fail-over network. Unlike HSR, PRP networks
	  can have Singly Attached Nodes (SAN) such as PC, printer, bridges
	  etc and will be able to communicate with DANP nodes.

	  This code is a "best effort" to comply with the HSR standard as
	  described in IEC 62439-3:2010 (HSRv0) and IEC 62439-3:2012 (HSRv1),
	  and PRP standard described in IEC 62439-4:2012 (PRP), but no
	  compliancy tests have been made. Use iproute2 to select the protocol
	  you would like to use.

	  You need to perform any and all necessary tests yourself before
	  relying on this code in a safety critical system!

	  If unsure, say N.
```

## net/ieee80211/Kconfig
```kconfig
config IEEE80211
	tristate
	select WIRELESS_EXT
	select CRYPTO
	select CRYPTO_ARC4
	select CRYPTO_ECB
	select CRYPTO_AES
	select CRYPTO_MICHAEL_MIC
	select CRYPTO_ECB
	select CRC32
	select IEEE80211_CRYPT_WEP
	select IEEE80211_CRYPT_TKIP
	select IEEE80211_CRYPT_CCMP
	---help---
	This option enables the hardware independent IEEE 802.11
	networking stack.  This component is deprecated in favor of the
	mac80211 component.

config IEEE80211_DEBUG
	bool "Full debugging output for the old IEEE80211 stack"
	depends on IEEE80211
	---help---
	  This option will enable debug tracing output for the
	  ieee80211 network stack.

	  This will result in the kernel module being ~70k larger.  You
	  can control which debug output is sent to the kernel log by
	  setting the value in

	  /proc/net/ieee80211/debug_level

	  For example:

	  % echo 0x00000FFO > /proc/net/ieee80211/debug_level

	  For a list of values you can assign to debug_level, you
	  can look at the bit mask values in <net/ieee80211.h>

	  If you are not trying to debug or develop the ieee80211
	  subsystem, you most likely want to say N here.

config IEEE80211_CRYPT_WEP
	tristate

config IEEE80211_CRYPT_CCMP
	tristate

config IEEE80211_CRYPT_TKIP
	tristate
```

## net/ieee80211/softmac/Kconfig
```kconfig
config IEEE80211_SOFTMAC
	tristate "Software MAC add-on to the IEEE 802.11 networking stack"
	depends on IEEE80211 && EXPERIMENTAL
	select WIRELESS_EXT
	---help---
	This option enables the hardware independent software MAC addon
	for the IEEE 802.11 networking stack.

config IEEE80211_SOFTMAC_DEBUG
	bool "Enable full debugging output"
	depends on IEEE80211_SOFTMAC
```

## net/ieee802154/6lowpan/Kconfig
```kconfig
config IEEE802154_6LOWPAN
	tristate "6lowpan support over IEEE 802.15.4"
	depends on 6LOWPAN
	---help---
	  IPv6 compression over IEEE 802.15.4.
```

## net/ieee802154/Kconfig
```kconfig
menuconfig IEEE802154
	tristate "IEEE Std 802.15.4 Low-Rate Wireless Personal Area Networks support"
	---help---
	  IEEE Std 802.15.4 defines a low data rate, low power and low
	  complexity short range wireless personal area networks. It was
	  designed to organise networks of sensors, switches, etc automation
	  devices. Maximum allowed data rate is 250 kb/s and typical personal
	  operating space around 10m.

	  Say Y here to compile LR-WPAN support into the kernel or say M to
	  compile it as modules.

if IEEE802154

config IEEE802154_NL802154_EXPERIMENTAL
	bool "IEEE 802.15.4 experimental netlink support"
	---help---
	  Adds experimental netlink support for nl802154.

config IEEE802154_SOCKET
	tristate "IEEE 802.15.4 socket interface"
	default y
	---help---
	  Socket interface for IEEE 802.15.4. Contains DGRAM sockets interface
	  for 802.15.4 dataframes. Also RAW socket interface to build MAC
	  header from userspace.

source "net/ieee802154/6lowpan/Kconfig"

endif
```

## net/ife/Kconfig
```kconfig
#
# IFE subsystem configuration
#

menuconfig NET_IFE
	depends on NET
        tristate "Inter-FE based on IETF ForCES InterFE LFB"
	default n
	help
	  Say Y here to add support of IFE encapsulation protocol
	  For details refer to netdev01 paper:
	  "Distributing Linux Traffic Control Classifier-Action Subsystem"
	   Authors: Jamal Hadi Salim and Damascene M. Joachimpillai

	  To compile this support as a module, choose M here: the module will
	  be called ife.
```
