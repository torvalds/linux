## net/nfc/nci/Kconfig
```kconfig
config NFC_NCI
	depends on NFC
	tristate "NCI protocol support"
	default n
	help
	  NCI (NFC Controller Interface) is a communication protocol between
	  an NFC Controller (NFCC) and a Device Host (DH).

	  Say Y here to compile NCI support into the kernel or say M to
	  compile it as module (nci).

config NFC_NCI_SPI
	depends on NFC_NCI && SPI
	select CRC_CCITT
	tristate "NCI over SPI protocol support"
	default n
	help
	  NCI (NFC Controller Interface) is a communication protocol between
	  an NFC Controller (NFCC) and a Device Host (DH).

	  Say yes if you use an NCI driver that requires SPI link layer.

config NFC_NCI_UART
	depends on NFC_NCI && TTY
	tristate "NCI over UART protocol support"
	default n
	help
	  Say yes if you use an NCI driver that requires UART link layer.
```

## net/nsh/Kconfig
```kconfig
# SPDX-License-Identifier: GPL-2.0-only
menuconfig NET_NSH
	tristate "Network Service Header (NSH) protocol"
	default n
	---help---
	  Network Service Header is an implementation of Service Function
	  Chaining (RFC 7665). The current implementation in Linux supports
	  only MD type 1 and only with the openvswitch module.

	  If unsure, say N.
```

## net/openvswitch/Kconfig
```kconfig
# SPDX-License-Identifier: GPL-2.0-only
#
# Open vSwitch
#

config OPENVSWITCH
	tristate "Open vSwitch"
	depends on INET
	depends on !NF_CONNTRACK || \
		   (NF_CONNTRACK && ((!NF_DEFRAG_IPV6 || NF_DEFRAG_IPV6) && \
				     (!NF_NAT || NF_NAT) && \
				     (!NETFILTER_CONNCOUNT || NETFILTER_CONNCOUNT)))
	select LIBCRC32C
	select MPLS
	select NET_MPLS_GSO
	select DST_CACHE
	select NET_NSH
	select NF_CONNTRACK_OVS if NF_CONNTRACK
	select NF_NAT_OVS if NF_NAT
	help
	  Open vSwitch is a multilayer Ethernet switch targeted at virtualized
	  environments.  In addition to supporting a variety of features
	  expected in a traditional hardware switch, it enables fine-grained
	  programmatic extension and flow-based control of the network.  This
	  control is useful in a wide variety of applications but is
	  particularly important in multi-server virtualization deployments,
	  which are often characterized by highly dynamic endpoints and the
	  need to maintain logical abstractions for multiple tenants.

	  The Open vSwitch datapath provides an in-kernel fast path for packet
	  forwarding.  It is complemented by a userspace daemon, ovs-vswitchd,
	  which is able to accept configuration from a variety of sources and
	  translate it into packet processing rules.

	  See http://openvswitch.org for more information and userspace
	  utilities.

	  To compile this code as a module, choose M here: the module will be
	  called openvswitch.

	  If unsure, say N.

config OPENVSWITCH_GRE
	tristate "Open vSwitch GRE tunneling support"
	depends on OPENVSWITCH
	depends on NET_IPGRE
	default OPENVSWITCH
	help
	  If you say Y here, then the Open vSwitch will be able create GRE
	  vport.

	  Say N to exclude this support and reduce the binary size.

	  If unsure, say Y.

config OPENVSWITCH_VXLAN
	tristate "Open vSwitch VXLAN tunneling support"
	depends on OPENVSWITCH
	depends on VXLAN
	default OPENVSWITCH
	help
	  If you say Y here, then the Open vSwitch will be able create vxlan vport.

	  Say N to exclude this support and reduce the binary size.

	  If unsure, say Y.

config OPENVSWITCH_GENEVE
	tristate "Open vSwitch Geneve tunneling support"
	depends on OPENVSWITCH
	depends on GENEVE
	default OPENVSWITCH
	help
	  If you say Y here, then the Open vSwitch will be able create geneve vport.

	  Say N to exclude this support and reduce the binary size.
```

## net/packet/Kconfig
```kconfig
#
# Packet configuration
#

config PACKET
	tristate "Packet socket"
	---help---
	  The Packet protocol is used by applications which communicate
	  directly with network devices without an intermediate network
	  protocol implemented in the kernel, e.g. tcpdump.  If you want them
	  to work, choose Y.

	  To compile this driver as a module, choose M here: the module will
	  be called af_packet.

	  If unsure, say Y.

config PACKET_DIAG
	tristate "Packet: sockets monitoring interface"
	depends on PACKET
	default n
	---help---
	  Support for PF_PACKET sockets monitoring interface used by the ss tool.
	  If unsure, say Y.
```

## net/phonet/Kconfig
```kconfig
# SPDX-License-Identifier: GPL-2.0-only
#
# Phonet protocol
#

config PHONET
	tristate "Phonet protocols family"
	help
	  The Phone Network protocol (PhoNet) is a packet-oriented
	  communication protocol developed by Nokia for use with its modems.

	  This is required for Maemo to use cellular data connectivity (if
	  supported). It can also be used to control Nokia phones
	  from a Linux computer, although AT commands may be easier to use.

	  To compile this driver as a module, choose M here: the module
	  will be called phonet. If unsure, say N.
```

## net/psample/Kconfig
```kconfig
# SPDX-License-Identifier: GPL-2.0-only
#
# psample packet sampling configuration
#

menuconfig PSAMPLE
	tristate "Packet-sampling netlink channel"
	default n
	help
	  Say Y here to add support for packet-sampling netlink channel
	  This netlink channel allows transferring packets alongside some
	  metadata to userspace.

	  To compile this support as a module, choose M here: the module will
	  be called psample.
```

## net/psp/Kconfig
```kconfig
# SPDX-License-Identifier: GPL-2.0-only
#
# PSP configuration
#
config INET_PSP
	bool "PSP Security Protocol support"
	depends on INET
	select SKB_DECRYPTED
	select SOCK_VALIDATE_XMIT
	help
	Enable kernel support for the PSP Security Protocol (PSP).
	For more information see:
	  https://raw.githubusercontent.com/google/psp/main/doc/PSP_Arch_Spec.pdf

	If unsure, say N.
```

## net/qmsgq/Kconfig
```kconfig
# SPDX-License-Identifier: GPL-2.0-only
# QTI Message Queue Socket configuration
#

config QMSGQ
	tristate "QTI Message Queue Socket"
	select VSOCKETS
	help
	  Say Y if you intend to use QTI Message Queue Socket protocol. The
	  protocol is used to communicate with baremetal VM and platforms
	  that use the Gunyah Hypervisor. This protocol will mimic the vsock
	  address space with cid and port id but allow for guest to guest
	  communication.

if QMSGQ

config QMSGQ_GUNYAH
	tristate "QTI Message Queue Socket Gunyah Transport"
	depends on GH_MSGQ
	depends on QMSGQ
	help
	  Say Y here to support Gunyah Message Queue based transport for the
	  QMSGQ Socket Transport. This transport is intended to facilitate
	  Guest to Guest communication on the Gunyah Hypervisor. This transport
	  supports Datagram and Seqpacket operations.

endif # QMSGQ
```

## net/qrtr/Kconfig
```kconfig
# SPDX-License-Identifier: GPL-2.0-only
# Qualcomm IPC Router configuration
#

config QRTR
	tristate "Qualcomm IPC Router support"
	help
	  Say Y if you intend to use Qualcomm IPC router protocol.  The
	  protocol is used to communicate with services provided by other
	  hardware blocks in the system.

	  In order to do service lookups, a userspace daemon is required to
	  maintain a service listing.

if QRTR

config QRTR_NODE_ID
	int "QRTR Local Node ID"
	default 1
	help
	  This option is used to configure the QRTR Node ID for the local
	  processor. The node ID published to other nodes within the system.
	  This value can be overridden by the name service application. This
	  option is for configurations where Node ID needs to be customized
	  but the name service application is not priveleged enough to use
	  netlink sockets.

config QRTR_WAKEUP_MS
	int "QRTR Wakeup timeout"
	default 0
	help
	  This option is used to configure the wakesource timeout that QRTR
	  should take when a packet is received. The qrtr driver can guarantee
	  that the packet gets queued to the socket but cannot guarantee the
	  client process will get time to run if auto sleep is enabled. This
	  config will help mitigate missed packets on systems where auto sleep
	  is aggressive.

config QRTR_SMD
	tristate "SMD IPC Router channels"
	depends on RPMSG || (COMPILE_TEST && RPMSG=n)
	help
	  Say Y here to support SMD based ipcrouter channels.  SMD is the
	  most common transport for IPC Router.

config QRTR_TUN
	tristate "TUN device for Qualcomm IPC Router"
	help
	  Say Y here to expose a character device that allows user space to
	  implement endpoints of QRTR, for purpose of tunneling data to other
	  hosts or testing purposes.

config QRTR_MHI
	tristate "MHI IPC Router channels"
	depends on MHI_BUS
	help
	  Say Y here to support MHI based ipcrouter channels. MHI is the
	  transport used for communicating to external modems.

config QRTR_GUNYAH
	tristate "Gunyah IPC Router channels"
	help
	  Say Y here to support a fifo based ipcrouter channel with gunyah
	  hypervisor signaling. The gunyah transport layer enables IPC
	  Router communication between two virtual machines. The transport
	  uses dynamically shared memory and gunyah doorbells.

config QRTR_GENPOOL
	tristate "Genpool FIFO IPC Router channels"
	help
	  Say Y here to support a fifo based ipcrouter channel with genpool and
	  IPCC signaling. The genpool fifo transport layer enables IPC Router
	  communication between two endpoints. The transport utilizes a reserved
	  memory created and owned by another device, which is shared through
	  the genpool framework.

endif # QRTR
```

## net/rds/Kconfig
```kconfig
config RDS
	tristate "The Reliable Datagram Sockets Protocol"
	depends on INET
	---help---
	  The RDS (Reliable Datagram Sockets) protocol provides reliable,
	  sequenced delivery of datagrams over Infiniband or TCP.

config RDS_RDMA
	tristate "RDS over Infiniband"
	depends on RDS && INFINIBAND && INFINIBAND_ADDR_TRANS
	---help---
	  Allow RDS to use Infiniband as a transport.
	  This transport supports RDMA operations.

config RDS_TCP
	tristate "RDS over TCP"
	depends on RDS
	depends on IPV6 || !IPV6
	---help---
	  Allow RDS to use TCP as a transport.
	  This transport does not support RDMA operations.

config RDS_DEBUG
        bool "RDS debugging messages"
	depends on RDS
        default n
```

## net/rfkill/Kconfig
```kconfig
#
# RF switch subsystem configuration
#
menuconfig RFKILL
	tristate "RF switch subsystem support"
	help
	  Say Y here if you want to have control over RF switches
	  found on many WiFi and Bluetooth cards.

	  To compile this driver as a module, choose M here: the
	  module will be called rfkill.

# LED trigger support
config RFKILL_LEDS
	bool
	depends on RFKILL
	depends on LEDS_TRIGGERS = y || RFKILL = LEDS_TRIGGERS
	default y

config RFKILL_INPUT
	bool "RF switch input support" if EXPERT
	depends on RFKILL
	depends on INPUT = y || RFKILL = INPUT
	default y if !EXPERT

config RFKILL_GPIO
	tristate "GPIO RFKILL driver"
	depends on RFKILL
	depends on GPIOLIB || COMPILE_TEST
	default n
	help
	  If you say yes here you get support of a generic gpio RFKILL
	  driver.

config RFKILL_RK
	tristate "Rockchip RFKILL driver"
	depends on RFKILL
	depends on MMC
	depends on ARCH_ROCKCHIP
	default y
	help
	  Rockchip rfkill driver for rk29/rk3X
```

## net/rxrpc/Kconfig
```kconfig
# SPDX-License-Identifier: GPL-2.0-only
#
# RxRPC session sockets
#

config AF_RXRPC
	tristate "RxRPC session sockets"
	depends on INET
	select CRYPTO
	select KEYS
	select NET_UDP_TUNNEL
	help
	  Say Y or M here to include support for RxRPC session sockets (just
	  the transport part, not the presentation part: (un)marshalling is
	  left to the application).

	  These are used for AFS kernel filesystem and userspace utilities.

	  This module at the moment only supports client operations and is
	  currently incomplete.

	  See Documentation/networking/rxrpc.rst.

if AF_RXRPC

config AF_RXRPC_IPV6
	bool "IPv6 support for RxRPC"
	depends on (IPV6 = m && AF_RXRPC = m) || (IPV6 = y && AF_RXRPC)
	help
	  Say Y here to allow AF_RXRPC to use IPV6 UDP as well as IPV4 UDP as
	  its network transport.

config AF_RXRPC_INJECT_LOSS
	bool "Inject packet loss into RxRPC packet stream"
	help
	  Say Y here to inject packet loss by discarding some received and some
	  transmitted packets.

config AF_RXRPC_INJECT_RX_DELAY
	bool "Inject delay into packet reception"
	depends on SYSCTL
	help
	  Say Y here to inject a delay into packet reception, allowing an
	  extended RTT time to be modelled.  The delay can be configured using
	  /proc/sys/net/rxrpc/rxrpc_inject_rx_delay, setting a number of
	  milliseconds up to 0.5s (note that the granularity is actually in
	  jiffies).

config AF_RXRPC_DEBUG
	bool "RxRPC dynamic debugging"
	help
	  Say Y here to make runtime controllable debugging messages appear.

	  See Documentation/networking/rxrpc.rst.


config RXKAD
	bool "RxRPC Kerberos security"
	select CRYPTO
	select CRYPTO_MANAGER
	select CRYPTO_SKCIPHER
	select CRYPTO_PCBC
	select CRYPTO_FCRYPT
	help
	  Provide kerberos 4 and AFS kaserver security handling for AF_RXRPC
	  through the use of the key retention service.

	  See Documentation/networking/rxrpc.rst.

config RXGK
	bool "RxRPC GSSAPI security"
	select CRYPTO_KRB5
	select CRYPTO_MANAGER
	select CRYPTO_KRB5ENC
	select CRYPTO_AUTHENC
	select CRYPTO_SKCIPHER
	select CRYPTO_HASH_INFO
	select CRYPTO_HMAC
	select CRYPTO_CMAC
	select CRYPTO_SHA1
	select CRYPTO_SHA256
	select CRYPTO_SHA512
	select CRYPTO_CBC
	select CRYPTO_CTS
	select CRYPTO_AES
	select CRYPTO_CAMELLIA
	help
	  Provide the GSSAPI-based RxGK security class for AFS.  Keys are added
	  with add_key().

	  See Documentation/networking/rxrpc.rst.

config RXPERF
	tristate "RxRPC test service"
	help
	  Provide an rxperf service tester.  This listens on UDP port 7009 for
	  incoming calls from the rxperf program (an example of which can be
	  found in OpenAFS).

endif
```
