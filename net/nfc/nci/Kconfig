## net/sctp/Kconfig
```kconfig
# SPDX-License-Identifier: GPL-2.0-only
#
# SCTP configuration
#

menuconfig IP_SCTP
	tristate "The SCTP Protocol"
	depends on INET
	depends on IPV6 || IPV6=n
	select CRYPTO_LIB_SHA1
	select CRYPTO_LIB_SHA256
	select CRYPTO_LIB_UTILS
	select NET_CRC32C
	select NET_UDP_TUNNEL
	help
	  Stream Control Transmission Protocol

	  From RFC 2960 <http://www.ietf.org/rfc/rfc2960.txt>.

	  "SCTP is a reliable transport protocol operating on top of a
	  connectionless packet network such as IP.  It offers the following
	  services to its users:

	  -- acknowledged error-free non-duplicated transfer of user data,
	  -- data fragmentation to conform to discovered path MTU size,
	  -- sequenced delivery of user messages within multiple streams,
	  with an option for order-of-arrival delivery of individual user
	  messages,
	  -- optional bundling of multiple user messages into a single SCTP
	  packet, and
	  -- network-level fault tolerance through supporting of multi-
	  homing at either or both ends of an association."

	  To compile this protocol support as a module, choose M here: the
	  module will be called sctp. Debug messages are handled by the
	  kernel's dynamic debugging framework.

	  If in doubt, say N.

if IP_SCTP

config SCTP_DBG_OBJCNT
	bool "SCTP: Debug object counts"
	depends on PROC_FS
	help
	  If you say Y, this will enable debugging support for counting the
	  type of objects that are currently allocated.  This is useful for
	  identifying memory leaks. This debug information can be viewed by
	  'cat /proc/net/sctp/sctp_dbg_objcnt'

	  If unsure, say N

choice
	prompt "Default SCTP cookie authentication method"
	default SCTP_DEFAULT_COOKIE_HMAC_SHA256
	help
	  This option sets the default SCTP cookie authentication method, for
	  when a method hasn't been explicitly selected via the
	  net.sctp.cookie_hmac_alg sysctl.

	  If unsure, choose the default (HMAC-SHA256).

config SCTP_DEFAULT_COOKIE_HMAC_SHA256
	bool "HMAC-SHA256"

config SCTP_DEFAULT_COOKIE_HMAC_NONE
	bool "None"

endchoice

config INET_SCTP_DIAG
	depends on INET_DIAG
	def_tristate INET_DIAG


endif # IP_SCTP
```

## net/smc/Kconfig
```kconfig
# SPDX-License-Identifier: GPL-2.0-only
config SMC
	tristate "SMC socket protocol family"
	depends on INET && INFINIBAND && DIBS
	help
	  SMC-R provides a "sockets over RDMA" solution making use of
	  RDMA over Converged Ethernet (RoCE) technology to upgrade
	  AF_INET TCP connections transparently.
	  The Linux implementation of the SMC-R solution is designed as
	  a separate socket family SMC.

	  Select this option if you want to run SMC socket applications

config SMC_DIAG
	tristate "SMC: socket monitoring interface"
	depends on SMC
	help
	  Support for SMC socket monitoring interface used by tools such as
	  smcss.

	  if unsure, say Y.

config SMC_HS_CTRL_BPF
	bool "Generic eBPF hook for SMC handshake flow"
	depends on SMC && BPF_JIT && BPF_SYSCALL
	default y
	help
	  SMC_HS_CTRL_BPF enables support to register generic eBPF hook for SMC
	  handshake flow, which offer much greater flexibility in modifying the behavior
	  of the SMC protocol stack compared to a complete kernel-based approach. Select
	  this option if you want filtring the handshake process via eBPF programs.
```

## net/sunrpc/Kconfig
```kconfig
# SPDX-License-Identifier: GPL-2.0-only
config SUNRPC
	tristate
	depends on MULTIUSER

config SUNRPC_GSS
	tristate
	select OID_REGISTRY
	depends on MULTIUSER

config SUNRPC_BACKCHANNEL
	bool
	depends on SUNRPC

config SUNRPC_SWAP
	bool
	depends on SUNRPC

config RPCSEC_GSS_KRB5
	tristate "Secure RPC: Kerberos V mechanism"
	depends on SUNRPC && CRYPTO
	default y
	select SUNRPC_GSS
	select CRYPTO_KRB5
	help
	  Choose Y here to enable Secure RPC using the Kerberos version 5
	  GSS-API mechanism (RFC 1964).

	  Secure RPC calls with Kerberos require an auxiliary user-space
	  daemon which may be found in the Linux nfs-utils package
	  available from http://linux-nfs.org/.  In addition, user-space
	  Kerberos support should be installed.

	  If unsure, say Y.

config SUNRPC_DEBUG
	bool "RPC: Enable dprintk debugging"
	depends on SUNRPC && SYSCTL
	select DEBUG_FS
	help
	  This option enables a sysctl-based debugging interface
	  that is be used by the 'rpcdebug' utility to turn on or off
	  logging of different aspects of the kernel RPC activity.

	  Disabling this option will make your kernel slightly smaller,
	  but makes troubleshooting NFS issues significantly harder.

	  If unsure, say Y.

config SUNRPC_DEBUG_TRACE
	bool "RPC: Send dfprintk() output to the trace buffer"
	depends on SUNRPC_DEBUG && TRACING
	default n
	help
          dprintk() output can be voluminous, which can overwhelm the
          kernel's logging facility as it must be sent to the console.
          This option causes dprintk() output to go to the trace buffer
          instead of the kernel log.

          This will cause warnings about trace_printk() being used to be
          logged at boot time, so say N unless you are debugging a problem
          with sunrpc-based clients or services.

config SUNRPC_XPRT_RDMA
	tristate "RPC-over-RDMA transport"
	depends on SUNRPC && INFINIBAND && INFINIBAND_ADDR_TRANS
	default SUNRPC && INFINIBAND
	select SG_POOL
	help
	  This option allows the NFS client and server to use RDMA
	  transports (InfiniBand, iWARP, or RoCE).

	  To compile this support as a module, choose M. The module
	  will be called rpcrdma.ko.

	  If unsure, or you know there is no RDMA capability on your
	  hardware platform, say N.
```

## net/switchdev/Kconfig
```kconfig
# SPDX-License-Identifier: GPL-2.0-only
#
# Configuration for Switch device support
#

config NET_SWITCHDEV
	bool "Switch (and switch-ish) device support"
	depends on INET
	help
	  This module provides glue between core networking code and device
	  drivers in order to support hardware switch chips in very generic
	  meaning of the word "switch". This include devices supporting L2/L3 but
	  also various flow offloading chips, including switches embedded into
	  SR-IOV NICs.
```

## net/tipc/Kconfig
```kconfig
# SPDX-License-Identifier: GPL-2.0-only
#
# TIPC configuration
#

menuconfig TIPC
	tristate "The TIPC Protocol"
	depends on INET
	---help---
	  The Transparent Inter Process Communication (TIPC) protocol is
	  specially designed for intra cluster communication. This protocol
	  originates from Ericsson where it has been used in carrier grade
	  cluster applications for many years.

	  For more information about TIPC, see http://tipc.sourceforge.net.

	  This protocol support is also available as a module ( = code which
	  can be inserted in and removed from the running kernel whenever you
	  want). The module will be called tipc. If you want to compile it
	  as a module, say M here and read <file:Documentation/kbuild/modules.rst>.

	  If in doubt, say N.

config TIPC_MEDIA_IB
	bool "InfiniBand media type support"
	depends on TIPC && INFINIBAND_IPOIB
	help
	  Saying Y here will enable support for running TIPC on
	  IP-over-InfiniBand devices.
config TIPC_MEDIA_UDP
	bool "IP/UDP media type support"
	depends on TIPC
	select NET_UDP_TUNNEL
	help
	  Saying Y here will enable support for running TIPC over IP/UDP
	bool
	default y
config TIPC_CRYPTO
	bool "TIPC encryption support"
	depends on TIPC
	select CRYPTO
	select CRYPTO_AES
	select CRYPTO_GCM
	help
	  Saying Y here will enable support for TIPC encryption.
	  All TIPC messages will be encrypted/decrypted by using the currently most
	  advanced algorithm: AEAD AES-GCM (like IPSec or TLS) before leaving/
	  entering the TIPC stack.
	  Key setting from user-space is performed via netlink by a user program
	  (e.g. the iproute2 'tipc' tool).
	bool
	default y

config TIPC_DIAG
	tristate "TIPC: socket monitoring interface"
	depends on TIPC
	default y
	---help---
	Support for TIPC socket monitoring interface used by ss tool.
	If unsure, say Y.
```

## net/tls/Kconfig
```kconfig
# SPDX-License-Identifier: GPL-2.0-only
#
# TLS configuration
#
config TLS
	tristate "Transport Layer Security support"
	depends on INET
	select CRYPTO
	select CRYPTO_AES
	select CRYPTO_GCM
	select STREAM_PARSER
	select NET_SOCK_MSG
	default n
	help
	Enable kernel support for TLS protocol. This allows symmetric
	encryption handling of the TLS protocol to be done in-kernel.

	If unsure, say N.

config TLS_DEVICE
	bool "Transport Layer Security HW offload"
	depends on TLS
	select SKB_DECRYPTED
	select SOCK_VALIDATE_XMIT
	select SOCK_RX_QUEUE_MAPPING
	default n
	help
	Enable kernel support for HW offload of the TLS protocol.

	If unsure, say N.

config TLS_TOE
	bool "Transport Layer Security TCP stack bypass"
	depends on TLS
	default n
	help
	Enable kernel support for legacy HW offload of the TLS protocol,
	which is incompatible with the Linux networking stack semantics.

	If unsure, say N.
```

## net/unix/Kconfig
```kconfig
# SPDX-License-Identifier: GPL-2.0-only
#
# Unix Domain Sockets
#

config UNIX
	bool "Unix domain sockets"
	help
	  If you say Y here, you will include support for Unix domain sockets;
	  sockets are the standard Unix mechanism for establishing and
	  accessing network connections.  Many commonly used programs such as
	  the X Window system and syslog use these sockets even if your
	  machine is not connected to any network.  Unless you are working on
	  an embedded system or something similar, you therefore definitely
	  want to say Y here.

	  Say Y unless you know what you are doing.

config	AF_UNIX_OOB
	bool "UNIX: out-of-bound messages"
	depends on UNIX
	default y
	help
	  Support for MSG_OOB in UNIX domain sockets. If unsure, say Y.

config UNIX_DIAG
	tristate "UNIX: socket monitoring interface"
	depends on UNIX
	default n
	help
	  Support for UNIX socket monitoring interface used by the ss tool.
	  If unsure, say Y.
```

## net/vmw_vsock/Kconfig
```kconfig
# SPDX-License-Identifier: GPL-2.0-only
#
# Vsock protocol
#

config VSOCKETS
	tristate "Virtual Socket protocol"
	help
	  Virtual Socket Protocol is a socket protocol similar to TCP/IP
	  allowing communication between Virtual Machines and hypervisor
	  or host.

	  You should also select one or more hypervisor-specific transports
	  below.

	  To compile this driver as a module, choose M here: the module
	  will be called vsock. If unsure, say N.

config VSOCKETS_DIAG
	tristate "Virtual Sockets monitoring interface"
	depends on VSOCKETS
	default y
	help
	  Support for PF_VSOCK sockets monitoring interface used by the ss tool.
	  If unsure, say Y.

	  Enable this module so userspace applications can query open sockets.

config VSOCKETS_LOOPBACK
	tristate "Virtual Sockets loopback transport"
	depends on VSOCKETS
	default y
	select VIRTIO_VSOCKETS_COMMON
	help
	  This module implements a loopback transport for Virtual Sockets,
	  using vmw_vsock_virtio_transport_common.

	  To compile this driver as a module, choose M here: the module
	  will be called vsock_loopback. If unsure, say N.

config VMWARE_VMCI_VSOCKETS
	tristate "VMware VMCI transport for Virtual Sockets"
	depends on VSOCKETS && VMWARE_VMCI
	help
	  This module implements a VMCI transport for Virtual Sockets.

	  Enable this transport if your Virtual Machine runs on a VMware
	  hypervisor.

	  To compile this driver as a module, choose M here: the module
	  will be called vmw_vsock_vmci_transport. If unsure, say N.

config VIRTIO_VSOCKETS
	tristate "virtio transport for Virtual Sockets"
	depends on VSOCKETS && VIRTIO
	select VIRTIO_VSOCKETS_COMMON
	help
	  This module implements a virtio transport for Virtual Sockets.

	  Enable this transport if your Virtual Machine host supports Virtual
	  Sockets over virtio.

	  To compile this driver as a module, choose M here: the module will be
	  called vmw_vsock_virtio_transport. If unsure, say N.

config VIRTIO_VSOCKETS_COMMON
	tristate
	help
	  This option is selected by any driver which needs to access
	  the virtio_vsock.  The module will be called
	  vmw_vsock_virtio_transport_common.

config HYPERV_VSOCKETS
	tristate "Hyper-V transport for Virtual Sockets"
	depends on VSOCKETS && HYPERV_VMBUS
	help
	  This module implements a Hyper-V transport for Virtual Sockets.

	  Enable this transport if your Virtual Machine host supports Virtual
	  Sockets over Hyper-V VMBus.

	  To compile this driver as a module, choose M here: the module will be
	  called hv_sock. If unsure, say N.
```

## net/wanrouter/Kconfig
```kconfig
#
# Configuration for WAN router
#

config WAN_ROUTER
	tristate "WAN router (DEPRECATED)"
	---help---
	  Wide Area Networks (WANs), such as X.25, frame relay and leased
	  lines, are used to interconnect Local Area Networks (LANs) over vast
	  distances with data transfer rates significantly higher than those
	  achievable with commonly used asynchronous modem connections.
	  Usually, a quite expensive external device called a `WAN router' is
	  needed to connect to a WAN.

	  As an alternative, WAN routing can be built into the Linux kernel.
	  With relatively inexpensive WAN interface cards available on the
	  market, a perfectly usable router can be built for less than half
	  the price of an external router.  If you have one of those cards and
	  wish to use your Linux box as a WAN router, say Y here and also to
	  the WAN driver for your card, below.  You will then need the
	  wan-tools package which is available from <ftp://ftp.sangoma.com/>.

	  To compile WAN routing support as a module, choose M here: the
	  module will be called wanrouter.

	  If unsure, say N.
```

## net/wimax/Kconfig
```kconfig
# SPDX-License-Identifier: GPL-2.0-only
#
# WiMAX LAN device configuration
#

menuconfig WIMAX
	tristate "WiMAX Wireless Broadband support"
	depends on RFKILL || !RFKILL
	help

	  Select to configure support for devices that provide
	  wireless broadband connectivity using the WiMAX protocol
	  (IEEE 802.16).

	  Please note that most of these devices require signing up
	  for a service plan with a provider.

	  The different WiMAX drivers can be enabled in the menu entry

	  Device Drivers > Network device support > WiMAX Wireless
	  Broadband devices

	  If unsure, it is safe to select M (module).

config WIMAX_DEBUG_LEVEL
	int "WiMAX debug level"
	depends on WIMAX
	default 8
	help

	  Select the maximum debug verbosity level to be compiled into
	  the WiMAX stack code.

	  By default, debug messages are disabled at runtime and can
	  be selectively enabled for different parts of the code using
	  the sysfs debug-levels file.

	  If set at zero, this will compile out all the debug code.

	  It is recommended that it is left at 8.
```
