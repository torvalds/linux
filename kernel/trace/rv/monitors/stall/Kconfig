## kernel/trace/rv/monitors/stall/Kconfig
```kconfig
# SPDX-License-Identifier: GPL-2.0-only
#
config RV_MON_STALL
	depends on RV
	select HA_MON_EVENTS_ID
	bool "stall monitor"
	help
	  Enable the stall sample monitor that illustrates the usage of hybrid
	  automata monitors. It can be used to identify tasks stalled for
	  longer than a threshold.

	  For further information, see:
	    Documentation/trace/rv/monitor_stall.rst
```

## kernel/trace/rv/monitors/sts/Kconfig
```kconfig
# SPDX-License-Identifier: GPL-2.0-only
#
config RV_MON_STS
	depends on RV
	depends on TRACE_IRQFLAGS
	depends on RV_MON_SCHED
	default y
	select DA_MON_EVENTS_IMPLICIT
	bool "sts monitor"
	help
	  Monitor to ensure relationships between scheduler and task switches
	   * the scheduler is called and returns with interrupts disabled
	   * each call to the scheduler has up to one switch
	   * switches only happen inside the scheduler
	   * each call to the scheduler disables interrupts to switch
	  This monitor is part of the sched monitors collection.

	  For further information, see:
	    Documentation/trace/rv/monitor_sched.rst
```

## kernel/trace/rv/monitors/tss/Kconfig
```kconfig
# SPDX-License-Identifier: GPL-2.0-only
#
config RV_MON_TSS
	depends on RV
	depends on RV_MON_SCHED
	default y
	select DA_MON_EVENTS_IMPLICIT
	bool "tss monitor"
	help
	  Monitor to ensure sched_switch happens only in scheduling context.
	  This monitor is part of the sched monitors collection.

	  For further information, see:
	    Documentation/trace/rv/monitor_sched.rst
```

## kernel/trace/rv/monitors/wip/Kconfig
```kconfig
config RV_MON_WIP
	depends on RV
	depends on PREEMPT_TRACER
	select DA_MON_EVENTS_IMPLICIT
	bool "wip monitor"
	help
	  Enable wip (wakeup in preemptive) sample monitor that illustrates
	  the usage of per-cpu monitors, and one limitation of the
	  preempt_disable/enable events.

	  For further information, see:
	    Documentation/trace/rv/monitor_wip.rst
```

## kernel/trace/rv/monitors/wwnr/Kconfig
```kconfig
config RV_MON_WWNR
	depends on RV
	select DA_MON_EVENTS_ID
	bool "wwnr monitor"
	help
	  Enable wwnr (wakeup while not running) sample monitor, this is a
	  sample monitor that illustrates the usage of per-task monitor.
	  The model is borken on purpose: it serves to test reactors.

	  For further information, see:
	    Documentation/trace/rv/monitor_wwnr.rst
```
