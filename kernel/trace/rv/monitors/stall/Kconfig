## lib/crypto/mips/Kconfig
```kconfig
# SPDX-License-Identifier: GPL-2.0-only

config CRYPTO_CHACHA_MIPS
	tristate
	depends on CPU_MIPS32_R2
	default CRYPTO_LIB_CHACHA
	select CRYPTO_ARCH_HAVE_LIB_CHACHA
```

## lib/crypto/riscv/Kconfig
```kconfig
# SPDX-License-Identifier: GPL-2.0-only

config CRYPTO_CHACHA_RISCV64
	tristate
	depends on 64BIT && RISCV_ISA_V && TOOLCHAIN_HAS_VECTOR_CRYPTO
	default CRYPTO_LIB_CHACHA
	select CRYPTO_ARCH_HAVE_LIB_CHACHA
	select CRYPTO_LIB_CHACHA_GENERIC
```

## lib/crypto/sparc/Kconfig
```kconfig
# SPDX-License-Identifier: GPL-2.0-only

config CRYPTO_SHA256_SPARC64
	tristate
	depends on SPARC64
	default CRYPTO_LIB_SHA256
	select CRYPTO_ARCH_HAVE_LIB_SHA256
	select CRYPTO_LIB_SHA256_GENERIC
```

## lib/crypto/tests/Kconfig
```kconfig
# SPDX-License-Identifier: GPL-2.0-or-later

config CRYPTO_LIB_AES_CBC_MACS_KUNIT_TEST
	tristate "KUnit tests for AES-CMAC, AES-XCBC-MAC, and AES-CBC-MAC" if !KUNIT_ALL_TESTS
	depends on KUNIT && CRYPTO_LIB_AES_CBC_MACS
	default KUNIT_ALL_TESTS || CRYPTO_SELFTESTS
	select CRYPTO_LIB_BENCHMARK_VISIBLE
	help
	  KUnit tests for the AES-CMAC, AES-XCBC-MAC, and AES-CBC-MAC message
	  authentication codes.

config CRYPTO_LIB_BLAKE2B_KUNIT_TEST
	tristate "KUnit tests for BLAKE2b" if !KUNIT_ALL_TESTS
	depends on KUNIT && CRYPTO_LIB_BLAKE2B
	default KUNIT_ALL_TESTS || CRYPTO_SELFTESTS
	select CRYPTO_LIB_BENCHMARK_VISIBLE
	help
	  KUnit tests for the BLAKE2b cryptographic hash function.

config CRYPTO_LIB_BLAKE2S_KUNIT_TEST
	tristate "KUnit tests for BLAKE2s" if !KUNIT_ALL_TESTS
	depends on KUNIT
	default KUNIT_ALL_TESTS || CRYPTO_SELFTESTS
	select CRYPTO_LIB_BENCHMARK_VISIBLE
	# No need to depend on CRYPTO_LIB_BLAKE2S here, as that option doesn't
	# exist; the BLAKE2s code is always built-in for the /dev/random driver.
	help
	  KUnit tests for the BLAKE2s cryptographic hash function.

config CRYPTO_LIB_CURVE25519_KUNIT_TEST
	tristate "KUnit tests for Curve25519" if !KUNIT_ALL_TESTS
	depends on KUNIT && CRYPTO_LIB_CURVE25519
	default KUNIT_ALL_TESTS || CRYPTO_SELFTESTS
	select CRYPTO_LIB_BENCHMARK_VISIBLE
	help
	  KUnit tests for the Curve25519 Diffie-Hellman function.

config CRYPTO_LIB_MD5_KUNIT_TEST
	tristate "KUnit tests for MD5" if !KUNIT_ALL_TESTS
	depends on KUNIT && CRYPTO_LIB_MD5
	default KUNIT_ALL_TESTS || CRYPTO_SELFTESTS
	select CRYPTO_LIB_BENCHMARK_VISIBLE
	help
	  KUnit tests for the MD5 cryptographic hash function and its
	  corresponding HMAC.

config CRYPTO_LIB_MLDSA_KUNIT_TEST
	tristate "KUnit tests for ML-DSA" if !KUNIT_ALL_TESTS
	depends on KUNIT && CRYPTO_LIB_MLDSA
	default KUNIT_ALL_TESTS || CRYPTO_SELFTESTS
	select CRYPTO_LIB_BENCHMARK_VISIBLE
	help
	  KUnit tests for the ML-DSA digital signature algorithm.

config CRYPTO_LIB_NH_KUNIT_TEST
	tristate "KUnit tests for NH" if !KUNIT_ALL_TESTS
	depends on KUNIT && CRYPTO_LIB_NH
	default KUNIT_ALL_TESTS || CRYPTO_SELFTESTS
	help
	  KUnit tests for the NH almost-universal hash function.

config CRYPTO_LIB_POLY1305_KUNIT_TEST
	tristate "KUnit tests for Poly1305" if !KUNIT_ALL_TESTS
	depends on KUNIT && CRYPTO_LIB_POLY1305
	default KUNIT_ALL_TESTS || CRYPTO_SELFTESTS
	select CRYPTO_LIB_BENCHMARK_VISIBLE
	help
	  KUnit tests for the Poly1305 library functions.

config CRYPTO_LIB_POLYVAL_KUNIT_TEST
	tristate "KUnit tests for POLYVAL" if !KUNIT_ALL_TESTS
	depends on KUNIT && CRYPTO_LIB_POLYVAL
	default KUNIT_ALL_TESTS || CRYPTO_SELFTESTS
	select CRYPTO_LIB_BENCHMARK_VISIBLE
	help
	  KUnit tests for the POLYVAL library functions.

config CRYPTO_LIB_SHA1_KUNIT_TEST
	tristate "KUnit tests for SHA-1" if !KUNIT_ALL_TESTS
	depends on KUNIT && CRYPTO_LIB_SHA1
	default KUNIT_ALL_TESTS || CRYPTO_SELFTESTS
	select CRYPTO_LIB_BENCHMARK_VISIBLE
	help
	  KUnit tests for the SHA-1 cryptographic hash function and its
	  corresponding HMAC.

# Option is named *_SHA256_KUNIT_TEST, though both SHA-224 and SHA-256 tests are
# included, for consistency with the naming used elsewhere (e.g. CRYPTO_SHA256).
config CRYPTO_LIB_SHA256_KUNIT_TEST
	tristate "KUnit tests for SHA-224 and SHA-256" if !KUNIT_ALL_TESTS
	depends on KUNIT && CRYPTO_LIB_SHA256
	default KUNIT_ALL_TESTS || CRYPTO_SELFTESTS
	select CRYPTO_LIB_BENCHMARK_VISIBLE
	help
	  KUnit tests for the SHA-224 and SHA-256 cryptographic hash functions
	  and their corresponding HMACs.

# Option is named *_SHA512_KUNIT_TEST, though both SHA-384 and SHA-512 tests are
# included, for consistency with the naming used elsewhere (e.g. CRYPTO_SHA512).
config CRYPTO_LIB_SHA512_KUNIT_TEST
	tristate "KUnit tests for SHA-384 and SHA-512" if !KUNIT_ALL_TESTS
	depends on KUNIT && CRYPTO_LIB_SHA512
	default KUNIT_ALL_TESTS || CRYPTO_SELFTESTS
	select CRYPTO_LIB_BENCHMARK_VISIBLE
	help
	  KUnit tests for the SHA-384 and SHA-512 cryptographic hash functions
	  and their corresponding HMACs.

config CRYPTO_LIB_SHA3_KUNIT_TEST
	tristate "KUnit tests for SHA-3" if !KUNIT_ALL_TESTS
	depends on KUNIT && CRYPTO_LIB_SHA3
	default KUNIT_ALL_TESTS || CRYPTO_SELFTESTS
	select CRYPTO_LIB_BENCHMARK_VISIBLE
	help
	  KUnit tests for the SHA3 cryptographic hash and XOF functions,
	  including SHA3-224, SHA3-256, SHA3-384, SHA3-512, SHAKE128 and
	  SHAKE256.

config CRYPTO_LIB_ENABLE_ALL_FOR_KUNIT
	tristate "Enable all crypto library code for KUnit tests"
	depends on KUNIT
	select CRYPTO_LIB_AES_CBC_MACS
	select CRYPTO_LIB_BLAKE2B
	select CRYPTO_LIB_CURVE25519
	select CRYPTO_LIB_MD5
	select CRYPTO_LIB_MLDSA
	select CRYPTO_LIB_NH
	select CRYPTO_LIB_POLY1305
	select CRYPTO_LIB_POLYVAL
	select CRYPTO_LIB_SHA1
	select CRYPTO_LIB_SHA256
	select CRYPTO_LIB_SHA512
	select CRYPTO_LIB_SHA3
	help
	  Enable all the crypto library code that has KUnit tests.

	  Enable this only if you'd like to test all the crypto library code,
	  even code that wouldn't otherwise need to be built.

	  You'll still need to enable the tests themselves, either individually
	  or using KUNIT_ALL_TESTS.

config CRYPTO_LIB_BENCHMARK_VISIBLE
	bool

config CRYPTO_LIB_BENCHMARK
	bool "Include benchmarks in KUnit tests for cryptographic functions"
	depends on CRYPTO_LIB_BENCHMARK_VISIBLE
	help
	  Include benchmarks in the KUnit tests for cryptographic functions.
	  The benchmark results are printed to the kernel log when the
	  corresponding KUnit test suite runs.

	  This is useful for evaluating the performance of the cryptographic
	  functions.  However, it will increase the runtime of the KUnit tests.

	  If you're only interested in correctness testing, leave this disabled.
```

## lib/crypto/x86/Kconfig
```kconfig
# SPDX-License-Identifier: GPL-2.0-only

config CRYPTO_BLAKE2S_X86
	def_bool y
	depends on 64BIT
	select CRYPTO_LIB_BLAKE2S_GENERIC
	select CRYPTO_ARCH_HAVE_LIB_BLAKE2S
	help
	  BLAKE2s cryptographic hash function (RFC 7693)

	  Architecture: x86_64 using:
	  - SSSE3 (Supplemental SSE3)
	  - AVX-512 (Advanced Vector Extensions-512)
```

## lib/fonts/Kconfig
```kconfig
# SPDX-License-Identifier: GPL-2.0-only
#
# Font configuration
#

config FONT_SUPPORT
	tristate

if FONT_SUPPORT

config FONTS
	bool "Select compiled-in fonts"
	depends on FRAMEBUFFER_CONSOLE || STI_CONSOLE
	help
	  Say Y here if you would like to use fonts other than the default
	  your frame buffer console usually use.

	  Note that the answer to this question won't directly affect the
	  kernel: saying N will just cause the configurator to skip all
	  the questions about foreign fonts.

	  If unsure, say N (the default choices are safe).

config FONT_8x8
	bool "VGA 8x8 font" if FONTS
	depends on FRAMEBUFFER_CONSOLE || STI_CONSOLE
	default y if !SPARC && !FONTS
	help
	  This is the "high resolution" font for the VGA frame buffer (the one
	  provided by the text console 80x50 (and higher) modes).

	  Note that this is a poor quality font. The VGA 8x16 font is quite a
	  lot more readable.

	  Given the resolution provided by the frame buffer device, answer N
	  here is safe.

config FONT_8x16
	bool "VGA 8x16 font" if FONTS
	default y if !SPARC && !FONTS
	help
	  This is the "high resolution" font for the VGA frame buffer (the one
	  provided by the VGA text console 80x25 mode.

	  If unsure, say Y.

config FONT_6x11
	bool "Mac console 6x11 font (not supported by all drivers)" if FONTS
	depends on FRAMEBUFFER_CONSOLE || STI_CONSOLE
	default y if !SPARC && !FONTS && MAC
	help
	  Small console font with Macintosh-style high-half glyphs.  Some Mac
	  framebuffer drivers don't support this one at all.

config FONT_7x14
	bool "console 7x14 font (not supported by all drivers)" if FONTS
	depends on FRAMEBUFFER_CONSOLE
	help
	  Console font with characters just a bit smaller than the default.
	  If the standard 8x16 font is a little too big for you, say Y.
	  Otherwise, say N.

config FONT_PEARL_8x8
	bool "Pearl (old m68k) console 8x8 font" if FONTS
	depends on FRAMEBUFFER_CONSOLE
	default y if !SPARC && !FONTS && AMIGA
	help
	  Small console font with PC-style control-character and high-half
	  glyphs.

config FONT_ACORN_8x8
	bool "Acorn console 8x8 font" if FONTS
	depends on FRAMEBUFFER_CONSOLE
	default y if !SPARC && !FONTS && ARM && ARCH_ACORN
	help
	  Small console font with PC-style control characters and high-half
	  glyphs.

config FONT_MINI_4x6
	bool "Mini 4x6 font"
	depends on !SPARC && FONTS

config FONT_6x10
	bool "Medium-size 6x10 font"
	depends on !SPARC && FONTS
	help
	  Medium-size console font. Suitable for framebuffer consoles on
	  embedded devices with a 320x240 screen, to get a reasonable number
	  of characters (53x24) that are still at a readable size.

config FONT_10x18
	bool "console 10x18 font (not supported by all drivers)" if FONTS
	depends on FRAMEBUFFER_CONSOLE
	help
	  This is a high resolution console font for machines with very
	  big letters. It fits between the sun 12x22 and the normal 8x16 font.
	  If other fonts are too big or too small for you, say Y, otherwise say N.

config FONT_SUN8x16
	bool "Sparc console 8x16 font"
	depends on FRAMEBUFFER_CONSOLE && (!SPARC && FONTS || SPARC)
	help
	  This is the high resolution console font for Sun machines. Say Y.

config FONT_SUN12x22
	bool "Sparc console 12x22 font (not supported by all drivers)"
	depends on FRAMEBUFFER_CONSOLE && (!SPARC && FONTS || SPARC)
	help
	  This is the high resolution console font for Sun machines with very
	  big letters (like the letters used in the SPARC PROM). If the
	  standard font is unreadable for you, say Y, otherwise say N.

config FONT_TER16x32
	bool "Terminus 16x32 font (not supported by all drivers)"
	depends on FRAMEBUFFER_CONSOLE && (!SPARC && FONTS || SPARC)
	help
	  Terminus Font is a clean, fixed width bitmap font, designed
	  for long (8 and more hours per day) work with computers.
	  This is the high resolution, large version for use with HiDPI screens.
	  If the standard font is unreadable for you, say Y, otherwise say N.

config FONT_AUTOSELECT
	def_bool y
	depends on !FONT_8x8
	depends on !FONT_6x11
	depends on !FONT_7x14
	depends on !FONT_PEARL_8x8
	depends on !FONT_ACORN_8x8
	depends on !FONT_MINI_4x6
	depends on !FONT_6x10
	depends on !FONT_SUN8x16
	depends on !FONT_SUN12x22
	depends on !FONT_10x18
	depends on !FONT_TER16x32
	select FONT_8x16

endif # FONT_SUPPORT
```

## lib/fp_printk/Kconfig
```kconfig
config FP_PRINTK 
        bool "fp_printk"

config FP_PRINTK_TEST
        tristate "Test for lib fp_printk" if !KUNIT_ALL_TESTS
        depends on FP_PRINTK && KUNIT=y
        default KUNIT_ALL_TESTS
```
