## kernel/trace/rv/Kconfig
```kconfig
# SPDX-License-Identifier: GPL-2.0-only
#
config RV_MON_EVENTS
	bool

config RV_MON_MAINTENANCE_EVENTS
	bool

config DA_MON_EVENTS_IMPLICIT
	select RV_MON_EVENTS
	select RV_MON_MAINTENANCE_EVENTS
	bool

config DA_MON_EVENTS_ID
	select RV_MON_EVENTS
	select RV_MON_MAINTENANCE_EVENTS
	bool

config LTL_MON_EVENTS_ID
	select RV_MON_EVENTS
	bool

config RV_LTL_MONITOR
	bool

menuconfig RV
	bool "Runtime Verification"
	select TRACING
	help
	  Enable the kernel runtime verification infrastructure. RV is a
	  lightweight (yet rigorous) method that complements classical
	  exhaustive verification techniques (such as model checking and
	  theorem proving). RV works by analyzing the trace of the system's
	  actual execution, comparing it against a formal specification of
	  the system behavior.

	  For further information, see:
	    Documentation/trace/rv/runtime-verification.rst

config RV_PER_TASK_MONITORS
	int "Maximum number of per-task monitor"
	depends on RV
	range 1 8
	default 2
	help
	  This option configures the maximum number of per-task RV monitors that can run
	  simultaneously.

source "kernel/trace/rv/monitors/wip/Kconfig"
source "kernel/trace/rv/monitors/wwnr/Kconfig"

source "kernel/trace/rv/monitors/sched/Kconfig"
source "kernel/trace/rv/monitors/sco/Kconfig"
source "kernel/trace/rv/monitors/snroc/Kconfig"
source "kernel/trace/rv/monitors/scpd/Kconfig"
source "kernel/trace/rv/monitors/snep/Kconfig"
source "kernel/trace/rv/monitors/sts/Kconfig"
source "kernel/trace/rv/monitors/nrp/Kconfig"
source "kernel/trace/rv/monitors/sssw/Kconfig"
source "kernel/trace/rv/monitors/opid/Kconfig"
# Add new sched monitors here

source "kernel/trace/rv/monitors/rtapp/Kconfig"
source "kernel/trace/rv/monitors/pagefault/Kconfig"
source "kernel/trace/rv/monitors/sleep/Kconfig"
# Add new rtapp monitors here

# Add new monitors here

config RV_REACTORS
	bool "Runtime verification reactors"
	default y
	depends on RV
	help
	  Enables the online runtime verification reactors. A runtime
	  monitor can cause a reaction to the detection of an exception
	  on the model's execution. By default, the monitors have
	  tracing reactions, printing the monitor output via tracepoints,
	  but other reactions can be added (on-demand) via this interface.

config RV_REACT_PRINTK
	bool "Printk reactor"
	depends on RV_REACTORS
	default y
	help
	  Enables the printk reactor. The printk reactor emits a printk()
	  message if an exception is found.

config RV_REACT_PANIC
	bool "Panic reactor"
	depends on RV_REACTORS
	default y
	help
	  Enables the panic reactor. The panic reactor emits a printk()
	  message if an exception is found and panic()s the system.
```

## kernel/trace/rv/monitors/deadline/Kconfig
```kconfig
config RV_MON_DEADLINE
	depends on RV
	bool "deadline monitor"
	help
	  Collection of monitors to check the deadline scheduler and server
	  behave according to specifications. Enable this to enable all
	  scheduler specification supported by the current kernel.

	  For further information, see:
	    Documentation/trace/rv/monitor_deadline.rst
```

## kernel/trace/rv/monitors/nomiss/Kconfig
```kconfig
# SPDX-License-Identifier: GPL-2.0-only
#
config RV_MON_NOMISS
	depends on RV
	depends on HAVE_SYSCALL_TRACEPOINTS
	depends on RV_MON_DEADLINE
	default y
	select HA_MON_EVENTS_ID
	bool "nomiss monitor"
	help
	  Monitor to ensure dl entities run to completion before their deadiline.
	  This monitor is part of the deadline monitors collection.

	  For further information, see:
	    Documentation/trace/rv/monitor_deadline.rst
```

## kernel/trace/rv/monitors/nrp/Kconfig
```kconfig
# SPDX-License-Identifier: GPL-2.0-only
#
config RV_MON_NRP
	depends on RV
	depends on RV_MON_SCHED
	default y if !ARM64
	select DA_MON_EVENTS_ID
	bool "nrp monitor"
	help
	  Monitor to ensure preemption requires need resched.
	  This monitor is part of the sched monitors collection.

	  This monitor is unstable on arm64, say N unless you are testing it.

	  For further information, see:
	    Documentation/trace/rv/monitor_sched.rst
```

## kernel/trace/rv/monitors/opid/Kconfig
```kconfig
# SPDX-License-Identifier: GPL-2.0-only
#
config RV_MON_OPID
	depends on RV
	depends on RV_MON_SCHED
	default y
	select HA_MON_EVENTS_IMPLICIT
	bool "opid monitor"
	help
	  Monitor to ensure operations like wakeup and need resched occur with
	  interrupts and preemption disabled.

	  For further information, see:
	    Documentation/trace/rv/monitor_sched.rst
```

## kernel/trace/rv/monitors/pagefault/Kconfig
```kconfig
# SPDX-License-Identifier: GPL-2.0-only
#
config RV_MON_PAGEFAULT
	depends on RV
	select RV_LTL_MONITOR
	depends on RV_MON_RTAPP
	depends on X86 || RISCV
	depends on MMU
	default y
	select LTL_MON_EVENTS_ID
	bool "pagefault monitor"
	help
	  Monitor that real-time tasks do not raise page faults, causing
	  undesirable latency.

	  If you are developing a real-time system and not entirely sure whether
	  the applications are designed correctly for real-time, you want to say
	  Y here.

	  This monitor does not affect execution speed while it is not running,
	  therefore it is safe to enable this in production kernel.
```

## kernel/trace/rv/monitors/rtapp/Kconfig
```kconfig
config RV_MON_RTAPP
	depends on RV
	depends on RV_PER_TASK_MONITORS >= 2
	bool "rtapp monitor"
	help
	  Collection of monitors to check for common problems with real-time
	  application that may cause unexpected latency.

	  If you are developing a real-time system and not entirely sure whether
	  the applications are designed correctly for real-time, you want to say
	  Y here.
```

## kernel/trace/rv/monitors/sched/Kconfig
```kconfig
# SPDX-License-Identifier: GPL-2.0-only
#
config RV_MON_SCHED
	depends on RV
	depends on RV_PER_TASK_MONITORS >= 3
	bool "sched monitor"
	help
	  Collection of monitors to check the scheduler behaves according to specifications.
	  Enable this to enable all scheduler specification supported by the current kernel.

	  For further information, see:
	    Documentation/trace/rv/monitor_sched.rst
```

## kernel/trace/rv/monitors/scpd/Kconfig
```kconfig
# SPDX-License-Identifier: GPL-2.0-only
#
config RV_MON_SCPD
	depends on RV
	depends on TRACE_PREEMPT_TOGGLE
	depends on RV_MON_SCHED
	default y
	select DA_MON_EVENTS_IMPLICIT
	bool "scpd monitor"
	help
	  Monitor to ensure schedule is called with preemption disabled.
	  This monitor is part of the sched monitors collection.

	  For further information, see:
	    Documentation/trace/rv/monitor_sched.rst
```

## kernel/trace/rv/monitors/sleep/Kconfig
```kconfig
# SPDX-License-Identifier: GPL-2.0-only
#
config RV_MON_SLEEP
	depends on RV
	select RV_LTL_MONITOR
	depends on HAVE_SYSCALL_TRACEPOINTS
	depends on RV_MON_RTAPP
	select TRACE_IRQFLAGS
	default y
	select LTL_MON_EVENTS_ID
	bool "sleep monitor"
	help
	  Monitor that real-time tasks do not sleep in a manner that may
	  cause undesirable latency.

	  If you are developing a real-time system and not entirely sure whether
	  the applications are designed correctly for real-time, you want to say
	  Y here.

	  Enabling this monitor may have performance impact (due to select
	  TRACE_IRQFLAGS). Therefore, you probably should say N for
	  production kernel.
```

## kernel/trace/rv/monitors/sncid/Kconfig
```kconfig
# SPDX-License-Identifier: GPL-2.0-only
#
config RV_MON_SNCID
	depends on RV
	depends on IRQSOFF_TRACER
	depends on RV_MON_SCHED
	default y
	select DA_MON_EVENTS_IMPLICIT
	bool "sncid monitor"
	help
	  Monitor to ensure schedule is not called with interrupt disabled.
	  This monitor is part of the sched monitors collection.

	  For further information, see:
	    Documentation/trace/rv/monitor_sched.rst
```

## kernel/trace/rv/monitors/snep/Kconfig
```kconfig
# SPDX-License-Identifier: GPL-2.0-only
#
config RV_MON_SNEP
	depends on RV
	depends on PREEMPT_TRACER
	depends on RV_MON_SCHED
	default y
	select DA_MON_EVENTS_IMPLICIT
	bool "snep monitor"
	help
	  Monitor to ensure schedule does not enable preempt.
	  This monitor is part of the sched monitors collection.

	  For further information, see:
	    Documentation/trace/rv/monitor_sched.rst
```

## kernel/trace/rv/monitors/snroc/Kconfig
```kconfig
# SPDX-License-Identifier: GPL-2.0-only
#
config RV_MON_SNROC
	depends on RV
	depends on RV_MON_SCHED
	default y
	select DA_MON_EVENTS_ID
	bool "snroc monitor"
	help
	  Monitor to ensure sched_set_state happens only in the respective task's context.
	  This monitor is part of the sched monitors collection.

	  For further information, see:
	    Documentation/trace/rv/monitor_sched.rst
```

## kernel/trace/rv/monitors/sssw/Kconfig
```kconfig
# SPDX-License-Identifier: GPL-2.0-only
#
config RV_MON_SSSW
	depends on RV
	depends on RV_MON_SCHED
	default y
	select DA_MON_EVENTS_ID
	bool "sssw monitor"
	help
	  Monitor to ensure sched_set_state to sleepable leads to sleeping and
	  sleeping tasks require wakeup.
	  This monitor is part of the sched monitors collection.

	  For further information, see:
	    Documentation/trace/rv/monitor_sched.rst
```
