## kernel/gcov/Kconfig
```kconfig
# SPDX-License-Identifier: GPL-2.0-only
menu "GCOV-based kernel profiling"

config GCOV_KERNEL
	bool "Enable gcov-based kernel profiling"
	depends on DEBUG_FS
	depends on !ARCH_WANTS_NO_INSTR || CC_HAS_NO_PROFILE_FN_ATTR
	select CONSTRUCTORS
	default n
	help
	This option enables gcov-based code profiling (e.g. for code coverage
	measurements).

	If unsure, say N.

	Additionally specify CONFIG_GCOV_PROFILE_ALL=y to get profiling data
	for the entire kernel. To enable profiling for specific files or
	directories, add a line similar to the following to the respective
	Makefile:

	For a single file (e.g. main.o):
	        GCOV_PROFILE_main.o := y

	For all files in one directory:
	        GCOV_PROFILE := y

	To exclude files from being profiled even when CONFIG_GCOV_PROFILE_ALL
	is specified, use:

	        GCOV_PROFILE_main.o := n
	and:
	        GCOV_PROFILE := n

	Note that the debugfs filesystem has to be mounted to access
	profiling data.

config ARCH_HAS_GCOV_PROFILE_ALL
	def_bool n

config GCOV_PROFILE_ALL
	bool "Profile entire Kernel"
	depends on !COMPILE_TEST
	depends on GCOV_KERNEL
	depends on ARCH_HAS_GCOV_PROFILE_ALL
	default n
	help
	This options activates profiling for the entire kernel.

	If unsure, say N.

	Note that a kernel compiled with profiling flags will be significantly
	larger and run slower. Also be sure to exclude files from profiling
	which are not linked to the kernel image to prevent linker errors.

endmenu
```

## kernel/irq/Kconfig
```kconfig
# SPDX-License-Identifier: GPL-2.0-only
menu "IRQ subsystem"
# Options selectable by the architecture code

# Make sparse irq Kconfig switch below available
config MAY_HAVE_SPARSE_IRQ
       bool

# Legacy support, required for itanic
config GENERIC_IRQ_LEGACY
       bool

# Enable the generic irq autoprobe mechanism
config GENERIC_IRQ_PROBE
	bool

# Use the generic /proc/interrupts implementation
config GENERIC_IRQ_SHOW
       bool

# Print level/edge extra information
config GENERIC_IRQ_SHOW_LEVEL
       bool

# Supports effective affinity mask
config GENERIC_IRQ_EFFECTIVE_AFF_MASK
       depends on SMP
       bool

# Support for delayed migration from interrupt context
config GENERIC_PENDING_IRQ
	bool

# Support for generic irq migrating off cpu before the cpu is offline.
config GENERIC_IRQ_MIGRATION
	bool

# Alpha specific irq affinity mechanism
config AUTO_IRQ_AFFINITY
       bool

# Interrupt injection mechanism
config GENERIC_IRQ_INJECTION
	bool

# Tasklet based software resend for pending interrupts on enable_irq()
config HARDIRQS_SW_RESEND
       bool

# Generic configurable interrupt chip implementation
config GENERIC_IRQ_CHIP
       bool
       select IRQ_DOMAIN

# Generic irq_domain hw <--> linux irq number translation
config IRQ_DOMAIN
	bool

# Support for simulated interrupts
config IRQ_SIM
	bool
	select IRQ_WORK
	select IRQ_DOMAIN

# Support for hierarchical irq domains
config IRQ_DOMAIN_HIERARCHY
	bool
	select IRQ_DOMAIN

# Support for obsolete non-mapping irq domains
config IRQ_DOMAIN_NOMAP
	bool
	select IRQ_DOMAIN

# Support for hierarchical fasteoi+edge and fasteoi+level handlers
config IRQ_FASTEOI_HIERARCHY_HANDLERS
	bool

# Generic IRQ IPI support
config GENERIC_IRQ_IPI
	bool
	depends on SMP
	select IRQ_DOMAIN_HIERARCHY

# Generic IRQ IPI Mux support
config GENERIC_IRQ_IPI_MUX
	bool
	depends on SMP

# Generic MSI hierarchical interrupt domain support
config GENERIC_MSI_IRQ
	bool
	select IRQ_DOMAIN_HIERARCHY

# irqchip drivers should select this if they call iommu_dma_prepare_msi()
config IRQ_MSI_IOMMU
	bool

config IRQ_TIMINGS
	bool

config GENERIC_IRQ_MATRIX_ALLOCATOR
	bool

config GENERIC_IRQ_RESERVATION_MODE
	bool

# Snapshot for interrupt statistics
config GENERIC_IRQ_STAT_SNAPSHOT
	bool

# Support forced irq threading
config IRQ_FORCED_THREADING
       bool

config SPARSE_IRQ
	bool "Support sparse irq numbering" if MAY_HAVE_SPARSE_IRQ
	help

	  Sparse irq numbering is useful for distro kernels that want
	  to define a high CONFIG_NR_CPUS value but still want to have
	  low kernel memory footprint on smaller machines.

	  ( Sparse irqs can also be beneficial on NUMA boxes, as they spread
	    out the interrupt descriptors in a more NUMA-friendly way. )

	  If you don't know what to do here, say N.

config GENERIC_IRQ_DEBUGFS
	bool "Expose irq internals in debugfs"
	depends on DEBUG_FS
	select GENERIC_IRQ_INJECTION
	default n
	help

	  Exposes internal state information through debugfs. Mostly for
	  developers and debugging of hard to diagnose interrupt problems.

	  If you don't know what to do here, say N.

# Clear forwarded VM interrupts during kexec.
# This option ensures the kernel clears active states for interrupts
# forwarded to virtual machines (VMs) during a machine kexec.
config GENERIC_IRQ_KEXEC_CLEAR_VM_FORWARD
	bool

endmenu

config GENERIC_IRQ_MULTI_HANDLER
	bool
	help
	  Allow to specify the low level IRQ handler at run time.

# Cavium Octeon is the last system to use this deprecated option
# Do not even think of enabling this on any new platform
config DEPRECATED_IRQ_CPU_ONOFFLINE
	bool
	depends on CAVIUM_OCTEON_SOC
	default CAVIUM_OCTEON_SOC
```

## kernel/livepatch/Kconfig
```kconfig
config ARCH_HAVE_LIVE_PATCHING
	boolean
	help
	  Arch supports kernel live patching

config LIVE_PATCHING
	boolean "Kernel Live Patching"
	depends on DYNAMIC_FTRACE_WITH_REGS
	depends on MODULES
	depends on SYSFS
	depends on KALLSYMS_ALL
	depends on ARCH_HAVE_LIVE_PATCHING
	help
	  Say Y here if you want to support kernel live patching.
	  This option has no runtime impact until a kernel "patch"
	  module uses the interface provided by this option to register
	  a patch, causing calls to patched functions to be redirected
	  to new function code contained in the patch module.
```

## kernel/liveupdate/Kconfig
```kconfig
# SPDX-License-Identifier: GPL-2.0-only

menu "Live Update and Kexec HandOver"
	depends on !DEFERRED_STRUCT_PAGE_INIT

config KEXEC_HANDOVER
	bool "kexec handover"
	depends on ARCH_SUPPORTS_KEXEC_HANDOVER && ARCH_SUPPORTS_KEXEC_FILE
	depends on !DEFERRED_STRUCT_PAGE_INIT
	select MEMBLOCK_KHO_SCRATCH
	select KEXEC_FILE
	select LIBFDT
	select CMA
	help
	  Allow kexec to hand over state across kernels by generating and
	  passing additional metadata to the target kernel. This is useful
	  to keep data or state alive across the kexec. For this to work,
	  both source and target kernels need to have this option enabled.

config KEXEC_HANDOVER_DEBUG
	bool "Enable Kexec Handover debug checks"
	depends on KEXEC_HANDOVER
	help
	  This option enables extra sanity checks for the Kexec Handover
	  subsystem. Since, KHO performance is crucial in live update
	  scenarios and the extra code might be adding overhead it is
	  only optionally enabled.

config KEXEC_HANDOVER_DEBUGFS
	bool "kexec handover debugfs interface"
	default KEXEC_HANDOVER
	depends on KEXEC_HANDOVER
	select DEBUG_FS
	help
	  Allow to control kexec handover device tree via debugfs
	  interface, i.e. finalize the state or aborting the finalization.
	  Also, enables inspecting the KHO fdt trees with the debugfs binary
	  blobs.

config KEXEC_HANDOVER_ENABLE_DEFAULT
	bool "Enable kexec handover by default"
	depends on KEXEC_HANDOVER
	help
	  Enable Kexec Handover by default. This avoids the need to
	  explicitly pass 'kho=on' on the kernel command line.

	  This is useful for systems where KHO is a prerequisite for other
	  features, such as Live Update, ensuring the mechanism is always
	  active.

	  The default behavior can still be overridden at boot time by
	  passing 'kho=off'.

config LIVEUPDATE
	bool "Live Update Orchestrator"
	depends on KEXEC_HANDOVER
	help
	  Enable the Live Update Orchestrator. Live Update is a mechanism,
	  typically based on kexec, that allows the kernel to be updated
	  while keeping selected devices operational across the transition.
	  These devices are intended to be reclaimed by the new kernel and
	  re-attached to their original workload without requiring a device
	  reset.

	  Ability to handover a device from current to the next kernel depends
	  on specific support within device drivers and related kernel
	  subsystems.

	  This feature primarily targets virtual machine hosts to quickly update
	  the kernel hypervisor with minimal disruption to the running virtual
	  machines.

	  If unsure, say N.

config LIVEUPDATE_MEMFD
	bool "Live update support for memfd"
	depends on LIVEUPDATE
	depends on MEMFD_CREATE
	depends on SHMEM
	default LIVEUPDATE
	help
	  Enable live update support for memfd regions. This allows preserving
	  memfd-backed memory across kernel live updates.

	  This can be used to back VM memory with memfds, allowing the guest
	  memory to persist, or for other user workloads needing to preserve
	  pages.

	  If unsure, say N.

endmenu
```
