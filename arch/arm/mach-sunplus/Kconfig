## arch/arm/mach-sunplus/Kconfig
```kconfig
# SPDX-License-Identifier: (GPL-2.0-only OR BSD-2-Clause)

menuconfig ARCH_SUNPLUS
	bool "Sunplus SoCs"
	depends on ARCH_MULTI_V7
	help
	  Support for Sunplus SoC family: SP7021 and succeeding SoC-based systems,
	  such as the Banana Pi BPI-F2S development board (and derivatives).
	  (<http://www.sinovoip.com.cn/ecp_view.asp?id=586>)
	  (<https://tibbo.com/store/plus1.html>)

config SOC_SP7021
	bool "Sunplus SP7021 SoC support"
	depends on ARCH_SUNPLUS
	default ARCH_SUNPLUS
	select HAVE_ARM_ARCH_TIMER
	select ARM_GIC
	select ARM_PSCI
	select PINCTRL
	select PINCTRL_SPPCTL
	select SERIAL_SUNPLUS if TTY
	select SERIAL_SUNPLUS_CONSOLE if TTY
	help
	  Support for Sunplus SP7021 SoC. It is based on ARM 4-core
	  Cortex-A7 with various peripherals (e.g.: I2C, SPI, SDIO,
	  Ethernet, etc.), FPGA interface,  chip-to-chip bus.
	  It is designed for industrial control.
```

## arch/arm/mach-sunxi/Kconfig
```kconfig
# SPDX-License-Identifier: GPL-2.0-only
menuconfig ARCH_SUNXI
	bool "Allwinner SoCs"
	depends on (CPU_LITTLE_ENDIAN && ARCH_MULTI_V5) || ARCH_MULTI_V7
	select ARCH_HAS_RESET_CONTROLLER
	select CLKSRC_MMIO
	select GPIOLIB
	select PINCTRL
	select PM_OPP
	select SUN4I_TIMER
	select RESET_CONTROLLER
	help
	  Support for Allwinner ARM-based family of processors

if ARCH_SUNXI

if ARCH_MULTI_V7

config MACH_SUN4I
	bool "Allwinner A10 (sun4i) SoCs support"
	default ARCH_SUNXI
	select SUN4I_INTC

config MACH_SUN5I
	bool "Allwinner A10s / A13 (sun5i) SoCs support"
	default ARCH_SUNXI
	select SUN4I_INTC
	select SUN5I_HSTIMER

config MACH_SUN6I
	bool "Allwinner A31 (sun6i) SoCs support"
	default ARCH_SUNXI
	select ARM_GIC
	select MFD_SUN6I_PRCM
	select SUN5I_HSTIMER
	select SUN6I_R_INTC
	select SUNXI_NMI_INTC

config MACH_SUN7I
	bool "Allwinner A20 (sun7i) SoCs support"
	default ARCH_SUNXI
	select ARM_GIC
	select ARM_PSCI
	select HAVE_ARM_ARCH_TIMER
	select SUN5I_HSTIMER
	select SUNXI_NMI_INTC

config MACH_SUN8I
	bool "Allwinner sun8i Family SoCs support"
	default ARCH_SUNXI
	select ARM_GIC
	select MFD_SUN6I_PRCM
	select SUN6I_R_INTC
	select SUNXI_NMI_INTC

config MACH_SUN9I
	bool "Allwinner (sun9i) SoCs support"
	default ARCH_SUNXI
	select ARM_GIC
	select SUNXI_NMI_INTC

config ARCH_SUNXI_MC_SMP
	bool
	depends on SMP
	default MACH_SUN9I || MACH_SUN8I
	select ARM_CCI400_PORT_CTRL
	select ARM_CPU_SUSPEND

endif

if ARCH_MULTI_V5

config MACH_SUNIV
	bool "Allwinner ARMv5 F-series (suniv) SoCs support"
	default ARCH_SUNXI
	select SUN4I_INTC
	help
	  Support for Allwinner suniv ARMv5 SoCs.
	  (F1C100A, F1C100s, F1C200s, F1C500, F1C600)

endif

endif
```

## arch/arm/mach-tango/Kconfig
```kconfig
config ARCH_TANGO
	bool "Sigma Designs Tango4 (SMP87xx)"
	depends on ARCH_MULTI_V7
	# Cortex-A9 MPCore r3p0, PL310 r3p2
	select ARCH_HAS_HOLES_MEMORYMODEL
	select ARM_ERRATA_754322
	select ARM_ERRATA_764369 if SMP
	select ARM_ERRATA_775420
	select ARM_GIC
	select CLKSRC_TANGO_XTAL
	select HAVE_ARM_SCU
	select HAVE_ARM_TWD
	select TANGO_IRQ
```

## arch/arm/mach-tcc8k/Kconfig
```kconfig
if ARCH_TCC8K

comment "TCC8000 systems:"

config MACH_TCC8000_SDK
	bool "Telechips TCC8000-SDK development kit"
	default y
	help
	  Support for the Telechips TCC8000-SDK board.

endif
```

## arch/arm/mach-tegra/Kconfig
```kconfig
menuconfig ARCH_TEGRA
	bool "NVIDIA Tegra" if ARCH_MULTI_V7
	select ARCH_REQUIRE_GPIOLIB
	select ARCH_SUPPORTS_TRUSTED_FOUNDATIONS
	select ARM_AMBA
	select ARM_GIC
	select CLKSRC_MMIO
	select HAVE_ARM_SCU if SMP
	select HAVE_ARM_TWD if SMP
	select PINCTRL
	select PM_OPP
	select ARCH_HAS_RESET_CONTROLLER
	select RESET_CONTROLLER
	select SOC_BUS
	help
	  This enables support for NVIDIA Tegra based systems.

if ARCH_TEGRA

config ARCH_TEGRA_2x_SOC
	bool "Enable support for Tegra20 family"
	select ARCH_NEEDS_CPU_IDLE_COUPLED if SMP
	select ARM_ERRATA_720789
	select ARM_ERRATA_754327 if SMP
	select ARM_ERRATA_764369 if SMP
	select PINCTRL_TEGRA20
	select PL310_ERRATA_727915 if CACHE_L2X0
	select PL310_ERRATA_769419 if CACHE_L2X0
	select TEGRA_TIMER
	help
	  Support for NVIDIA Tegra AP20 and T20 processors, based on the
	  ARM CortexA9MP CPU and the ARM PL310 L2 cache controller

config ARCH_TEGRA_3x_SOC
	bool "Enable support for Tegra30 family"
	select ARM_ERRATA_754322
	select ARM_ERRATA_764369 if SMP
	select PINCTRL_TEGRA30
	select PL310_ERRATA_769419 if CACHE_L2X0
	select TEGRA_TIMER
	help
	  Support for NVIDIA Tegra T30 processor family, based on the
	  ARM CortexA9MP CPU and the ARM PL310 L2 cache controller

config ARCH_TEGRA_114_SOC
	bool "Enable support for Tegra114 family"
	select ARM_ERRATA_798181 if SMP
	select ARM_L1_CACHE_SHIFT_6
	select HAVE_ARM_ARCH_TIMER
	select PINCTRL_TEGRA114
	select TEGRA_TIMER
	help
	  Support for NVIDIA Tegra T114 processor family, based on the
	  ARM CortexA15MP CPU

config ARCH_TEGRA_124_SOC
	bool "Enable support for Tegra124 family"
	select ARM_L1_CACHE_SHIFT_6
	select HAVE_ARM_ARCH_TIMER
	select PINCTRL_TEGRA124
	select TEGRA_TIMER
	help
	  Support for NVIDIA Tegra T124 processor family, based on the
	  ARM CortexA15MP CPU

endif
```

## arch/arm/mach-tegra/nv/Kconfig
```kconfig
comment "NVIDIA NVRM/NVOS options"


config TEGRA_NVRM
	bool "Enable NVRM stub driver"
	default n
	help
		Enable NVRM stub driver


config TEGRA_NVOS
	bool "Enable NVOS driver"
	default n
	help
		Enable NVOS driver
```

## arch/arm/mach-u300/Kconfig
```kconfig
# SPDX-License-Identifier: GPL-2.0
menuconfig ARCH_U300
	bool "ST-Ericsson U300 Series"
	depends on ARCH_MULTI_V5 && MMU
	select ARM_AMBA
	select ARM_VIC
	select U300_TIMER
	select CPU_ARM926T
	select GPIOLIB
	select HAVE_TCM
	select PINCTRL
	select PINCTRL_COH901
	select PINCTRL_U300
	select MFD_SYSCON
	help
	  Support for ST-Ericsson U300 series mobile platforms.

if ARCH_U300

config MACH_U300
	depends on ARCH_U300
	bool "U300"
	default y

config U300_DEBUG
	depends on ARCH_U300
	bool "Debug support for U300"
	depends on PM
	help
		Debug support for U300 in sysfs, procfs etc.

endif
```

## arch/arm/mach-uniphier/Kconfig
```kconfig
# SPDX-License-Identifier: GPL-2.0
config ARCH_UNIPHIER
	bool "Socionext UniPhier SoCs"
	depends on ARCH_MULTI_V7
	select ARCH_HAS_RESET_CONTROLLER
	select ARM_AMBA
	select ARM_GLOBAL_TIMER
	select ARM_GIC
	select HAVE_ARM_SCU
	select HAVE_ARM_TWD if SMP
	select PINCTRL
	help
	  Support for UniPhier SoC family developed by Socionext Inc.
	  (formerly, System LSI Business Division of Panasonic Corporation)
```

## arch/arm/mach-ux500/Kconfig
```kconfig
# SPDX-License-Identifier: GPL-2.0
menuconfig ARCH_U8500
	bool "ST-Ericsson U8500 Series"
	depends on ARCH_MULTI_V7 && MMU
	select AB8500_CORE
	select ABX500_CORE
	select ARM_AMBA
	select ARM_ERRATA_754322
	select ARM_ERRATA_764369 if SMP
	select ARM_GIC
	select CACHE_L2X0
	select CLKSRC_DBX500_PRCMU
	select CLKSRC_NOMADIK_MTU
	select GPIOLIB
	select HAVE_ARM_SCU if SMP
	select HAVE_ARM_TWD if SMP
	select I2C
	select I2C_NOMADIK
	select MFD_DB8500_PRCMU
	select PINCTRL
	select PINCTRL_AB8500
	select PINCTRL_AB8505
	select PINCTRL_ABX500
	select PINCTRL_DB8500
	select PINCTRL_NOMADIK
	select PL310_ERRATA_753970 if CACHE_L2X0
	select PM_GENERIC_DOMAINS if PM
	select REGULATOR
	select REGULATOR_DB8500_PRCMU
	select REGULATOR_FIXED_VOLTAGE
	select SOC_BUS
	select RESET_CONTROLLER
	help
	  Support for ST-Ericsson's Ux500 architecture

if ARCH_U8500

config UX500_SOC_DB8500
	def_bool y

config UX500_DEBUG_UART
	int "Ux500 UART to use for low-level debug"
	default 2
	help
	  Choose the UART on which kernel low-level debug messages should be
	  output.

endif
```
