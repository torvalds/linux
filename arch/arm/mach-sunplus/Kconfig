## arch/arm/mvp/Kconfig
```kconfig
config VMWARE_MVP
       bool "Build VMware Mobile Virtualization Platform modules"
       select MODULES
       select MODULE_UNLOAD
       select SYSFS
       select NAMESPACES
       select NET_NS
       select INET
       select IPV6
       select TUN
       select NETFILTER
       help
	 Say Y here to enable the building of kernel modules
	 for VMware's Mobile Virtualization Platform

config VMWARE_MVP_DEBUG
       bool "Enable debug for VMware Mobile Virtualization Platform modules"
       depends on VMWARE_MVP
       select IKCONFIG
       select IKCONFIG_PROC
       help
	 Say Y here to enable debug on kernel modules
	 for VMware's Mobile Virtualization Platform.
	 This should be enabled for eng or userdebug builds.
```

## arch/arm/oprofile/Kconfig
```kconfig
menu "Profiling support"
	depends on EXPERIMENTAL

config PROFILING
	bool "Profiling support (EXPERIMENTAL)"
	help
	  Say Y here to enable the extended profiling support mechanisms used
	  by profilers such as OProfile.


config OPROFILE
	tristate "OProfile system profiling (EXPERIMENTAL)"
	depends on PROFILING
	help
	  OProfile is a profiling system capable of profiling the
	  whole system, include the kernel, kernel modules, libraries,
	  and applications.

	  If unsure, say N.

if OPROFILE

config OPROFILE_ARMV6
	bool
	depends on CPU_V6 && !SMP
	default y
	select OPROFILE_ARM11_CORE

config OPROFILE_MPCORE
	bool
	depends on CPU_V6 && SMP
	default y
	select OPROFILE_ARM11_CORE

config OPROFILE_ARM11_CORE
	bool

endif

endmenu
```

## arch/arm/plat-meson/Kconfig
```kconfig
if PLAT_MESON

menu "Amlogic Meson platform"
	depends on PLAT_MESON
choice
	prompt "Meson SoC"
	default ARCH_MESON8

config ARCH_MESON6
	bool "Meson6 series"
	help
	  Enable support for Amlogic Meson6 based system

config ARCH_MESON6TV
	bool "Meson6TV series"
	help
	  Enable support for Amlogic Meson6TV based system

config ARCH_MESON6TVD
	bool "Meson6TVD series"
	help
	  Enable support for Amlogic Meson6TVD based system

config ARCH_MESON8
	bool "Meson8 series"
	help
	  Enable support for Amlogic Meson8 based system

config ARCH_MESON8B
	bool "Meson8 baby series"
	help
	  Enable support for Amlogic Meson8 baby based system

config ARCH_MESON8M2
	bool "Meson8M2 series"
	help
	  Enable support for Amlogic Meson8M2 based system

config ARCH_MESONG9TV
	bool "MesonG9TV series"
	help
	  Enable support for Amlogic G9TV based system

endchoice

menu "Meson development boards"

source "arch/arm/mach-meson6/Kconfig.boards"
source "arch/arm/mach-meson6tv/Kconfig.boards"
source "arch/arm/mach-meson6tvd/Kconfig.boards"
source "arch/arm/mach-meson8/Kconfig.boards"
source "arch/arm/mach-meson8b/Kconfig.boards"
source "arch/arm/mach-mesong9tv/Kconfig.boards"

#if MESON_CUSTOM_BOARD_SUPPORT
#isource "customer/meson/dt/Kconfig"
#endif # MESON_CUSTOM_BOARD_SUPPORT

endmenu # "Meson reference boards"

choice
	prompt "Interrupt Controller Select"
	default MESON_ARM_GIC

config MESON_IRQ
	bool "Meson Interrupt controller"
	help
	  If SMP is opend , you should not Enable it

config MESON_ARM_GIC
	bool "ARM Generic Interrupt Controller"
	select ARM_GIC
	help
	  Interrupt Controller from ARM Company

endchoice

config MESON_CLOCK_TICK_RATE
	int "Clock Tick Rate"
	default 24000000

config MESON_ARM_GIC_FIQ
	bool "ARM Generic Interrupt Controller FIQ"
	depends on ARM_GIC
	help
	  enable ARM GIC FIQ
	default n

config MESON_SUSPEND
	bool "Support Meson A9 domain power down"
	depends on SUSPEND
	default n

config SUSPEND_WATCHDOG
	bool "Enable hardware watchdog while system halt in suspend or resume process"
	depends on MESON_SUSPEND
	default n

config MESON_SUSPEND_TEST
	bool "Enable suspend/resume test"
	depends on MESON_SUSPEND
	default n

config SCREEN_ON_EARLY
	bool "Turn on screen early"
	depends on MESON_SUSPEND
	default n

config CLK81_DFS
	bool "Scale clk81 freqence in dynamic mode"
	default n

config MESON_LEGACY_REGISTER_API
	bool "Support legacy Meson regiser operation API"
	default n
	help
	  Enable support for legacy Meson register operation API.

config MESON_CPU_EMULATOR
	bool "Support Meson serial CPU running at Emulator"
	default n
	help
	  Enable support for Meson serial CPU running at VLSI Emulator

source "arch/arm/mach-meson6/Kconfig"
source "arch/arm/mach-meson6tv/Kconfig"
source "arch/arm/mach-meson6tvd/Kconfig"
source "arch/arm/mach-meson8/Kconfig"
source "arch/arm/mach-meson8b/Kconfig"
source "arch/arm/mach-mesong9tv/Kconfig"

config MESON_CUSTOM_BOARD_SUPPORT
	bool "Support customer board"
	default n
	help
	  This enables board definition from external customer directory

menu "Meson customer board drivers"
depends on MESON_CUSTOM_BOARD_SUPPORT
#isource "customer/drivers/Kconfig"
endmenu # "Customer drivers"

endmenu # "Amlogic Meson platform"

endif # PLAT_MESON
```

## arch/arm/plat-mxc/Kconfig
```kconfig
if ARCH_MXC

source "arch/arm/plat-mxc/devices/Kconfig"

menu "Freescale MXC Implementations"

choice
	prompt "Freescale CPU family:"
	default ARCH_IMX_V6_V7

config ARCH_IMX_V4_V5
	bool "i.MX1, i.MX21, i.MX25, i.MX27"
	select AUTO_ZRELADDR if !ZBOOT_ROM
	select ARM_PATCH_PHYS_VIRT
	help
	  This enables support for systems based on the Freescale i.MX ARMv4
	  and ARMv5 SoCs

config ARCH_IMX_V6_V7
	bool "i.MX3, i.MX5, i.MX6"
	select AUTO_ZRELADDR if !ZBOOT_ROM
	select ARM_PATCH_PHYS_VIRT
	select MIGHT_HAVE_CACHE_L2X0
	help
	  This enables support for systems based on the Freescale i.MX3, i.MX5
	  and i.MX6 family.

endchoice

source "arch/arm/mach-imx/Kconfig"

endmenu

config MXC_IRQ_PRIOR
	bool "Use IRQ priority"
	help
	  Select this if you want to use prioritized IRQ handling.
	  This feature prevents higher priority ISR to be interrupted
	  by lower priority IRQ even IRQF_DISABLED flag is not set.
	  This may be useful in embedded applications, where are strong
	  requirements for timing.
	  Say N here, unless you have a specialized requirement.

config MXC_TZIC
	bool

config MXC_AVIC
	bool

config MXC_PWM
	tristate "Enable PWM driver"
	select HAVE_PWM
	help
	  Enable support for the i.MX PWM controller(s).

config MXC_DEBUG_BOARD
	bool "Enable MXC debug board(for 3-stack)"
	help
	  The debug board is an integral part of the MXC 3-stack(PDK)
	  platforms, it can be attached or removed from the peripheral
	  board. On debug board, several debug devices(ethernet, UART,
	  buttons, LEDs and JTAG) are implemented. Between the MCU and
	  these devices, a CPLD is added as a bridge which performs
	  data/address de-multiplexing and decode, signal level shift,
	  interrupt control and various board functions.

config HAVE_EPIT
	bool

config MXC_USE_EPIT
	bool "Use EPIT instead of GPT"
	depends on HAVE_EPIT
	help
	  Use EPIT as the system timer on systems that have it. Normally you
	  don't have a reason to do so as the EPIT has the same features and
	  uses the same clocks as the GPT. Anyway, on some systems the GPT
	  may be in use for other purposes.

config MXC_ULPI
	bool

config ARCH_HAS_RNGA
	bool

config IMX_HAVE_IOMUX_V1
	bool

config ARCH_MXC_IOMUX_V3
	bool

config ARCH_MXC_AUDMUX_V1
	bool

config ARCH_MXC_AUDMUX_V2
	bool

config IRAM_ALLOC
	bool
	select GENERIC_ALLOCATOR

endif
```

## arch/arm/plat-mxc/devices/Kconfig
```kconfig
config IMX_HAVE_PLATFORM_ESDHC
	bool

config IMX_HAVE_PLATFORM_FEC
	bool
	default y if ARCH_MX25 || SOC_IMX27 || ARCH_MX35 || ARCH_MX51

config IMX_HAVE_PLATFORM_FLEXCAN
	select HAVE_CAN_FLEXCAN if CAN
	bool

config IMX_HAVE_PLATFORM_GPIO_KEYS
	bool
	default y if ARCH_MX51
	
config IMX_HAVE_PLATFORM_IMX2_WDT
	bool

config IMX_HAVE_PLATFORM_IMX_I2C
	bool

config IMX_HAVE_PLATFORM_IMX_SSI
	bool

config IMX_HAVE_PLATFORM_IMX_UART
	bool

config IMX_HAVE_PLATFORM_IMX_UDC
	bool

config IMX_HAVE_PLATFORM_MX1_CAMERA
	bool

config IMX_HAVE_PLATFORM_MX2_CAMERA
	bool

config IMX_HAVE_PLATFORM_MXC_NAND
	bool

config IMX_HAVE_PLATFORM_MXC_W1
	bool

config IMX_HAVE_PLATFORM_SPI_IMX
	bool
```

## arch/arm/plat-nomadik/Kconfig
```kconfig
# We keep common IP's here for Nomadik and other similar
# familiy of processors from ST-Ericsson. At the moment we have
# just MTU, others to follow soon.

config PLAT_NOMADIK
	bool
	depends on ARCH_NOMADIK || ARCH_U8500
	select CLKSRC_MMIO
	default y
	help
	  Common platform code for Nomadik and other ST-Ericsson
	  platforms.

if PLAT_NOMADIK

config HAS_MTU
	bool
	help
	  Support for Multi Timer Unit. MTU provides access
	  to multiple interrupt generating programmable
	  32-bit free running decrementing counters.

config NOMADIK_MTU_SCHED_CLOCK
	bool
	depends on HAS_MTU
	help
	  Use the Multi Timer Unit as the sched_clock.

endif
```

## arch/arm/plat-omap/Kconfig
```kconfig
if ARCH_OMAP

menu "TI OMAP Common Features"

config ARCH_OMAP_OTG
	bool

comment "OMAP Feature Selections"

config OMAP_DEBUG_DEVICES
	bool
	help
	  For debug cards on TI reference boards.

config OMAP_DEBUG_LEDS
	def_bool y if NEW_LEDS
	depends on OMAP_DEBUG_DEVICES
	select LEDS_CLASS

config POWER_AVS_OMAP
	bool "AVS(Adaptive Voltage Scaling) support for OMAP IP versions 1&2"
	depends on POWER_AVS && (ARCH_OMAP3 || ARCH_OMAP4) && PM
	select POWER_SUPPLY
	help
	  Say Y to enable AVS(Adaptive Voltage Scaling)
	  support on OMAP containing the version 1 or
	  version 2 of the SmartReflex IP.
	  V1 is the 65nm version used in OMAP3430.
	  V2 is the update for the 45nm version of the IP used in OMAP3630
	  and OMAP4430

	  Please note, that by default SmartReflex is only
	  initialized and not enabled. To enable the automatic voltage
	  compensation for vdd mpu and vdd core from user space,
	  user must write 1 to
		/debug/smartreflex/sr_<X>/autocomp,
	  where X is mpu_iva or core for OMAP3.
	  Optionally autocompensation can be enabled in the kernel
	  by default during system init via the enable_on_init flag
	  which an be passed as platform data to the smartreflex driver.

config POWER_AVS_OMAP_CLASS3
	bool "Class 3 mode of Smartreflex Implementation"
	depends on POWER_AVS_OMAP && TWL4030_CORE
	help
	  Say Y to enable Class 3 implementation of Smartreflex

	  Class 3 implementation of Smartreflex employs continuous hardware
	  voltage calibration.

config OMAP_RESET_CLOCKS
	bool "Reset unused clocks during boot"
	depends on ARCH_OMAP
	help
	  Say Y if you want to reset unused clocks during boot.
	  This option saves power, but assumes all drivers are
	  using the clock framework. Broken drivers that do not
	  yet use clock framework may not work with this option.
	  If you are booting from another operating system, you
	  probably do not want this option enabled until your
	  device drivers work properly.

config OMAP_MUX
	bool "OMAP multiplexing support"
	depends on ARCH_OMAP
	default y
	help
	  Pin multiplexing support for OMAP boards. If your bootloader
	  sets the multiplexing correctly, say N. Otherwise, or if unsure,
	  say Y.

config OMAP_MUX_DEBUG
	bool "Multiplexing debug output"
	depends on OMAP_MUX
	help
	  Makes the multiplexing functions print out a lot of debug info.
	  This is useful if you want to find out the correct values of the
	  multiplexing registers.

config OMAP_MUX_WARNINGS
	bool "Warn about pins the bootloader didn't set up"
	depends on OMAP_MUX
	default y
	help
	  Choose Y here to warn whenever driver initialization logic needs
	  to change the pin multiplexing setup.	 When there are no warnings
	  printed, it's safe to deselect OMAP_MUX for your product.

config OMAP_MBOX_FWK
	tristate "Mailbox framework support"
	depends on ARCH_OMAP && !ARCH_MULTIPLATFORM
	help
	  Say Y here if you want to use OMAP Mailbox framework support for
	  DSP, IVA1.0 and IVA2 in OMAP1/2/3.

config OMAP_MBOX_KFIFO_SIZE
	int "Mailbox kfifo default buffer size (bytes)"
	depends on OMAP_MBOX_FWK
	default 256
	help
	  Specify the default size of mailbox's kfifo buffers (bytes).
	  This can also be changed at runtime (via the mbox_kfifo_size
	  module parameter).

config OMAP_IOMMU_IVA2
	bool

config OMAP_MPU_TIMER
	bool "Use mpu timer"
	depends on ARCH_OMAP1
	help
	  Select this option if you want to use the OMAP mpu timer. This
	  timer provides more intra-tick resolution than the 32KHz timer,
	  but consumes more power.

config OMAP_32K_TIMER
	bool "Use 32KHz timer"
	depends on ARCH_OMAP16XX || ARCH_OMAP2PLUS
	default y if (ARCH_OMAP16XX || ARCH_OMAP2PLUS)
	help
	  Select this option if you want to enable the OMAP 32KHz timer.
	  This timer saves power compared to the OMAP_MPU_TIMER, and has
	  support for no tick during idle. The 32KHz timer provides less
	  intra-tick resolution than OMAP_MPU_TIMER. The 32KHz timer is
	  currently only available for OMAP16XX, 24XX, 34XX and OMAP4/5.

	  On OMAP2PLUS this value is only used for CONFIG_HZ and
	  CLOCK_TICK_RATE compile time calculation.
	  The actual timer selection is done in the board file
	  through the (DT_)MACHINE_START structure.


config OMAP3_L2_AUX_SECURE_SAVE_RESTORE
	bool "OMAP3 HS/EMU save and restore for L2 AUX control register"
	depends on ARCH_OMAP3 && PM
	default n
	help
	  Without this option, L2 Auxiliary control register contents are
	  lost during off-mode entry on HS/EMU devices. This feature
	  requires support from PPA / boot-loader in HS/EMU devices, which
	  currently does not exist by default.

config OMAP3_L2_AUX_SECURE_SERVICE_SET_ID
	int "Service ID for the support routine to set L2 AUX control"
	depends on OMAP3_L2_AUX_SECURE_SAVE_RESTORE
	default 43
	help
	  PPA routine service ID for setting L2 auxiliary control register.

config OMAP_DM_TIMER
	bool "Use dual-mode timer"
	depends on ARCH_OMAP16XX || ARCH_OMAP2PLUS
	help
	 Select this option if you want to use OMAP Dual-Mode timers.

config OMAP_SERIAL_WAKE
	bool "Enable wake-up events for serial ports"
	depends on ARCH_OMAP1 && OMAP_MUX
	default y
	help
	  Select this option if you want to have your system wake up
	  to data on the serial RX line. This allows you to wake the
	  system from serial console.

choice
	prompt "OMAP PM layer selection"
	depends on ARCH_OMAP
	default OMAP_PM_NOOP

config OMAP_PM_NOOP
	bool "No-op/debug PM layer"

endchoice

endmenu

endif
```
