## arch/arm/mach-npcm/Kconfig
```kconfig
menuconfig ARCH_NPCM
	bool "Nuvoton NPCM Architecture"
	depends on ARCH_MULTI_V7
	select PINCTRL

if ARCH_NPCM

config ARCH_NPCM7XX
	bool "Support for NPCM7xx BMC (Poleg)"
	depends on ARCH_MULTI_V7
	select PINCTRL_NPCM7XX
	select NPCM7XX_TIMER
	select GPIOLIB
	select CACHE_L2X0
	select ARM_GIC
	select HAVE_ARM_TWD if SMP
	select HAVE_ARM_SCU if SMP
	select ARM_ERRATA_764369 if SMP
	select ARM_ERRATA_720789
	select ARM_ERRATA_754322
	select ARM_ERRATA_794072
	select PL310_ERRATA_588369
	select PL310_ERRATA_727915
	select MFD_SYSCON
	help
	  General support for NPCM7xx BMC (Poleg).

	  Nuvoton NPCM7xx BMC based on the Cortex A9.

endif
```

## arch/arm/mach-ns9xxx/Kconfig
```kconfig
if ARCH_NS9XXX

menu "NS9xxx Implementations"

config NS9XXX_HAVE_SERIAL8250
	bool

config PROCESSOR_NS9360
	bool

config MODULE_CC9P9360
	bool
	select PROCESSOR_NS9360

config BOARD_A9M9750DEV
	select NS9XXX_HAVE_SERIAL8250
	bool

config BOARD_JSCC9P9360
	bool

config MACH_CC9P9360DEV
	bool "ConnectCore 9P 9360 on an A9M9750 Devboard"
	select MODULE_CC9P9360
	select BOARD_A9M9750DEV
	help
	  Say Y here if you are using the Digi ConnectCore 9P 9360
	  on an A9M9750 Development Board.

config MACH_CC9P9360JS
	bool "ConnectCore 9P 9360 on a JSCC9P9360 Devboard"
	select MODULE_CC9P9360
	select BOARD_JSCC9P9360
	help
	  Say Y here if you are using the Digi ConnectCore 9P 9360
	  on an JSCC9P9360 Development Board.

endmenu

endif
```

## arch/arm/mach-nspire/Kconfig
```kconfig
# SPDX-License-Identifier: GPL-2.0-only
config ARCH_NSPIRE
	bool "TI-NSPIRE based"
	depends on ARCH_MULTI_V4T
	depends on CPU_LITTLE_ENDIAN
	select CPU_ARM926T
	select GENERIC_IRQ_CHIP
	select ARM_AMBA
	select ARM_VIC
	select ARM_TIMER_SP804
	select NSPIRE_TIMER
	select POWER_RESET
	select POWER_RESET_SYSCON
	help
	  This enables support for systems using the TI-NSPIRE CPU
```

## arch/arm/mach-nuc93x/Kconfig
```kconfig
if ARCH_NUC93X

config CPU_NUC932
	bool
	help
	  Support for NUC932 of Nuvoton NUC93X CPUs.

menu "NUC932 Machines"

config MACH_NUC932EVB
	bool "Nuvoton NUC932 Evaluation Board"
	default y
	select CPU_NUC932
	help
	   Say Y here if you are using the Nuvoton NUC932EVB

endmenu

endif
```

## arch/arm/mach-omap/Kconfig
```kconfig
if ARCH_OMAP

menu "TI OMAP Implementations"

comment "OMAP Core Type"

config ARCH_OMAP730
	depends on ARCH_OMAP
	bool "OMAP730 Based System"
	select ARCH_OMAP_OTG

config ARCH_OMAP1510
	depends on ARCH_OMAP
	default y
	bool "OMAP1510 Based System"

config ARCH_OMAP16XX
	depends on ARCH_OMAP
	bool "OMAP16XX Based System"
	select ARCH_OMAP_OTG

config ARCH_OMAP_OTG
	bool

comment "OMAP Board Type"

config MACH_OMAP_INNOVATOR
	bool "TI Innovator"
	depends on ARCH_OMAP1510 || ARCH_OMAP16XX
	help
          TI OMAP 1510 or 1610 Innovator board support. Say Y here if you
          have such a board.

config MACH_OMAP_H2
	bool "TI H2 Support"
	depends on ARCH_OMAP16XX
    	help
	  TI OMAP 1610/1611B H2 board support. Say Y here if you have such
	  a board.

config MACH_OMAP_H3
	bool "TI H3 Support"
	depends on ARCH_OMAP16XX
    	help
	  TI OMAP 1710 H3 board support. Say Y here if you have such
	  a board.

config MACH_OMAP_H4
	bool "TI H4 Support"
	depends on ARCH_OMAP16XX
    	help
	  TI OMAP 1610 H4 board support. Say Y here if you have such
	  a board.

config MACH_OMAP_OSK
	bool "TI OSK Support"
	depends on ARCH_OMAP16XX
    	help
	  TI OMAP 5912 OSK (OMAP Starter Kit) board support. Say Y here
          if you have such a board.

config MACH_OMAP_PERSEUS2
	bool "TI Perseus2"
	depends on ARCH_OMAP730
    	help
	  Support for TI OMAP 730 Perseus2 board. Say Y here if you have such
	  a board.

config MACH_VOICEBLUE
	bool "Voiceblue"
	depends on ARCH_OMAP1510
	help
	  Support for Voiceblue GSM/VoIP gateway. Say Y here if you have such
	  board.

config MACH_NETSTAR
	bool "NetStar"
	depends on ARCH_OMAP1510
	help
	  Support for NetStar PBX. Say Y here if you have such a board.

config MACH_OMAP_GENERIC
	bool "Generic OMAP board"
	depends on ARCH_OMAP1510 || ARCH_OMAP16XX
	help
          Support for generic OMAP-1510, 1610 or 1710 board with
          no FPGA. Can be used as template for porting Linux to
          custom OMAP boards. Say Y here if you have a custom
          board.

comment "OMAP Feature Selections"

#config OMAP_BOOT_TAG
#	bool "OMAP bootloader information passing"
#        depends on ARCH_OMAP
#        default n
#        help
#          Say Y, if you have a bootloader which passes information
#          about your board and its peripheral configuration.

config OMAP_MUX
	bool "OMAP multiplexing support"
        depends on ARCH_OMAP
	default y
        help
          Pin multiplexing support for OMAP boards. If your bootloader
          sets the multiplexing correctly, say N. Otherwise, or if unsure,
          say Y.

config OMAP_MUX_DEBUG
	bool "Multiplexing debug output"
        depends on OMAP_MUX
        default n
        help
          Makes the multiplexing functions print out a lot of debug info.
          This is useful if you want to find out the correct values of the
          multiplexing registers.

config OMAP_MUX_WARNINGS
	bool "Warn about pins the bootloader didn't set up"
        depends on OMAP_MUX
        default y
        help
	  Choose Y here to warn whenever driver initialization logic needs
	  to change the pin multiplexing setup.  When there are no warnings
	  printed, it's safe to deselect OMAP_MUX for your product.

choice
        prompt "System timer"
	default OMAP_MPU_TIMER

config OMAP_MPU_TIMER
	bool "Use mpu timer"
	help
	  Select this option if you want to use the OMAP mpu timer. This
	  timer provides more intra-tick resolution than the 32KHz timer,
	  but consumes more power.

config OMAP_32K_TIMER
	bool "Use 32KHz timer"
	depends on ARCH_OMAP16XX
	help
	  Select this option if you want to enable the OMAP 32KHz timer.
	  This timer saves power compared to the OMAP_MPU_TIMER, and has
	  support for no tick during idle. The 32KHz timer provides less
	  intra-tick resolution than OMAP_MPU_TIMER. The 32KHz timer is
	  currently only available for OMAP-16xx.

endchoice

config OMAP_32K_TIMER_HZ
       int "Kernel internal timer frequency for 32KHz timer"
       range 32 1024
       depends on OMAP_32K_TIMER
       default "128"
       help
	  Kernel internal timer frequency should be a divisor of 32768,
	  such as 64 or 128.

choice
	prompt "Low-level debug console UART"
	depends on ARCH_OMAP
	default OMAP_LL_DEBUG_UART1

config OMAP_LL_DEBUG_UART1
	bool "UART1"

config OMAP_LL_DEBUG_UART2
	bool "UART2"

config OMAP_LL_DEBUG_UART3
	bool "UART3"

endchoice

config OMAP_ARM_195MHZ
	bool "OMAP ARM 195 MHz CPU"
	depends on ARCH_OMAP730
	help
          Enable 195MHz clock for OMAP CPU. If unsure, say N.

config OMAP_ARM_192MHZ
	bool "OMAP ARM 192 MHz CPU"
	depends on ARCH_OMAP16XX
	help
          Enable 192MHz clock for OMAP CPU. If unsure, say N.

config OMAP_ARM_182MHZ
	bool "OMAP ARM 182 MHz CPU"
	depends on ARCH_OMAP730
	help
          Enable 182MHz clock for OMAP CPU. If unsure, say N.

config OMAP_ARM_168MHZ
	bool "OMAP ARM 168 MHz CPU"
	depends on ARCH_OMAP1510 || ARCH_OMAP16XX || ARCH_OMAP730
	help
          Enable 168MHz clock for OMAP CPU. If unsure, say N.

config OMAP_ARM_120MHZ
	bool "OMAP ARM 120 MHz CPU"
	depends on ARCH_OMAP1510 || ARCH_OMAP16XX || ARCH_OMAP730
	help
          Enable 120MHz clock for OMAP CPU. If unsure, say N.

config OMAP_ARM_60MHZ
	bool "OMAP ARM 60 MHz CPU"
	depends on ARCH_OMAP1510 || ARCH_OMAP16XX || ARCH_OMAP730
        default y
	help
          Enable 60MHz clock for OMAP CPU. If unsure, say Y.

config OMAP_ARM_30MHZ
	bool "OMAP ARM 30 MHz CPU"
	depends on ARCH_OMAP1510 || ARCH_OMAP16XX || ARCH_OMAP730
	help
          Enable 30MHz clock for OMAP CPU. If unsure, say N.

endmenu

endif
```

## arch/arm/mach-omap1/Kconfig
```kconfig
# SPDX-License-Identifier: GPL-2.0-only
menuconfig ARCH_OMAP1
	bool "TI OMAP1"
	depends on ARCH_MULTI_V4T || ARCH_MULTI_V5
	depends on CPU_LITTLE_ENDIAN
	depends on ATAGS
	select ARCH_OMAP
	select ARCH_HAS_HOLES_MEMORYMODEL
	select ARCH_OMAP
	select CLKSRC_MMIO
	select FORCE_PCI if PCCARD
	select GPIOLIB
	help
	  Support for older TI OMAP1 (omap7xx, omap15xx or omap16xx)

if ARCH_OMAP1

menu "TI OMAP1 specific features"

comment "OMAP Core Type"

config ARCH_OMAP15XX
	depends on ARCH_MULTI_V4T
	default y
	bool "OMAP15xx Based System"
	select CPU_ARM925T
	select OMAP_MPU_TIMER

config ARCH_OMAP16XX
	depends on ARCH_MULTI_V5
	bool "OMAP16xx Based System"
	select ARCH_OMAP_OTG
	select CPU_ARM926T
	select OMAP_DM_TIMER

config ARCH_OMAP
	bool

comment "OMAP Feature Selections"

config OMAP_MUX
	bool "OMAP multiplexing support"
	default y
	help
	  Pin multiplexing support for OMAP boards. If your bootloader
	  sets the multiplexing correctly, say N. Otherwise, or if unsure,
	  say Y.

config OMAP_MUX_DEBUG
	bool "Multiplexing debug output"
	depends on OMAP_MUX
	help
	  Makes the multiplexing functions print out a lot of debug info.
	  This is useful if you want to find out the correct values of the
	  multiplexing registers.

config OMAP_MUX_WARNINGS
	bool "Warn about pins the bootloader didn't set up"
	depends on OMAP_MUX
	default y
	help
	  Choose Y here to warn whenever driver initialization logic needs
	  to change the pin multiplexing setup.	 When there are no warnings
	  printed, it's safe to deselect OMAP_MUX for your product.

config OMAP_32K_TIMER
	bool "Use 32KHz timer"
	depends on ARCH_OMAP16XX
	default ARCH_OMAP16XX
	help
	  Select this option if you want to enable the OMAP 32KHz timer.
	  This timer saves power compared to the OMAP_MPU_TIMER, and has
	  support for no tick during idle. The 32KHz timer provides less
	  intra-tick resolution than OMAP_MPU_TIMER. The 32KHz timer is
	  currently only available for OMAP16XX, 24XX, 34XX, OMAP4/5 and DRA7XX.

	  On OMAP2PLUS this value is only used for CONFIG_HZ and
	  CLOCK_TICK_RATE compile time calculation.
	  The actual timer selection is done in the board file
	  through the (DT_)MACHINE_START structure.

config OMAP_MPU_TIMER
	bool "Use mpu timer"
	depends on ARCH_OMAP1
	help
	  Select this option if you want to use the OMAP mpu timer. This
	  timer provides more intra-tick resolution than the 32KHz timer,
	  but consumes more power.

config OMAP_SERIAL_WAKE
	bool "Enable wake-up events for serial ports"
	depends on ARCH_OMAP1 && OMAP_MUX
	default y
	help
	  Select this option if you want to have your system wake up
	  to data on the serial RX line. This allows you to wake the
	  system from serial console.

config OMAP_RESET_CLOCKS
	bool "Reset unused clocks during boot"
	depends on ARCH_OMAP
	help
	  Say Y if you want to reset unused clocks during boot.
	  This option saves power, but assumes all drivers are
	  using the clock framework. Broken drivers that do not
	  yet use clock framework may not work with this option.
	  If you are booting from another operating system, you
	  probably do not want this option enabled until your
	  device drivers work properly.

config ARCH_OMAP_OTG
	bool

comment "OMAP Board Type"

config MACH_OMAP_OSK
	bool "TI OSK Support"
	depends on ARCH_OMAP16XX
	help
	  TI OMAP 5912 OSK (OMAP Starter Kit) board support. Say Y here
	  if you have such a board.

config MACH_OMAP_PALMTE
	bool "Palm Tungsten E"
	depends on ARCH_OMAP15XX
	help
	  Support for the Palm Tungsten E PDA.  To boot the kernel, you'll
	  need a PalmOS compatible bootloader; check out
	  http://palmtelinux.sourceforge.net/ for more information.
	  Say Y here if you have this PDA model, say N otherwise.

config MACH_SX1
	bool "Siemens SX1"
	depends on ARCH_OMAP15XX
	select I2C
	help
	  Support for the Siemens SX1 phone. To boot the kernel,
	  you'll need a SX1 compatible bootloader; check out
	  http://forum.oslik.ru and
	  https://www.handhelds.org/moin/moin.cgi/SiemensSX1
	  for more information.
	  Say Y here if you have such a phone, say NO otherwise.

config MACH_NOKIA770
	bool "Nokia 770"
	depends on ARCH_OMAP16XX
	help
	  Support for the Nokia 770 Internet Tablet. Say Y here if you
	  have such a device.

config MACH_AMS_DELTA
	bool "Amstrad E3 (Delta)"
	depends on ARCH_OMAP15XX
	select FIQ
	select GPIO_GENERIC_PLATFORM
	select LEDS_GPIO_REGISTER
	select REGULATOR
	select REGULATOR_FIXED_VOLTAGE
	help
	  Support for the Amstrad E3 (codename Delta) videophone. Say Y here
	  if you have such a device.

endmenu

endif
```
