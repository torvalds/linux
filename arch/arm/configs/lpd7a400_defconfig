## arch/arm/configs/meson6_tee_defconfig
```kconfig
CONFIG_KERNEL_LZMA=y
CONFIG_SYSVIPC=y
CONFIG_AUDIT=y
CONFIG_NO_HZ=y
CONFIG_HIGH_RES_TIMERS=y
CONFIG_BSD_PROCESS_ACCT=y
CONFIG_IKCONFIG=y
CONFIG_BLK_DEV_INITRD=y
CONFIG_KALLSYMS_ALL=y
CONFIG_EMBEDDED=y
CONFIG_MODULES=y
CONFIG_MODULE_UNLOAD=y
CONFIG_ARCH_MESON6=y
CONFIG_MESON_SUSPEND=y
CONFIG_MESON_LEGACY_REGISTER_API=y
CONFIG_MESON_TRUSTZONE=y
CONFIG_ARM_ERRATA_751472=y
CONFIG_ARM_ERRATA_754322=y
CONFIG_ARM_ERRATA_764369=y
CONFIG_SMP=y
CONFIG_NR_CPUS=2
CONFIG_PREEMPT=y
CONFIG_AEABI=y
CONFIG_HIGHMEM=y
CONFIG_CPU_FREQ=y
CONFIG_CPU_FREQ_DEFAULT_GOV_CONSERVATIVE=y
CONFIG_CPU_FREQ_GOV_ONDEMAND=y
CONFIG_CPU_FREQ_GOV_INTERACTIVE=y
CONFIG_AMLOGIC_MESON_CPUFREQ=y
CONFIG_VFP=y
CONFIG_NEON=y
CONFIG_BINFMT_MISC=y
CONFIG_WAKELOCK=y
CONFIG_PM_RUNTIME=y
CONFIG_PACKET=y
CONFIG_PACKET_DIAG=y
CONFIG_UNIX=y
CONFIG_UNIX_DIAG=y
CONFIG_NET_KEY=y
CONFIG_INET=y
CONFIG_IP_MULTICAST=y
CONFIG_IP_ADVANCED_ROUTER=y
CONFIG_IP_MULTIPLE_TABLES=y
CONFIG_INET_ESP=y
CONFIG_IPV6=y
CONFIG_IPV6_PRIVACY=y
CONFIG_IPV6_ROUTER_PREF=y
CONFIG_IPV6_OPTIMISTIC_DAD=y
CONFIG_INET6_AH=y
CONFIG_INET6_ESP=y
CONFIG_INET6_IPCOMP=y
CONFIG_IPV6_MIP6=y
CONFIG_IPV6_TUNNEL=y
CONFIG_IPV6_MULTIPLE_TABLES=y
CONFIG_NETFILTER=y
CONFIG_NF_CONNTRACK=y
CONFIG_NF_CONNTRACK_EVENTS=y
CONFIG_NF_CT_PROTO_DCCP=y
CONFIG_NF_CT_PROTO_SCTP=y
CONFIG_NF_CT_PROTO_UDPLITE=y
CONFIG_NF_CONNTRACK_AMANDA=y
CONFIG_NF_CONNTRACK_FTP=y
CONFIG_NF_CONNTRACK_H323=y
CONFIG_NF_CONNTRACK_IRC=y
CONFIG_NF_CONNTRACK_NETBIOS_NS=y
CONFIG_NF_CONNTRACK_PPTP=y
CONFIG_NF_CONNTRACK_SANE=y
CONFIG_NF_CONNTRACK_TFTP=y
CONFIG_NF_CT_NETLINK=y
CONFIG_NETFILTER_TPROXY=y
CONFIG_NETFILTER_XT_TARGET_CLASSIFY=y
CONFIG_NETFILTER_XT_TARGET_CONNMARK=y
CONFIG_NETFILTER_XT_TARGET_MARK=y
CONFIG_NETFILTER_XT_TARGET_NFLOG=y
CONFIG_NETFILTER_XT_TARGET_NFQUEUE=y
CONFIG_NETFILTER_XT_TARGET_TPROXY=y
CONFIG_NETFILTER_XT_TARGET_TRACE=y
CONFIG_NETFILTER_XT_MATCH_COMMENT=y
CONFIG_NETFILTER_XT_MATCH_CONNBYTES=y
CONFIG_NETFILTER_XT_MATCH_CONNLIMIT=y
CONFIG_NETFILTER_XT_MATCH_CONNMARK=y
CONFIG_NETFILTER_XT_MATCH_CONNTRACK=y
CONFIG_NETFILTER_XT_MATCH_HASHLIMIT=y
CONFIG_NETFILTER_XT_MATCH_HELPER=y
CONFIG_NETFILTER_XT_MATCH_IPRANGE=y
CONFIG_NETFILTER_XT_MATCH_LENGTH=y
CONFIG_NETFILTER_XT_MATCH_LIMIT=y
CONFIG_NETFILTER_XT_MATCH_MAC=y
CONFIG_NETFILTER_XT_MATCH_MARK=y
CONFIG_NETFILTER_XT_MATCH_POLICY=y
CONFIG_NETFILTER_XT_MATCH_PKTTYPE=y
CONFIG_NETFILTER_XT_MATCH_QTAGUID=y
CONFIG_NETFILTER_XT_MATCH_QUOTA=y
CONFIG_NETFILTER_XT_MATCH_QUOTA2=y
CONFIG_NETFILTER_XT_MATCH_QUOTA2_LOG=y
CONFIG_NETFILTER_XT_MATCH_SOCKET=y
CONFIG_NETFILTER_XT_MATCH_STATE=y
CONFIG_NETFILTER_XT_MATCH_STATISTIC=y
CONFIG_NETFILTER_XT_MATCH_STRING=y
CONFIG_NETFILTER_XT_MATCH_TIME=y
CONFIG_NETFILTER_XT_MATCH_U32=y
CONFIG_NF_CONNTRACK_IPV4=y
CONFIG_IP_NF_IPTABLES=y
CONFIG_IP_NF_MATCH_AH=y
CONFIG_IP_NF_MATCH_ECN=y
CONFIG_IP_NF_MATCH_TTL=y
CONFIG_IP_NF_FILTER=y
CONFIG_IP_NF_TARGET_REJECT=y
CONFIG_IP_NF_TARGET_REJECT_SKERR=y
CONFIG_NF_NAT_IPV4=y
CONFIG_IP_NF_TARGET_MASQUERADE=y
CONFIG_IP_NF_TARGET_NETMAP=y
CONFIG_IP_NF_TARGET_REDIRECT=y
CONFIG_IP_NF_MANGLE=y
CONFIG_IP_NF_RAW=y
CONFIG_IP_NF_ARPTABLES=y
CONFIG_IP_NF_ARPFILTER=y
CONFIG_IP_NF_ARP_MANGLE=y
CONFIG_NF_CONNTRACK_IPV6=y
CONFIG_IP6_NF_IPTABLES=y
CONFIG_IP6_NF_FILTER=y
CONFIG_IP6_NF_TARGET_REJECT=y
CONFIG_IP6_NF_TARGET_REJECT_SKERR=y
CONFIG_IP6_NF_MANGLE=y
CONFIG_IP6_NF_RAW=y
CONFIG_NF_NAT_IPV6=y
CONFIG_IP6_NF_TARGET_MASQUERADE=y
CONFIG_IP6_NF_TARGET_NPT=y
CONFIG_BRIDGE=y
# CONFIG_BRIDGE_IGMP_SNOOPING is not set
CONFIG_PHONET=y
CONFIG_NET_SCHED=y
CONFIG_NET_SCH_HTB=y
CONFIG_NET_SCH_INGRESS=y
CONFIG_NET_CLS_U32=y
CONFIG_NET_EMATCH=y
CONFIG_NET_EMATCH_U32=y
CONFIG_NET_CLS_ACT=y
CONFIG_NET_ACT_POLICE=y
CONFIG_NET_ACT_GACT=y
CONFIG_NET_ACT_MIRRED=y
CONFIG_BT=y
CONFIG_BT_RFCOMM=y
CONFIG_BT_RFCOMM_TTY=y
CONFIG_BT_BNEP=y
CONFIG_BT_BNEP_MC_FILTER=y
CONFIG_BT_BNEP_PROTO_FILTER=y
CONFIG_BT_HIDP=y
CONFIG_BT_HCIUART=y
CONFIG_BT_HCIUART_H4=y
CONFIG_CFG80211=y
CONFIG_MAC80211=y
CONFIG_RFKILL=y
CONFIG_RFKILL_INPUT=y
CONFIG_EARLY_INIT=y
CONFIG_I2C_AML=y
CONFIG_SARADC_AM=y
CONFIG_AM_REMOTE=y
# CONFIG_MESON_NEW_INPUT_REMOTE is not set
CONFIG_ADC_KEYPADS_AM=y
CONFIG_KEY_INPUT_CUSTOM_AM=y
CONFIG_MESON_INPUT_TOUCHSCREEN=y
CONFIG_FOCALTECH_CAPACITIVE_TOUCHSCREEN=y
CONFIG_GOODIX_GT81XX_CAPACITIVE_TOUCHSCREEN=y
CONFIG_GSLX680_CAPACITIVE_TOUCHSCREEN=y
CONFIG_GOODIX_GT9XX_CAPACITIVE_TOUCHSCREEN=y
CONFIG_TOUCHSCREEN_CT36X=y
CONFIG_SENSOR_DEVICES=y
CONFIG_GRAVITY_BMA250=y
CONFIG_GRAVITY_BMA222=y
CONFIG_GRAVITY_MMA7660=y
CONFIG_GRAVITY_MIR3DA=y
CONFIG_GRAVITY_LIS3DH=y
CONFIG_GRAVITY_MMA8452=y
CONFIG_GRAVITY_MC32X0=y
CONFIG_GRAVITY_DMARD06=y
CONFIG_GRAVITY_MMA865X=y
CONFIG_GRAVITY_LSM303D=y
CONFIG_GRAVITY_DMARD10=y
CONFIG_GRAVITY_KXTJ9=y
CONFIG_GRAVITY_STK8312=y
CONFIG_GRAVITY_MM3A310=y
CONFIG_GRAVITY_MXC622X=y
CONFIG_GRAVITY_MXC6255XC=y
CONFIG_LIGHT_CM36283=y
CONFIG_LIGHT_CM3232=y
CONFIG_LIGHT_CM3217=y
CONFIG_LIGHT_LTR501=y
CONFIG_LIGHT_EPL6814=y
CONFIG_LIGHT_ISL29023=y
CONFIG_LIGHT_STK220X=y
CONFIG_LIGHT_LTR558=y
CONFIG_AML_PMU_ALGORITHM_SUPPORT=m
CONFIG_AW_AXP=y
CONFIG_MESON_CS_DCDC_REGULATOR=y
CONFIG_AML_PMU=y
CONFIG_AML1212=y
CONFIG_RICOH_PMU=y
CONFIG_SECURITYKEY=y
CONFIG_EFUSE=y
CONFIG_AMLOGIC_USB=y
CONFIG_MMC_AML=y
CONFIG_AMLOGIC_SPI_NOR=y
CONFIG_AML_NEXT_GEN_NAND=y
CONFIG_AML_NAND_KEY=y
# CONFIG_AM_NAND is not set
CONFIG_AM_ETHERNET=y
CONFIG_AML_LAN8720=y
CONFIG_AML_IP101_PHY=y
CONFIG_AML_KSZ8091=y
CONFIG_AM_WIFI=y
CONFIG_AM_WIFI_SD_MMC=y
CONFIG_AM_WIFI_USB=y
CONFIG_SDIO_DHD_CDC_WIFI_40181_MODULE=m
CONFIG_BCMDHD_POWER_OFF_IN_SUSPEND=y
CONFIG_RTL8188EU=m
CONFIG_RTL8192CU=m
CONFIG_BT_DEVICE=y
CONFIG_VSYNC_RDMA=y
CONFIG_AM_VIDEO=y
CONFIG_AM_TV_OUTPUT2=y
CONFIG_FB_AM=y
CONFIG_FB_OSD2_CURSOR=y
CONFIG_FB_OSD2_DEFAULT_WIDTH=32
CONFIG_FB_OSD2_DEFAULT_HEIGHT=32
CONFIG_FB_OSD2_DEFAULT_WIDTH_VIRTUAL=32
CONFIG_FB_OSD2_DEFAULT_HEIGHT_VIRTUAL=32
CONFIG_AM_FB_EXT=y
CONFIG_AM_LOGO=y
CONFIG_AM_HDMI_ONLY=y
# CONFIG_TVIN_CSI is not set
CONFIG_POST_PROCESS_MANAGER=y
CONFIG_POST_PROCESS_MANAGER_PPSCALER=y
CONFIG_VIDEO_AMLOGIC_CAPTURE=y
CONFIG_AMLOGIC_CAPTURE_FRAME_ROTATE=y
CONFIG_AMLOGIC_VM_DISABLE_VIDEOLAYER=y
CONFIG_VIDEO_AMLOGIC_CAPTURE_GT2005=y
CONFIG_VIDEO_AMLOGIC_CAPTURE_GC0308=y
CONFIG_VIDEO_AMLOGIC_CAPTURE_GC0328=y
CONFIG_VIDEO_AMLOGIC_CAPTURE_GC2035=y
CONFIG_VIDEO_AMLOGIC_CAPTURE_OV5640=y
CONFIG_VIDEO_AMLOGIC_CAPTURE_HI253=y
CONFIG_V4L_AMLOGIC_VIDEO=y
CONFIG_V4L_AMLOGIC_VIDEO2=y
CONFIG_AMLOGIC_IONVIDEO=y
CONFIG_DEINTERLACE=y
# CONFIG_CRYPTO_AML_HW_CRYPRO is not set
# CONFIG_CRYPTO_DEVICE_DRIVER is not set
CONFIG_UEVENT_HELPER_PATH="/sbin/hotplug"
CONFIG_DEVTMPFS=y
CONFIG_DEVTMPFS_MOUNT=y
CONFIG_PROC_DEVICETREE=y
CONFIG_OF_SELFTEST=y
CONFIG_BLK_DEV_LOOP=y
CONFIG_SCSI=y
CONFIG_BLK_DEV_SD=y
CONFIG_BLK_DEV_SR=y
CONFIG_SCSI_MULTI_LUN=y
CONFIG_NETDEVICES=y
CONFIG_TUN=y
CONFIG_PPP=y
CONFIG_PPP_BSDCOMP=y
CONFIG_PPP_DEFLATE=y
CONFIG_PPP_FILTER=y
CONFIG_PPP_MPPE=y
CONFIG_PPP_MULTILINK=y
CONFIG_PPPOLAC=y
CONFIG_PPPOPNS=y
CONFIG_PPP_ASYNC=y
CONFIG_PPP_SYNC_TTY=y
CONFIG_USB_USBNET=y
# CONFIG_WLAN is not set
CONFIG_INPUT_POLLDEV=y
CONFIG_INPUT_EVDEV=y
CONFIG_INPUT_MISC=y
CONFIG_INPUT_UINPUT=y
CONFIG_DEVPTS_MULTIPLE_INSTANCES=y
CONFIG_MEDIA_CAMERA_SUPPORT=y
CONFIG_MEDIA_USB_SUPPORT=y
CONFIG_USB_VIDEO_CLASS=y
CONFIG_V4L_PLATFORM_DRIVERS=y
CONFIG_BACKLIGHT_LCD_SUPPORT=y
CONFIG_SND_USB_AUDIO=y
CONFIG_SND_AML_M6_SOC=y
CONFIG_SND_AML_M6_RT5631=y
CONFIG_SND_AML_M6_WM8960=y
CONFIG_SND_AML_M_DUMMY_CODEC=y
CONFIG_UHID=y
CONFIG_USB=y
CONFIG_USB_ACM=y
CONFIG_USB_STORAGE=y
CONFIG_USB_SERIAL=y
CONFIG_USB_SERIAL_OPTION=y
CONFIG_USB_GADGET=y
CONFIG_USB_GADGET_DWC_OTG=y
CONFIG_USB_G_ANDROID=y
CONFIG_MMC_DEBUG=y
CONFIG_UIO=y
CONFIG_UIO_PDRV=y
CONFIG_UIO_PDRV_GENIRQ=y
CONFIG_STAGING=y
CONFIG_ZSMALLOC=y
CONFIG_ZRAM=y
CONFIG_ZRAM_DEBUG=y
CONFIG_ANDROID=y
CONFIG_ANDROID_BINDER_IPC=y
CONFIG_ASHMEM=y
CONFIG_ANDROID_LOGGER=y
CONFIG_ANDROID_LOW_MEMORY_KILLER=y
CONFIG_ANDROID_INTF_ALARM_DEV=y
CONFIG_SYNC=y
CONFIG_EXT2_FS=y
CONFIG_EXT3_FS=y
CONFIG_EXT3_FS_POSIX_ACL=y
CONFIG_EXT3_FS_SECURITY=y
CONFIG_EXT4_FS=y
CONFIG_EXT4_FS_POSIX_ACL=y
CONFIG_EXT4_FS_SECURITY=y
CONFIG_EXT4_DEBUG=y
CONFIG_QUOTA=y
CONFIG_QFMT_V2=y
CONFIG_FUSE_FS=y
CONFIG_ISO9660_FS=y
CONFIG_JOLIET=y
CONFIG_ZISOFS=y
CONFIG_UDF_FS=y
CONFIG_MSDOS_FS=y
CONFIG_VFAT_FS=y
CONFIG_TMPFS=y
CONFIG_CRAMFS=y
CONFIG_NLS_CODEPAGE_437=y
CONFIG_NLS_ISO8859_1=y
CONFIG_PRINTK_TIME=y
CONFIG_MAGIC_SYSRQ=y
CONFIG_READABLE_ASM=y
CONFIG_DEBUG_FS=y
CONFIG_DEBUG_SECTION_MISMATCH=y
CONFIG_SCHEDSTATS=y
CONFIG_TIMER_STATS=y
CONFIG_DEBUG_INFO=y
# CONFIG_FTRACE is not set
CONFIG_SECURITY=y
CONFIG_SECURITY_NETWORK=y
CONFIG_SECURITY_SELINUX=y
CONFIG_CRC_T10DIF=y
CONFIG_CRC7=y
```

## arch/arm/configs/meson6tvc_h15_defconfig
```kconfig
CONFIG_KERNEL_LZMA=y
CONFIG_SYSVIPC=y
CONFIG_NO_HZ=y
CONFIG_HIGH_RES_TIMERS=y
CONFIG_BSD_PROCESS_ACCT=y
CONFIG_IKCONFIG=y
CONFIG_IKCONFIG_PROC=y
CONFIG_BLK_DEV_INITRD=y
CONFIG_KALLSYMS_ALL=y
CONFIG_EMBEDDED=y
CONFIG_MODULES=y
CONFIG_MODULE_UNLOAD=y
CONFIG_ARCH_MESON6TV=y
CONFIG_MESON_SUSPEND=y
CONFIG_MESON_LEGACY_REGISTER_API=y
CONFIG_ARM_ERRATA_751472=y
CONFIG_ARM_ERRATA_754322=y
CONFIG_ARM_ERRATA_764369=y
CONFIG_SMP=y
CONFIG_NR_CPUS=2
CONFIG_PREEMPT=y
CONFIG_AEABI=y
CONFIG_HIGHMEM=y
# CONFIG_COMPACTION is not set
CONFIG_CPU_FREQ=y
CONFIG_CPU_FREQ_DEFAULT_GOV_CONSERVATIVE=y
CONFIG_CPU_FREQ_GOV_ONDEMAND=y
CONFIG_AMLOGIC_MESON_CPUFREQ=y
CONFIG_VFP=y
CONFIG_NEON=y
CONFIG_BINFMT_MISC=y
CONFIG_WAKELOCK=y
CONFIG_PACKET=y
CONFIG_PACKET_DIAG=y
CONFIG_UNIX=y
CONFIG_UNIX_DIAG=y
CONFIG_NET_KEY=y
CONFIG_INET=y
CONFIG_IP_ADVANCED_ROUTER=y
CONFIG_IP_MULTIPLE_TABLES=y
CONFIG_INET_ESP=y
CONFIG_IPV6=y
CONFIG_IPV6_PRIVACY=y
CONFIG_IPV6_ROUTER_PREF=y
CONFIG_IPV6_OPTIMISTIC_DAD=y
CONFIG_INET6_AH=y
CONFIG_INET6_ESP=y
CONFIG_INET6_IPCOMP=y
CONFIG_IPV6_MIP6=y
CONFIG_IPV6_TUNNEL=y
CONFIG_IPV6_MULTIPLE_TABLES=y
CONFIG_NETFILTER=y
CONFIG_NF_CONNTRACK=y
CONFIG_NF_CONNTRACK_EVENTS=y
CONFIG_NF_CT_PROTO_DCCP=y
CONFIG_NF_CT_PROTO_SCTP=y
CONFIG_NF_CT_PROTO_UDPLITE=y
CONFIG_NF_CONNTRACK_AMANDA=y
CONFIG_NF_CONNTRACK_FTP=y
CONFIG_NF_CONNTRACK_H323=y
CONFIG_NF_CONNTRACK_IRC=y
CONFIG_NF_CONNTRACK_NETBIOS_NS=y
CONFIG_NF_CONNTRACK_PPTP=y
CONFIG_NF_CONNTRACK_SANE=y
CONFIG_NF_CONNTRACK_TFTP=y
CONFIG_NF_CT_NETLINK=y
CONFIG_NETFILTER_TPROXY=y
CONFIG_NETFILTER_XT_TARGET_CLASSIFY=y
CONFIG_NETFILTER_XT_TARGET_CONNMARK=y
CONFIG_NETFILTER_XT_TARGET_MARK=y
CONFIG_NETFILTER_XT_TARGET_NFLOG=y
CONFIG_NETFILTER_XT_TARGET_NFQUEUE=y
CONFIG_NETFILTER_XT_TARGET_TPROXY=y
CONFIG_NETFILTER_XT_TARGET_TRACE=y
CONFIG_NETFILTER_XT_MATCH_COMMENT=y
CONFIG_NETFILTER_XT_MATCH_CONNBYTES=y
CONFIG_NETFILTER_XT_MATCH_CONNLIMIT=y
CONFIG_NETFILTER_XT_MATCH_CONNMARK=y
CONFIG_NETFILTER_XT_MATCH_CONNTRACK=y
CONFIG_NETFILTER_XT_MATCH_HASHLIMIT=y
CONFIG_NETFILTER_XT_MATCH_HELPER=y
CONFIG_NETFILTER_XT_MATCH_IPRANGE=y
CONFIG_NETFILTER_XT_MATCH_LENGTH=y
CONFIG_NETFILTER_XT_MATCH_LIMIT=y
CONFIG_NETFILTER_XT_MATCH_MAC=y
CONFIG_NETFILTER_XT_MATCH_MARK=y
CONFIG_NETFILTER_XT_MATCH_POLICY=y
CONFIG_NETFILTER_XT_MATCH_PKTTYPE=y
CONFIG_NETFILTER_XT_MATCH_QTAGUID=y
CONFIG_NETFILTER_XT_MATCH_QUOTA=y
CONFIG_NETFILTER_XT_MATCH_QUOTA2=y
CONFIG_NETFILTER_XT_MATCH_QUOTA2_LOG=y
CONFIG_NETFILTER_XT_MATCH_SOCKET=y
CONFIG_NETFILTER_XT_MATCH_STATE=y
CONFIG_NETFILTER_XT_MATCH_STATISTIC=y
CONFIG_NETFILTER_XT_MATCH_STRING=y
CONFIG_NETFILTER_XT_MATCH_TIME=y
CONFIG_NETFILTER_XT_MATCH_U32=y
CONFIG_NF_CONNTRACK_IPV4=y
CONFIG_IP_NF_IPTABLES=y
CONFIG_IP_NF_MATCH_AH=y
CONFIG_IP_NF_MATCH_ECN=y
CONFIG_IP_NF_MATCH_TTL=y
CONFIG_IP_NF_FILTER=y
CONFIG_IP_NF_TARGET_REJECT=y
CONFIG_IP_NF_TARGET_REJECT_SKERR=y
CONFIG_NF_NAT_IPV4=y
CONFIG_IP_NF_TARGET_MASQUERADE=y
CONFIG_IP_NF_TARGET_NETMAP=y
CONFIG_IP_NF_TARGET_REDIRECT=y
CONFIG_IP_NF_MANGLE=y
CONFIG_IP_NF_RAW=y
CONFIG_IP_NF_ARPTABLES=y
CONFIG_IP_NF_ARPFILTER=y
CONFIG_IP_NF_ARP_MANGLE=y
CONFIG_NF_CONNTRACK_IPV6=y
CONFIG_IP6_NF_IPTABLES=y
CONFIG_IP6_NF_FILTER=y
CONFIG_IP6_NF_TARGET_REJECT=y
CONFIG_IP6_NF_TARGET_REJECT_SKERR=y
CONFIG_IP6_NF_MANGLE=y
CONFIG_IP6_NF_RAW=y
CONFIG_NF_NAT_IPV6=y
CONFIG_IP6_NF_TARGET_MASQUERADE=y
CONFIG_IP6_NF_TARGET_NPT=y
CONFIG_BRIDGE=y
# CONFIG_BRIDGE_IGMP_SNOOPING is not set
CONFIG_PHONET=y
CONFIG_NET_SCHED=y
CONFIG_NET_SCH_HTB=y
CONFIG_NET_SCH_INGRESS=y
CONFIG_NET_CLS_U32=y
CONFIG_NET_EMATCH=y
CONFIG_NET_EMATCH_U32=y
CONFIG_NET_CLS_ACT=y
CONFIG_NET_ACT_POLICE=y
CONFIG_NET_ACT_GACT=y
CONFIG_NET_ACT_MIRRED=y
CONFIG_CFG80211=y
CONFIG_MAC80211=y
CONFIG_AML_REG_DEBUG=y
# CONFIG_AML_RTC is not set
CONFIG_I2C_AML=y
CONFIG_SARADC_AM=y
CONFIG_AM_REMOTE=y
# CONFIG_MESON_NEW_INPUT_REMOTE is not set
CONFIG_ADC_KEYPADS_AM=y
CONFIG_KEY_INPUT_CUSTOM_AM=y
# CONFIG_AMLOGIC_BOARD_HAS_PMU is not set
CONFIG_MESON_CS_DCDC_REGULATOR=y
CONFIG_AM_SMARTCARD=y
CONFIG_AMLOGIC_USB=y
CONFIG_MMC_AML=y
# CONFIG_AML_NFTL_NEW is not set
# CONFIG_AM_NAND is not set
# CONFIG_AML_NEXT_NAND is not set
CONFIG_AM_ETHERNET=y
CONFIG_PHYLIB=y
CONFIG_AM_WIFI=y
CONFIG_AM_WIFI_SD_MMC=y
CONFIG_AM_WIFI_USB=y
CONFIG_RTL8188EU=m
CONFIG_RTL8192CU=m
CONFIG_AMAUDIO2=y
CONFIG_VSYNC_RDMA=y
CONFIG_AM_VIDEO=y
CONFIG_AM_VDEC_AVS=y
# CONFIG_AM_LCD_OUTPUT is not set
CONFIG_AML_TV_LCD=y
CONFIG_FB_AM=y
CONFIG_FB_OSD1_DEFAULT_BITS_PER_PIXEL=32
CONFIG_FB_OSD1_DEFAULT_WIDTH=1920
CONFIG_FB_OSD1_DEFAULT_HEIGHT=1080
CONFIG_FB_OSD1_DEFAULT_WIDTH_VIRTUAL=1920
CONFIG_FB_OSD1_DEFAULT_HEIGHT_VIRTUAL=2160
CONFIG_AM_LOGO=y
# CONFIG_AML_HDMI_TX is not set
CONFIG_TVIN=y
CONFIG_TVIN_VDIN=y
CONFIG_TVIN_AFE=y
CONFIG_TVIN_VBI=y
CONFIG_TVIN_HDMI=y
# CONFIG_TVIN_BT656 is not set
# CONFIG_TVIN_CSI is not set
CONFIG_VIUIN=y
CONFIG_VIDEO_AMLOGIC_CAPTURE=y
CONFIG_AMLOGIC_CAPTURE_FRAME_ROTATE=y
CONFIG_AMLOGIC_VM_DISABLE_VIDEOLAYER=y
CONFIG_V4L_AMLOGIC_VIDEO2=y
CONFIG_AMLOGIC_IONVIDEO=y
CONFIG_DEINTERLACE=y
CONFIG_D2D3_PROCESS=y
CONFIG_AM_VECM=y
CONFIG_AM_DVB=y
CONFIG_AM_ATBM8869=m
CONFIG_AM_SI2177=m
CONFIG_MALI400=y
CONFIG_MALI400_DEBUG=y
# CONFIG_CRYPTO_AML_HW_CRYPRO is not set
# CONFIG_CRYPTO_DEVICE_DRIVER is not set
CONFIG_UEVENT_HELPER_PATH="/sbin/hotplug"
CONFIG_DEVTMPFS=y
CONFIG_DEVTMPFS_MOUNT=y
CONFIG_PROC_DEVICETREE=y
CONFIG_OF_SELFTEST=y
CONFIG_BLK_DEV_LOOP=y
CONFIG_SCSI=y
CONFIG_BLK_DEV_SD=y
CONFIG_BLK_DEV_SR=y
CONFIG_SCSI_MULTI_LUN=y
CONFIG_NETDEVICES=y
CONFIG_MARVELL_PHY=y
CONFIG_AMLOGIC_PHY=y
CONFIG_SMSC_PHY=y
CONFIG_INPUT_POLLDEV=y
CONFIG_INPUT_EVDEV=y
CONFIG_INPUT_MISC=y
CONFIG_INPUT_UINPUT=y
CONFIG_DEVPTS_MULTIPLE_INSTANCES=y
CONFIG_POWER_SUPPLY=y
CONFIG_MEDIA_CAMERA_SUPPORT=y
CONFIG_MEDIA_USB_SUPPORT=y
CONFIG_USB_VIDEO_CLASS=y
CONFIG_V4L_PLATFORM_DRIVERS=y
CONFIG_BACKLIGHT_LCD_SUPPORT=y
CONFIG_SND_USB_AUDIO=y
CONFIG_SND_AML_M6_SOC=y
CONFIG_SND_AML_M_DUMMY_CODEC=y
CONFIG_SND_AML_M6TV_AUDIO_CODEC=y
CONFIG_UHID=y
CONFIG_USB=y
CONFIG_USB_ACM=y
CONFIG_USB_STORAGE=y
CONFIG_USB_SERIAL=y
CONFIG_USB_GADGET=y
CONFIG_RTC_CLASS=y
CONFIG_UIO=y
CONFIG_UIO_PDRV=y
CONFIG_UIO_PDRV_GENIRQ=y
CONFIG_STAGING=y
CONFIG_ZSMALLOC=y
CONFIG_ZRAM=y
CONFIG_ZRAM_DEBUG=y
CONFIG_ANDROID=y
CONFIG_ANDROID_BINDER_IPC=y
CONFIG_ASHMEM=y
CONFIG_ANDROID_LOGGER=y
CONFIG_ANDROID_LOW_MEMORY_KILLER=y
CONFIG_ANDROID_INTF_ALARM_DEV=y
CONFIG_SYNC=y
CONFIG_EXT2_FS=y
CONFIG_EXT3_FS=y
CONFIG_EXT3_FS_POSIX_ACL=y
CONFIG_EXT3_FS_SECURITY=y
CONFIG_EXT4_FS=y
CONFIG_EXT4_FS_POSIX_ACL=y
CONFIG_EXT4_FS_SECURITY=y
CONFIG_EXT4_DEBUG=y
CONFIG_QUOTA=y
CONFIG_QFMT_V2=y
CONFIG_FUSE_FS=y
CONFIG_ISO9660_FS=y
CONFIG_JOLIET=y
CONFIG_ZISOFS=y
CONFIG_UDF_FS=y
CONFIG_MSDOS_FS=y
CONFIG_VFAT_FS=y
CONFIG_TMPFS=y
CONFIG_CONFIGFS_FS=y
CONFIG_CRAMFS=y
CONFIG_NLS_CODEPAGE_437=y
CONFIG_NLS_ISO8859_1=y
CONFIG_PRINTK_TIME=y
CONFIG_MAGIC_SYSRQ=y
CONFIG_READABLE_ASM=y
CONFIG_DEBUG_FS=y
CONFIG_DEBUG_SECTION_MISMATCH=y
CONFIG_SCHEDSTATS=y
CONFIG_TIMER_STATS=y
CONFIG_DEBUG_INFO=y
CONFIG_RCU_CPU_STALL_TIMEOUT=60
# CONFIG_FTRACE is not set
CONFIG_CRC_T10DIF=y
CONFIG_CRC7=y
```
