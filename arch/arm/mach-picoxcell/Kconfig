## arch/arm/mach-picoxcell/Kconfig
```kconfig
config ARCH_PICOXCELL
	bool "Picochip PicoXcell"
	depends on ARCH_MULTI_V6
	select ARM_VIC
	select DW_APB_TIMER_OF
	select GPIOLIB
	select HAVE_TCM
	select NO_IOPORT_MAP
```

## arch/arm/mach-prima2/Kconfig
```kconfig
menuconfig ARCH_SIRF
	bool "CSR SiRF"
	depends on ARCH_MULTI_V7
	select ARCH_HAS_RESET_CONTROLLER
	select RESET_CONTROLLER
	select GENERIC_IRQ_CHIP
	select GPIOLIB
	select NO_IOPORT_MAP
	select REGMAP
	select PINCTRL
	select PINCTRL_SIRF
	help
	  Support for CSR SiRFprimaII/Marco/Polo platforms

if ARCH_SIRF

comment "CSR SiRF atlas6/primaII/Atlas7 Specific Features"

config ARCH_ATLAS6
	bool "CSR SiRFSoC ATLAS6 ARM Cortex A9 Platform"
	default y
	select SIRF_IRQ
	help
          Support for CSR SiRFSoC ARM Cortex A9 Platform

config ARCH_ATLAS7
	bool "CSR SiRFSoC ATLAS7 ARM Cortex A7 Platform"
	default y
	select ARM_GIC
	select CPU_V7
	select ATLAS7_TIMER
	select HAVE_ARM_SCU if SMP
	select HAVE_SMP
	help
          Support for CSR SiRFSoC ARM Cortex A7 Platform

config ARCH_PRIMA2
	bool "CSR SiRFSoC PRIMA2 ARM Cortex A9 Platform"
	default y
	select SIRF_IRQ
	select ZONE_DMA
	select PRIMA2_TIMER
	help
          Support for CSR SiRFSoC ARM Cortex A9 Platform

config SIRF_IRQ
	bool

endif
```

## arch/arm/mach-pxa/Kconfig
```kconfig
# SPDX-License-Identifier: GPL-2.0-only
menuconfig ARCH_PXA
	bool "PXA2xx/PXA3xx-based"
	depends on ARCH_MULTI_V5
	depends on CPU_LITTLE_ENDIAN
	select ARM_CPU_SUSPEND if PM
	select CLKSRC_PXA
	select CLKSRC_MMIO
	select TIMER_OF
	select CPU_XSCALE if !CPU_XSC3
	select GPIO_PXA
	select GPIOLIB
	select PLAT_PXA
	help
	  Support for Intel/Marvell's PXA2xx/PXA3xx processor line.

if ARCH_PXA

config MACH_PXA25X_DT
	bool "Support PXA25x platforms from device tree"
	select PINCTRL
	select POWER_SUPPLY
	select PXA25x
	select USE_OF
	help
	  Include support for Marvell PXA25x based platforms using
	  the device tree. Needn't select any other machine while
	  MACH_PXA25x_DT is enabled.

config MACH_PXA27X_DT
	bool "Support PXA27x platforms from device tree"
	select PINCTRL
	select POWER_SUPPLY
	select PXA27x
	select USE_OF
	help
	  Include support for Marvell PXA27x based platforms using
	  the device tree. Needn't select any other machine while
	  MACH_PXA27X_DT is enabled.

config MACH_PXA3XX_DT
	bool "Support PXA3xx platforms from device tree"
	select CPU_PXA300
	select CPU_PXA310
	select CPU_PXA320
	select PINCTRL
	select POWER_SUPPLY
	select PXA3xx
	select USE_OF
	help
	  Include support for Marvell PXA3xx based platforms using
	  the device tree. Needn't select any other machine while
	  MACH_PXA3XX_DT is enabled.

if ATAGS

comment "Legacy board files"

config ARCH_GUMSTIX
	bool "Gumstix XScale 255 boards"
	select PXA25x
	help
	  Say Y here if you intend to run this kernel on
	  Basix, Connex, ws-200ax, ws-400ax systems

choice
	prompt "Gumstix Carrier/Expansion Board"
	depends on ARCH_GUMSTIX

config GUMSTIX_AM200EPD
	bool "Enable AM200EPD board support"

config GUMSTIX_AM300EPD
	bool "Enable AM300EPD board support"

endchoice

config PXA_SHARPSL
	bool "SHARP Zaurus SL-5600, SL-C7xx and SL-Cxx00 Models"
	select SHARP_PARAM
	select SHARP_SCOOP
	help
	  Say Y here if you intend to run this kernel on a
	  Sharp Zaurus SL-5600 (Poodle), SL-C700 (Corgi),
	  SL-C750 (Shepherd), SL-C760 (Husky), SL-C1000 (Akita),
	  SL-C3000 (Spitz), SL-C3100 (Borzoi) or SL-C6000x (Tosa)
	  handheld computer.

config PXA_SHARPSL_DETECT_MACH_ID
	bool "Detect machine ID at run-time in the decompressor"
	depends on PXA_SHARPSL
	help
	  Say Y here if you want the zImage decompressor to detect
	  the Zaurus machine ID at run-time. For latest kexec-based
	  boot loader, this is not necessary.

config MACH_AKITA
	bool "Enable Sharp SL-1000 (Akita) Support"
	depends on PXA_SHARPSL
	select I2C
	select I2C_PXA
	select MACH_SPITZ
	select PXA27x
	select PXA_SHARP_Cxx00

config MACH_SPITZ
	bool "Enable Sharp Zaurus SL-3000 (Spitz) Support"
	depends on PXA_SHARPSL
	select PXA27x
	select PXA_SHARP_Cxx00

config MACH_BORZOI
	bool "Enable Sharp Zaurus SL-3100 (Borzoi) Support"
	depends on PXA_SHARPSL
	select PXA27x
	select PXA_SHARP_Cxx00

endif # ATAGS

config PXA25x
	bool
	select CPU_XSCALE
	help
	  Select code specific to PXA21x/25x/26x variants

config PXA27x
	bool
	select CPU_XSCALE
	help
	  Select code specific to PXA27x variants

config PXA3xx
	bool
	select CPU_XSC3
	help
	  Select code specific to PXA3xx variants

config CPU_PXA300
	bool
	select PXA3xx
	help
	  PXA300 (codename Monahans-L)

config CPU_PXA310
	bool
	select CPU_PXA300
	help
	  PXA310 (codename Monahans-LV)

config CPU_PXA320
	bool
	select PXA3xx
	help
	  PXA320 (codename Monahans-P)

config PXA_SHARP_Cxx00
	bool
	select SHARPSL_PM
	help
	  Enable common support for Sharp Cxx00 models

config SHARPSL_PM
	bool
	select APM_EMULATION
	select SHARPSL_PM_MAX1111

config SHARPSL_PM_MAX1111
	bool
	select HWMON
	select SENSORS_MAX1111
	select SPI
	select SPI_MASTER

endif
```

## arch/arm/mach-qcom/Kconfig
```kconfig
# SPDX-License-Identifier: GPL-2.0-only
menuconfig ARCH_QCOM
	bool "Qualcomm Support"
	depends on ARCH_MULTI_V7
	select ARM_GIC
	select ARM_AMBA
	select PINCTRL
	select QCOM_SCM if SMP
	help
	  Support for Qualcomm's devicetree based systems.

if ARCH_QCOM

config ARCH_IPQ40XX
	bool "Enable support for IPQ40XX"
	select CLKSRC_QCOM
	select HAVE_ARM_ARCH_TIMER

config ARCH_MSM8X60
	bool "Enable support for MSM8X60"
	select CLKSRC_QCOM

config ARCH_MSM8909
	bool "Enable support for MSM8909"
	select HAVE_ARM_ARCH_TIMER

config ARCH_MSM8916
	bool "Enable support for MSM8916"
	select HAVE_ARM_ARCH_TIMER
	help
	  Enable support for the Qualcomm Snapdragon 410 (MSM8916/APQ8016).

	  Note that ARM64 is the main supported architecture for MSM8916.
	  The ARM32 option is intended for a few devices with signed firmware
	  that does not allow booting ARM64 kernels.

config ARCH_MSM8960
	bool "Enable support for MSM8960"
	select CLKSRC_QCOM

config ARCH_MSM8974
	bool "Enable support for MSM8974"
	select HAVE_ARM_ARCH_TIMER

config ARCH_MDM9615
	bool "Enable support for MDM9615"
	select CLKSRC_QCOM

config ARCH_MDM9607
	bool "Enable support for MDM9607"
	select ARM_GIC
	select CPU_V7
	select REGULATOR
	select REGULATOR_RPM_SMD
	select HAVE_ARM_ARCH_TIMER
	select MSM_RPM_SMD
	select MEMORY_HOLE_CARVEOUT
	select MSM_CORTEX_A7
	select PINCTRL
	select QCOM_GDSC
	select USE_PINCTRL_IRQ
	select MSM_IRQ
	select MSM_PM if PM
	select PM_DEVFREQ
	select MSM_DEVFREQ_DEVBW
	select MSM_BIMC_BWMON
	select DEVFREQ_GOV_MSM_BW_HWMON
	select HWSPINLOCK
	select MTD_UBI
	select HAVE_CLK_PREPARE
	help
	  Enable support for MDM9607.

	  This enables support for MDM9607 SoC devicetree based systems.
	  If you do not wish to build a kernel that runs on this
	  chipset or if you are unsure, say 'N' here.
endif
```

## arch/arm/mach-rda/Kconfig
```kconfig
menuconfig ARCH_RDA
	bool "RDA Micro SoCs"
	depends on ARCH_MULTI_V7
	select RDA_INTC
	select RDA_TIMER
	help
	  This enables support for the RDA Micro 8810PL SoC family.
```

## arch/arm/mach-realtek/Kconfig
```kconfig
# SPDX-License-Identifier: GPL-2.0-or-later
menuconfig ARCH_REALTEK
	bool "Realtek SoCs"
	depends on ARCH_MULTI_V7
	select ARM_GIC
	select ARM_GLOBAL_TIMER
	select CLKSRC_ARM_GLOBAL_TIMER_SCHED_CLOCK
	select GENERIC_IRQ_CHIP
	select RESET_CONTROLLER
	help
	  This enables support for the Realtek RTD1195 SoC family.
```

## arch/arm/mach-realview/Kconfig
```kconfig
# SPDX-License-Identifier: GPL-2.0-only
menuconfig ARCH_REALVIEW
	bool "ARM Ltd. RealView family"
	depends on ARCH_MULTI_V5 || ARCH_MULTI_V6 || ARCH_MULTI_V7
	select ARM_AMBA
	select ARM_GIC
	select ARM_TIMER_SP804
	select CLK_SP810
	select GPIO_PL061 if GPIOLIB
	select HAVE_ARM_SCU if SMP
	select HAVE_ARM_TWD if SMP
	select HAVE_PATA_PLATFORM
	select HAVE_TCM
	select ICST
	select MACH_REALVIEW_EB if ARCH_MULTI_V5
	select MFD_SYSCON
	select PLAT_VERSATILE
	select POWER_RESET
	select POWER_RESET_VERSATILE
	select POWER_SUPPLY
	select SOC_REALVIEW
	help
	  This enables support for ARM Ltd RealView boards.

if ARCH_REALVIEW

config MACH_REALVIEW_EB
	bool "Support RealView(R) Emulation Baseboard"
	select ARM_GIC
	select CPU_ARM926T if ARCH_MULTI_V5
	help
	  Include support for the ARM(R) RealView(R) Emulation Baseboard
	  platform. On an ARMv5 kernel, this will include support for
	  the ARM926EJ-S core tile, while on an ARMv6/v7 kernel, at least
	  one of the ARM1136, ARM1176, ARM11MPCore or Cortex-A9MPCore
	  core tile options should be enabled.

config REALVIEW_EB_ARM1136
	bool "Support ARM1136J(F)-S Tile"
	depends on MACH_REALVIEW_EB && ARCH_MULTI_V6
	select CPU_V6
	help
	  Enable support for the ARM1136 tile fitted to the
	  Realview(R) Emulation Baseboard platform.

config REALVIEW_EB_ARM1176
	bool "Support ARM1176JZ(F)-S Tile"
	depends on MACH_REALVIEW_EB && ARCH_MULTI_V6
	help
	  Enable support for the ARM1176 tile fitted to the
	  Realview(R) Emulation Baseboard platform.

config REALVIEW_EB_A9MP
	bool "Support Multicore Cortex-A9 Tile"
	depends on MACH_REALVIEW_EB && ARCH_MULTI_V7
	help
	  Enable support for the Cortex-A9MPCore tile fitted to the
	  Realview(R) Emulation Baseboard platform.

config REALVIEW_EB_ARM11MP
	bool "Support ARM11MPCore Tile"
	depends on MACH_REALVIEW_EB && ARCH_MULTI_V6
	select HAVE_SMP
	help
	  Enable support for the ARM11MPCore tile fitted to the Realview(R)
	  Emulation Baseboard platform.

config MACH_REALVIEW_PB11MP
	bool "Support RealView(R) Platform Baseboard for ARM11MPCore"
	depends on ARCH_MULTI_V6
	select HAVE_SMP
	help
	  Include support for the ARM(R) RealView(R) Platform Baseboard for
	  the ARM11MPCore.  This platform has an on-board ARM11MPCore and has
	  support for PCI-E and Compact Flash.

# ARMv6 CPU without K extensions, but does have the new exclusive ops
config MACH_REALVIEW_PB1176
	bool "Support RealView(R) Platform Baseboard for ARM1176JZF-S"
	depends on ARCH_MULTI_V6
	select CPU_V6
	select HAVE_TCM
	help
	  Include support for the ARM(R) RealView(R) Platform Baseboard for
	  ARM1176JZF-S.

config MACH_REALVIEW_PBA8
	bool "Support RealView(R) Platform Baseboard for Cortex(tm)-A8 platform"
	depends on ARCH_MULTI_V7
	help
	  Include support for the ARM(R) RealView Platform Baseboard for
	  Cortex(tm)-A8.  This platform has an on-board Cortex-A8 and has
	  support for PCI-E and Compact Flash.

config MACH_REALVIEW_PBX
	bool "Support RealView(R) Platform Baseboard Explore for Cortex-A9"
	depends on ARCH_MULTI_V7
	select ZONE_DMA
	help
	  Include support for the ARM(R) RealView(R) Platform Baseboard
	  Explore.

endif
```

## arch/arm/mach-rk2818/Kconfig
```kconfig
if ARCH_RK2818

comment "ROCKCHIP rk2818 Board Type"
	depends on ARCH_RK2818

config MACH_RK2818MID
	depends on ARCH_RK2818
	default y
	bool "ROCKCHIP Board For Mid"
	help
	  Support for the ROCKCHIP Board For Rk2818 Mid.

config MACH_RK2818PHONE
        depends on ARCH_RK2818
        default y
        bool "ROCKCHIP Board For PHONE"
        help
          Support for the ROCKCHIP Board For Rk2818 Phone.

config MACH_RAHO
			depends on ARCH_RK2818
        default n
        bool "ROCKCHIP Board For raho"
        help
          Support for the ROCKCHIP Board For raho Phone.

config MACH_RK2818INFO
			depends on ARCH_RK2818
        default n
        bool "ROCKCHIP Board For Info"
        help
          Support for the ROCKCHIP Board For Info Telephone.
          
config MACH_RK2818INFO_IT50
			depends on ARCH_RK2818
        default n
        bool "ROCKCHIP Board For Info It50"
        help
          Support for the ROCKCHIP Board For Info IT50 Telephone. 
                   
config RK28_GPIO_IRQ
	int
	default 16 if ARCH_RK2818	
	default 0	
config RK28_ADC
	tristate "RK28 ADC Driver"
	depends on ARCH_RK2818
	default y
	---help---
		RK28 ADC Driver

config RK28_USB_WAKE
	bool "Enable wake-up events for USB ports"
	depends on ARCH_RK2818 && PM
	default y
	help
	  Select this option if you want to have your system wake up from USB.
	  This will poll usb every second while suspend, so consumes more power.

config WIFI_CONTROL_FUNC
        bool "Enable WiFi control function abstraction"
        help
          Enables Power/Reset/Carddetect function abstraction
config RK2818_SOC_PM
  bool "Enable soc power manager function"
		default n
endif
```
