## arch/arm/mach-rk29/Kconfig
```kconfig
if ARCH_RK29

choice
	prompt "Select Board Type"
	depends on ARCH_RK29
	default MACH_RK29SDK

config MACH_RK29SDK
	depends on ARCH_RK29
	bool "ROCKCHIP Board Rk29 For Sdk"
        help
	  Support for the ROCKCHIP Board For Rk29 Sdk.

config MACH_RK29SDK_DDR3
        depends on ARCH_RK29
        bool "ROCKCHIP Board Rk29 For DDR3 SDK"
        help
          Support for the ROCKCHIP Board For Rk29 Sdk.

config MACH_RK29WINACCORD
	depends on ARCH_RK29
	bool "ROCKCHIP Board Rk29 For Winaccord"
        help
	  Support for the ROCKCHIP Board For Rk29 Winaccord.

config MACH_RK29_K97
        depends on ARCH_RK29
        bool "ROCKCHIP Board Rk29 For K97"
        help
          Support for the ROCKCHIP Board For Rk29 K97.

config MACH_RK29FIH
	depends on ARCH_RK29
	bool "ROCKCHIP Board Rk29 For FIH"
        help
	  Support for the ROCKCHIP Board For Rk29 FIH.

config MACH_RK29_MALATA
	depends on ARCH_RK29
	bool "ROCKCHIP Board Rk29 For Malata"
        help
	  Support for the ROCKCHIP Board For Rk29 Malata.

config MACH_RK29_PHONESDK
	depends on ARCH_RK29
	bool "ROCKCHIP Board Rk29 For Phone Sdk"
        help
	  Support for the ROCKCHIP Board For Rk29 Phone Sdk.

config MACH_RK29_A22
	depends on ARCH_RK29
	bool "ROCKCHIP Board Rk29 For A22"
        help
	  Support for the ROCKCHIP Board For A22.

config MACH_RK29_TD8801_V2
	depends on ARCH_RK29
	bool "ROCKCHIP Board Rk29 For TD8801_v2"
        help
	  Support for the ROCKCHIP Board For TD8801_v2.

config MACH_RK29_PHONEPADSDK
	depends on ARCH_RK29
	bool "ROCKCHIP Board Rk29 For Phone Pad Sdk"
        help
	  Support for the ROCKCHIP Board For Rk29 Phone Pad Sdk.
	  
config MACH_RK29_newton
		depends on ARCH_RK29
		bool "ROCKCHIP Board Rk29 For project newton"
		help
		  Support for the ROCKCHIP Board For project newton.

config MACH_RK29_PHONE_Z5
	depends on ARCH_RK29
	bool "ROCKCHIP Board Rk29 For Z5"
        help
	  Support for the ROCKCHIP Board For Z5.
		  
config MACH_RK29_P91
	depends on ARCH_RK29
	bool "ROCKCHIP Board Rk29 For P91"
        help
	  Support for the ROCKCHIP Board For Rk29 P91.
	  
endchoice

config RK29_NEWTON_CLOCK
	depends on MACH_RK29_newton
	bool "enable newton 1.2G cpu clock support"
	help
	  support for newton 1.2G cpu clock.

choice DDR_TYPE
	prompt "DDR Memory Type"
	default DDR_TYPE_DDR3_DEFAULT 

config DDR_TYPE_DDRII
	bool "DDRII"
	help
	  Support for DDRII memory

config DDR_TYPE_LPDDR
	bool "mobile DDR"
	help
	  Support for mobile DDR, MCP device

config DDR_TYPE_DDR3_800D
	bool "DDR3-800 5-5-5"

config DDR_TYPE_DDR3_800E
	bool "DDR3-800 6-6-6"

config DDR_TYPE_DDR3_1066E
	bool "DDR3-1066 6-6-6"

config DDR_TYPE_DDR3_1066F
	bool "DDR3-1066 7-7-7"

config DDR_TYPE_DDR3_1066G
	bool "DDR3-1066 8-8-8"

config DDR_TYPE_DDR3_1333F
	bool "DDR3-1333 7-7-7"

config DDR_TYPE_DDR3_1333G
	bool "DDR3-1333 8-8-8"

config DDR_TYPE_DDR3_1333H
	bool "DDR3-1333 9-9-9"

config DDR_TYPE_DDR3_1333J
	bool "DDR3-1333 10-10-10"

config DDR_TYPE_DDR3_1600G
	bool "DDR3-1600 8-8-8"

config DDR_TYPE_DDR3_1600H
	bool "DDR3-1600 9-9-9"

config DDR_TYPE_DDR3_1600J
	bool "DDR3-1600 10-10-10"

config DDR_TYPE_DDR3_1600K
	bool "DDR3-1600 11-11-11"

config DDR_TYPE_DDR3_1866J
	bool "DDR3-1866 10-10-10"

config DDR_TYPE_DDR3_1866K
	bool "DDR3-1866 11-11-11"

config DDR_TYPE_DDR3_1866L
	bool "DDR3-1866 12-12-12"

config DDR_TYPE_DDR3_1866M
	bool "DDR3-1866 13-13-13"

config DDR_TYPE_DDR3_2133K
	bool "DDR3-2133 11-11-11"

config DDR_TYPE_DDR3_2133L
	bool "DDR3-2133 12-12-12"

config DDR_TYPE_DDR3_2133M
	bool "DDR3-2133 13-13-13"

config DDR_TYPE_DDR3_2133N
	bool "DDR3-2133 14-14-14"

config DDR_TYPE_DDR3_DEFAULT
	bool "DDR3 (Type default)"

endchoice

config RK29_MEM_SIZE_M
	int "DDR Memory size (in MB)"
	default 512

config DDR_SDRAM_FREQ
	int "DDR SDRAM frequence (in MHz)"
	default 400

config DDR_FREQ
	bool "Enable DDR frequency scaling"
	default y

config DDR_RECONFIG
	bool "Enable dynamic DDR reconfiguration (EXPERIMENTAL)"

config WIFI_CONTROL_FUNC
        bool "Enable WiFi control function abstraction"
        help
          Enables Power/Reset/Carddetect function abstraction

menu "RK29 VPU (Video Processing Unit) support"

config RK29_VPU
	bool "VPU service driver in kernel"
	depends on ARCH_RK29
	default y

config RK29_VPU_DEBUG
	bool "RK29 VPU debugging"
        depends on RK29_VPU != n
        help
          This is an option for the developers; most people should
          say N here.  This enables RK29 VPU driver debugging.

endmenu

config RK29_JTAG
	bool "Enable JTAG support (debug only)"
	help
	  This is an option for SDK board. Always enable JTAG clock,
	  but consumes more power.

config RK29_LAST_LOG
	bool "Save the last kernel log on /proc/last_log"
	depends on DEBUG_KERNEL && PRINTK
	default y
	help
	  It is only intended for debugging.

menu "support for RK29 power manage "
config RK29_WORKING_POWER_MANAGEMENT
	bool "Support power saving in working"
	default n
	help 
	  a series of measures to reduce working power

config RK29_CLK_SWITCH_TO_32K
	bool "Support clock switch to 32.768k"
	default n

config RK29_GPIO_SUSPEND
	bool "Support gpio suspend"
	default n

config RK29_NEON_POWERDOMAIN_SET
	bool "Support neon powerdomain on and off"
	default n

config RK29_SPI_INSRAM
	tristate "Support spi control interface"
	depends on REGULATOR_WM831X
	default ns
config RK29_I2C_INSRAM
	tristate "Support i2c control interface"
	depends on REGULATOR_ACT8891
	default ns
config RK29_PWM_INSRAM
	tristate "Support pwm control interface"
	depends on RK29_PWM_REGULATOR
	default y
endmenu


endif
```

## arch/arm/mach-rk2928/Kconfig
```kconfig
if ARCH_RK2928

choice
	prompt "RK2928 Board Type"
	default MACH_RK2928_SDK

config MACH_RK2928
	bool "RK2928 Board"
	select RK_CONFIG


config MACH_RK2928_SDK
	bool "RK2928(BGA) SDK board"

config MACH_RK2926_SDK
	bool "RK2926 SDK board"

config MACH_RK2928_PHONEPAD
	bool "RK2928_PhonePad board"

config MACH_RK2928_A720
	bool "RK2928 A720 board"

config MACH_RK2928_TB
	bool "RK2928 top board"

config MACH_RK2928_FPGA
	bool "RK2928 FPGA board"

endchoice

endif
```

## arch/arm/mach-rk2928b/Kconfig
```kconfig
choice
	prompt "RK2928B Board Type"
	depends on SOC_RK2928B

config MACH_RK2928B_TB
	bool "RK2928B Top Board"

endchoice
```

## arch/arm/mach-rk30/Kconfig
```kconfig
config ARCH_RK30XX
	depends on ARCH_RK30
	bool

config ARCH_RK3066B
	depends on ARCH_RK30
	bool

choice
	prompt "Rockchip SoC Type"
	depends on ARCH_RK30
	default SOC_RK3066

config SOC_RK3000
	bool "RK3000"
	select ARCH_RK30XX

config SOC_RK3028
	bool "RK3028"
	select ARCH_RK3066B

config SOC_RK3066
	bool "RK3066"
	select ARCH_RK30XX

config SOC_RK3068
	bool "RK3068"
	select ARCH_RK30XX

config SOC_RK3066B
	bool "RK3066B"
	select ARCH_RK3066B
	select USB_ARCH_HAS_EHCI

config SOC_RK3108
	bool "RK3108"
	select ARCH_RK3066B
	select USB_ARCH_HAS_EHCI

config SOC_RK3168
	bool "RK3168"
	select ARCH_RK3066B
	select USB_ARCH_HAS_EHCI

config SOC_RK3168M
	bool "RK3168M"
	select ARCH_RK3066B
	select USB_ARCH_HAS_EHCI

endchoice

choice
	prompt "RK30xx Board Type"
	depends on ARCH_RK30XX
	default MACH_RK30_SDK

config MACH_RK30_SDK
	bool "RK30 SDK board"
	
config MACH_RK30_DS975
	bool "RK30 DS975 board"

config MACH_RK3066_SDK
	bool "RK3066 SDK board"

config MACH_RK30_DS1001B
        bool "RK30 DS1001B board"
     
config MACH_RK30_PHONE
	bool "RK30 smart phone board"

config MACH_RK30_PHONE_LOQUAT
	bool "RK30 smart phone loquat board"

config MACH_RK30_PHONE_A22
        bool "RK30 smart phone a22 board"
	
config MACH_RK30_PHONE_PAD
        bool "RK30 phone pad board"

config MACH_RK30_Z600T
        bool "RK30 Z600T smart phone pad board"
		
endchoice

choice
	prompt "RK30 phone pad board type"
	depends on MACH_RK30_PHONE_PAD
	default MACH_RK30_PHONE_PAD_DS763

	config MACH_RK30_PHONE_PAD_DS763
	bool "ds763"

	config MACH_RK30_PHONE_PAD_C8003
	bool "c8003"

endchoice

choice
	prompt "RK3028 Board Type"
	depends on SOC_RK3028

config MACH_RK3028_TB
	bool "RK3028 Top Board"

endchoice

choice
	prompt "RK3066B Board Type"
	depends on SOC_RK3066B

config MACH_RK3066B_FPGA
	bool "RK3066B FPGA board"
	select RK_FPGA

config MACH_RK3066B_SDK
	bool "RK3066B SDK board"

config MACH_RK3066B_M701
	bool "RK3066B M701 board"

endchoice

choice
	prompt "RK3108 Board Type"
	depends on SOC_RK3108

config MACH_RK3108_TB
	bool "RK3108 Top Board"

endchoice

choice
	prompt "RK3168 Board Type"
	depends on SOC_RK3168

config MACH_RK3168_TB
	bool "RK3168 Top Board"

config MACH_RK3168_FT
	bool "RK3168 FT Board"

config MACH_RK3168_LR097
	bool "RK3168 LR097 JC21CA board"

config MACH_RK3168_DS1006H
	bool "RK3168 DS1006h Board"

config MACH_RK3168_86V
	bool "RK3168 86V Board"

config MACH_RK3168_86V_OLD
        bool "RK3168 86V  Old Board"
endchoice

choice
	prompt "RK3168M Board Type"
	depends on SOC_RK3168M

config MACH_RK3168M_TB
	bool "RK3168M Top Board"

endchoice
```

## arch/arm/mach-rk3026/Kconfig
```kconfig
choice
	prompt "RK3026/RK3028A Board Type"
	depends on ARCH_RK3026

config MACH_RK3026_FPGA
	bool "RK3026 FPGA Board"

config MACH_RK3026_TB
	bool "RK3026 Top Board"

config MACH_RK3026_86V
	bool "RK3026 86V Board"

config MACH_RK3028A_TB
	bool "RK3028A Top Board"

config MACH_RK3028A_86V
	bool "RK3028A 86V Board"
	
config MACH_RK3028A_FAC
  bool "RK3028A Board for factory"
  select MACH_RK_FAC
  
config MACH_RK3026_86V_FAC
  bool "RK3026 86V Board for factory"
  select MACH_RK_FAC

endchoice
```

## arch/arm/mach-rk3188/Kconfig
```kconfig
choice
	prompt "Rockchip SoC Type"
	depends on ARCH_RK3188

config SOC_RK3188
	bool "RK3188"
	select USB_ARCH_HAS_EHCI if USB_SUPPORT

config SOC_RK3188M
	bool "RK3188M"
	select USB_ARCH_HAS_EHCI if USB_SUPPORT

endchoice

choice
	prompt "RK3188 Board Type"
	depends on SOC_RK3188

config MACH_RK3188_TB
	bool "RK3188 Top Board"

config MACH_RK3188_SDK
	bool "RK3188 sdk Board"

config MACH_RK3188_FPGA
	bool "RK3188 FPGA board"
	select RK_FPGA

config MACH_RK3188_LR097
        bool "RK3188 LR097 JC21CA board"

config MACH_RK3188_DS1006H
	bool "RK3188 ds1006h board"

config MACH_RK3188_U30GT2
	bool "RK3188 u30gt2 board"

        
config MACH_RK3188_FAC
        bool "RK3188 Board for factory"
        select MACH_RK_FAC

config MACH_RK3188_JETTAB
	bool "RK3188 jettaB top board"

config MACH_RK3188_RK618
        bool "RK3188 RK618 sdk"

config MACH_RK3188_FT
	bool "RK3188 FT Board"

endchoice

choice
	prompt "RK3188M Board Type"
	depends on SOC_RK3188M

config MACH_RK3188M_TB
	bool "RK3188m Top Board"
	
config MACH_RK3188M_F304
	bool "RK3188m F304 Board"	

endchoice
```

## arch/arm/mach-rk319x/Kconfig
```kconfig
choice
	prompt "Rockchip SoC Type"
	depends on ARCH_RK319X

config SOC_RK3190
	bool "RK3190"
	select USB_ARCH_HAS_EHCI if USB_SUPPORT

endchoice

choice
	prompt "RK3190 Board Type"
	depends on SOC_RK3190

config MACH_RK3190_TB
	bool "RK3190 Top Board"

config MACH_RK3190_FPGA
	bool "RK3188 FPGA board"
	select RK_FPGA

endchoice
```

## arch/arm/mach-rockchip/Kconfig
```kconfig
# SPDX-License-Identifier: GPL-2.0-only
config ARCH_ROCKCHIP
	bool "Rockchip RK2928 and RK3xxx SOCs"
	depends on ARCH_MULTI_V7
	select PINCTRL
	select PINCTRL_ROCKCHIP
	select ARCH_HAS_RESET_CONTROLLER
	select ARM_AMBA
	select ARM_GIC
	select CACHE_L2X0 if (CPU_RK30XX || CPU_RK3188)
	select GPIOLIB
	select HAVE_ARM_ARCH_TIMER
	select HAVE_ARM_SCU if SMP
	select HAVE_ARM_TWD if SMP && (CPU_RK30XX || CPU_RK3188)
	select DW_APB_TIMER_OF if CPU_RK30XX
	select REGULATOR if PM
	select ROCKCHIP_TIMER
	select ARM_GLOBAL_TIMER if (CPU_RK30XX || CPU_RK3188)
	select CLKSRC_ARM_GLOBAL_TIMER_SCHED_CLOCK if (CPU_RK30XX || CPU_RK3188)
	select ZONE_DMA if ARM_LPAE
	select PM
	help
	  Support for Rockchip's Cortex-A9 Single-to-Quad-Core-SoCs
	  containing the RK2928, RK30xx and RK31xx series.

config RV1106_HPMCU_FAST_WAKEUP
	bool "Rockchip RV1106 HPMCU fast wakeup configuration support"
	depends on PM_SLEEP && CPU_RV1106
	help
	  This config aims to support HPMCU fast wakeup.
```

## arch/arm/mach-rockchip/Kconfig.common
```kconfig
if ARCH_ROCKCHIP

config RK_LAST_LOG
	bool "Save the last kernel log on /proc/last_log"
	depends on DEBUG_KERNEL && PRINTK
	default y
	help
	  It is only intended for debugging.

config RK_DEBUG_UART
	int "Debug UART"
	default 2
	help
	  Select a UART for debugging. -1 disable.

config RK_USB_UART
        bool "Support USB UART Bypass Function"
        depends on (RK_DEBUG_UART = 2) 

config RK_CONSOLE_THREAD
	bool "Console write by thread"
	default y
	help
	  Normal kernel printk will write out to UART by "kconsole" kthread

config BLOCK_RKNAND
	tristate "RK NAND Device Support"
	default n
	help
	  RK NAND Device Support.

config RK_FPGA
	bool "FPGA Board"

config DVFS
        bool "Enable dvfs"
	default y
	select PM_OPP
	select CPU_FREQ

config RK_PM_TESTS
	bool "/sys/pm_tests/ support"
	default n
	select DVFS
	select WATCHDOG

config DDR_TEST
	bool "DDR Test"
	select CRC32
	default n

config RK_VCODEC
	tristate "VCODEC (VPU HEVC) service driver in kernel"
	depends on ARCH_ROCKCHIP
	default y

config RK_PL330_DMA_TEST
	bool "pl330 DMA memcpy test"

endif
```

## arch/arm/mach-rpc/Kconfig
```kconfig
config ARCH_RPC
	bool "RiscPC"
	depends on ARCH_MULTI_V4 && !(ARCH_MULTI_V4T || ARCH_MULTI_V5)
	depends on !(ARCH_FOOTBRIDGE || ARCH_SA1100 || ARCH_MOXART || ARCH_GEMINI)
	depends on !CC_IS_CLANG && GCC_VERSION < 90100 && GCC_VERSION >= 60000
	depends on CPU_LITTLE_ENDIAN
	depends on ATAGS
	depends on MMU
	select ARCH_ACORN
	select ARCH_MAY_HAVE_PC_FDC
	select CPU_SA110
	select FIQ
	select HAVE_PATA_PLATFORM
	select ISA_DMA_API
	select LEGACY_TIMER_TICK
	select NEED_MACH_IO_H
	select NEED_MACH_MEMORY_H
	select NO_IOPORT_MAP
	help
	  On the Acorn Risc-PC, Linux can support the internal IDE disk and
	  CD-ROM interface, serial and parallel port, and the floppy drive.
```
