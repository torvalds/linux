## arch/arm/plat-pxa/Kconfig
```kconfig
# SPDX-License-Identifier: GPL-2.0-only
if PLAT_PXA

config PXA_SSP
	tristate
	help
	  Enable support for PXA2xx SSP ports

endif
```

## arch/arm/plat-rk/Kconfig
```kconfig
if PLAT_RK

choice DDR_TYPE
	prompt "DDR Memory Type"
	default DDR_TYPE_DDR3_DEFAULT 

config DDR_TYPE_DDRII
	bool "DDRII"
	help
	  Support for DDRII memory

config DDR_TYPE_LPDDR
	bool "mobile DDR"
	help
	  Support for mobile DDR, MCP device

config DDR_TYPE_DDR3_800D
	bool "DDR3-800 5-5-5"

config DDR_TYPE_DDR3_800E
	bool "DDR3-800 6-6-6"

config DDR_TYPE_DDR3_1066E
	bool "DDR3-1066 6-6-6"

config DDR_TYPE_DDR3_1066F
	bool "DDR3-1066 7-7-7"

config DDR_TYPE_DDR3_1066G
	bool "DDR3-1066 8-8-8"

config DDR_TYPE_DDR3_1333F
	bool "DDR3-1333 7-7-7"

config DDR_TYPE_DDR3_1333G
	bool "DDR3-1333 8-8-8"

config DDR_TYPE_DDR3_1333H
	bool "DDR3-1333 9-9-9"

config DDR_TYPE_DDR3_1333J
	bool "DDR3-1333 10-10-10"

config DDR_TYPE_DDR3_1600G
	bool "DDR3-1600 8-8-8"

config DDR_TYPE_DDR3_1600H
	bool "DDR3-1600 9-9-9"

config DDR_TYPE_DDR3_1600J
	bool "DDR3-1600 10-10-10"

config DDR_TYPE_DDR3_1600K
	bool "DDR3-1600 11-11-11"

config DDR_TYPE_DDR3_1866J
	bool "DDR3-1866 10-10-10"

config DDR_TYPE_DDR3_1866K
	bool "DDR3-1866 11-11-11"

config DDR_TYPE_DDR3_1866L
	bool "DDR3-1866 12-12-12"

config DDR_TYPE_DDR3_1866M
	bool "DDR3-1866 13-13-13"

config DDR_TYPE_DDR3_2133K
	bool "DDR3-2133 11-11-11"

config DDR_TYPE_DDR3_2133L
	bool "DDR3-2133 12-12-12"

config DDR_TYPE_DDR3_2133M
	bool "DDR3-2133 13-13-13"

config DDR_TYPE_DDR3_2133N
	bool "DDR3-2133 14-14-14"

config DDR_TYPE_DDR3_DEFAULT
	bool "DDR3 (Type default)"

endchoice

config DDR_SDRAM_FREQ
	int "DDR SDRAM frequence (in MHz)"
	default 400

config DDR_FREQ
	bool "Enable DDR frequency scaling"
	select RK_SRAM_DMA if ARCH_RK30

config DDR_TEST
	bool "DDR Test"
	depends on !ARCH_RK29
	select CRC32
	default y

config DVFS
	bool "Enable dvfs"
	depends on REGULATOR&&CPU_FREQ
	default y

config RK_CLOCK_PROC
	bool "/proc/clocks support"
	depends on PROC_FS

if !ARCH_RK29
menu "Support for RK power manage"

config CLK_SWITCH_TO_32K
	bool "Support clock switch to 32.768k"

config RK30_I2C_INSRAM
	bool "Support i2c control interface in sram"
	

endmenu
endif


choice WIFI_CONTROL
       prompt "wifi control func Type."
       default WIFI_CONTROL_FUNC
 
config WIFI_CONTROL_FUNC
        bool "Enable WiFi control function abstraction"
        help
          Enables Power/Reset/Carddetect function abstraction

config WIFI_COMBO_MODULE_CONTROL_FUNC
        bool "Enable WiFi_combo_module control function abstraction"
        help
          Enables Power/Reset/Carddetect function abstraction

endchoice


config RK29_VPU
	tristate "VPU (Video Processing Unit) service driver in kernel"
	depends on ARCH_RK29 || ARCH_RK30 || ARCH_RK2928
	default m

config RK29_LAST_LOG
	bool "Save the last kernel log on /proc/last_log"
	depends on DEBUG_KERNEL && PRINTK
	default y
	help
	  It is only intended for debugging.

config RK_EARLY_PRINTK
	bool "Early printk"
	depends on PRINTK && !DEBUG_LL
	default y
	help
	  Say Y here if you want to have an early console using the
	  kernel low-level debugging functions.

config RK_DEBUG_UART
	int "Debug UART"
	default 1 if ARCH_RK29
	default 2 if ARCH_RK30
	help
	  Select a UART for debugging. -1 disable.

config RK_CONSOLE_THREAD
	bool "Console write by thread"
	depends on FIQ_DEBUGGER_CONSOLE
	default y
	help
	  Normal kernel printk will write out to UART by "kconsole" kthread

config RK_SRAM_DMA
	bool "Sound DMA buffer in internal SRAM"
	depends on ARCH_RK30

config RK_PL330_DMA
	bool
	select PL330
	help
	  DMA API Driver for PL330 DMAC
	  
config RK_PL330_DMA_TEST
	bool "pl330 DMA memcpy test"
	depends on RK_PL330_DMA	  

endif
```

## arch/arm/plat-rk/bid/Kconfig
```kconfig
menuconfig BOARD_ID
	bool "board id support for OneImage solution"
	default n	

choice
	depends on BOARD_ID
	prompt  "board id type"
	
config BOARD_ID_FLASH
bool "board id save in flash"

config BOARD_ID_AUTO_XML
bool "auto print cust.xml"
	depends on BOARD_ID_FLASH

config BOARD_ID_HW
bool "board id get from hardware such as gpios"

endchoice
```

## arch/arm/plat-rk/rk_pm_tests/Kconfig
```kconfig
menuconfig RK_PM_TESTS
	tristate "/sys/pm_tests/ support"
	help
	  PM tests tools

if RK_PM_TESTS

config PM_TEST_CLK_RATE
	bool "Scale clock rate"
	default y
	help
	  Use to set clock rate

config PM_TEST_CLK_VOLT
	bool "Scale voltage"
	default y
	help
	  Use to set voltage domain's voltage

config PM_TEST_MAXFREQ
	bool "For max runable frequency test"
	default y
	help
	  Use to test the max runable frequency of a fixed voltage

config PM_TEST_FREQ_LIMIT
	bool "Limit clocks' frequency"
	help
	  Use to limit clocks' frequency

config PM_TEST_CPU_USAGE
	bool "Set cpu running at a fixed frequency"
	help
	  Use to Set cpu running at a fixed frequency

config PM_TEST_SUSPEND_DBG
	bool "suspend debug control"
	help
	  Use to suspend debug

config PM_TEST_CLK_AUTO_VOLT
	bool "Auto scale voltage"
	help
	  Use to auto scale regulator's voltage by step

config PM_TEST_DVFS_TABLE_SCAN
	bool "dvfs table scan"
	help
	  Use to scan dvfs table

config PM_TEST_DVFS_TABLE_RESET
	bool "dvfs table reset"
	help
	  Use to reset dvfs table

config PM_TEST_DELAYLINE
	bool "Get delayline value"
	help
	  Use to get delayline value
	  
config PM_TEST_FT
	bool "Test kernel for FT"
	help
	  Use to test kernel for FT

endif
```

## arch/arm/plat-s3c/Kconfig
```kconfig
# Copyright 2007 Simtec Electronics
#
# Licensed under GPLv2

config PLAT_S3C
	bool
	depends on ARCH_S3C2410 || ARCH_S3C24A0 || ARCH_S3C64XX
	default y
	select NO_IOPORT
	help
	  Base platform code for any Samsung S3C device
```

## arch/arm/plat-s3c24xx/Kconfig
```kconfig
# Copyright 2007 Simtec Electronics
#
# Licensed under GPLv2

config PLAT_S3C24XX
	bool
	depends on ARCH_S3C24XX
	default y
	select ARCH_REQUIRE_GPIOLIB
	select NO_IOPORT
	select S3C_DEV_NAND
	help
	  Base platform code for any Samsung S3C24XX device

if PLAT_S3C24XX

# low-level serial option nodes

config CPU_LLSERIAL_S3C2410_ONLY
	bool
	default y if CPU_LLSERIAL_S3C2410 && !CPU_LLSERIAL_S3C2440

config CPU_LLSERIAL_S3C2440_ONLY
	bool
	default y if CPU_LLSERIAL_S3C2440 && !CPU_LLSERIAL_S3C2410

config CPU_LLSERIAL_S3C2410
	bool
	help
	  Selected if there is an S3C2410 (or register compatible) serial
	  low-level implementation needed

config CPU_LLSERIAL_S3C2440
	bool
	help
	  Selected if there is an S3C2440 (or register compatible) serial
	  low-level implementation needed

# code that is shared between a number of the s3c24xx implementations

config S3C2410_CLOCK
	bool
	help
	  Clock code for the S3C2410, and similar processors which
	  is currently includes the S3C2410, S3C2440, S3C2442.

config S3C24XX_DCLK
	bool
	help
	  Clock code for supporting DCLK/CLKOUT on S3C24XX architectures

# gpio configurations

config S3C24XX_GPIO_EXTRA
	int
	default 128 if S3C24XX_GPIO_EXTRA128
	default 64 if S3C24XX_GPIO_EXTRA64
	default 16 if ARCH_H1940
	default 0

config S3C24XX_GPIO_EXTRA64
	bool
	help
	  Add an extra 64 gpio numbers to the available GPIO pool. This is
	  available for boards that need extra gpios for external devices.

config S3C24XX_GPIO_EXTRA128
	bool
	help
	  Add an extra 128 gpio numbers to the available GPIO pool. This is
	  available for boards that need extra gpios for external devices.

config S3C24XX_DMA
	bool "S3C2410 DMA support"
	depends on ARCH_S3C24XX
	select S3C_DMA
	help
	  S3C2410 DMA support. This is needed for drivers like sound which
	  use the S3C2410's DMA system to move data to and from the
	  peripheral blocks.

config S3C2410_DMA_DEBUG
	bool "S3C2410 DMA support debug"
	depends on ARCH_S3C24XX && S3C2410_DMA
	help
	  Enable debugging output for the DMA code. This option sends info
	  to the kernel log, at priority KERN_DEBUG.

# common code for s3c24xx based machines, such as the SMDKs.

# cpu frequency items common between s3c2410 and s3c2440/s3c2442

config S3C2410_IOTIMING
	bool
	depends on CPU_FREQ_S3C24XX
	help
	  Internal node to select io timing code that is common to the s3c2410
	  and s3c2440/s3c2442 cpu frequency support.

config S3C2410_CPUFREQ_UTILS
	bool
	depends on CPU_FREQ_S3C24XX
	help
	  Internal node to select timing code that is common to the s3c2410
	  and s3c2440/s3c244 cpu frequency support.

# cpu frequency support common to s3c2412, s3c2413 and s3c2442

config S3C2412_IOTIMING
	bool
	depends on CPU_FREQ_S3C24XX && (CPU_S3C2412 || CPU_S3C2443)
	help
	  Intel node to select io timing code that is common to the s3c2412
	  and the s3c2443.

endif
```

## arch/arm/plat-s3c64xx/Kconfig
```kconfig
# Copyright 2008 Openmoko, Inc.
# Copyright 2008 Simtec Electronics
#	Ben Dooks <ben@simtec.co.uk>
#
# Licensed under GPLv2

config PLAT_S3C64XX
	bool
	depends on ARCH_S3C64XX
	default y
	help
	  Base platform code for any Samsung S3C64XX device
```

## arch/arm/plat-s5p/Kconfig
```kconfig
# arch/arm/plat-s5p/Kconfig
#
# Copyright (c) 2009 Samsung Electronics Co., Ltd.
#		http://www.samsung.com/
#
# Licensed under GPLv2

config PLAT_S5P
	bool
	depends on (ARCH_S5P64X0 || ARCH_S5PC100 || ARCH_S5PV210 || ARCH_EXYNOS)
	default y
	select ARM_VIC if !ARCH_EXYNOS
	select ARM_GIC if ARCH_EXYNOS
	select GIC_NON_BANKED if ARCH_EXYNOS4
	select NO_IOPORT
	select ARCH_REQUIRE_GPIOLIB
	select S3C_GPIO_TRACK
	select S5P_GPIO_DRVSTR
	select SAMSUNG_GPIOLIB_4BIT
	select PLAT_SAMSUNG
	select SAMSUNG_CLKSRC
	select SAMSUNG_IRQ_VIC_TIMER
	help
	  Base platform code for Samsung's S5P series SoC.

config S5P_EXT_INT
	bool
	help
	  Use the external interrupts (other than GPIO interrupts.)
	  Note: Do not choose this for S5P6440 and S5P6450.

config S5P_GPIO_INT
	bool
	help
	  Common code for the GPIO interrupts (other than external interrupts.)

config S5P_HRT
	bool
	select SAMSUNG_DEV_PWM
	help
	  Use the High Resolution timer support

config S5P_DEV_UART
	def_bool y
	depends on (ARCH_S5P64X0 || ARCH_S5PC100 || ARCH_S5PV210)

config S5P_PM
	bool
	help
	  Common code for power management support on S5P and newer SoCs
	  Note: Do not select this for S5P6440 and S5P6450.

config S5P_SLEEP
	bool
	help
	  Internal config node to apply common S5P sleep management code.
	  Can be selected by S5P and newer SoCs with similar sleep procedure.

config S5P_DEV_JPEG
	bool
	help
	  Compile in platform device definitions for JPEG codec

config S5P_DEV_G2D
	bool
	help
	  Compile in platform device definitions for G2D device

config S5P_DEV_FIMD0
	bool
	help
	  Compile in platform device definitions for FIMD controller 0

config S5P_DEV_FIMD1
	bool
	help
	  Compile in platform device definitions for FIMD controller 1

config S5P_DEV_I2C_HDMIPHY
	bool
	help
	  Compile in platform device definitions for I2C HDMIPHY controller

config S5P_DEV_MFC
	bool
	help
	  Compile in platform device definitions for MFC

config S5P_DEV_ONENAND
	bool
	help
	  Compile in platform device definition for OneNAND controller

config S5P_DEV_TV
	bool
	help
	  Compile in platform device definition for TV interface

config S5P_DEV_USB_EHCI
	bool
	help
	  Compile in platform device definition for USB EHCI

config S5P_SETUP_MIPIPHY
	bool
	depends on (VIDEO_S5P_MIPI_CSIS || VIDEO_EXYNOS_MIPI_CSIS)
	default y
	help
	  Compile in common setup code for MIPI-CSIS and MIPI-DSIM devices

config S5P_DEV_ACE
	bool
	help
	  Compile in common setup code for Crypto Engine devices.
```

## arch/arm/plat-s5pc1xx/Kconfig
```kconfig
# Copyright 2009 Samsung Electronics Co.
#	Byungho Min <bhmin@samsung.com>
#
# Licensed under GPLv2

config PLAT_S5PC1XX
	bool
	depends on ARCH_S5PC1XX
	default y
	select PLAT_S3C
	select ARM_VIC
	select NO_IOPORT
	select ARCH_REQUIRE_GPIOLIB
	select SAMSUNG_CLKSRC
	select SAMSUNG_IRQ_UART
	select SAMSUNG_IRQ_VIC_TIMER
	select S3C_GPIO_TRACK
	select S3C_GPIO_PULL_UPDOWN
	select S5P_GPIO_DRVSTR
	select S3C_GPIO_CFG_S3C24XX
	select S3C_GPIO_CFG_S3C64XX
	select SAMSUNG_GPIOLIB_4BIT
	help
	  Base platform code for any Samsung S5PC1XX device

if PLAT_S5PC1XX

# Configuration options shared by all S3C64XX implementations

config CPU_S5PC100_INIT
	bool
	help
	  Common initialisation code for the S5PC1XX

config CPU_S5PC100_CLOCK
	bool
	help
	  Common clock support code for the S5PC1XX

# platform specific device setup

config S5PC1XX_SETUP_SDHCI_GPIO
	bool
	help
	  Common setup code for SDHCI gpio.

endif
```
