## arch/arm/mach-sa1100/Kconfig
```kconfig
# SPDX-License-Identifier: GPL-2.0-only
menuconfig ARCH_SA1100
	bool "SA11x0 Implementations"
	depends on ARCH_MULTI_V4 && !(ARCH_MULTI_V4T || ARCH_MULTI_V5)
	depends on !(ARCH_MOXART || ARCH_GEMINI)
	depends on ATAGS
	depends on CPU_LITTLE_ENDIAN
	depends on MMU
	select ARCH_NO_SG_CHAIN
	select ARCH_MTD_XIP
	select CLKSRC_MMIO
	select CLKSRC_PXA
	select CPU_FREQ
	select CPU_SA1100
	select GPIOLIB
	select IRQ_DOMAIN
	select ISA
	select NEED_MACH_MEMORY_H
	help
	  Support for StrongARM 11x0 based boards.

if ARCH_SA1100

config SA1100_ASSABET
	bool "Assabet"
	select ARM_SA1110_CPUFREQ
	select GPIO_REG
	select LEDS_GPIO_REGISTER
	select REGULATOR
	select REGULATOR_FIXED_VOLTAGE
	help
	  Say Y here if you are using the Intel(R) StrongARM(R) SA-1110
	  Microprocessor Development Board (also known as the Assabet).

config ASSABET_NEPONSET
	bool "Include support for Neponset"
	depends on SA1100_ASSABET
	select SA1111
	help
	  Say Y here if you are using the Intel(R) StrongARM(R) SA-1110
	  Microprocessor Development Board (Assabet)  with the SA-1111
	  Development Board (Nepon).

config SA1100_COLLIE
	bool "Sharp Zaurus SL5500"
	# FIXME: select ARM_SA11x0_CPUFREQ
	select SHARP_LOCOMO
	select SHARP_PARAM
	select SHARP_SCOOP
	help
	  Say Y here to support the Sharp Zaurus SL5500 PDAs.

config SA1100_H3600
	bool "Compaq iPAQ H3600/H3700"
	select ARM_SA1110_CPUFREQ
	select HTC_EGPIO
	select MFD_IPAQ_MICRO
	help
	  Say Y here if you intend to run this kernel on the Compaq iPAQ
	  H3600 and H3700 handheld computers.

config SA1100_JORNADA720
	bool "HP Jornada 720"
	# FIXME: select ARM_SA11x0_CPUFREQ
	select SA1111
	help
	  Say Y here if you want to build a kernel for the HP Jornada 720
	  handheld computer.  See 
	  <http://h10025.www1.hp.com/ewfrf/wc/product?product=61677&cc=us&lc=en&dlc=en&product=61677#> 

config SA1100_JORNADA720_SSP
	bool "HP Jornada 720 Extended SSP driver"
	depends on SA1100_JORNADA720
	select SA1100_SSP
	help
	  Say Y here if you have a HP Jornada 7xx handheld computer and you
	  want to access devices connected to the MCU. Those include the
	  keyboard, touchscreen, backlight and battery. This driver also activates
	  the generic SSP which it extends.

config SA1100_SSP
	tristate "Generic PIO SSP"
	help
	  Say Y here to enable support for the generic PIO SSP driver.
	  This isn't for audio support, but for attached sensors and
	  other devices, eg for BadgePAD 4 sensor support.

endif
```

## arch/arm/mach-shmobile/Kconfig
```kconfig
# SPDX-License-Identifier: GPL-2.0
menuconfig ARCH_RENESAS
	bool "Renesas ARM SoCs"
	depends on ARCH_MULTI_V7
	select ARM_GIC
	select GPIOLIB
	select NO_IOPORT_MAP
	select PINCTRL
	select ZONE_DMA if ARM_LPAE
```

## arch/arm/mach-socfpga/Kconfig
```kconfig
# SPDX-License-Identifier: GPL-2.0-only
menuconfig ARCH_SOCFPGA
	bool "Altera SOCFPGA family"
	depends on ARCH_MULTI_V7
	select ARCH_SUPPORTS_BIG_ENDIAN
	select ARM_AMBA
	select ARM_GIC
	select CACHE_L2X0
	select DW_APB_TIMER_OF
	select GPIO_PL061 if GPIOLIB
	select HAVE_ARM_SCU
	select HAVE_ARM_TWD if SMP
	select MFD_SYSCON
	select ARM_ERRATA_754322
	select ARM_ERRATA_764369 if SMP
	select ARM_ERRATA_775420
	select PL310_ERRATA_588369
	select PL310_ERRATA_727915
	select PL310_ERRATA_753970 if PL310
	select PL310_ERRATA_769419

if ARCH_SOCFPGA
config SOCFPGA_SUSPEND
	bool "Suspend to RAM on SOCFPGA"
	help
	  Select this if you want to enable Suspend-to-RAM on SOCFPGA
	  platforms.
endif
```

## arch/arm/mach-spear/Kconfig
```kconfig
#
# SPEAr Platform configuration file
#

menuconfig PLAT_SPEAR
	bool "ST SPEAr Family" if ARCH_MULTI_V7 || ARCH_MULTI_V5
	default PLAT_SPEAR_SINGLE
	select ARCH_REQUIRE_GPIOLIB
	select ARM_AMBA
	select CLKSRC_MMIO

if PLAT_SPEAR

config ARCH_SPEAR13XX
	bool "ST SPEAr13xx"
	depends on ARCH_MULTI_V7 || PLAT_SPEAR_SINGLE
	select ARM_GIC
	select GPIO_SPEAR_SPICS
	select HAVE_ARM_SCU if SMP
	select HAVE_ARM_TWD if SMP
	select PINCTRL
	select MFD_SYSCON
	select MIGHT_HAVE_PCI
	help
	  Supports for ARM's SPEAR13XX family

if ARCH_SPEAR13XX

config MACH_SPEAR1310
	bool "SPEAr1310 Machine support with Device Tree"
	select PINCTRL_SPEAR1310
	select PHY_ST_SPEAR1310_MIPHY
	help
	  Supports ST SPEAr1310 machine configured via the device-tree

config MACH_SPEAR1340
	bool "SPEAr1340 Machine support with Device Tree"
	select PINCTRL_SPEAR1340
	select PHY_ST_SPEAR1340_MIPHY
	help
	  Supports ST SPEAr1340 machine configured via the device-tree

endif #ARCH_SPEAR13XX

config ARCH_SPEAR3XX
	bool "ST SPEAr3xx"
	depends on ARCH_MULTI_V5 || PLAT_SPEAR_SINGLE
	depends on !ARCH_SPEAR13XX
	select ARM_VIC
	select PINCTRL
	help
	  Supports for ARM's SPEAR3XX family

if ARCH_SPEAR3XX

config MACH_SPEAR300
	bool "SPEAr300 Machine support with Device Tree"
	select PINCTRL_SPEAR300
	help
	  Supports ST SPEAr300 machine configured via the device-tree

config MACH_SPEAR310
	bool "SPEAr310 Machine support with Device Tree"
	select PINCTRL_SPEAR310
	help
	  Supports ST SPEAr310 machine configured via the device-tree

config MACH_SPEAR320
	bool "SPEAr320 Machine support with Device Tree"
	select PINCTRL_SPEAR320
	help
	  Supports ST SPEAr320 machine configured via the device-tree

endif

config ARCH_SPEAR6XX
	bool "ST SPEAr6XX"
	depends on ARCH_MULTI_V5 || PLAT_SPEAR_SINGLE
	depends on !ARCH_SPEAR13XX
	select ARM_VIC
	help
	  Supports for ARM's SPEAR6XX family

config MACH_SPEAR600
	def_bool y
	depends on ARCH_SPEAR6XX
	help
	  Supports ST SPEAr600 boards configured via the device-tree

config ARCH_SPEAR_AUTO
	def_bool PLAT_SPEAR_SINGLE
	depends on !ARCH_SPEAR13XX && !ARCH_SPEAR6XX
	select ARCH_SPEAR3XX

endif
```

## arch/arm/mach-spear13xx/Kconfig
```kconfig
#
# SPEAr13XX Machine configuration file
#

if ARCH_SPEAR13XX

menu "SPEAr13xx Implementations"
config MACH_SPEAR1310
	bool "SPEAr1310 Machine support with Device Tree"
	select PINCTRL_SPEAR1310
	help
	  Supports ST SPEAr1310 machine configured via the device-tree

config MACH_SPEAR1340
	bool "SPEAr1340 Machine support with Device Tree"
	select PINCTRL_SPEAR1340
	help
	  Supports ST SPEAr1340 machine configured via the device-tree
endmenu
endif #ARCH_SPEAR13XX
```

## arch/arm/mach-spear3xx/Kconfig
```kconfig
#
# SPEAr3XX Machine configuration file
#

if ARCH_SPEAR3XX

menu "SPEAr3xx Implementations"
config MACH_SPEAR300
	bool "SPEAr300 Machine support with Device Tree"
	help
	  Supports ST SPEAr300 machine configured via the device-tree

config MACH_SPEAR310
	bool "SPEAr310 Machine support with Device Tree"
	help
	  Supports ST SPEAr310 machine configured via the device-tree

config MACH_SPEAR320
	bool "SPEAr320 Machine support with Device Tree"
	help
	  Supports ST SPEAr320 machine configured via the device-tree
endmenu
endif #ARCH_SPEAR3XX
```

## arch/arm/mach-spear6xx/Kconfig
```kconfig
#
# SPEAr6XX Machine configuration file
#

config MACH_SPEAR600
	def_bool y
	depends on ARCH_SPEAR6XX
	select USE_OF
	help
	  Supports ST SPEAr600 boards configured via the device-tree
```

## arch/arm/mach-sti/Kconfig
```kconfig
menuconfig ARCH_STI
	bool "STMicroelectronics Consumer Electronics SOCs"
	depends on ARCH_MULTI_V7
	select ARM_GIC
	select ST_IRQCHIP
	select ARM_GLOBAL_TIMER
	select CLKSRC_ST_LPC
	select PINCTRL
	select PINCTRL_ST
	select MFD_SYSCON
	select ARCH_HAS_RESET_CONTROLLER
	select HAVE_ARM_SCU if SMP
	select GPIOLIB
	select ARM_ERRATA_754322
	select ARM_ERRATA_764369 if SMP
	select ARM_ERRATA_775420
	select PL310_ERRATA_753970 if CACHE_L2X0
	select PL310_ERRATA_769419 if CACHE_L2X0
	select RESET_CONTROLLER
	help
	  Include support for STMicroelectronics' STiH415/416, STiH407/10 and
	  STiH418 family SoCs using the Device Tree for discovery.  More
	  information can be found in Documentation/arm/sti/ and
	  Documentation/devicetree.

if ARCH_STI

config SOC_STIH415
	bool "STiH415 STMicroelectronics Consumer Electronics family"
	default y
	select STIH415_RESET
	help
	  This enables support for STMicroelectronics Digital Consumer
	  Electronics family StiH415 parts, primarily targeted at set-top-box
	  and other digital audio/video applications using Flattned Device
	  Trees.

config SOC_STIH416
	bool "STiH416 STMicroelectronics Consumer Electronics family"
	default y
	select STIH416_RESET
	help
	  This enables support for STMicroelectronics Digital Consumer
	  Electronics family StiH416 parts, primarily targeted at set-top-box
	  and other digital audio/video applications using Flattened Device
	  Trees.

config SOC_STIH407
	bool "STiH407 STMicroelectronics Consumer Electronics family"
	default y
	select STIH407_RESET
	help
	  This enables support for STMicroelectronics Digital Consumer
	  Electronics family StiH407 parts, targetted at set-top-box
	  and other digital audio/video applications using Flattened Device
	  Trees.

endif
```

## arch/arm/mach-stm32/Kconfig
```kconfig
# SPDX-License-Identifier: GPL-2.0-only
menuconfig ARCH_STM32
	bool "STMicroelectronics STM32 family"
	depends on ARM_SINGLE_ARMV7M || ARCH_MULTI_V7
	select ARMV7M_SYSTICK if ARM_SINGLE_ARMV7M
	select HAVE_ARM_ARCH_TIMER if ARCH_MULTI_V7
	select ARM_GIC if ARCH_MULTI_V7
	select ARM_PSCI if ARCH_MULTI_V7
	select ARM_AMBA
	select ARCH_HAS_RESET_CONTROLLER
	select CLKSRC_STM32
	select PINCTRL
	select RESET_CONTROLLER
	select STM32_EXTI if ARM_SINGLE_ARMV7M
	select STM32_FIREWALL
	help
	  Support for STMicroelectronics STM32MP1 processors using Cortex-A7
	  cores. Note that support for the earlier Cortex-M based variants
	  is deprecated and scheduled for removal in early 2027.

if ARCH_STM32

if ARM_SINGLE_ARMV7M

config MACH_STM32F429
	bool "STMicroelectronics STM32F429 (DEPRECATED)"
	default y

config MACH_STM32F469
	bool "STMicroelectronics STM32F469 (DEPRECATED)"
	default y

config MACH_STM32F746
	bool "STMicroelectronics STM32F746 (DEPRECATED)"
	default y

config MACH_STM32F769
	bool "STMicroelectronics STM32F769 (DEPRECATED)"
	default y

config MACH_STM32H743
	bool "STMicroelectronics STM32H743 (DEPRECATED)"
	default y

endif # ARMv7-M

if ARCH_MULTI_V7

config MACH_STM32MP157
	bool "STMicroelectronics STM32MP157"
	select ARM_ERRATA_814220
	default y

config MACH_STM32MP13
	bool "STMicroelectronics STM32MP13x"
	select ARM_ERRATA_814220
	default y
	help
	  Support for STM32MP13 SoCs:
	  STM32MP131, STM32MP133, STM32MP135

endif # ARMv7-A

endif
```

## arch/arm/mach-sun3i/Kconfig
```kconfig
menu "All winner system configure"
depends on ARCH_SUN3I

config SW_SYSMEM_TOTAL_MEM
	int "Memory Size in MB"
	default 128
	---help---
	  In MB size

config SW_SYSMEM_RESERVED_BASE
	hex "Physical address base to reserved for sun3i"
	default 0x83000000
	---help---
	  Sun3i reserves some memory for its hardware

config SW_SYSMEM_RESERVED_SIZE
	int "Memory reserved size in KB"
	default 16448
	---help---
	  In KB size. Lowwer 32KB for PIN, and then for FB & DE

config SW_PIN_TEST
	tristate "Test code for PIN module"
	default n
	---help---
	  "Test code for PIN module"

endmenu
```

## arch/arm/mach-sun4i/Kconfig
```kconfig
if ARCH_SUN4I

comment "Allwinner A10 options"

config SW_DEBUG_UART
	int "UART to use for low-level debug"
	depends on DEBUG_LL
	default 0
	help
	  Choose the UART on which kernel low-level debug messages should be
	  output.

config SUNXI_IGNORE_ATAG_MEM
	bool "Use AllWinner's hack to assume memory size"
	default n

config SUNXI_MALI_RESERVED_MEM
	bool
	depends on MALI
	default y

config MACH_SUN4I
	bool
	default y

endif
```

## arch/arm/mach-sun5i/Kconfig
```kconfig
if ARCH_SUN5I

config SW_DEBUG_UART
	int "UART to use for low-level debug"
	depends on DEBUG_LL
	default 0
	help
	  Choose the UART on which kernel low-level debug messages should be
	  output.

config SUNXI_MALI_RESERVED_MEM
	bool
	depends on MALI
	default y

endif
```

## arch/arm/mach-sun7i/Kconfig
```kconfig
comment "Allwinner Platform Type"
choice
    prompt "Allwinner Platform Type"
    depends on ARCH_SUN7I
    default AW_ASIC_PLATFORM

config AW_FPGA_PLATFORM
    bool "FPGA board"
    help
        Support for Allwinner's FPGA board

config AW_ASIC_PLATFORM
    bool "ASIC board"
    help
        Support for Allwinner's ASIC board

endchoice
```
