## arch/arm/mach-meson6/Kconfig
```kconfig
if ARCH_MESON6

config CLKTREE_DEBUG
	bool "New clock tree debug support"
	default y
	help
		Create a node /sys/class/meson_clocktree/clkTree to get/set clocks
menu    "Meson Global Timer Setting"
config MESON_TIMERA
	bool "Enable EE Domain Timer A"
	default y
	help
		Enable EE Timer A . if enable the timer is 1Mhz
config MESON_TIMERB
	bool "Enable EE Domain Timer B"
	depends on !SMP || HAVE_ARM_TWD
	default n
	help
		Enable EE Timer B . if enable the timer is 1Mhz
config MESON_TIMERC
	bool "Enable EE Domain Timer C"
	default n
	help
		Enable EE Timer C . if enable the timer is 1Mhz
config MESON_TIMERD
	bool "Enable EE Domain Timer D"
	depends on !SMP || HAVE_ARM_TWD
	default n
	help
		Enable EE Timer D . if enable the timer is 1Mhz
endmenu
choice 
	prompt "Meson Local timer select"
	depends on SMP
	default MESON_LOCAL_TIMER
config  MESON_LOCAL_TIMER
	bool "USE Meson timer "
config  MESON_ARM_TWD
	bool "USE Meson ARM TWD"
	select HAVE_ARM_TWD
endchoice
config MESON_CPU_TEMP_SENSOR
	bool "meson temperature sensor cpu interface support"
	default n
	help
		/sys/class/saradc/temperature can got the celius . 
config CORE_FREQ_TRACK
    bool "trace for cpu frequence with kernel timestamp"
    default n
    help
        Create /dev/core_freq to collect cpu frequent change information with kernel timestamp

config MESON6_SMP_HOTPLUG
	bool "Hotplug support for test"
	depends on SMP
	default n
	help
		Hotplug let cpu1 enter wfi. Wake up it via SGI by cpu0

config SUPPORT_USB_BURNING
	bool "USB burning support"
	default n
	help
		select it for enable USB burning function

config MESON_L2CC_OPTIMIZE
	bool "Optimize L2 cache"
	depends on SMP && CACHE_L2X0
	default n
	help
		enable PL310 double linefill

config MESON_L2CC_DLF
	bool "L2 cache double line fill"
	depends on SMP && CACHE_L2X0
	default n
	help
		enable PL310 double line fill

config MESON_L2CC_STANDBY
	bool "Enable L2 cache standby"
	depends on SMP && CACHE_L2X0
	default n
	help
		enable PL310 dynamic gating & standby mode

config MESON_SUSPEND_FIRMWARE_BASE
        hex
        default 0x1ff00000
        depends on MESON_SUSPEND
        help
          The base address of 1MB of memory reserved for suspend firmware.

config MESON_TRUSTZONE
	bool "Enable ARM Trustzone secure extension"
	default n
	help
		Enable ARM Trustzone secure extension
		
endif # ARCH_MESON36
```

## arch/arm/mach-meson6/Kconfig.boards
```kconfig
if ARCH_MESON6

config MACH_MESON6_COMMON_BOARD
	depends on ARCH_MESON6
	bool "Meson6 common board"
	default y 
	help
      Support for Amlogic Meson6 common development platform.

endif # ARCH_MESON6
```

## arch/arm/mach-meson6tv/Kconfig.boards
```kconfig
if ARCH_MESON6TV

config MACH_MESON6TV_COMMON_BOARD
	depends on ARCH_MESON6TV
	bool "Meson6TV common board"
	default y
	help
	  Support for Amlogic Meson6TV common development platform.

endif # ARCH_MESON6TV
```

## arch/arm/mach-meson6tvd/Kconfig
```kconfig
if ARCH_MESON6TVD

config MESON_M6TV_RECOVERY_MODE
	bool "Recovery mode"
	help
		Include support for revocery mode.

config CLKTREE_DEBUG
	bool "New clock tree debug support"
	default y
	help
		Create a node /sys/class/meson_clocktree/clkTree to get/set clocks


menu    "Meson Global Timer Setting"
config MESON_TIMERA
	bool "Enable EE Domain Timer A"
	default y
	help
		Enable EE Timer A . if enable the timer is 1Mhz
config MESON_TIMERB
	bool "Enable EE Domain Timer B"
	depends on !SMP || HAVE_ARM_TWD
	default n
	help
		Enable EE Timer B . if enable the timer is 1Mhz
config MESON_TIMERC
	bool "Enable EE Domain Timer C"
	default n
	help
		Enable EE Timer C . if enable the timer is 1Mhz
config MESON_TIMERD
	bool "Enable EE Domain Timer D"
	depends on !SMP || HAVE_ARM_TWD
	default n
	help
		Enable EE Timer D . if enable the timer is 1Mhz
endmenu


config MESON_CPU_TEMP_SENSOR
	bool "meson temperature sensor cpu interface support"
	default n
	help
		/sys/class/saradc/temperature can got the celius .
config CORE_FREQ_TRACK
    bool "trace for cpu frequence with kernel timestamp"
    default n
    help
        Create /dev/core_freq to collect cpu frequent change information with kernel timestamp

config MESON6_SMP_HOTPLUG
	bool "Hotplug support for test"
	depends on SMP
	default n
	help
		Hotplug let cpu1 enter wfi. Wake up it via SGI by cpu0

config SUPPORT_USB_BURNING
	bool "USB burning support"
	default n
	help
		select it for enable USB burning function

config MESON_L2CC_OPTIMIZE
	bool "Optimize L2 cache"
	depends on SMP && CACHE_L2X0
	default n
	help
		enable PL310 double linefill

config MESON_L2CC_STANDBY
	bool "Enable L2 cache standby"
	depends on SMP && CACHE_L2X0
	default n
	help
		enable PL310 dynamic gating & standby mode

endif # ARCH_MESON6TVD
```

## arch/arm/mach-meson6tvd/Kconfig.boards
```kconfig
if ARCH_MESON6TVD

config MACH_MESON6TVD_COMMON_BOARD
	depends on ARCH_MESON6TVD
	bool "Meson6TVD common board"
	default y
	help
	  Support for Amlogic Meson6TVD common development platform.

endif # ARCH_MESON6TVD
```

## arch/arm/mach-meson8/Kconfig
```kconfig
if ARCH_MESON8 || ARCH_MESON8M2

config CLKTREE_DEBUG
	bool "New clock tree debug support"
	default y
	help
		Create a node /sys/class/meson_clocktree/clkTree to get/set clocks

config MESON_CPU_TEMP_SENSOR
	bool "meson temperature sensor cpu interface support"
	default n
	help
		/sys/class/saradc/temperature can got the celius . 
config CORE_FREQ_TRACK
    bool "trace for cpu frequence with kernel timestamp"
    default n
    help
        Create /dev/core_freq to collect cpu frequent change information with kernel timestamp

config SUPPORT_USB_BURNING
	bool "USB burning support"
	default n
	help
		select it for enable USB burning function

config MESON_L2CC_OPTIMIZE
	bool "Optimize L2 cache"
	depends on SMP && CACHE_L2X0
	default n
	help
		enable PL310 double linefill

config MESON_L2CC_DLF
	bool "L2 cache double line fill"
	depends on SMP && CACHE_L2X0
	default n
	help
		enable PL310 double line fill

config MESON_L2CC_STANDBY
	bool "Enable L2 cache standby"
	depends on SMP && CACHE_L2X0
	default n
	help
		enable PL310 dynamic gating & standby mode
		
config MESON_FIX_SMP_SCALING_WARNING
	bool "Fix scaling warning"
	depends on SMP
	default n
	help
		Fix scaling warning which caused by smp_call_function

config MESON_SUSPEND_FIRMWARE_BASE
	hex
	default 0x04f00000
	depends on MESON_SUSPEND
	help
		The base address of 1MB of memory reserved for suspend firmware.

config MESON_TRUSTZONE
	bool "Enable ARM Trustzone secure extension"
	default n
	help
		Enable ARM Trustzone secure extension
		
config GPIO_TEST
	bool "support gpio group test"
	default n
	help
		support gpio group test

endif # ARCH_MESON8
```

## arch/arm/mach-meson8/Kconfig.boards
```kconfig
if ARCH_MESON8 || ARCH_MESON8M2

config MACH_MESON8_COMMON_BOARD
	depends on ARCH_MESON8 || ARCH_MESON8M2
	bool "Meson8 common board"
	default y 
	help
      Support for Amlogic Meson8 common development platform.

endif # ARCH_MESON8
```

## arch/arm/mach-meson8b/Kconfig.boards
```kconfig
config MACH_MESON8B_COMMON_BOARD
	depends on ARCH_MESON8B
	bool "Meson8 baby common board"
	default y 
	help
      Support for Amlogic Meson8 baby common development platform.
```

## arch/arm/mach-mesong9tv/Kconfig
```kconfig
if ARCH_MESONG9TV

config CLKTREE_DEBUG
	bool "New clock tree debug support"
	default y
	help
	  Create a node /sys/class/meson_clocktree/clkTree to get/set clocks.

config MESON_CPU_TEMP_SENSOR
	bool "meson temperature sensor cpu interface support"
	default n
	help
	  /sys/class/saradc/temperature can got the celius.

config MESON_SUSPEND_FIRMWARE_BASE
	hex
	default 0x04f00000
	depends on MESON_SUSPEND
	help
	  The base address of 1MB of memory reserved for suspend firmware.

endif # ARCH_MESONG9TV
```

## arch/arm/mach-mesong9tv/Kconfig.boards
```kconfig
config MACH_MESONG9TV_COMMON_BOARD
	depends on ARCH_MESONG9TV
	bool "G9TV common board"
	default y
	help
	  Support for Amlogic G9TV common development platform.
```

## arch/arm/mach-milbeaut/Kconfig
```kconfig
# SPDX-License-Identifier: GPL-2.0
menuconfig ARCH_MILBEAUT
	bool "Socionext Milbeaut SoCs"
	depends on ARCH_MULTI_V7
	select ARM_GIC
	help
	  This enables support for Socionext Milbeaut SoCs

if ARCH_MILBEAUT

config ARCH_MILBEAUT_M10V
	bool "Milbeaut SC2000/M10V platform"
	select ARM_ARCH_TIMER
	select MILBEAUT_TIMER
	select PINCTRL
	select PINCTRL_MILBEAUT
	help
	  Support for Socionext's MILBEAUT M10V based systems

endif
```

## arch/arm/mach-mmp/Kconfig
```kconfig
# SPDX-License-Identifier: GPL-2.0-only
menuconfig ARCH_MMP
	bool "Marvell PXA168/910/MMP2/MMP3"
	depends on (CPU_LITTLE_ENDIAN && ARCH_MULTI_V5) || ARCH_MULTI_V7
	select GPIO_PXA
	select GPIOLIB
	select PINCTRL
	select PLAT_PXA
	help
	  Support for Marvell's PXA168/PXA910(MMP), MMP2, and MMP3 processor lines.

if ARCH_MMP

menu "Marvell PXA168/910/MMP2 Implementations"

config MACH_MMP_DT
	bool "Support MMP (ARMv5) platforms from device tree"
	depends on ARCH_MULTI_V5
	select PINCTRL
	select PINCTRL_SINGLE
	select ARCH_HAS_RESET_CONTROLLER
	select CPU_MOHAWK
	help
	  Include support for Marvell MMP2 based platforms using
	  the device tree. Needn't select any other machine while
	  MACH_MMP_DT is enabled.

config MACH_MMP2_DT
	bool "Support MMP2 (ARMv7) platforms from device tree"
	depends on ARCH_MULTI_V7
	select PINCTRL
	select PINCTRL_SINGLE
	select ARCH_HAS_RESET_CONTROLLER
	select CPU_PJ4
	select PM_GENERIC_DOMAINS if PM
	select PM_GENERIC_DOMAINS_OF if PM && OF
	help
	  Include support for Marvell MMP2 based platforms using
	  the device tree.

config MACH_MMP3_DT
	bool "Support MMP3 (ARMv7) platforms"
	depends on ARCH_MULTI_V7
	select ARM_GIC
	select HAVE_ARM_SCU if SMP
	select HAVE_ARM_TWD if SMP
	select CACHE_L2X0
	select PINCTRL
	select PINCTRL_SINGLE
	select ARCH_HAS_RESET_CONTROLLER
	select CPU_PJ4B
	select PM_GENERIC_DOMAINS if PM
	select PM_GENERIC_DOMAINS_OF if PM && OF
	help
	  Say 'Y' here if you want to include support for platforms
	  with Marvell MMP3 processor, also known as PXA2128 or
	  Armada 620.

endmenu

config CPU_PXA168
	bool
	select CPU_MOHAWK
	help
	  Select code specific to PXA168

config CPU_PXA910
	bool
	select CPU_MOHAWK
	help
	  Select code specific to PXA910

config CPU_MMP2
	bool
	select CPU_PJ4
	help
	  Select code specific to MMP2. MMP2 is ARMv7 compatible.

endif
```

## arch/arm/mach-moxart/Kconfig
```kconfig
menuconfig ARCH_MOXART
	bool "MOXA ART SoC"
	depends on ARCH_MULTI_V4
	select CPU_FA526
	select ARM_DMA_MEM_BUFFERABLE
	select MOXART_TIMER
	select GENERIC_IRQ_CHIP
	select GPIOLIB
	select PHYLIB if NETDEVICES
	help
	  Say Y here if you want to run your kernel on hardware with a
	  MOXA ART SoC.
	  The MOXA ART SoC is based on a Faraday FA526 ARMv4 32-bit
	  192 MHz CPU with MMU and 16KB/8KB D/I-cache (UC-7112-LX).
	  Used on models UC-7101, UC-7112/UC-7110, IA240/IA241, IA3341.

if ARCH_MOXART

config MACH_UC7112LX
	bool "MOXA UC-7112-LX"
	depends on ARCH_MOXART
	help
	  Say Y here if you intend to run this kernel on a MOXA
	  UC-7112-LX embedded computer.

endif
```
