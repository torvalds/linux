## arch/arm/mach-iop3xx/Kconfig
```kconfig
if ARCH_IOP3XX

menu "IOP3xx Implementation Options"

comment "IOP3xx Platform Types"

config ARCH_IQ80321
	bool "Enable support for IQ80321"
	select ARCH_IOP321
	help
	  Say Y here if you want to run your kernel on the Intel IQ80321
	  evaluation kit for the IOP321 chipset.

config ARCH_IQ31244
	bool "Enable support for IQ31244"
	select ARCH_IOP321
	help
	  Say Y here if you want to run your kernel on the Intel IQ31244
	  evaluation kit for the IOP321 chipset.

config ARCH_IQ80331
	bool "Enable support for IQ80331"
	select ARCH_IOP331
	help
	  Say Y here if you want to run your kernel on the Intel IQ80331
	  evaluation kit for the IOP331 chipset.

config MACH_IQ80332
	bool "Enable support for IQ80332"
	select ARCH_IOP331
	help
	  Say Y here if you want to run your kernel on the Intel IQ80332
	  evaluation kit for the IOP332 chipset

config ARCH_EP80219
    bool "Enable support for EP80219"
    select ARCH_IOP321
    select ARCH_IQ31244

# Which IOP variant are we running?
config ARCH_IOP321
	bool
	help
	  The IQ80321 uses the IOP321 variant.
	  The IQ31244 and EP80219 uses the IOP321 variant.

config ARCH_IOP331
	bool
	default ARCH_IQ80331
	help
	  The IQ80331, IQ80332, and IQ80333 uses the IOP331 variant.

comment "IOP3xx Chipset Features"

config IOP331_STEPD
	bool "Chip stepping D of the IOP80331 processor or IOP80333"
	depends on (ARCH_IOP331)
	help
		  Say Y here if you have StepD of the IOP80331 or IOP8033
		  based platforms.

endmenu
endif
```

## arch/arm/mach-ixp2000/Kconfig
```kconfig
if ARCH_IXP2000

config ARCH_SUPPORTS_BIG_ENDIAN
	bool
	default y

menu "Intel IXP2400/2800 Implementation Options"

comment "IXP2400/2800 Platforms"

config ARCH_ENP2611
	bool "Support Radisys ENP-2611"
	help
	  Say 'Y' here if you want your kernel to support the Radisys
	  ENP2611 PCI network processing card. For more information on
	  this card, see <file:Documentation/arm/IXP2000>.

config ARCH_IXDP2400
	bool "Support Intel IXDP2400"
	help
	  Say 'Y' here if you want your kernel to support the Intel
	  IXDP2400 reference platform. For more information on
	  this platform, see <file:Documentation/arm/IXP2000>.

config ARCH_IXDP2800
	bool "Support Intel IXDP2800"
	help
	  Say 'Y' here if you want your kernel to support the Intel
	  IXDP2800 reference platform. For more information on
	  this platform, see <file:Documentation/arm/IXP2000>.

config ARCH_IXDP2X00
	bool
	depends on ARCH_IXDP2400 || ARCH_IXDP2800
	default y	

config ARCH_IXDP2401
	bool "Support Intel IXDP2401"
	help
	  Say 'Y' here if you want your kernel to support the Intel
	  IXDP2401 reference platform. For more information on
	  this platform, see <file:Documentation/arm/IXP2000>.

config ARCH_IXDP2801
	bool "Support Intel IXDP2801 and IXDP28x5"
	help
	  Say 'Y' here if you want your kernel to support the Intel
	  IXDP2801/2805/2855 reference platforms. For more information on
	  this platform, see <file:Documentation/arm/IXP2000>.

config MACH_IXDP28X5
	bool
	depends on ARCH_IXDP2801
	default y

config ARCH_IXDP2X01
	bool
	depends on ARCH_IXDP2401 || ARCH_IXDP2801
	default y	

config IXP2000_SUPPORT_BROKEN_PCI_IO
	bool "Support broken PCI I/O on older IXP2000s"
	default y
	help
	  Say 'N' here if you only intend to run your kernel on an
	  IXP2000 B0 or later model and do not need the PCI I/O
	  byteswap workaround.  Say 'Y' otherwise.

endmenu

endif
```

## arch/arm/mach-ixp23xx/Kconfig
```kconfig
if ARCH_IXP23XX

config ARCH_SUPPORTS_BIG_ENDIAN
	bool
	default y

menu "Intel IXP23xx Implementation Options"

comment "IXP23xx Platforms"

config MACH_ESPRESSO
	bool "Support IP Fabrics Double Espresso platform"
	help

config MACH_IXDP2351
	bool "Support Intel IXDP2351 platform"
	help

config MACH_ROADRUNNER
	bool "Support ADI RoadRunner platform"
	help

endmenu

endif
```

## arch/arm/mach-ixp4xx/Kconfig
```kconfig
# SPDX-License-Identifier: GPL-2.0-only
menuconfig ARCH_IXP4XX
	bool "IXP4xx-based platforms"
	depends on ARCH_MULTI_V5
	depends on CPU_BIG_ENDIAN
	select ARM_APPENDED_DTB # Old Redboot bootloaders deployed
	select CPU_XSCALE
	select GPIO_IXP4XX
	select GPIOLIB
	select FORCE_PCI
	select I2C
	select I2C_IOP3XX
	select IXP4XX_IRQ
	select IXP4XX_TIMER
	select USB_EHCI_BIG_ENDIAN_DESC
	select USB_EHCI_BIG_ENDIAN_MMIO
	select USE_OF
	help
	  Support for Intel's IXP4XX (XScale) family of processors.
```

## arch/arm/mach-keystone/Kconfig
```kconfig
# SPDX-License-Identifier: GPL-2.0-only
config ARCH_KEYSTONE
	bool "Texas Instruments Keystone Devices"
	depends on ARCH_MULTI_V7
	select ARM_GIC
	select HAVE_ARM_ARCH_TIMER
	select KEYSTONE_TIMER
	select ARCH_HAS_RESET_CONTROLLER
	select ARM_ERRATA_798181 if SMP
	select COMMON_CLK_KEYSTONE
	select ZONE_DMA if ARM_LPAE
	select PINCTRL
	select PM_GENERIC_DOMAINS if PM
	help
	  Support for boards based on the Texas Instruments Keystone family of
	  SoCs.
```

## arch/arm/mach-kirkwood/Kconfig
```kconfig
if ARCH_KIRKWOOD

menu "Marvell Kirkwood Implementations"

config KIRKWOOD_LEGACY
	bool

config MACH_D2NET_V2
	bool "LaCie d2 Network v2 NAS Board"
	select KIRKWOOD_LEGACY
	help
	  Say 'Y' here if you want your kernel to support the
	  LaCie d2 Network v2 NAS.

config MACH_NET2BIG_V2
	bool "LaCie 2Big Network v2 NAS Board"
	select KIRKWOOD_LEGACY
	help
	  Say 'Y' here if you want your kernel to support the
	  LaCie 2Big Network v2 NAS.

config MACH_NET5BIG_V2
	bool "LaCie 5Big Network v2 NAS Board"
	select KIRKWOOD_LEGACY
	help
	  Say 'Y' here if you want your kernel to support the
	  LaCie 5Big Network v2 NAS.

config MACH_OPENRD
	select KIRKWOOD_LEGACY
        bool

config MACH_OPENRD_BASE
	bool "Marvell OpenRD Base Board"
	select MACH_OPENRD
	help
	  Say 'Y' here if you want your kernel to support the
	  Marvell OpenRD Base Board.

config MACH_OPENRD_CLIENT
	bool "Marvell OpenRD Client Board"
	select MACH_OPENRD
	help
	  Say 'Y' here if you want your kernel to support the
	  Marvell OpenRD Client Board.

config MACH_OPENRD_ULTIMATE
	bool "Marvell OpenRD Ultimate Board"
	select MACH_OPENRD
	help
	  Say 'Y' here if you want your kernel to support the
	  Marvell OpenRD Ultimate Board.

config MACH_RD88F6192_NAS
	bool "Marvell RD-88F6192-NAS Reference Board"
	select KIRKWOOD_LEGACY
	help
	  Say 'Y' here if you want your kernel to support the
	  Marvell RD-88F6192-NAS Reference Board.

config MACH_RD88F6281
	bool "Marvell RD-88F6281 Reference Board"
	select KIRKWOOD_LEGACY
	help
	  Say 'Y' here if you want your kernel to support the
	  Marvell RD-88F6281 Reference Board.

config MACH_T5325
	bool "HP t5325 Thin Client"
	select KIRKWOOD_LEGACY
	help
	  Say 'Y' here if you want your kernel to support the
	  HP t5325 Thin Client.

config MACH_TS219
	bool "QNAP TS-110, TS-119, TS-119P+, TS-210, TS-219, TS-219P and TS-219P+ Turbo NAS"
	select KIRKWOOD_LEGACY
	help
	  Say 'Y' here if you want your kernel to support the
	  QNAP TS-110, TS-119, TS-119P+, TS-210, TS-219, TS-219P and
	  TS-219P+ Turbo NAS devices.

config MACH_TS41X
	bool "QNAP TS-410, TS-410U, TS-419P, TS-419P+ and TS-419U Turbo NAS"
	select KIRKWOOD_LEGACY
	help
	  Say 'Y' here if you want your kernel to support the
	  QNAP TS-410, TS-410U, TS-419P, TS-419P+ and TS-419U Turbo
	  NAS devices.

comment "Device tree entries"

config ARCH_KIRKWOOD_DT
	bool "Marvell Kirkwood Flattened Device Tree"
	select KIRKWOOD_CLK
	select OF_IRQ
	select ORION_IRQCHIP
	select ORION_TIMER
	select POWER_SUPPLY
	select POWER_RESET
	select POWER_RESET_GPIO
	select REGULATOR
	select REGULATOR_FIXED_VOLTAGE
	select USE_OF
	help
	  Say 'Y' here if you want your kernel to support the
	  Marvell Kirkwood using flattened device tree.

endmenu

endif
```

## arch/arm/mach-ks8695/Kconfig
```kconfig
if ARCH_KS8695

menu "Kendin/Micrel KS8695 Implementations"

config MACH_KS8695
	bool "KS8695 development board"
	select HAVE_PCI
	help
	  Say 'Y' here if you want your kernel to run on the original
	  Kendin-Micrel KS8695 development board.

config MACH_DSM320
	bool "DSM-320 Wireless Media Player"
	help
	  Say 'Y' here if you want your kernel to run on the D-Link
	  DSM-320 Wireless Media Player.

config MACH_ACS5K
	bool "Brivo Systems LLC, ACS-5000 Master board"
	help
	  say 'Y' here if you want your kernel to run on the Brivo
	  Systems LLC, ACS-5000 Master board.

config MACH_LITE300
	bool "SecureComputing SG300"
	help
	  Say 'Y' here if you want your kernel to support the
	  SecureComputing / SnapGear SG300 VPN Internet Router.
	  See http://www.securecomputing.com for more details.

config MACH_SG310
	bool "McAfee SG310"
	help
	  Say 'Y' here if you want your kernel to support the
	  McAfee / SnapGear SG310 VPN Internet Router.
	  See http://www.mcafee.com for more details.

config MACH_SE4200
	bool "SecureComputing SE4200"
	help
	  Say 'Y' here if you want your kernel to support the
	  SecureComputing / SnapGear SE4200 Secure Wireless VPN
	  Internet Router.
	  See http://www.securecomputing.com for more details.

config MACH_CM4002
	bool "OpenGear CM4002"
	help
	  Say 'Y' here if you want your kernel to support the OpenGear
	  CM4002 Secure Access Server. See http://www.opengear.com for
	  more details.

config MACH_CM4008
	bool "OpenGear CM4008"
	select HAVE_PCI
	help
	  Say 'Y' here if you want your kernel to support the OpenGear
	  CM4008 Console Server. See http://www.opengear.com for more
	  details.

config MACH_CM41xx
	bool "OpenGear CM41xx"
	select HAVE_PCI
	help
	  Say 'Y' here if you want your kernel to support the OpenGear
	  CM4016 or CM4048 Console Servers. See http://www.opengear.com for
	  more details.

config MACH_IM4004
	bool "OpenGear IM4004"
	select HAVE_PCI
	help
	  Say 'Y' here if you want your kernel to support the OpenGear
	  IM4004 Secure Access Server. See http://www.opengear.com for
	  more details.

config MACH_IM42xx
	bool "OpenGear IM42xx"
	select HAVE_PCI
	help
	  Say 'Y' here if you want your kernel to support the OpenGear
	  IM4216 or IM4248 Console Servers. See http://www.opengear.com for
	  more details.

endmenu

endif
```

## arch/arm/mach-lh7a40x/Kconfig
```kconfig
if ARCH_LH7A40X

menu "LH7A40X Implementations"

config MACH_KEV7A400
	bool "KEV7A400"
	select ARCH_LH7A400
	help
	  Say Y here if you are using the Sharp KEV7A400 development
	  board.  This hardware is discontinued, so I'd be very
	  suprised if you wanted this option.

config MACH_LPD7A400
	bool "LPD7A400 Card Engine"
	select ARCH_LH7A400
#	select IDE_POLL
	select HAS_TOUCHSCREEN_ADS7843_LH7
	help
	  Say Y here if you are using Logic Product Development's
	  LPD7A400 CardEngine.  For the time being, the LPD7A400 and
	  LPD7A404 options are mutually exclusive.

config MACH_LPD7A404
	bool "LPD7A404 Card Engine"
	select ARCH_LH7A404
#	select IDE_POLL
	select HAS_TOUCHSCREEN_ADC_LH7
	help
	  Say Y here if you are using Logic Product Development's
	  LPD7A404 CardEngine. For the time being, the LPD7A400 and
	  LPD7A404 options are mutually exclusive.

config ARCH_LH7A400
	bool

config ARCH_LH7A404
	bool

config LPD7A40X_CPLD_SSP
	bool

config LH7A40X_CONTIGMEM
	bool "Disable NUMA Support"
	depends on ARCH_LH7A40X
	help
	  Say Y here if your bootloader sets the SROMLL bit(s) in
	  the SDRAM controller, organizing memory as a contiguous
	  array.  This option will disable CONFIG_DISCONTIGMEM and
          force the kernel to manage all memory in one node.

	  Setting this option incorrectly may prevent the kernel from
	  booting.  It is OK to leave it N.

	  For more information, consult
	    <file:Documentation/arm/Sharp-LH/SDRAM>.

config LH7A40X_ONE_BANK_PER_NODE
	bool "Optimize NUMA Node Tables for Size"
	depends on ARCH_LH7A40X && !LH7A40X_CONTIGMEM
	help
	  Say Y here to produce compact memory node tables.  By
	  default pairs of adjacent physical RAM banks are managed
	  together in a single node, incurring some wasted overhead
	  in the node tables, however also maintaining compatibility
	  with systems where physical memory is truly contiguous.

	  Setting this option incorrectly may prevent the kernel from
	  booting.  It is OK to leave it N.

	  For more information, consult
	    <file:Documentation/arm/Sharp-LH/SDRAM>.

endmenu

endif
```

## arch/arm/mach-loki/Kconfig
```kconfig
if ARCH_LOKI

menu "Marvell Loki (88RC8480) Implementations"

config MACH_LB88RC8480
	bool "Marvell LB88RC8480 Development Board"
	help
	  Say 'Y' here if you want your kernel to support the
	  Marvell LB88RC8480 Development Board.

endmenu

endif
```

## arch/arm/mach-lpc32xx/Kconfig
```kconfig
# SPDX-License-Identifier: GPL-2.0-only

config ARCH_LPC32XX
	bool "NXP LPC32XX"
	depends on ARCH_MULTI_V5
	depends on CPU_LITTLE_ENDIAN
	select ARM_AMBA
	select CLKSRC_LPC32XX
	select CPU_ARM926T
	select GPIOLIB
	help
	  Support for the NXP LPC32XX family of processors
```

## arch/arm/mach-mediatek/Kconfig
```kconfig
menuconfig ARCH_MEDIATEK
	bool "MediaTek SoC Support"
	depends on ARCH_MULTI_V7
	select ARM_GIC
	select PINCTRL
	select MTK_TIMER
	select MFD_SYSCON
	help
	  Support for Mediatek MT65xx & MT81xx SoCs

if ARCH_MEDIATEK

config MACH_MT2701
	bool "MediaTek MT2701 SoCs support"
	default ARCH_MEDIATEK

config MACH_MT6589
	bool "MediaTek MT6589 SoCs support"
	default ARCH_MEDIATEK

config MACH_MT6592
	bool "MediaTek MT6592 SoCs support"
	default ARCH_MEDIATEK

config MACH_MT7623
	bool "MediaTek MT7623 SoCs support"
	default ARCH_MEDIATEK

config MACH_MT8127
	bool "MediaTek MT8127 SoCs support"
	default ARCH_MEDIATEK

config MACH_MT8135
	bool "MediaTek MT8135 SoCs support"
	default ARCH_MEDIATEK

endif
```

## arch/arm/mach-meson/Kconfig
```kconfig
menuconfig ARCH_MESON
	bool "Amlogic Meson SoCs"
	depends on ARCH_MULTI_V7
	select GPIOLIB
	select GENERIC_IRQ_CHIP
	select ARM_GIC
	select ARM_GLOBAL_TIMER
	select CACHE_L2X0
	select PINCTRL
	select PINCTRL_MESON
	select COMMON_CLK
	select COMMON_CLK_AMLOGIC
	select HAVE_ARM_SCU if SMP
	select HAVE_ARM_TWD if SMP

if ARCH_MESON

config MACH_MESON6
	bool "Amlogic Meson6 (8726MX) SoCs support"
	default ARCH_MESON
	select MESON6_TIMER

config MACH_MESON8
	bool "Amlogic Meson8, Meson8b and Meson8m2 SoCs support"
	default ARCH_MESON
	select MESON6_TIMER
	select COMMON_CLK_MESON8B
	select MESON_IRQ_GPIO

endif
```
