## arch/arm/mach-bcm2835/Kconfig
```kconfig
config ARCH_BCM2835
	bool "Broadcom BCM2835 family" if ARCH_MULTI_V6
	select ARCH_REQUIRE_GPIOLIB
	select ARM_AMBA
	select ARM_ERRATA_411920
	select ARM_TIMER_SP804
	select CPU_V6
	select PINCTRL
	select PINCTRL_BCM2835
	help
	  This enables support for the Broadcom BCM2835 SoC. This SoC is
	  used in the Raspberry Pi and Roku 2 devices.
```

## arch/arm/mach-bcmring/Kconfig
```kconfig
choice
	prompt "Processor selection in BCMRING family of devices"
	depends on ARCH_BCMRING
	default ARCH_BCM11107

config ARCH_FPGA11107
	bool "FPGA11107"

config ARCH_BCM11107
	bool "BCM11107"
endchoice

menu "BCMRING Options"
	depends on ARCH_BCMRING

config BCM_ZRELADDR
	hex "Compressed ZREL ADDR"

endmenu

# source "drivers/char/bcmring/Kconfig"
```

## arch/arm/mach-berlin/Kconfig
```kconfig
# SPDX-License-Identifier: GPL-2.0-only
menuconfig ARCH_BERLIN
	bool "Marvell Berlin SoCs"
	depends on ARCH_MULTI_V7
	select ARCH_HAS_RESET_CONTROLLER
	select ARM_GIC
	select DW_APB_ICTL
	select DW_APB_TIMER_OF
	select GENERIC_IRQ_CHIP
	select GPIOLIB
	select MFD_SYSCON
	select PINCTRL

if ARCH_BERLIN

config MACH_BERLIN_BG2
	bool "Marvell Armada 1500 (BG2)"
	select CACHE_L2X0
	select CPU_PJ4B
	select HAVE_ARM_SCU if SMP
	select HAVE_ARM_TWD if SMP
	select PINCTRL_BERLIN_BG2

config MACH_BERLIN_BG2CD
	bool "Marvell Armada 1500-mini (BG2CD)"
	select ARM_ERRATA_754322
	select ARM_ERRATA_775420
	select ARM_GLOBAL_TIMER
	select CACHE_L2X0
	select HAVE_ARM_SCU
	select HAVE_ARM_TWD
	select PINCTRL_BERLIN_BG2CD

config MACH_BERLIN_BG2Q
	bool "Marvell Armada 1500 Pro (BG2-Q)"
	select CACHE_L2X0
	select HAVE_ARM_SCU if SMP
	select HAVE_ARM_TWD if SMP
	select PINCTRL_BERLIN_BG2Q

endif
```

## arch/arm/mach-clps711x/Kconfig
```kconfig
# SPDX-License-Identifier: GPL-2.0
menuconfig ARCH_CLPS711X
	bool "Cirrus Logic EP721x/EP731x-based"
	depends on ARCH_MULTI_V4T
	select CLPS711X_TIMER
	select CPU_ARM720T
	select GPIOLIB
	select MFD_SYSCON
	select OF_IRQ
	help
	  Select this if you use ARMv4T Cirrus Logic chips.
```

## arch/arm/mach-cns3xxx/Kconfig
```kconfig
menuconfig ARCH_CNS3XXX
	bool "Cavium Networks CNS3XXX family" if ARCH_MULTI_V6
	select ARM_GIC
	select PCI_DOMAINS if PCI
	help
	  Support for Cavium Networks CNS3XXX platform.

if ARCH_CNS3XXX

config MACH_CNS3420VB
	bool "Support for CNS3420 Validation Board"
	depends on ATAGS
	help
	  Include support for the Cavium Networks CNS3420 MPCore Platform
	  Baseboard.
	  This is a platform with an on-board ARM11 MPCore and has support
	  for USB, USB-OTG, MMC/SD/SDIO, SATA, PCI-E, etc.

endif
```

## arch/arm/mach-davinci/Kconfig
```kconfig
# SPDX-License-Identifier: GPL-2.0

menuconfig ARCH_DAVINCI
	bool "TI DaVinci"
	depends on ARCH_MULTI_V5
	depends on CPU_LITTLE_ENDIAN
	select DAVINCI_TIMER
	select ZONE_DMA
	select PM_GENERIC_DOMAINS if PM
	select PM_GENERIC_DOMAINS_OF if PM && OF
	select REGMAP_MMIO
	select RESET_CONTROLLER
	select PINCTRL
	select PINCTRL_SINGLE

if ARCH_DAVINCI

comment "DaVinci Core Type"

config ARCH_DAVINCI_DA830
	bool "DA830/OMAP-L137/AM17x based system"
	select ARCH_DAVINCI_DA8XX
	# needed on silicon revs 1.0, 1.1:
	select CPU_DCACHE_WRITETHROUGH if !CPU_DCACHE_DISABLE
	select DAVINCI_CP_INTC

config ARCH_DAVINCI_DA850
	bool "DA850/OMAP-L138/AM18x based system"
	select DAVINCI_CP_INTC

config ARCH_DAVINCI_DA8XX
	bool

config DAVINCI_MUX
	bool "DAVINCI multiplexing support"
	depends on ARCH_DAVINCI
	default y
	help
	  Pin multiplexing support for DAVINCI boards. If your bootloader
	  sets the multiplexing correctly, say N. Otherwise, or if unsure,
	  say Y.

config DAVINCI_MUX_DEBUG
	bool "Multiplexing debug output"
	depends on DAVINCI_MUX
	help
	  Makes the multiplexing functions print out a lot of debug info.
	  This is useful if you want to find out the correct values of the
	  multiplexing registers.

config DAVINCI_MUX_WARNINGS
	bool "Warn about pins the bootloader didn't set up"
	depends on DAVINCI_MUX
	help
	  Choose Y here to warn whenever driver initialization logic needs
	  to change the pin multiplexing setup. When there are no warnings
	  printed, it's safe to deselect DAVINCI_MUX for your product.

endif
```

## arch/arm/mach-digicolor/Kconfig
```kconfig
config ARCH_DIGICOLOR
	bool "Conexant Digicolor SoC Support"
	depends on ARCH_MULTI_V7
	select CLKSRC_MMIO
	select DIGICOLOR_TIMER
	select GENERIC_IRQ_CHIP
	select GPIOLIB
	select MFD_SYSCON
	select PINCTRL
	select PINCTRL_DIGICOLOR
```

## arch/arm/mach-dove/Kconfig
```kconfig
# SPDX-License-Identifier: GPL-2.0
menuconfig ARCH_DOVE
	bool "Marvell Dove" if ARCH_MULTI_V7
	depends on ATAGS
	select CPU_PJ4
	select GPIOLIB
	select MVEBU_MBUS
	select PINCTRL
	select PINCTRL_DOVE
	select PLAT_ORION_LEGACY
	select PM_GENERIC_DOMAINS if PM
	select PCI_QUIRKS if PCI
	help
	  Support for the Marvell Dove SoC 88AP510

if ARCH_DOVE

config DOVE_LEGACY
	bool

config MACH_CM_A510
	bool "CompuLab CM-A510 Board"
	select DOVE_LEGACY
	help
	  Say 'Y' here if you want your kernel to support the
	  CompuLab CM-A510 Board.

endif
```

## arch/arm/mach-ep93xx/Kconfig
```kconfig
# SPDX-License-Identifier: GPL-2.0-only
menuconfig ARCH_EP93XX
	bool "EP93xx-based"
	depends on ATAGS
	depends on ARCH_MULTI_V4T
	# CONFIG_ARCH_MULTI_V7 is not set
	depends on CPU_LITTLE_ENDIAN
	select ARCH_HAS_RESET_CONTROLLER
	select ARCH_SPARSEMEM_ENABLE
	select ARM_AMBA
	select ARM_VIC
	select ARM_APPENDED_DTB # Old Redboot bootloaders deployed
	select ARM_ATAG_DTB_COMPAT # we need this to update dt memory node
	select COMMON_CLK_EP93XX
	select EP93XX_TIMER
	select CLKSRC_MMIO
	select CPU_ARM920T
	select GPIOLIB
	select PINCTRL
	select PINCTRL_EP93XX
	help
	  This enables support for the Cirrus EP93xx series of CPUs.

if ARCH_EP93XX

# menu "EP93xx Platforms"

config MACH_BK3
	bool "Support Liebherr BK3.1"
	select MACH_TS72XX
	help
	  Say 'Y' here if you want your kernel to support the
	  Liebherr controller BK3.1.

config MACH_EDB93XX
	bool

config MACH_EDB9301
	bool "Support Cirrus Logic EDB9301"
	select MACH_EDB93XX
	help
	  Say 'Y' here if you want your kernel to support the Cirrus
	  Logic EDB9301 Evaluation Board.

config MACH_EDB9302
	bool "Support Cirrus Logic EDB9302"
	select MACH_EDB93XX
	help
	  Say 'Y' here if you want your kernel to support the Cirrus
	  Logic EDB9302 Evaluation Board.

config MACH_EDB9302A
	bool "Support Cirrus Logic EDB9302A"
	select MACH_EDB93XX
	help
	  Say 'Y' here if you want your kernel to support the Cirrus
	  Logic EDB9302A Evaluation Board.

config MACH_EDB9307
	bool "Support Cirrus Logic EDB9307"
	select MACH_EDB93XX
	help
	  Say 'Y' here if you want your kernel to support the Cirrus
	  Logic EDB9307 Evaluation Board.

config MACH_EDB9307A
	bool "Support Cirrus Logic EDB9307A"
	select MACH_EDB93XX
	help
	  Say 'Y' here if you want your kernel to support the Cirrus
	  Logic EDB9307A Evaluation Board.

config MACH_EDB9312
	bool "Support Cirrus Logic EDB9312"
	select MACH_EDB93XX
	help
	  Say 'Y' here if you want your kernel to support the Cirrus
	  Logic EDB9312 Evaluation Board.

config MACH_EDB9315
	bool "Support Cirrus Logic EDB9315"
	select MACH_EDB93XX
	help
	  Say 'Y' here if you want your kernel to support the Cirrus
	  Logic EDB9315 Evaluation Board.

config MACH_EDB9315A
	bool "Support Cirrus Logic EDB9315A"
	select MACH_EDB93XX
	help
	  Say 'Y' here if you want your kernel to support the Cirrus
	  Logic EDB9315A Evaluation Board.

config MACH_TS72XX
	bool "Support Technologic Systems TS-72xx SBC"
	help
	  Say 'Y' here if you want your kernel to support the
	  Technologic Systems TS-72xx board.

config MACH_VISION_EP9307
	bool "Support Vision Engraving Systems EP9307 SoM"
	help
	  Say 'Y' here if you want your kernel to support the
	  Vision Engraving Systems EP9307 SoM.

# endmenu

endif
```

## arch/arm/mach-epxa10db/Kconfig
```kconfig
if ARCH_CAMELOT

menu "Epxa10db"

comment "PLD hotswap support"

config PLD
	bool
	default y

config PLD_HOTSWAP
	bool "Support for PLD device hotplugging (experimental)"
	depends on EXPERIMENTAL
	help
	  This enables support for the dynamic loading and configuration of
	  compatible drivers when the contents of the PLD are changed. This
	  is still experimental and requires configuration tools which are
	  not yet generally available. Say N here. You must enable the kernel
	  module loader for this feature to work.

endmenu

endif
```

## arch/arm/mach-exynos/Kconfig
```kconfig
# SPDX-License-Identifier: GPL-2.0
#
# Copyright (c) 2010-2011 Samsung Electronics Co., Ltd.
#		http://www.samsung.com/

# Configuration options for the Samsung Exyanals

menuconfig ARCH_EXYANALS
	bool "Samsung Exyanals"
	depends on ARCH_MULTI_V7
	select ARM_AMBA
	select ARM_GIC
	select EXYANALS_IRQ_COMBINER
	select COMMON_CLK_SAMSUNG
	select EXYANALS_THERMAL
	select EXYANALS_PMU
	select EXYANALS_SROM
	select EXYANALS_PM_DOMAINS if PM_GENERIC_DOMAINS
	select HAVE_ARM_ARCH_TIMER if ARCH_EXYANALS5
	select HAVE_ARM_SCU if SMP
	select PINCTRL
	select PINCTRL_EXYANALS
	select PM_GENERIC_DOMAINS if PM
	select S5P_DEV_MFC
	select SAMSUNG_MC
	select SOC_SAMSUNG
	select SRAM
	select THERMAL
	select THERMAL_OF
	select MFD_SYSCON
	select MEMORY
	select CLKSRC_EXYANALS_MCT
	select POWER_RESET
	select POWER_RESET_SYSCON
	select POWER_RESET_SYSCON_POWEROFF
	help
	  Support for Samsung Exyanals SoCs

if ARCH_EXYANALS

config S5P_DEV_MFC
	bool
	help
	  Compile in setup memory (init) code for MFC

config ARCH_EXYANALS3
	bool "Samsung Exyanals3"
	default y
	select ARM_CPU_SUSPEND if PM
	help
	  Samsung Exyanals3 (Cortex-A7) SoC based systems

config ARCH_EXYANALS4
	bool "Samsung Exyanals4"
	default y
	select ARM_CPU_SUSPEND if PM_SLEEP
	select CLKSRC_SAMSUNG_PWM if CPU_EXYANALS4210
	select CPU_EXYANALS4210
	select GIC_ANALN_BANKED
	help
	  Samsung Exyanals4 (Cortex-A9) SoC based systems

config ARCH_EXYANALS5
	bool "Samsung Exyanals5"
	default y
	help
	  Samsung Exyanals5 (Cortex-A15/A7) SoC based systems

comment "Exyanals SoCs"

config SOC_EXYANALS3250
	bool "Samsung Exyanals3250"
	default y
	depends on ARCH_EXYANALS3

config CPU_EXYANALS4210
	bool "Samsung Exyanals4210"
	default y
	depends on ARCH_EXYANALS4

config SOC_EXYANALS4212
	bool "Samsung Exyanals4212"
	default y
	depends on ARCH_EXYANALS4

config SOC_EXYANALS4412
	bool "Samsung Exyanals4412"
	default y
	depends on ARCH_EXYANALS4

config SOC_EXYANALS5250
	bool "Samsung Exyanals5250"
	default y
	depends on ARCH_EXYANALS5

config SOC_EXYANALS5260
	bool "Samsung Exyanals5260"
	default y
	depends on ARCH_EXYANALS5

config SOC_EXYANALS5410
	bool "Samsung Exyanals5410"
	default y
	depends on ARCH_EXYANALS5

config SOC_EXYANALS5420
	bool "Samsung Exyanals5420"
	default y
	depends on ARCH_EXYANALS5
	select EXYANALS_MCPM if SMP
	select ARM_CCI400_PORT_CTRL
	select ARM_CPU_SUSPEND

config SOC_EXYANALS5800
	bool "Samsung EXYANALS5800"
	default y
	depends on SOC_EXYANALS5420
	select EXYANALS_REGULATOR_COUPLER

config EXYANALS_MCPM
	bool
	select MCPM

config EXYANALS_CPU_SUSPEND
	bool
	select ARM_CPU_SUSPEND
	default PM_SLEEP || ARM_EXYANALS_CPUIDLE

endif
```
