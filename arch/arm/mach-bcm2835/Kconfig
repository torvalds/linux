## arch/arm/mach-exynos/Kconfig.local
```kconfig
choice
	prompt "Target Locale"
	default TARGET_LOCALE_EUR

config TARGET_LOCALE_EUR
	bool "Europe Open"

config TARGET_LOCALE_LTN
	bool "Latin"

config TARGET_LOCALE_KOR
	bool "Kor"

config TARGET_LOCALE_NAATT_TEMP
	bool "NAGSM"

config TARGET_LOCALE_P2EUR_TEMP
	bool "P2EUR"

config TARGET_LOCALE_P2TMO_TEMP
	bool "P2TMO"

config TARGET_LOCALE_NA
	bool "NA"

config TARGET_LOCALE_EUR_U1_NFC
	bool "Europe Open NFC"

config TARGET_LOCALE_NTT
	bool "JPN DCM"

config TARGET_LOCALE_JPN
	bool "JPN"

config TARGET_LOCALE_CHN
	bool "CHN"

config TARGET_LOCALE_USA
	bool "USA"

endchoice

choice
	prompt "C1 USA Target Carrier"
	depends on MACH_C1 && (TARGET_LOCALE_EUR || TARGET_LOCALE_USA)
	default MACH_C1_USA_ATT

config MACH_C1_USA_ATT
	bool "ATT"

config MACH_C1_USA_VZW
	bool "VZW"
endchoice

choice
	prompt "M3 Target Carrier"
	depends on MACH_M3 && (TARGET_LOCALE_USA || TARGET_LOCALE_JPN)
	default MACH_M3_USA_TMO

config MACH_M3_USA_TMO
	bool "M3 T-Mobile (Stretto)"

config MACH_M3_JPN_DCM
	bool "M3 JPN DCM"
endchoice

choice
	prompt "T0 Target"
	depends on MACH_T0 && \
		(TARGET_LOCALE_EUR || TARGET_LOCALE_USA || TARGET_LOCALE_KOR || TARGET_LOCALE_JPN || TARGET_LOCALE_CHN)
	default MACH_T0_EUR_OPEN

config MACH_T0_USA_ATT
	bool "ATT"

config MACH_T0_USA_TMO
	bool "TMO"

config MACH_T0_USA_VZW
	bool "VZW"

config MACH_T0_USA_SPR
	bool "SPR"

config MACH_T0_USA_USCC
	bool "USCC"

config MACH_T0_EUR_LTE
	bool "EUR LTE"

config MACH_T0_EUR_OPEN
	bool "EUR OPEN"

config MACH_T0_KOR_SKT
	bool "SKT"

config MACH_T0_KOR_KT
	bool "KT"

config MACH_T0_KOR_LGT
	bool "LG U+"

config MACH_T0_JPN_LTE_DCM
	bool "JPN LTE DCM T0"

config MACH_T0_CHN_OPEN
	bool "CHN OPEN"

config MACH_T0_CHN_CU
	bool "CHN CU"

config MACH_T0_CHN_CU_DUOS
	bool "CHN CU DUOS"

config MACH_T0_CHN_OPEN_DUOS
	bool "CHN OPEN DUOS"

config MACH_T0_CHN_CMCC
	bool "CHN CMCC"

config MACH_T0_CHN_CTC
	bool "CHN CTC"

endchoice

choice
	prompt "U1 KOR Target Carrier"
	depends on MACH_U1 && TARGET_LOCALE_KOR
	default MACH_U1_KOR_SKT

config MACH_U1_KOR_SKT
	bool "SKT"

config MACH_U1_KOR_KT
	bool "KT"

config MACH_U1_KOR_LGT
	bool "LG U+"
endchoice

choice
	prompt "C1 KOR Target Carrier"
	depends on MACH_C1 && TARGET_LOCALE_KOR
	default MACH_C1_KOR_SKT

config MACH_C1_KOR_SKT
	bool "SKT"

config MACH_C1_KOR_KT
	bool "KT"

config MACH_C1_KOR_LGT
	bool "LG U+"
endchoice

choice
	prompt "M0 KOR Target Carrier"
	depends on MACH_M0 && TARGET_LOCALE_KOR
	default MACH_M0_KOR_SKT

config MACH_M0_KOR_SKT
	bool "SKT"

config MACH_M0_KOR_KT
	bool "KT"

config MACH_M0_KOR_LGT
	bool "LG U+"
endchoice

choice
	prompt "CAMERA LTE KOR Target Carrier"
	depends on MACH_GC1 && TARGET_LOCALE_KOR
	default MACH_GC1_KOR_SKT

config MACH_GC1_KOR_SKT
	bool "SKT"

config MACH_GC1_KOR_KT
	bool "KT"

config MACH_GC1_KOR_LGT
	bool "LG U+"
endchoice

choice
	prompt "S USA Target Carrier"
	depends on MACH_GC1 && TARGET_LOCALE_USA
	default MACH_GC1_USA_ATT

config MACH_GC1_USA_ATT
	bool "S USA ATT Board"

config MACH_GC1_USA_VZW
	bool "S USA VZW Board"
endchoice

choice
        prompt "P4 LTE USA Target Carrier"
        depends on MACH_P4NOTE && TARGET_LOCALE_USA
        default MACH_P4NOTE_USA_ANY

config MACH_P4NOTELTE_USA_VZW
        bool "P4NOTE LTE USA VZW"

config MACH_P4NOTELTE_USA_ATT
        bool "P4NOTE LTE USA ATT"

config MACH_P4NOTELTE_USA_TMO
        bool "P4NOTE LTE USA TMO"

config MACH_P4NOTELTE_USA_SPR
        bool "P4NOTE LTE USA SPR"

config MACH_P4NOTELTE_USA_ANY
        bool "P4NOTE LTE USA ANY"

endchoice

choice
	prompt "P4 KOR Target Carrier"
	depends on MACH_P4NOTE && TARGET_LOCALE_KOR
	default MACH_P4NOTE_KOR_ANY

config MACH_P4NOTE_KOR_ANY
	bool "P4NOTE KOR OPEN Board"

config MACH_P4NOTE_KOR_SKT
	bool "P4NOTE KOR SKT Board"

config MACH_P4NOTE_KOR_KT
	bool "P4NOTE KOR KT Board"

config MACH_P4NOTELTE_KOR_SKT
	bool "P4NOTELTE KOR SKT Board"

config MACH_P4NOTELTE_KOR_KT
	bool "P4NOTELTE KOR KT Board"

config MACH_P4NOTELTE_KOR_LGT
	bool "P4NOTELTE KOR LGT Board"
endchoice

choice
	prompt "M0 Chinese Target Carrier"
	depends on (MACH_M0 || MACH_GRANDE) && TARGET_LOCALE_CHN

config MACH_M0_CMCC
	bool "M0 CHN CMCC board"

config MACH_M0_CHNOPEN
	bool "M0 CHN OPEN board"

config MACH_M0_HKTW
	bool "M0 CHN HKTW board"

config MACH_M0_CTC
	bool "M0 CHN CTC board"
endchoice

choice
	prompt "Q1 Chinese Target Carrier"
	depends on MACH_U1 && TARGET_LOCALE_CHN

config MACH_Q1_CMCC_BD
	bool "Q1 CHN CMCC board"
endchoice

choice
	prompt "BAFFIN KOR Target Carrier"
	depends on MACH_BAFFIN && TARGET_LOCALE_KOR
	default MACH_BAFFIN_KOR_SKT

config MACH_BAFFIN_KOR_SKT
	bool "SKT"

config MACH_BAFFIN_KOR_KT
	bool "KT"

config MACH_BAFFIN_KOR_LGT
	bool "LG U+"

config MACH_SUPERIOR_KOR_SKT
	bool "SUPERIOR SKT"
endchoice

menu "M0 CTC based models"
	depends on MACH_M0_CTC && TARGET_LOCALE_CHN

config MACH_M0_GRANDECTC
	bool "M0 CHN GRANDE CTC board"

config MACH_M0_DUOSCTC
	bool "M0 CHN DUOS CTC board"

endmenu
```

## arch/arm/mach-exynos4/Kconfig
```kconfig
# arch/arm/mach-exynos4/Kconfig
#
# Copyright (c) 2010-2011 Samsung Electronics Co., Ltd.
#		http://www.samsung.com/
#
# Licensed under GPLv2

# Configuration options for the EXYNOS4

if ARCH_EXYNOS4

config CPU_EXYNOS4210
	bool
	select S3C_PL330_DMA
	help
	  Enable EXYNOS4210 CPU support

config EXYNOS4_MCT
	bool
	default y
	help
	  Use MCT (Multi Core Timer) as kernel timers

config EXYNOS4_DEV_AHCI
	bool
	help
	  Compile in platform device definitions for AHCI

config EXYNOS4_SETUP_FIMD0
	bool
	help
	  Common setup code for FIMD0.

config EXYNOS4_DEV_PD
	bool
	help
	  Compile in platform device definitions for Power Domain

config EXYNOS4_DEV_SYSMMU
	bool
	help
	  Common setup code for SYSTEM MMU in EXYNOS4

config EXYNOS4_DEV_DWMCI
	bool
	help
	  Compile in platform device definitions for DWMCI

config EXYNOS4_SETUP_I2C1
	bool
	help
	  Common setup code for i2c bus 1.

config EXYNOS4_SETUP_I2C2
	bool
	help
	  Common setup code for i2c bus 2.

config EXYNOS4_SETUP_I2C3
	bool
	help
	  Common setup code for i2c bus 3.

config EXYNOS4_SETUP_I2C4
	bool
	help
	  Common setup code for i2c bus 4.

config EXYNOS4_SETUP_I2C5
	bool
	help
	  Common setup code for i2c bus 5.

config EXYNOS4_SETUP_I2C6
	bool
	help
	  Common setup code for i2c bus 6.

config EXYNOS4_SETUP_I2C7
	bool
	help
	  Common setup code for i2c bus 7.

config EXYNOS4_SETUP_KEYPAD
	bool
	help
	  Common setup code for keypad.

config EXYNOS4_SETUP_SDHCI
	bool
	select EXYNOS4_SETUP_SDHCI_GPIO
	help
	  Internal helper functions for EXYNOS4 based SDHCI systems.

config EXYNOS4_SETUP_SDHCI_GPIO
	bool
	help
	  Common setup code for SDHCI gpio.

config EXYNOS4_SETUP_FIMC
	bool
	help
	  Common setup code for the camera interfaces.

config EXYNOS4_SETUP_USB_PHY
	bool
	help
	  Common setup code for USB PHY controller

# machine support

menu "EXYNOS4 Machines"

config MACH_SMDKC210
	bool "SMDKC210"
	select CPU_EXYNOS4210
	select S5P_DEV_FIMD0
	select S3C_DEV_RTC
	select S3C_DEV_WDT
	select S3C_DEV_I2C1
	select S3C_DEV_HSMMC
	select S3C_DEV_HSMMC1
	select S3C_DEV_HSMMC2
	select S3C_DEV_HSMMC3
	select SAMSUNG_DEV_PWM
	select SAMSUNG_DEV_BACKLIGHT
	select EXYNOS4_DEV_PD
	select EXYNOS4_DEV_SYSMMU
	select EXYNOS4_SETUP_FIMD0
	select EXYNOS4_SETUP_I2C1
	select EXYNOS4_SETUP_SDHCI
	help
	  Machine support for Samsung SMDKC210

config MACH_SMDKV310
	bool "SMDKV310"
	select CPU_EXYNOS4210
	select S5P_DEV_FIMD0
	select S3C_DEV_RTC
	select S3C_DEV_WDT
	select S3C_DEV_I2C1
	select S3C_DEV_HSMMC
	select S3C_DEV_HSMMC1
	select S3C_DEV_HSMMC2
	select S3C_DEV_HSMMC3
	select SAMSUNG_DEV_BACKLIGHT
	select EXYNOS4_DEV_AHCI
	select SAMSUNG_DEV_KEYPAD
	select EXYNOS4_DEV_PD
	select SAMSUNG_DEV_PWM
	select EXYNOS4_DEV_SYSMMU
	select EXYNOS4_SETUP_FIMD0
	select EXYNOS4_SETUP_I2C1
	select EXYNOS4_SETUP_KEYPAD
	select EXYNOS4_SETUP_SDHCI
	help
	  Machine support for Samsung SMDKV310

config MACH_ARMLEX4210
	bool "ARMLEX4210"
	select CPU_EXYNOS4210
	select S3C_DEV_RTC
	select S3C_DEV_WDT
	select S3C_DEV_HSMMC
	select S3C_DEV_HSMMC2
	select S3C_DEV_HSMMC3
	select EXYNOS4_DEV_AHCI
	select EXYNOS4_DEV_SYSMMU
	select EXYNOS4_SETUP_SDHCI
	help
	  Machine support for Samsung ARMLEX4210 based on EXYNOS4210

config MACH_UNIVERSAL_C210
	bool "Mobile UNIVERSAL_C210 Board"
	select CPU_EXYNOS4210
	select S5P_GPIO_INT
	select S5P_DEV_FIMC0
	select S5P_DEV_FIMC1
	select S5P_DEV_FIMC2
	select S5P_DEV_FIMC3
	select S3C_DEV_HSMMC
	select S3C_DEV_HSMMC2
	select S3C_DEV_HSMMC3
	select S3C_DEV_I2C1
	select S3C_DEV_I2C3
	select S3C_DEV_I2C5
	select S5P_DEV_MFC
	select S5P_DEV_ONENAND
	select EXYNOS4_DEV_PD
	select EXYNOS4_SETUP_I2C1
	select EXYNOS4_SETUP_I2C3
	select EXYNOS4_SETUP_I2C5
	select EXYNOS4_SETUP_SDHCI
	help
	  Machine support for Samsung Mobile Universal S5PC210 Reference
	  Board.

config MACH_NURI
	bool "Mobile NURI Board"
	select CPU_EXYNOS4210
	select S3C_DEV_WDT
	select S3C_DEV_HSMMC
	select S3C_DEV_HSMMC2
	select S3C_DEV_HSMMC3
	select S3C_DEV_I2C1
	select S3C_DEV_I2C3
	select S3C_DEV_I2C5
	select S5P_DEV_MFC
	select S5P_DEV_USB_EHCI
	select EXYNOS4_DEV_PD
	select EXYNOS4_SETUP_I2C1
	select EXYNOS4_SETUP_I2C3
	select EXYNOS4_SETUP_I2C5
	select EXYNOS4_SETUP_SDHCI
	select EXYNOS4_SETUP_USB_PHY
	select SAMSUNG_DEV_PWM
	select SAMSUNG_DEV_ADC
	help
	  Machine support for Samsung Mobile NURI Board.

endmenu

comment "Configuration for HSMMC bus width"

menu "Use 8-bit bus width"

config EXYNOS4_SDHCI_CH0_8BIT
	bool "Channel 0 with 8-bit bus"
	help
	  Support HSMMC Channel 0 8-bit bus.
	  If selected, Channel 1 is disabled.

config EXYNOS4_SDHCI_CH2_8BIT
	bool "Channel 2 with 8-bit bus"
	help
	  Support HSMMC Channel 2 8-bit bus.
	  If selected, Channel 3 is disabled.

endmenu

endif
```

## arch/arm/mach-footbridge/Kconfig
```kconfig
# SPDX-License-Identifier: GPL-2.0-only
menuconfig ARCH_FOOTBRIDGE
	bool "FootBridge Implementations (DEPRECATED)"
	depends on ARCH_MULTI_V4 && !(ARCH_MULTI_V4T || ARCH_MULTI_V5)
	depends on !(ARCH_MOXART || ARCH_GEMINI || ARCH_SA1100)
	depends on ATAGS
	depends on CPU_LITTLE_ENDIAN
	depends on MMU
	select ARCH_NO_SG_CHAIN
	select CPU_SA110
	select FOOTBRIDGE
	select NEED_MACH_MEMORY_H
	help
	  Support for systems based on the DC21285 companion chip
	  ("FootBridge"), used in the EBSA285 and the Rebel NetWinder.

	  Support for these machines will go away in 2027,
	  unless there are any remaining users that speak up.

if ARCH_FOOTBRIDGE

config ARCH_EBSA285_HOST
	bool "EBSA285 (host mode)"
	select ARCH_EBSA285
	select ISA
	select ARCH_MAY_HAVE_PC_FDC
	select FORCE_PCI
	help
	  Say Y here if you intend to run this kernel on the EBSA285 card
	  in host ("central function") mode.

	  Saying N will reduce the size of the Footbridge kernel.

config ARCH_NETWINDER
	bool "NetWinder"
	select CLKEVT_I8253
	select CLKSRC_I8253
	select ISA
	select FORCE_PCI
	help
	  Say Y here if you intend to run this kernel on the Rebel.COM
	  NetWinder.  Information about this machine can be found at:

	  <http://www.netwinder.org/>

	  Saying N will reduce the size of the Footbridge kernel.

# Footbridge support
config FOOTBRIDGE
	def_bool y
	select ARCH_MIGHT_HAVE_PC_SERIO
	select ISA_DMA_API

config ARCH_EBSA285
	bool

endif
```

## arch/arm/mach-gemini/Kconfig
```kconfig
menuconfig ARCH_GEMINI
	bool "Cortina Systems Gemini"
	depends on ARCH_MULTI_V4
	select ARCH_HAS_RESET_CONTROLLER
	select ARM_AMBA
	select ARM_APPENDED_DTB # Old Redboot bootloaders deployed
	select COMMON_CLK_GEMINI
	select FARADAY_FTINTC010
	select FTTMR010_TIMER
	select GPIO_FTGPIO010
	select GPIOLIB
	select PINCTRL
	select PINCTRL_GEMINI
	select POWER_RESET
	select POWER_RESET_GEMINI_POWEROFF
	select POWER_RESET_SYSCON
	help
	  Support for the Cortina Systems Gemini family SoCs
```

## arch/arm/mach-h720x/Kconfig
```kconfig
if ARCH_H720X

menu "h720x Implementations"

config ARCH_H7201
	bool "gms30c7201"
	depends on ARCH_H720X
	select CPU_H7201
	select ZONE_DMA
	help
	  Say Y here if you are using the Hynix GMS30C7201 Reference Board

config ARCH_H7202
	bool "hms30c7202"
	select CPU_H7202
	select ZONE_DMA
	depends on ARCH_H720X
	help
	  Say Y here if you are using the Hynix HMS30C7202 Reference Board

endmenu

config CPU_H7201
	bool
	help
	  Select code specific to h7201 variants

config CPU_H7202
	bool
	help
	  Select code specific to h7202 variants
config H7202_SERIAL23
	depends on CPU_H7202
	bool "Use serial ports 2+3"
	help
	  Say Y here if you wish to use serial ports 2+3. They share their
	  pins with the keyboard matrix controller, so you have to decide.


endif
```

## arch/arm/mach-highbank/Kconfig
```kconfig
config ARCH_HIGHBANK
	bool "Calxeda ECX-1000/2000 (Highbank/Midway)" if ARCH_MULTI_V7
	select ARCH_DMA_ADDR_T_64BIT if ARM_LPAE
	select ARCH_HAS_HOLES_MEMORYMODEL
	select ARCH_SUPPORTS_BIG_ENDIAN
	select ARM_AMBA
	select ARM_ERRATA_764369 if SMP
	select ARM_ERRATA_775420
	select ARM_ERRATA_798181 if SMP
	select ARM_GIC
	select ARM_PSCI
	select ARM_TIMER_SP804
	select CACHE_L2X0
	select HAVE_ARM_SCU
	select HAVE_ARM_TWD if SMP
	select MAILBOX
	select PL320_MBOX
	select ZONE_DMA if ARM_LPAE
```

## arch/arm/mach-hisi/Kconfig
```kconfig
# SPDX-License-Identifier: GPL-2.0-only
config ARCH_HISI
	bool "Hisilicon SoC Support"
	depends on ARCH_MULTI_V7 || ARCH_MULTI_V5
	select ARM_AMBA
	select ARM_GIC if ARCH_MULTI_V7
	select ARM_TIMER_SP804
	select POWER_RESET
	select POWER_RESET_HISI
	select POWER_SUPPLY

if ARCH_HISI

menu "Hisilicon platform type"

config ARCH_HI3xxx
	bool "Hisilicon Hi36xx family"
	depends on ARCH_MULTI_V7
	select CACHE_L2X0
	select HAVE_ARM_SCU if SMP
	select HAVE_ARM_TWD if SMP
	select PINCTRL
	select PINCTRL_SINGLE
	help
	  Support for Hisilicon Hi36xx SoC family

config ARCH_HIP01
	bool "Hisilicon HIP01 family"
	depends on ARCH_MULTI_V7
	select HAVE_ARM_SCU if SMP
	select HAVE_ARM_TWD if SMP
	select ARM_GLOBAL_TIMER
	help
	  Support for Hisilicon HIP01 SoC family

config ARCH_HIP04
	bool "Hisilicon HiP04 Cortex A15 family"
	depends on ARCH_MULTI_V7
	select ARM_ERRATA_798181 if SMP
	select HAVE_ARM_ARCH_TIMER
	select MCPM if SMP
	select MCPM_QUAD_CLUSTER if SMP
	select GENERIC_IRQ_EFFECTIVE_AFF_MASK
	help
	  Support for Hisilicon HiP04 SoC family

config ARCH_HIX5HD2
	bool "Hisilicon X5HD2 family"
	depends on ARCH_MULTI_V7
	select CACHE_L2X0
	select HAVE_ARM_SCU if SMP
	select HAVE_ARM_TWD if SMP
	select PINCTRL
	select PINCTRL_SINGLE
	help
	  Support for Hisilicon HIX5HD2 SoC family

config ARCH_SD5203
	bool "Hisilicon SD5203 family"
	depends on ARCH_MULTI_V5
	select DW_APB_ICTL
	help
	  Support for Hisilicon SD5203 SoC family

endmenu

endif
```

## arch/arm/mach-hpe/Kconfig
```kconfig
menuconfig ARCH_HPE
	bool "HPE SoC support"
	depends on ARCH_MULTI_V7
	help
	  This enables support for HPE ARM based BMC chips.
if ARCH_HPE

config ARCH_HPE_GXP
	bool "HPE GXP SoC"
	depends on ARCH_MULTI_V7
	select ARM_VIC
	select GENERIC_IRQ_CHIP
	select CLKSRC_MMIO
	help
	  HPE GXP is the name of the HPE Soc. This SoC is used to implement many
	  BMC features at HPE. It supports ARMv7 architecture based on the Cortex
	  A9 core. It is capable of using an AXI bus to which a memory controller
	  is attached. It has multiple SPI interfaces to connect boot flash and
	  BIOS flash. It uses a 10/100/1000 MAC for network connectivity. It
	  has multiple i2c engines to drive connectivity with a host
	  infrastructure.

endif
```
