// SPDX-License-Identifier: (GPL-2.0+ OR MIT)
#include "rk3128-box.dts"

/ {
	chosen {
		bootargs = "vmalloc=496M rockchip_jtag psci=enable";
	};

	fiq-debugger {
		rockchip,irq-mode-enable = <1>;
		status = "okay";
	};
};

&clk_ddr_dvfs_table {
	status = "disabled";
};

