// SPDX-License-Identifier: GPL-2.0-only
/*
 * Author: Anthoine Bourgeois <anthoine.bourgois@gmail.com>
 */
/dts-v1/;

/*
 * 7.0'' LCD panel sold with some devkit8000 board
 */

#include "omap3-devkit8000-lcd-common.dtsi"
/ {
	model = "TimLL OMAP3 Devkit8000 with 7.0'' LCD panel";
	compatible = "timll,omap3-devkit8000", "ti,omap3430", "ti,omap3";

	lcd0: display {
		panel-timing {
			clock-frequency = <40000000>;
			hactive = <800>;
			vactive = <480>;
			hfront-porch = <1>;
			hback-porch = <1>;
			hsync-len = <48>;
			vback-porch = <25>;
			vfront-porch = <12>;
			vsync-len = <3>;

			hsync-active = <0>;
			vsync-active = <0>;
			de-active = <1>;
			pixelclk-active = <1>;
		};
	};
};
