// SPDX-License-Identifier: GPL-2.0
/*
 * Copyright (C) 2019 Phytec Messtechnik GmbH
 * Author: Teresa Remmet <t.remmet@phytec.de>
 *
 */

/dts-v1/;

#include "am335x-phycore-som.dtsi"
#include "am335x-regor.dtsi"

/* SoM */
&gpmc {
	status = "okay";
};

&i2c_eeprom {
	status = "okay";
};

&serial_flash {
	status = "okay";
};
