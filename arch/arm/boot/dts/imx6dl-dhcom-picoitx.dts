// SPDX-License-Identifier: GPL-2.0+
/*
 * Copyright (C) 2021 DH electronics GmbH
 *
 * DHCOM iMX6 variant:
 * DHCM-iMX6DL-C0800-R102-F0819-E-SD-RTC-T-HS-I-01D2
 * DHCOM PCB number: 493-300 or newer
 * PicoITX PCB number: 487-600 or newer
 */
/dts-v1/;

#include "imx6dl.dtsi"
#include "imx6qdl-dhcom-som.dtsi"
#include "imx6qdl-dhcom-picoitx.dtsi"

/ {
	model = "DH electronics i.MX6DL DHCOM on PicoITX";
	compatible = "dh,imx6dl-dhcom-picoitx", "dh,imx6dl-dhcom-som",
		     "fsl,imx6dl";
};
