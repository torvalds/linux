// SPDX-License-Identifier: GPL-2.0
/*
 * Copyright 2013 Freescale Semiconductor, Inc.
 *
 * Author: Fabio Estevam <fabio.estevam@freescale.com>
 */
/dts-v1/;
#include "imx6q.dtsi"
#include "imx6qdl-wandboard-revb1.dtsi"

/ {
	model = "Wandboard i.MX6 Quad Board rev B1";
	compatible = "wand,imx6q-wandboard", "fsl,imx6q";

	memory@10000000 {
		reg = <0x10000000 0x80000000>;
	};
};

&sata {
	status = "okay";
};
