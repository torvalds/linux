// SPDX-License-Identifier: GPL-2.0-or-later
/*
 * Copyright (C) 2025 Alexey Charkov <alchark@gmail.com>
 */

/dts-v1/;
/include/ "wm8950.dtsi"

/ {
	model = "VIA APC Rock";
	compatible = "via,apc-rock", "wm,wm8950";

	memory@0 {
		device_type = "memory";
		reg = <0x0 0x20000000>;
	};
};

&uart0 {
	status = "okay";
};
