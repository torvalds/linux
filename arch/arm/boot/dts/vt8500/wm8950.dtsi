// SPDX-License-Identifier: GPL-2.0-or-later
/*
 * Copyright (C) 2025 Alexey Charkov <alchark@gmail.com>
 */

/* No differences have been discovered vs. WM8850, but chip markings differ */
/include/ "wm8850.dtsi"

/ {
	compatible = "wm,wm8950";
};
