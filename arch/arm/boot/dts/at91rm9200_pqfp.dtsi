// SPDX-License-Identifier: GPL-2.0-or-later
/*
 * at91rm9200_pqfp.dtsi - Device Tree Include file for AT91RM9200 PQFP family SoC
 *
 * Copyright (C) 2013 Jean-Christophe PLAGNIOL-VILLARD <plagnioj@jcrosoft.com>
 */

#include "at91rm9200.dtsi"

/ {
	compatible = "atmel,at91rm9200-pqfp", "atmel,at91rm9200";
};

&pioD {
	status = "disabled";
};
