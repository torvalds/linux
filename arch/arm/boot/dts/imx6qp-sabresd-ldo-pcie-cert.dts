/*
 * Copyright (C) 2016 Freescale Semiconductor, Inc.
 *
 * This program is free software; you can redistribute it and/or modify
 * it under the terms of the GNU General Public License version 2 as
 * published by the Free Software Foundation.
 */

#include "imx6qp-sabresd-ldo.dts"

&fec {
	status = "disabled";
};

&pcie {
	ext_osc = <1>;
};

&sata {
	status = "disabled";
};
