/*
 * Copyright (C) 2015 Freescale Semiconductor, Inc.
 *
 * This program is free software; you can redistribute it and/or modify
 * it under the terms of the GNU General Public License version 2 as
 * published by the Free Software Foundation.
 */

#include "imx7d-12x12-lpddr3-arm2.dts"

/*
 * On imx7d 12x12 arm2 board, there is pin(gpio6_21) iomux
 * between ecspi3 and pcie_rst_b. In order to resove this
 * pin conflict, disable ecspi3 in this pcie named dts file.
 */
&ecspi3 {
        status = "disabled";
};

&pcie{
	status = "okay";
};
