// SPDX-License-Identifier: GPL-2.0-only
/*
 * Copyright (c) 2026 Stefan Dösinger <stefandoesinger@gmail.com>
 */

/dts-v1/;

#include "zx297520v3.dtsi"

/ {
	model = "D-Link DWR-932M";
	compatible = "dlink,dwr932m", "zte,zx297520v3";

	memory@20000000 {
		device_type = "memory";
		reg = <0x20000000 0x04000000>;
	};
};

&uart1 {
	status = "okay";
};
