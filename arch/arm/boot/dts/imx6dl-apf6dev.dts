// SPDX-License-Identifier: GPL-2.0+ OR MIT
//
// Copyright 2015 Armadeus Systems <support@armadeus.com>

/dts-v1/;
#include "imx6dl.dtsi"
#include "imx6qdl-apf6.dtsi"
#include "imx6qdl-apf6dev.dtsi"

/ {
	model = "Armadeus APF6 Solo Module on APF6Dev Board";
	compatible = "armadeus,imx6dl-apf6dev", "armadeus,imx6dl-apf6", "fsl,imx6dl";

	memory@10000000 {
		device_type = "memory";
		reg = <0x10000000 0x20000000>;
	};
};
