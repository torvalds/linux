#include "rk312x.dtsi" 
#include "rk312x-pinctrl.dtsi"
#include "../../mach-rockchip/rk_camera_sensor_info.h"
/{
	cif_sensor: cif_sensor{
			compatible = "rockchip,sensor";
			CONFIG_SENSOR_POWER_IOCTL_USR 		= <1>;
			CONFIG_SENSOR_RESET_IOCTL_USR 		= <0>;
			CONFIG_SENSOR_POWERDOWN_IOCTL_USR	= <0>;
			CONFIG_SENSOR_FLASH_IOCTL_USR	  	= <0>;
			CONFIG_SENSOR_AF_IOCTL_USR	   		= <0>;

		ov2659{
			is_front = <1>; 
			rockchip,powerdown = <&gpio3 GPIO_D7 GPIO_ACTIVE_HIGH>;
			#pwdn_active = <>;
			#rockchip,power = <>;
			#pwr_active = <>;
			#rockchip,reset = <>;
			#rst_active = <>;
			mir = <0>;
			flash_attach = <0>;
			resolution = <ov2659_FULL_RESOLUTION>;
			pwdn_info = <ov2659_PWRDN_ACTIVE>;
			powerup_sequence = <ov2659_PWRSEQ>;		
			orientation = <0>;
			i2c_add = <ov2659_I2C_ADDR>;
			i2c_rata = <100000>;
			i2c_chl = <0>;
			cif_chl = <0>;
			mclk_rate = <24>;
		};
		gc0329{
			is_front = <1>; 
			rockchip,powerdown = <&gpio3 GPIO_D7 GPIO_ACTIVE_HIGH>;
			#pwdn_active = <>;
			#rockchip,power = <>;
			#pwr_active = <>;
			#rockchip,reset = <>;
			#rst_active = <>;
			mir = <0>;
			flash_attach = <0>;
			resolution = <gc0329_FULL_RESOLUTION>;
			pwdn_info = <gc0329_PWRDN_ACTIVE>;
			powerup_sequence = <gc0329_PWRSEQ>;	
			orientation = <0>;
			i2c_add = <gc0329_I2C_ADDR>;
			i2c_rata = <100000>;
			i2c_chl = <0>;
			cif_chl = <0>;
			mclk_rate = <24>;
		};
	};
};

