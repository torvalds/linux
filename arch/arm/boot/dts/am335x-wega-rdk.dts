// SPDX-License-Identifier: GPL-2.0-only
/*
 * Copyright (C) 2015 Phytec Messtechnik GmbH
 * Author: Teresa Remmet <t.remmet@phytec.de>
 */

/dts-v1/;

#include "am335x-phycore-som.dtsi"
#include "am335x-wega.dtsi"

/* SoM */
&i2c_eeprom {
	status = "okay";
};

&i2c_rtc {
	status = "okay";
};
