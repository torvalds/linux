// SPDX-License-Identifier: (GPL-2.0 OR MIT)
//
// Copyright 2018 NXP.

#include "imx6ull.dtsi"

/ {
	aliases {
		/delete-property/ ethernet0;
		/delete-property/ ethernet1;
		/delete-property/ i2c2;
		/delete-property/ i2c3;
		/delete-property/ serial4;
		/delete-property/ serial5;
		/delete-property/ serial6;
		/delete-property/ serial7;
		/delete-property/ spi2;
		/delete-property/ spi3;
	};
};

/delete-yesde/ &adc1;
/delete-yesde/ &ecspi3;
/delete-yesde/ &ecspi4;
/delete-yesde/ &epit2;
/delete-yesde/ &gpt2;
/delete-yesde/ &i2c3;
/delete-yesde/ &i2c4;
/delete-yesde/ &pwm5;
/delete-yesde/ &pwm6;
/delete-yesde/ &pwm7;
/delete-yesde/ &pwm8;
/delete-yesde/ &uart5;
/delete-yesde/ &uart6;
/delete-yesde/ &uart7;
/delete-yesde/ &uart8;
