// SPDX-License-Identifier: GPL-2.0-or-later
// Copyright 2021 IBM Corp.
/dts-v1/;

#include "aspeed-bmc-ibm-rainier-4u.dts"

/ {
	model = "Rainier 1S4U";
};

&max {
	/delete-node/ fan3;
	/delete-node/ fan5;
};
