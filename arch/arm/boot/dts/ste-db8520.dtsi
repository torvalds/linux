// SPDX-License-Identifier: GPL-2.0-or-later

#include "ste-dbx5x0.dtsi"

/ {
	cpus {
		cpu@300 {
			/* cpufreq controls */
			operating-points = <1152000 0
					    800000 0
					    400000 0
					    200000 0>;
		};
	};
};
