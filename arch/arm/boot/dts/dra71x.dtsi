/*
 * Copyright (C) 2019 Texas Instruments Incorporated - https://www.ti.com/
 *
 * This program is free software; you can redistribute it and/or modify
 * it under the terms of the GNU General Public License version 2 as
 * published by the Free Software Foundation.
 */

#include "dra72-evm-common.dtsi"

&rtctarget {
	status = "disabled";
};

&usb4_tm {
	status = "disabled";
};
