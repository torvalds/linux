/*
 * Marvell RD88F6181 A0 Board descrition
 *
 * Andrew Lunn <andrew@lunn.ch>
 *
 * This file is licensed under the terms of the GNU General Public
 * License version 2.  This program is licensed "as is" without any
 * warranty of any kind, whether express or implied.
 *
 * This file contains the definitions for the board with the A0 variant of
 * the SoC. The ethernet switch does not have a "wan" port.
 */

/dts-v1/;
#include "kirkwood-rd88f6281.dtsi"

/ {
	model = "Marvell RD88f6281 Reference design, with A0 SoC";
	compatible = "marvell,rd88f6281-a0", "marvell,rd88f6281","marvell,kirkwood-88f6281", "marvell,kirkwood";

	dsa@0 {
		switch@0 {
			reg = <10 0>;    /* MDIO address 10, switch 0 in tree */
		};
	};
};