/*
 * wm8650-mid.dts - Device tree file for Wondermedia WM8650-MID Tablet
 *
 * Copyright (C) 2012 Tony Prisk <linux@prisktech.co.nz>
 *
 * Licensed under GPLv2 or later
 */

/dts-v1/;
/include/ "wm8650.dtsi"

/ {
	model = "Wondermedia WM8650-MID Tablet";

	/*
	 * Display node is based on Sascha Hauer's patch on dri-devel.
	 * Added a bpp property to calculate the size of the framebuffer
	 * until the binding is formalized.
	 */
	display: display@0 {
		modes {
			mode0: mode@0 {
				hactive = <800>;
				vactive = <480>;
				hback-porch = <88>;
				hfront-porch = <40>;
				hsync-len = <0>;
				vback-porch = <32>;
				vfront-porch = <11>;
				vsync-len = <1>;
				clock = <0>;	/* unused but required */
				bpp = <16>;	/* non-standard but required */
			};
		};
	};
};
