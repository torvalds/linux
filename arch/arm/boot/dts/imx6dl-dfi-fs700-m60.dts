// SPDX-License-Identifier: GPL-2.0-or-later
/*
 * Copyright 2013 Sascha Hauer <s.hauer@pengutronix.de>
 */

#ifndef __DTS_V1__
#define __DTS_V1__
/dts-v1/;
#endif

#include "imx6dl.dtsi"
#include "imx6qdl-dfi-fs700-m60.dtsi"

/ {
	model = "DFI FS700-M60-6DL i.MX6dl Q7 Board";
	compatible = "dfi,fs700-m60-6dl", "dfi,fs700e-m60", "fsl,imx6dl";

	/* Will be filled by the bootloader */
	memory@10000000 {
		device_type = "memory";
		reg = <0x10000000 0>;
	};
};
