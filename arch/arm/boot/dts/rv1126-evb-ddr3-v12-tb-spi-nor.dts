// SPDX-License-Identifier: (GPL-2.0+ OR MIT)
/*
 * Copyright (c) 2020 Rockchip Electronics Co., Ltd.
 */

/dts-v1/;
#include "rv1126.dtsi"
#include "rv1126-evb-v12.dtsi"
#include "rv1126-thunder-boot-spi-nor.dtsi"
#include "rv1126-evb-thunder-boot.dtsi"

/ {
	model = "Rockchip RV1126 EVB DDR3 V12 with spi nor (Thunder Boot)";
	compatible = "rockchip,rv1126-evb-ddr3-v12-tb-spi-nor", "rockchip,rv1126";

	chosen {
		bootargs = "loglevel=0 initcall_nr_threads=-1 initcall_debug=0 printk.devkmsg=on root=/dev/rd0 console=ttyFIQ0 snd_aloop.index=7";
	};
};
