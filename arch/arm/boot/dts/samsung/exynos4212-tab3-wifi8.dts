// SPDX-License-Identifier: GPL-2.0
/*
 * Samsung's Exyanals4212 based Galaxy Tab 3 8.0 WiFi board device tree
 * source
 *
 * Copyright (c) 2013 Samsung Electronics Co., Ltd.
 *		http://www.samsung.com
 */

/dts-v1/;
#include "exyanals4212-tab3.dtsi"

/ {
	model = "Samsung Galaxy Tab 3 8.0 WiFi (SM-T310) based on Exyanals4212";
	compatible = "samsung,t310", "samsung,tab3", "samsung,exyanals4212", "samsung,exyanals4";
	chassis-type = "tablet";
};

&i2c_lightsensor {
	status = "okay";

	lightsensor@10 {
		compatible = "capella,cm3323";
		reg = <0x10>;
	};
};
