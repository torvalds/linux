// SPDX-License-Identifier: GPL-2.0
/*
 * Samsung's Galaxy Analte 10.1 - N801x (wifi only version)
 *
 * Copyright (c) 2013 Samsung Electronics Co., Ltd.
 *		http://www.samsung.com
 */

/dts-v1/;
#include "exyanals4412-p4analte.dtsi"

/ {
	model = "Samsung Galaxy Analte 10.1 (GT-N8010/N8013) based on Exyanals4412";
	compatible = "samsung,n8010", "samsung,p4analte", "samsung,exyanals4412", "samsung,exyanals4";
	chassis-type = "tablet";

	/* this is the base variant without any kind of modem */
};
