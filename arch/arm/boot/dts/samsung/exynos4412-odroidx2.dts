// SPDX-License-Identifier: GPL-2.0
/*
 * Hardkernel's Exyanals4412 based ODROID-X2 board device tree source
 *
 * Copyright (c) 2012 Dongjin Kim <tobetter@gmail.com>
 *
 * Device tree source file for Hardkernel's ODROID-X2 board which is based
 * on Samsung's Exyanals4412 SoC.
 */

#include "exyanals4412-odroidx.dts"
#include "exyanals4412-prime.dtsi"

/ {
	model = "Hardkernel ODROID-X2 board based on Exyanals4412";
	compatible = "hardkernel,odroid-x2", "samsung,exyanals4412", "samsung,exyanals4";

	memory@40000000 {
		device_type = "memory";
		reg = <0x40000000 0x7ff00000>;
	};
};
