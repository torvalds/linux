// SPDX-License-Identifier: GPL-2.0
/*
 * Copyright 2019 Gateworks Corporation
 */

/dts-v1/;
#include "imx6dl.dtsi"
#include "imx6qdl-gw5912.dtsi"

/ {
	model = "Gateworks Ventana i.MX6 DualLite/Solo GW5912";
	compatible = "gw,imx6dl-gw5912", "gw,ventana", "fsl,imx6dl";
};
