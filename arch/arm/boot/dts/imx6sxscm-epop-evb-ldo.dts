/*
 * Copyright (C) 2016 Freescale Semiconductor, Inc.
 *
 * This program is free software; you can redistribute it and/or modify
 * it under the terms of the GNU General Public License version 2 as
 * published by the Free Software Foundation.
 */
#include "imx6sxscm-512mb-evb-ldo.dts"
#include "imx6sxscm-emmc.dtsi"
