/*
 * sama5d35.dtsi - Device Tree Include file for SAMA5D35 SoC
 *
 *  Copyright (C) 2013 Boris BREZILLON <b.brezillon@overkiz.com>
 *
 * Licensed under GPLv2 or later.
 */
#include "sama5d3.dtsi"
#include "sama5d3_gmac.dtsi"
#include "sama5d3_emac.dtsi"
#include "sama5d3_can.dtsi"
#include "sama5d3_mci2.dtsi"
#include "sama5d3_uart.dtsi"
#include "sama5d3_tcb1.dtsi"

/ {
	compatible = "atmel,sama5d35", "atmel,sama5d3", "atmel,sama5";
};
