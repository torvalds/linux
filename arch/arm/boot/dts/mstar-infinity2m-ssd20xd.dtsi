// SPDX-License-Identifier: GPL-2.0-or-later
/*
 * Copyright (c) 2020 thingy.jp.
 * Author: Daniel Palmer <daniel@thingy.jp>
 */

#include "mstar-infinity2m.dtsi"

&gpio {
	compatible = "sstar,ssd20xd-gpio";
	status = "okay";
};

&smpctrl {
	compatible = "sstar,ssd201-smpctrl", "mstar,smpctrl";
	status = "okay";
};
