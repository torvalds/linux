// SPDX-License-Identifier: GPL-2.0-or-later
/*
 * usb_a9g20.dts - Device Tree file for Calao USB A9G20 board
 *
 *  Copyright (C) 2011 Jean-Christophe PLAGNIOL-VILLARD <plagnioj@jcrosoft.com>
 */
/dts-v1/;
#include "at91sam9g20.dtsi"
#include "usb_a9260_common.dtsi"

/ {
	model = "Calao USB A9G20";
	compatible = "calao,usb-a9g20", "atmel,at91sam9g20", "atmel,at91sam9";
};

&spi0 {
	cs-gpios = <&pioC 11 GPIO_ACTIVE_LOW>;
	status = "okay";
	/* TODO: Some revisions might have a dataflash here instead of an EEPROM */
	eeprom@0 {
		compatible = "st,m95640", "atmel,at25";
		reg = <0>;
		spi-max-frequency = <2000000>;
		size = <8192>;
		pagesize = <32>;
		address-width = <16>;
	};
};
