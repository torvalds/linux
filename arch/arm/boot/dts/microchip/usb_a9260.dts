// SPDX-License-Identifier: GPL-2.0-or-later
/*
 * usb_a9260.dts - Device Tree file for Calao USB A9260 board
 *
 *  Copyright (C) 2011-2012 Jean-Christophe PLAGNIOL-VILLARD <plagnioj@jcrosoft.com>
 */
/dts-v1/;
#include "at91sam9260.dtsi"
#include "usb_a9260_common.dtsi"

/ {
	model = "Calao USB A9260";
	compatible = "calao,usb-a9260", "atmel,at91sam9260", "atmel,at91sam9";

	ahb {
		apb {
			shdwc: poweroff@fffffd10 {
				atmel,wakeup-counter = <10>;
				atmel,wakeup-rtt-timer;
			};
		};
	};
};
