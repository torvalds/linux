// SPDX-License-Identifier: GPL-2.0-only
/*
 * tny_a9260.dts - Device Tree file for Calao TNY A9260 board
 *
 * Copyright (C) 2012 Jean-Christophe PLAGNIOL-VILLARD <plagnioj@jcrosoft.com>
 */
/dts-v1/;
#include "at91sam9260.dtsi"
#include "tny_a9260_common.dtsi"

/ {
	model = "Calao TNY A9260";
	compatible = "calao,tny-a9260", "atmel,at91sam9260", "atmel,at91sam9";
};
