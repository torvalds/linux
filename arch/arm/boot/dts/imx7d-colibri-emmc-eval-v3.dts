// SPDX-License-Identifier: (GPL-2.0 OR MIT)
/*
 * Copyright 2017 Toradex AG
 */

/dts-v1/;
#include "imx7d-colibri-emmc.dtsi"
#include "imx7-colibri-eval-v3.dtsi"

/ {
	model = "Toradex Colibri iMX7D 1GB (eMMC) on Colibri Evaluation Board V3";
	compatible = "toradex,colibri-imx7d-emmc-eval-v3",
		     "toradex,colibri-imx7d-emmc", "fsl,imx7d";
};

&usbotg2 {
	vbus-supply = <&reg_usbh_vbus>;
	status = "okay";
};
