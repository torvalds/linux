// SPDX-License-Identifier: GPL-2.0
/*
 * Copyright (C) 2015 Altera Corporation. All rights reserved.
 */

/dts-v1/;
#include "socfpga_arria10_socdk.dtsi"

&nand {
	status = "okay";

	nand@0 {
		reg = <0>;
		#address-cells = <1>;
		#size-cells = <1>;

		partition@0 {
			label = "Boot and fpga data";
			reg = <0x0 0x02000000>;
		};
		partition@1c00000 {
			label = "Root Filesystem - JFFS2";
			reg = <0x02000000 0x06000000>;
		};
	};
};
