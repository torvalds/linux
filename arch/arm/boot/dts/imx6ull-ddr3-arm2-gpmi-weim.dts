/*
 * Copyright (C) 2016 Freescale Semiconductor, Inc.
 *
 * This program is free software; you can redistribute it and/or modify
 * it under the terms of the GNU General Public License version 2 as
 * published by the Free Software Foundation.
 */

#include "imx6ull-ddr3-arm2.dts"

&gpmi {
	status ="okay";
};

&qspi {
	status ="disabled";
};

&usdhc2{
	status ="disabled";
};

&iomuxc {
	pinctrl-0 = <&pinctrl_hog &pinctrl_hog_sd &pinctrl_hog_sd2>;
};
