// SPDX-License-Identifier: GPL-2.0
/dts-v1/;

#include "tegra30-asus-nexus7-grouper-maxim-pmic.dtsi"
#include "tegra30-asus-nexus7-grouper.dtsi"

/ {
	model = "ASUS Google Nexus 7 (Project Nakasi / ME370T) E1565";
};
