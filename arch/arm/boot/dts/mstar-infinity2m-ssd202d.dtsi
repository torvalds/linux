// SPDX-License-Identifier: GPL-2.0-or-later
/*
 * Copyright (c) 2020 thingy.jp.
 * Author: Daniel Palmer <daniel@thingy.jp>
 */

#include "mstar-infinity2m-ssd20xd.dtsi"

/ {
	memory {
		device_type = "memory";
		reg = <0x20000000 0x8000000>;
	};
};
