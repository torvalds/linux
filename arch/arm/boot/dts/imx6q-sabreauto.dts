// SPDX-License-Identifier: GPL-2.0+
//
// Copyright 2012 Freescale Semiconductor, Inc.
// Copyright 2011 Linaro Ltd.

/dts-v1/;

#include "imx6q.dtsi"
#include "imx6qdl-sabreauto.dtsi"

/ {
	model = "Freescale i.MX6 Quad SABRE Automotive Board";
	compatible = "fsl,imx6q-sabreauto", "fsl,imx6q";
};

&sata {
	status = "okay";
};
