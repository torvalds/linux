// SPDX-License-Identifier: GPL-2.0
/*
 * Copyright 2013 Freescale Semiconductor, Inc.
 *
 * Author: Fabio Estevam <fabio.estevam@freescale.com>
 */
/dts-v1/;
#include "imx6dl.dtsi"
#include "imx6qdl-udoo.dtsi"

/ {
	model = "Udoo i.MX6 Dual-lite Board";
	compatible = "udoo,imx6dl-udoo", "fsl,imx6dl";
};
