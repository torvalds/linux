/*
 * Copyright 2013 Freescale Semiconductor, Inc.
 *
 * Author: Fabio Estevam <fabio.estevam@freescale.com>
 *
 * This program is free software; you can redistribute it and/or modify
 * it under the terms of the GNU General Public License version 2 as
 * published by the Free Software Foundation.
 *
 */
/dts-v1/;
#include "imx6qp.dtsi"
#include "imx6qdl-wandboard-revd1.dtsi"

/ {
	model = "Wandboard i.MX6 QuadPlus Board revD1";
	compatible = "wand,imx6qp-wandboard", "fsl,imx6qp";

	memory {
		reg = <0x10000000 0x80000000>;
	};
};

&sata {
	status = "okay";
};
