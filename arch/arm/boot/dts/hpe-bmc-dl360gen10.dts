// SPDX-License-Identifier: GPL-2.0
/*
 * Device Tree file for HPE DL360Gen10
 */

/include/ "hpe-gxp.dtsi"

/ {
	#address-cells = <1>;
	#size-cells = <1>;
	compatible = "hpe,gxp-dl360gen10", "hpe,gxp";
	model = "Hewlett Packard Enterprise ProLiant dl360 Gen10";

	aliases {
		serial0 = &uartc;
	};

	chosen {
		stdout-path = "serial0:115200n8";
	};

	memory@40000000 {
		device_type = "memory";
		reg = <0x40000000 0x20000000>;
	};
};
