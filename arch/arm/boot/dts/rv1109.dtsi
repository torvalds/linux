// SPDX-License-Identifier: (GPL-2.0+ OR MIT)
/*
 * Copyright (c) 2019 Fuzhou Rockchip Electronics Co., Ltd.
 */

/dts-v1/;

#include "rv1126.dtsi"

/ {
	compatible = "rockchip,rv1109";

	cpus {
		/delete-node/ cpu@f02;
		/delete-node/ cpu@f03;
	};

	arm-pmu {
		interrupts = <GIC_SPI 123 IRQ_TYPE_LEVEL_HIGH>,
			     <GIC_SPI 124 IRQ_TYPE_LEVEL_HIGH>;
		interrupt-affinity = <&cpu0>, <&cpu1>;
	};
};

&npu_opp_table {
	/delete-node/ opp-700000000;
	/delete-node/ opp-800000000;
	/delete-node/ opp-934000000;
};

