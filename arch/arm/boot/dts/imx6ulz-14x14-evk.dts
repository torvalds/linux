// SPDX-License-Identifier: (GPL-2.0 OR MIT)
//
// Copyright 2018 NXP.

/dts-v1/;

#include "imx6ulz.dtsi"
#include "imx6ul-14x14-evk.dtsi"

/delete-yesde/ &fec1;
/delete-yesde/ &fec2;
/delete-yesde/ &can1;
/delete-yesde/ &can2;
/delete-yesde/ &lcdif;
/delete-yesde/ &tsc;

/ {
	model = "Freescale i.MX6 ULZ 14x14 EVK Board";
	compatible = "fsl,imx6ulz-14x14-evk", "fsl,imx6ull", "fsl,imx6ulz";

	/delete-yesde/ panel;
};
