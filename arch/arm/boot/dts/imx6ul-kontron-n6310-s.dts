// SPDX-License-Identifier: GPL-2.0
/*
 * Copyright (C) 2017 exceet electronics GmbH
 * Copyright (C) 2018 Kontron Electronics GmbH
 * Copyright (c) 2019 Krzysztof Kozlowski <krzk@kernel.org>
 */

/dts-v1/;

#include "imx6ul-kontron-n6310-som.dtsi"
#include "imx6ul-kontron-n6x1x-s.dtsi"

/ {
	model = "Kontron N6310 S";
	compatible = "kontron,imx6ul-n6310-s", "kontron,imx6ul-n6310-som",
		     "fsl,imx6ul";
};
