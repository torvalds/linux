// SPDX-License-Identifier: GPL-2.0
/*
 * Copyright (c) 2014 MediaTek Inc.
 * Author: Joe.C <yingjoe.chen@mediatek.com>
 *
 */

/dts-v1/;
#include "mt8127.dtsi"

/ {
	model = "MediaTek MT8127 Moose Board";
	compatible = "mediatek,mt8127-moose", "mediatek,mt8127";

	memory {
		device_type = "memory";
		reg = <0 0x80000000 0 0x40000000>;
	};
};

&uart0 {
	status = "okay";
};
