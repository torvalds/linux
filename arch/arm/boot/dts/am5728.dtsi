// SPDX-License-Identifier: GPL-2.0
/*
 * Copyright (C) 2019 Texas Instruments Incorporated - http://www.ti.com/
 */

#include "dra74x.dtsi"

/ {
	compatible = "ti,am5728", "ti,dra7";
};

/*
 * These modules are not present on AM5728
 *
 * EVE1, EVE2
 * ATL
 * VCP1, VCP2
 * MLB
 * ISS
 * USB3, USB4
 */

&usb3_tm {
	status = "disabled";
};

&usb4_tm {
	status = "disabled";
};

&atl_tm {
	status = "disabled";
};
