// SPDX-License-Identifier: GPL-2.0
/*
 * Copyright (c) 2019 thingy.jp.
 * Author: Daniel Palmer <daniel@thingy.jp>
 */

/dts-v1/;
#include "mstar-infinity-msc313.dtsi"

/ {
	model = "BreadBee Crust";
	compatible = "thingyjp,breadbee-crust", "mstar,infinity";

	aliases {
		serial0 = &pm_uart;
	};

	chosen {
		stdout-path = "serial0:115200n8";
	};
};

&pm_uart {
	status = "okay";
};
