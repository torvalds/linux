// SPDX-License-Identifier: GPL-2.0-only
/*
 * Copyright (C) 2014 PHYTEC Messtechnik GmbH
 * Author: Wadim Egorov <w.egorov@phytec.de>
 */

/dts-v1/;

#include "am335x-phycore-som.dtsi"
#include "am335x-pcm-953.dtsi"

/* SoM */
&gpmc {
	status = "okay";
};

&i2c_eeprom {
	status = "okay";
};

&i2c_rtc {
	status = "okay";
};

&serial_flash {
	status = "okay";

};
