// SPDX-License-Identifier: (GPL-2.0+ OR MIT)
/*
 * Copyright (C) 2018 Engicam S.r.l.
 * Copyright (C) 2018 Amarula Solutions B.V.
 * Author: Jagan Teki <jagan@amarulasolutions.com>
 */

/dts-v1/;

#include "imx6dl.dtsi"
#include "imx6qdl-icore-1.5.dtsi"

/ {
	model = "Engicam i.CoreM6 DualLite/Solo MIPI Starter Kit";
	compatible = "engicam,imx6-icore", "fsl,imx6dl";
};

&hdmi {
	ddc-i2c-bus = <&i2c2>;
	status = "okay";
};

&usdhc3 {
	status = "okay";
};
