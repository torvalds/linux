// SPDX-License-Identifier: (GPL-2.0+ OR MIT)
/*
 * Copyright (c) 2019 Fuzhou Rockchip Electronics Co., Ltd.
 */

/dts-v1/;

#include "rv1126.dtsi"
#include "rv11xx-evb-v10.dtsi"

/ {
	model = "Rockchip RV1126 EVB LPDDR3 Board";
	compatible = "rockchip,rv1126-evb-lp3-v10", "rockchip,rv1126";

	chosen {
		bootargs = "earlycon=uart8250,mmio32,0xff570000 console=ttyFIQ0 root=PARTUUID=614e0000-0000 rootfstype=ext4 rootwait snd_aloop.index=7";
	};
};
