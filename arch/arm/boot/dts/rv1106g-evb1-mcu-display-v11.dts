// SPDX-License-Identifier: (GPL-2.0+ OR MIT)
/*
 * Copyright (c) 2022 Rockchip Electronics Co., Ltd.
 */

/dts-v1/;

#include "rv1106g-evb1-v11.dts"
#include "rv1106-evb-ext-mcu-v10.dtsi"

/ {
	model = "Rockchip RV1106G EVB1 V11 Board + RK EVB RGB2HDMI And MCU PANEL V10 Ext Board";
	compatible = "rockchip,rv1106g-evb1-mcu-display-v11", "rockchip,rv1106";
};

&mcu_panel {
	enable-gpios = <&gpio0 RK_PA5 GPIO_ACTIVE_LOW>;
	reset-gpios = <&gpio0 RK_PA6 GPIO_ACTIVE_LOW>;
};
