// SPDX-License-Identifier: GPL-2.0
#include "qcom-msm8974-sony-xperia-rhine.dtsi"

/ {
	model = "Sony Xperia Z1";
	compatible = "sony,xperia-honami", "qcom,msm8974";
	chassis-type = "handset";

	gpio-keys {
		key-camera-snapshot {
			label = "camera_snapshot";
			gpios = <&pm8941_gpios 3 GPIO_ACTIVE_LOW>;
			linux,input-type = <1>;
			linux,code = <KEY_CAMERA>;
		};

		key-camera-focus {
			label = "camera_focus";
			gpios = <&pm8941_gpios 4 GPIO_ACTIVE_LOW>;
			linux,input-type = <1>;
			linux,code = <KEY_CAMERA_FOCUS>;
		};
	};
};
