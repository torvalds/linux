// SPDX-License-Identifier: GPL-2.0

/* This PMIC is used on a secondary SSBI bus */
&ssbi2 {
	pm8821: pmic {
		compatible = "qcom,pm8821";
		interrupt-controller;
		#interrupt-cells = <2>;
		#address-cells = <1>;
		#size-cells = <0>;

		pm8821_mpps: mpps@50 {
			compatible = "qcom,pm8821-mpp", "qcom,ssbi-mpp";
			reg = <0x50>;
			gpio-controller;
			#gpio-cells = <2>;
			gpio-ranges = <&pm8821_mpps 0 0 4>;
			interrupt-controller;
			#interrupt-cells = <2>;
		};
	};
};
