// SPDX-License-Identifier: BSD-3-Clause
/*
 * Copyright (c) 2022, Matti Lehtimäki <matti.lehtimaki@gmail.com>
 * Copyright (c) 2023, Stefan Hansson <newbyte@postmarketos.org>
 */

/dts-v1/;

#include "qcom-msm8226-samsung-matisse-common.dtsi"

/ {
	model = "Samsung Galaxy Tab 4 10.1 LTE";
	compatible = "samsung,matisselte", "qcom,msm8926", "qcom,msm8226";
	chassis-type = "tablet";

	reg_tsp_3p3v: regulator-tsp-3p3v {
		compatible = "regulator-fixed";
		regulator-name = "tsp_3p3v";
		regulator-min-microvolt = <3300000>;
		regulator-max-microvolt = <3300000>;

		gpio = <&tlmm 32 GPIO_ACTIVE_HIGH>;
		enable-active-high;

		pinctrl-names = "default";
		pinctrl-0 = <&tsp_en1_default_state>;
	};
};

&tlmm {
	tsp_en1_default_state: tsp-en1-default-state {
		pins = "gpio32";
		function = "gpio";
		drive-strength = <2>;
		bias-disable;
	};
};
