/*
 * Copyright (C) 2016 Freescale Semiconductor, Inc.
 *
 * This program is free software; you can redistribute it and/or modify
 * it under the terms of the GNU General Public License version 2 as
 * published by the Free Software Foundation.
 */

#include "imx6ull-14x14-ddr3-arm2.dts"

/* flexcan2 tx/rx pin conflicts with uart2 */

&uart2{
	status = "disabled";
};

&flexcan2 {
	status = "okay";
};
