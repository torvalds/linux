// SPDX-License-Identifier: (GPL-2.0 OR BSD-3-Clause)
/*
 * Copyright (C) 2022 Marek Vasut <marex@denx.de>
 *
 * DHCOR STM32MP1 variant:
 * DHCR-STM32MP153C-C065-R051-V33-SPI-I-01LG
 * DHCOR PCB number: 586-100 or newer
 * DRC Compact PCB number: 627-100 or newer
 */

/dts-v1/;

#include "stm32mp153.dtsi"
#include "stm32mp15xc.dtsi"
#include "stm32mp15xx-dhcor-som.dtsi"
#include "stm32mp15xx-dhcor-drc-compact.dtsi"

/ {
	model = "DH electronics STM32MP153C DHCOR DRC Compact";
	compatible = "dh,stm32mp153c-dhcor-drc-compact",
		     "dh,stm32mp153c-dhcor-som",
		     "st,stm32mp153";
};

&m_can1 {
	pinctrl-names = "default", "sleep";
	pinctrl-0 = <&m_can1_pins_c>;
	pinctrl-1 = <&m_can1_sleep_pins_c>;
	status = "okay";
};
