/*
 * Copyright (C) 2016 Freescale Semiconductor, Inc.
 *
 * This program is free software; you can redistribute it and/or modify
 * it under the terms of the GNU General Public License version 2 as
 * published by the Free Software Foundation.
 */
&usdhc4 {
	pinctrl-names = "default", "state_100mhz", "state_200mhz";
	pinctrl-0 = <&pinctrl_usdhc4_1>;
	pinctrl-1 = <&pinctrl_usdhc4_1_100mhz>;
	pinctrl-2 = <&pinctrl_usdhc4_1_200mhz>;
	bus-width = <8>;
	no-1-8-v;
	non-removable;
	status = "okay";
};

&spdif {
	status = "disabled";
};
