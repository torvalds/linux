// SPDX-License-Identifier: GPL-2.0
/*
 * Device Tree Source for the iWave-RZ/G1N Qseven board
 *
 * Copyright (C) 2018 Renesas Electronics Corp.
 */

/dts-v1/;
#include "r8a7744-iwg20m.dtsi"
#include "iwg20d-q7-common.dtsi"

/ {
	model = "iWave Systems RainboW-G20D-Qseven board based on RZ/G1N";
	compatible = "iwave,g20d", "iwave,g20m", "renesas,r8a7744";
};
