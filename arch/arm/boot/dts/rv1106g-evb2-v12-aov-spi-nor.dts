// SPDX-License-Identifier: (GPL-2.0+ OR MIT)
/*
 * Copyright (c) 2023 Rockchip Electronics Co., Ltd.
 */

/dts-v1/;

#include "rv1106g-evb2-v10.dts"

/ {
	model = "Rockchip RV1106G EVB2 V12 Board";
	compatible = "rockchip,rv1106g-evb2-v12", "rockchip,rv1106";
};

&rkcif_mipi_lvds {
	rtt-suspend;
	status = "okay";
};

&rkisp_vir0 {
	memory-region-thunderboot = <&rkisp_thunderboot>;
	rtt-suspend;
	status = "okay";
};

&thunder_boot_service {
	memory-no-free;
	status = "okay";
};
