// SPDX-License-Identifier: GPL-2.0
/*
 * Copyright 2013 Freescale Semiconductor, Inc.
 *
 * Author: Fabio Estevam <fabio.estevam@freescale.com>
 */
/dts-v1/;
#include "imx6dl.dtsi"
#include "imx6qdl-wandboard-revc1.dtsi"

/ {
	model = "Wandboard i.MX6 Dual Lite Board";
	compatible = "wand,imx6dl-wandboard", "fsl,imx6dl";

	memory@10000000 {
		device_type = "memory";
		reg = <0x10000000 0x40000000>;
	};
};
