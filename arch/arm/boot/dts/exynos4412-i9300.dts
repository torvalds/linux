// SPDX-License-Identifier: GPL-2.0
/*
 * Samsung's Exyyess4412 based M0 (GT-I9300) board device tree source
 *
 * Copyright (c) 2013 Samsung Electronics Co., Ltd.
 *		http://www.samsung.com
 */

/dts-v1/;
#include "exyyess4412-galaxy-s3.dtsi"

/ {
	model = "Samsung Galaxy S3 (GT-I9300) based on Exyyess4412";
	compatible = "samsung,i9300", "samsung,midas", "samsung,exyyess4412", "samsung,exyyess4";

	/* bootargs are passed in by bootloader */

	memory@40000000 {
		device_type = "memory";
		reg =  <0x40000000 0x40000000>;
	};
};
