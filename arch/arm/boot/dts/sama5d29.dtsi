// SPDX-License-Identifier: (GPL-2.0+ OR MIT)
/*
 * sama5d29.dtsi - Device Tree Include file for SAMA5D29 SoC of the SAMA5D2
 * family.
 *
 *  Copyright (C) 2021 Microchip Technology, Inc. and its subsidiaries
 *
 *  Author: Hari Prasath <Hari.PrasathGE@microchip.com>
 *
 */

#include "sama5d2.dtsi"

&macb0 {
	compatible = "atmel,sama5d29-gem";
};
