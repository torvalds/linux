// SPDX-License-Identifier: GPL-2.0
/*
 * Device tree sources for default Exynos5440 thermal zone definition
 *
 * Copyright (c) 2014 Lukasz Majewski <l.majewski@samsung.com>
 */

polling-delay-passive = <0>;
polling-delay = <0>;
trips {
	cpu-alert-0 {
		temperature = <100000>; /* millicelsius */
		hysteresis = <0>; /* millicelsius */
		type = "active";
	};
	cpu-crit-0 {
		temperature = <105000>; /* millicelsius */
		hysteresis = <0>; /* millicelsius */
		type = "critical";
	};
};
