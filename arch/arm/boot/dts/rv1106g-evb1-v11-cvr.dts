// SPDX-License-Identifier: (GPL-2.0+ OR MIT)
/*
 * Copyright (c) 2022 Rockchip Electronics Co., Ltd.
 */

/dts-v1/;

#include "rv1106g-evb1-v11.dts"

/ {
	model = "Rockchip RV1106G EVB1 V11 Board For CVR";
	compatible = "rockchip,rv1106g-evb1-v11-cvr", "rockchip,rv1106";
};

&saradc {
	status = "okay";
	vref-supply = <&vcc_1v8>;
};
