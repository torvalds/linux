// SPDX-License-Identifier: GPL-2.0-only
/*
 * Author: Anthoine Bourgeois <anthoine.bourgois@gmail.com>
 */
/dts-v1/;

/*
 * 4.3'' LCD panel sold with devkit8000 board
 */

#include "omap3-devkit8000-lcd-common.dtsi"
/ {
	model = "TimLL OMAP3 Devkit8000 with 4.3'' LCD panel";
	compatible = "timll,omap3-devkit8000", "ti,omap3";

	lcd0: display {
		panel-timing {
			clock-frequency = <10164705>;
			hactive = <480>;
			vactive = <272>;
			hfront-porch = <2>;
			hback-porch = <2>;
			hsync-len = <41>;
			vback-porch = <2>;
			vfront-porch = <2>;
			vsync-len = <10>;

			hsync-active = <0>;
			vsync-active = <0>;
			de-active = <1>;
			pixelclk-active = <1>;
		};
	};
};
