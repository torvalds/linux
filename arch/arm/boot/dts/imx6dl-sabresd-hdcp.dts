/*
 * Copyright (C) 2013-2014 Freescale Semiconductor, Inc.
 *
 * This program is free software; you can redistribute it and/or modify
 * it under the terms of the GNU General Public License version 2 as
 * published by the Free Software Foundation.
 */

#include "imx6dl-sabresd.dts"

&hdmi_video {
	pinctrl-names = "default";
	pinctrl-0 = <&pinctrl_hdmi_hdcp>;
	fsl,hdcp;
};

&i2c2 {
	status = "disable";
};
