// SPDX-License-Identifier: GPL-2.0-or-later OR MIT
/*
 * Copyright 2026 Mehmet Fide
 */

/dts-v1/;
#include "vf610-colibri.dtsi"
#include "vf-colibri-iris.dtsi"

/ {
	model = "Toradex Colibri VF61 on Iris Carrier Board";
	compatible = "toradex,vf610-colibri-vf61-on-iris", "toradex,vf610-colibri_vf61",
		     "fsl,vf610";
};
