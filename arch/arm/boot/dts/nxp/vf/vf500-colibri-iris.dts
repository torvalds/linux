// SPDX-License-Identifier: GPL-2.0-or-later OR MIT
/*
 * Copyright 2026 Mehmet Fide
 */

/dts-v1/;
#include "vf500-colibri.dtsi"
#include "vf-colibri-iris.dtsi"

/ {
	model = "Toradex Colibri VF50 on Iris Carrier Board";
	compatible = "toradex,vf500-colibri-vf50-on-iris", "toradex,vf500-colibri_vf50",
		     "fsl,vf500";
};
