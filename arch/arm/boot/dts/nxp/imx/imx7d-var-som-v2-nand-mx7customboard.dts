// SPDX-License-Identifier: (GPL-2.0+ OR MIT)
/*
 * VAR-MX7CustomBoard for VAR-SOM-MX7 V2 with NAND
 *
 * Link: https://variscite.com/carrier-boards/var-mx7customboard/
 *
 * Copyright (C) 2026 Variscite Ltd. - https://www.variscite.com/
 *
 */

/dts-v1/;

#include "imx7d-var-som.dtsi"
#include "imx7d-var-som-v2.dtsi"
#include "imx7d-var-som-nand.dtsi"
#include "imx7d-var-som-wm8904.dtsi"
#include "imx7d-var-som-mx7customboard.dtsi"

/ {
	model = "Variscite VAR-SOM-MX7-5G_V2 with NAND flash & WM8904 on VAR-MX7CustomBoard";
	compatible = "variscite,var-som-imx7d-v2-nand-mx7customboard",
		     "variscite,var-som-imx7d-v2",
		     "fsl,imx7d";
};
