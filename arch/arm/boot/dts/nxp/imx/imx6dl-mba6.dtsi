// SPDX-License-Identifier: GPL-2.0-only
/*
 * Copyright 2013 Sascha Hauer, Pengutronix
 *
 * Copyright 2013-2021 TQ-Systems GmbH
 * Author: Markus Niebel <Markus.Niebel@tq-group.com>
 */

&ethphy {
	rxdv-skew-ps = <180>;
	txen-skew-ps = <0>;
	rxd3-skew-ps = <180>;
	rxd2-skew-ps = <180>;
	rxd1-skew-ps = <180>;
	rxd0-skew-ps = <180>;
	txd3-skew-ps = <120>;
	txd2-skew-ps = <0>;
	txd1-skew-ps = <300>;
	txd0-skew-ps = <120>;
	txc-skew-ps = <1860>;
	rxc-skew-ps = <1860>;
};
