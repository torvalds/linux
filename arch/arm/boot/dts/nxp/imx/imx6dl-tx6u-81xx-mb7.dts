// SPDX-License-Identifier: (GPL-2.0-only OR MIT)
/*
 * Copyright 2016-2017 Lothar Waßmann <LW@KARO-electronics.de>
 */

/dts-v1/;
#include "imx6dl-tx6u-811x.dts"
#include "imx6qdl-tx6-mb7.dtsi"

/ {
	model = "Ka-Ro electronics TX6U-8130/-8110 Module on MB7 baseboard";
};
