// SPDX-License-Identifier: (GPL-2.0-only OR MIT)
/*
 * Copyright 2016-2017 Lothar Waßmann <LW@KARO-electronics.de>
 */

/dts-v1/;
#include "imx6q-tx6q-1110.dts"
#include "imx6qdl-tx6-mb7.dtsi"

/ {
	model = "Ka-Ro electronics TX6Q-1110/-1130 Module on MB7 baseboard";
};
