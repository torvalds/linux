// SPDX-License-Identifier: GPL-2.0-or-later OR MIT
/* Copyright (c) 2025 Toradex */

/dts-v1/;

#include "imx6dl-colibri-eval-v3.dts"
#include "imx6qdl-colibri-v1.2.dtsi"

/ {
	model = "Toradex Colibri iMX6DL/S V1.2+ on Colibri Evaluation Board V3";
};
