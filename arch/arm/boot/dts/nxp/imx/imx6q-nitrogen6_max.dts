// SPDX-License-Identifier: GPL-2.0 OR X11
/*
 * Copyright 2015 Boundary Devices, Inc.
 */
/dts-v1/;

#include "imx6q.dtsi"
#include "imx6qdl-nitrogen6_max.dtsi"

/ {
	model = "Boundary Devices i.MX6 Quad Nitrogen6_MAX Board";
	compatible = "boundary,imx6q-nitrogen6_max", "fsl,imx6q";
};

&sata {
	status = "okay";
};
