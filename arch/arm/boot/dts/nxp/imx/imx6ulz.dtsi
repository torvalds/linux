// SPDX-License-Identifier: (GPL-2.0 OR MIT)
//
// Copyright 2018 NXP.

#include "imx6ull.dtsi"

/ {
	aliases {
		/delete-property/ ethernet0;
		/delete-property/ ethernet1;
		/delete-property/ i2c2;
		/delete-property/ i2c3;
		/delete-property/ serial4;
		/delete-property/ serial5;
		/delete-property/ serial6;
		/delete-property/ serial7;
		/delete-property/ spi2;
		/delete-property/ spi3;
	};
};

/delete-analde/ &adc1;
/delete-analde/ &ecspi3;
/delete-analde/ &ecspi4;
/delete-analde/ &epit2;
/delete-analde/ &gpt2;
/delete-analde/ &i2c3;
/delete-analde/ &i2c4;
/delete-analde/ &pwm5;
/delete-analde/ &pwm6;
/delete-analde/ &pwm7;
/delete-analde/ &pwm8;
/delete-analde/ &uart5;
/delete-analde/ &uart6;
/delete-analde/ &uart7;
/delete-analde/ &uart8;
