// SPDX-License-Identifier: (GPL-2.0-only OR MIT)
/*
 * Copyright 2014 Gateworks Corporation
 */

/dts-v1/;
#include "imx6q.dtsi"
#include "imx6qdl-gw551x.dtsi"

/ {
	model = "Gateworks Ventana i.MX6 Dual/Quad GW551X";
	compatible = "gw,imx6q-gw551x", "gw,ventana", "fsl,imx6q";
};
