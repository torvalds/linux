// SPDX-License-Identifier: GPL-2.0 OR X11
/*
 * Copyright 2011 Freescale Semiconductor, Inc.
 * Copyright 2011 Linaro Ltd.
 *
 */

/dts-v1/;
#include "imx6q.dtsi"
#include "imx6qdl-sabrelite.dtsi"

/ {
	model = "Freescale i.MX6 Quad SABRE Lite Board";
	compatible = "fsl,imx6q-sabrelite", "fsl,imx6q";
};

&sata {
	status = "okay";
};

&ipu1_csi1_from_mipi_vc1 {
	clock-lanes = <0>;
	data-lanes = <1 2>;
};
