// SPDX-License-Identifier: GPL-2.0-or-later
/*
 * Copyright 2014 Gateworks Corporation
 */

/dts-v1/;

#include "imx6dl.dtsi"
#include "imx6qdl-gw552x.dtsi"

/ {
	model = "Gateworks Ventana i.MX6 DualLite/Solo GW552X";
	compatible = "gw,imx6dl-gw552x", "gw,ventana", "fsl,imx6dl";
};
