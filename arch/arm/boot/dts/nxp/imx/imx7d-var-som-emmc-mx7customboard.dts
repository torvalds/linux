// SPDX-License-Identifier: (GPL-2.0+ OR MIT)
/*
 * VAR-MX7CustomBoard for VAR-SOM-MX7 with eMMC
 *
 * Link: https://variscite.com/carrier-boards/var-mx7customboard/
 *
 * Copyright (C) 2026 Variscite Ltd. - https://www.variscite.com/
 *
 */

/dts-v1/;

#include "imx7d-var-som.dtsi"
#include "imx7d-var-som-emmc.dtsi"
#include "imx7d-var-som-wm8904.dtsi"
#include "imx7d-var-som-mx7customboard.dtsi"

/ {
	model = "Variscite VAR-SOM-MX7 with eMMC & WM8904 on VAR-MX7CustomBoard";
	compatible = "variscite,var-som-imx7d-emmc-mx7customboard",
		     "variscite,var-som-imx7d",
		     "fsl,imx7d";
};
