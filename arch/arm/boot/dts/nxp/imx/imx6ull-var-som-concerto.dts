// SPDX-License-Identifier: GPL-2.0+
/*
 * Support for Variscite Concerto Carrier board with the VAR-SOM-6UL
 * Variscite SoM mounted on it (6ULL CPU variant)
 *
 * Copyright 2026 Dimonoff
 */

/dts-v1/;

#include "imx6ull-var-som.dtsi"
#include "imx6ul-var-som-concerto-common.dtsi"
#include "imx6ul-var-som-sd.dtsi"
#include "imx6ul-var-som-enet2.dtsi"
#include "imx6ul-var-som-audio.dtsi"
#include "imx6ul-var-som-lvds-panel.dtsi"

/ {
	model = "Variscite VAR-SOM-6UL Concerto Board (6ULL CPU)";
	compatible = "variscite,mx6ullconcerto", "variscite,var-som-imx6ull", "fsl,imx6ull";
};
