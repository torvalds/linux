// SPDX-License-Identifier: GPL-2.0 OR X11
/*
 * Copyright 2019 (C) Pengutronix, Marco Felsch <kernel@pengutronix.de>
 */

#include "imx6dl.dtsi"
#include "imx6qdl-kontron-samx6i.dtsi"

/ {
	model = "Kontron SMARC sAMX6i Dual-Lite/Solo";
	compatible = "kontron,imx6dl-samx6i", "fsl,imx6dl";
};
