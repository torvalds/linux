// SPDX-License-Identifier: GPL-2.0+
/*
 * Copyright (C) 2015-2021 DH electronics GmbH
 * Copyright (C) 2018 Marek Vasut <marex@denx.de>
 *
 * DHCOM iMX6 variant:
 * DHCM-iMX6Q-C0800-R102-F0819-E-SD-RTC-T-HS-I-01D2
 * DHCOM PCB number: 493-300 or newer
 * PDK2 PCB number: 516-400 or newer
 */
/dts-v1/;

#include "imx6q.dtsi"
#include "imx6qdl-dhcom-som.dtsi"
#include "imx6qdl-dhcom-pdk2.dtsi"

/ {
	model = "DH electronics i.MX6Q DHCOM on Premium Developer Kit (2)";
	compatible = "dh,imx6q-dhcom-pdk2", "dh,imx6q-dhcom-som",
		     "fsl,imx6q";
};

&sata {
	status = "okay";
};
