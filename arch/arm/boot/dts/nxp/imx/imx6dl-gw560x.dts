// SPDX-License-Identifier: (GPL-2.0-only OR MIT)
/*
 * Copyright 2017 Gateworks Corporation
 */

/dts-v1/;
#include "imx6dl.dtsi"
#include "imx6qdl-gw560x.dtsi"

/ {
	model = "Gateworks Ventana i.MX6 DualLite/Solo GW560X";
	compatible = "gw,imx6dl-gw560x", "gw,ventana", "fsl,imx6dl";
};
