// SPDX-License-Identifier: GPL-2.0+ OR MIT
//
// Copyright 2015 Armadeus Systems <support@armadeus.com>

/dts-v1/;
#include "imx6q.dtsi"
#include "imx6qdl-apf6.dtsi"
#include "imx6qdl-apf6dev.dtsi"

/ {
	model = "Armadeus APF6 Quad / Dual Module on APF6Dev Board";
	compatible = "armadeus,imx6q-apf6dev", "armadeus,imx6q-apf6", "fsl,imx6q";

	memory@10000000 {
		device_type = "memory";
		reg = <0x10000000 0x40000000>;
	};
};

&sata {
	status = "okay";
};
