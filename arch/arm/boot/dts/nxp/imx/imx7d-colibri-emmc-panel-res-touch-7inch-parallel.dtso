// SPDX-License-Identifier: GPL-2.0-or-later OR MIT
/*
 * Copyright (c) Toradex
 *
 * Toradex Resistive Touch Display 7" Parallel connected through the 40-way
 * Unified Interface Display connector.
 *
 * https://docs.toradex.com/104498-7-inch-parallel-resistive-touch-display-800x480.pdf
 * https://developer.toradex.com/hardware/accessories/displays/resistive-touch-display-7inch-parallel/
 * https://www.toradex.com/accessories/resistive-touch-display
 */

/dts-v1/;
/plugin/;

&ad7879_ts {
	status = "okay";
};

&backlight {
	status = "okay";
};

&lcdif {
	status = "okay";
};

&panel_dpi {
	compatible = "logictechno,lt161010-2nhr";

	status = "okay";
};
