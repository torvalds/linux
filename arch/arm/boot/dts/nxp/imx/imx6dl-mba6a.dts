// SPDX-License-Identifier: GPL-2.0-only
/*
 * Copyright 2013 Sascha Hauer, Pengutronix
 *
 * Copyright 2013-2021 TQ-Systems GmbH
 * Author: Markus Niebel <Markus.Niebel@tq-group.com>
 */

/dts-v1/;

#include <dt-bindings/gpio/gpio.h>
#include "imx6dl-tqma6a.dtsi"
#include "imx6qdl-mba6.dtsi"
#include "imx6qdl-mba6a.dtsi"
#include "imx6dl-mba6.dtsi"

/ {
	model = "TQ TQMa6S/DL on MBa6x";
	compatible = "tq,imx6dl-mba6x-a", "tq,mba6a",
		     "tq,imx6dl-tqma6dl-a", "fsl,imx6dl";
};
