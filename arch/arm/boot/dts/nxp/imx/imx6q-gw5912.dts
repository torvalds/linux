// SPDX-License-Identifier: GPL-2.0
/*
 * Copyright 2019 Gateworks Corporation
 */

/dts-v1/;
#include "imx6q.dtsi"
#include "imx6qdl-gw5912.dtsi"

/ {
	model = "Gateworks Ventana i.MX6 Dual/Quad GW5912";
	compatible = "gw,imx6q-gw5912", "gw,ventana", "fsl,imx6q";
};
