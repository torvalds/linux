// SPDX-License-Identifier: GPL-2.0 OR X11

/dts-v1/;

#include "imx6dl.dtsi"
#include "imx6qdl-kontron-samx6i.dtsi"
#include "imx6qdl-kontron-samx6i-ads2.dtsi"

/ {
	model = "Kontron SMARC-sAMX6i Dual-Lite/Solo on SMARC Eval 2.0 carrier";
	compatible = "kontron,imx6dl-samx6i-ads2", "kontron,imx6dl-samx6i", "fsl,imx6dl";
};
