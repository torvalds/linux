// SPDX-License-Identifier: GPL-2.0-or-later OR MIT
/* Copyright (c) 2025 Toradex */

/dts-v1/;

#include "imx6q-apalis-eval-v1.2.dts"
#include "imx6qdl-apalis-v1.2.dtsi"

/ {
	model = "Toradex Apalis iMX6Q/D Module V1.2+ on Apalis Evaluation Board v1.2";
};
