// SPDX-License-Identifier: (GPL-2.0-only OR MIT)
/*
 * Copyright 2016 Gateworks Corporation
 */

/dts-v1/;
#include "imx6dl.dtsi"
#include "imx6qdl-gw553x.dtsi"

/ {
	model = "Gateworks Ventana i.MX6 DualLite/Solo GW553X";
	compatible = "gw,imx6dl-gw553x", "gw,ventana", "fsl,imx6dl";
};
