// SPDX-License-Identifier: (GPL-2.0-only OR MIT)
/*
 * Copyright 2015 Lothar Waßmann <LW@KARO-electronics.de>
 */

/dts-v1/;
#include "imx6ul.dtsi"
#include "imx6ul-tx6ul.dtsi"

/ {
	model = "Ka-Ro electronics TXUL-0011 Module";
	compatible = "karo,imx6ul-tx6ul", "fsl,imx6ul";

	aliases {
		mmc0 = &usdhc2;
		mmc1 = &usdhc1;
	};
};

&gpmi {
	status = "disabled";
};

&usdhc2 {
	pinctrl-names = "default";
	pinctrl-0 = <&pinctrl_usdhc2>;
	bus-width = <4>;
	no-1-8-v;
	non-removable;
	fsl,wp-controller;
	status = "okay";
};
