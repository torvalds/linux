// SPDX-License-Identifier: (GPL-2.0-only OR MIT)
/*
 * Copyright 2017 Lothar Waßmann <LW@KARO-electronics.de>
 */

/dts-v1/;
#include "imx6qp-tx6qp-8137.dts"
#include "imx6qdl-tx6-mb7.dtsi"

/ {
	model = "Ka-Ro electronics TX6Q-8137 Module on MB7 baseboard";
	compatible = "karo,imx6qp-tx6qp", "fsl,imx6qp";
};

&ipu2 {
	status = "disabled";
};

&sata {
	status = "okay";
};
