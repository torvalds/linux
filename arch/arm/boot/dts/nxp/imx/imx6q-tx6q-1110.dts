// SPDX-License-Identifier: (GPL-2.0-only OR MIT)
/*
 * Copyright 2014-2017 Lothar Waßmann <LW@KARO-electronics.de>
 */

/dts-v1/;
#include "imx6q.dtsi"
#include "imx6qdl-tx6.dtsi"
#include "imx6qdl-tx6-lvds.dtsi"

/ {
	model = "Ka-Ro electronics TX6Q-1110/-1130 Module";
	compatible = "karo,imx6q-tx6q", "fsl,imx6q";
};

&ipu2 {
	status = "disabled";
};

&sata {
	status = "okay";
};
