// SPDX-License-Identifier: (GPL-2.0+ OR MIT)
/*
 * Copyright (C) 2019 PHYTEC Messtechnik GmbH
 * Author: Stefan Riedmueller <s.riedmueller@phytec.de>
 */

#include "imx6ul-phytec-segin-peb-eval-01.dtsi"

&iomuxc {
	/delete-node/ gpio_keysgrp;
};

&iomuxc_snvs {
	pinctrl_gpio_keys: gpio_keysgrp {
		fsl,pins = <
			MX6ULL_PAD_SNVS_TAMPER0__GPIO5_IO00	0x79
		>;
	};
};
