// SPDX-License-Identifier: (GPL-2.0-only OR MIT)
/*
 * Copyright 2017 Gateworks Corporation
 */

/dts-v1/;
#include "imx6dl.dtsi"
#include "imx6qdl-gw5903.dtsi"

/ {
	model = "Gateworks Ventana i.MX6 Duallite/Solo GW5903";
	compatible = "gw,imx6dl-gw5903", "gw,ventana", "fsl,imx6dl";
};
