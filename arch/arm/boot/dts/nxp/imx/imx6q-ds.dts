// SPDX-License-Identifier: GPL-2.0+
//
// Copyright 2021 Dillon Min <dillon.minfei@gmail.com>
//
// Based on imx6qdl-sabresd.dtsi which is:
// Copyright 2012 Freescale Semiconductor, Inc.
// Copyright 2011 Linaro Ltd.

/dts-v1/;

#include "imx6q.dtsi"
#include "imx6qdl-ds.dtsi"

/ {
	model = "DaSheng i.MX6 Quad Com-9xx Board";
	compatible = "ds,imx6q-sbc", "fsl,imx6q";
};
