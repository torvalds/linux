// SPDX-License-Identifier: (GPL-2.0-only OR MIT)
/*
 * Copyright 2014-2017 Lothar Waßmann <LW@KARO-electronics.de>
 */

/dts-v1/;
#include "imx6dl.dtsi"
#include "imx6qdl-tx6.dtsi"
#include "imx6qdl-tx6-lvds.dtsi"

/ {
	model = "Ka-Ro electronics TX6U-811x Module";
	compatible = "karo,imx6dl-tx6dl", "fsl,imx6dl";
};
