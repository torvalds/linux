// SPDX-License-Identifier: (GPL-2.0-only OR MIT)
/*
 * Copyright 2017 Lothar Waßmann <LW@KARO-electronics.de>
 */

/dts-v1/;
#include "imx6q-tx6q-1010.dts"
#include "imx6qdl-tx6-mb7.dtsi"

/ {
	model = "Ka-Ro electronics TX6Q-1010/-1030 Module on MB7 baseboard";
};
