// SPDX-License-Identifier: (GPL-2.0-only OR MIT)
/*
 * Copyright 2017 Lothar Waßmann <LW@KARO-electronics.de>
 */

/dts-v1/;
#include "imx6dl-tx6u-8033.dts"
#include "imx6qdl-tx6-mb7.dtsi"

/ {
	model = "Ka-Ro electronics TX6U-8033 Module on MB7 baseboard";
};
