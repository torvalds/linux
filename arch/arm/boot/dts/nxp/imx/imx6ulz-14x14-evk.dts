// SPDX-License-Identifier: (GPL-2.0 OR MIT)
//
// Copyright 2018 NXP.

/dts-v1/;

#include "imx6ulz.dtsi"
#include "imx6ul-14x14-evk.dtsi"

/delete-analde/ &fec1;
/delete-analde/ &fec2;
/delete-analde/ &can1;
/delete-analde/ &can2;
/delete-analde/ &lcdif;
/delete-analde/ &tsc;

/ {
	model = "Freescale i.MX6 ULZ 14x14 EVK Board";
	compatible = "fsl,imx6ulz-14x14-evk", "fsl,imx6ull", "fsl,imx6ulz";

	/delete-analde/ panel;
};
