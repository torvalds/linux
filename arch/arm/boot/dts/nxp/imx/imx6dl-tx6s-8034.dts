// SPDX-License-Identifier: (GPL-2.0-only OR MIT)
/*
 * Copyright 2015-2017 Lothar Waßmann <LW@KARO-electronics.de>
 */

/dts-v1/;
#include "imx6dl.dtsi"
#include "imx6qdl-tx6.dtsi"
#include "imx6qdl-tx6-lcd.dtsi"

/ {
	model = "Ka-Ro electronics TX6S-8034 Module";
	compatible = "karo,imx6dl-tx6dl", "fsl,imx6dl";

	cpus {
		/delete-node/ cpu@1;
	};
};

&ds1339 {
	status = "disabled";
};

&pinctrl_usdhc1 {
	fsl,pins = <
		MX6QDL_PAD_SD1_CMD__SD1_CMD		0x070b1
		MX6QDL_PAD_SD1_CLK__SD1_CLK		0x070b1
		MX6QDL_PAD_SD1_DAT0__SD1_DATA0		0x070b1
		MX6QDL_PAD_SD1_DAT1__SD1_DATA1		0x070b1
		MX6QDL_PAD_SD1_DAT2__SD1_DATA2		0x070b1
		MX6QDL_PAD_SD1_DAT3__SD1_DATA3		0x070b1
		MX6QDL_PAD_SD3_CMD__GPIO7_IO02		0x170b0 /* SD1 CD */
	>;
};
