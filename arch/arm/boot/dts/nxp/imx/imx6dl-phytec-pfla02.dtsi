// SPDX-License-Identifier: GPL-2.0-or-later
/*
 * Copyright 2013 Christian Hemp, Phytec Messtechnik GmbH
 */

#include "imx6dl.dtsi"
#include "imx6qdl-phytec-pfla02.dtsi"

/ {
	model = "Phytec phyFLEX-i.MX6 DualLite/Solo";
	compatible = "phytec,imx6dl-pfla02", "fsl,imx6dl";

	memory@10000000 {
		device_type = "memory";
		reg = <0x10000000 0x20000000>;
	};
};
