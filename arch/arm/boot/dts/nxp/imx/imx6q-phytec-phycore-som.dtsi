// SPDX-License-Identifier: (GPL-2.0+ OR MIT)
/*
 * Copyright (C) 2021 PHYTEC Messtechnik GmbH
 * Author: Yunus Bas <y.bas@phytec.de>
 */

#include "imx6qdl-phytec-phycore-som.dtsi"

&cpu0 {
	operating-points =
		/* kHz    uV */
		<1200000 1300000>,
		<996000  1250000>,
		<852000  1250000>,
		<792000  1175000>,
		<396000  1075000>;
	fsl,soc-operating-points =
		/* ARM kHz  SOC-PU uV */
		<1200000 1275000>,
		<996000  1250000>,
		<852000  1250000>,
		<792000  1250000>,
		<396000  1250000>;
};

&cpu1 {
	operating-points =
		/* kHz    uV */
		<1200000 1300000>,
		<996000  1250000>,
		<852000  1250000>,
		<792000  1175000>,
		<396000  1075000>;
	fsl,soc-operating-points =
		/* ARM kHz  SOC-PU uV */
		<1200000 1275000>,
		<996000  1250000>,
		<852000  1250000>,
		<792000  1250000>,
		<396000  1250000>;
};

&cpu2 {
	operating-points =
		/* kHz    uV */
		<1200000 1300000>,
		<996000  1250000>,
		<852000  1250000>,
		<792000  1175000>,
		<396000  1075000>;
	fsl,soc-operating-points =
		/* ARM kHz  SOC-PU uV */
		<1200000 1275000>,
		<996000  1250000>,
		<852000  1250000>,
		<792000  1250000>,
		<396000  1250000>;
};

&cpu3 {
	operating-points =
		/* kHz    uV */
		<1200000 1300000>,
		<996000  1250000>,
		<852000  1250000>,
		<792000  1175000>,
		<396000  1075000>;
	fsl,soc-operating-points =
		/* ARM kHz  SOC-PU uV */
		<1200000 1275000>,
		<996000  1250000>,
		<852000  1250000>,
		<792000  1250000>,
		<396000  1250000>;
};
