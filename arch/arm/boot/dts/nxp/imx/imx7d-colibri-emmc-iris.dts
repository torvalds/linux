// SPDX-License-Identifier: GPL-2.0-or-later OR MIT
/*
 * Copyright 2022 Toradex
 */

/dts-v1/;
#include "imx7d-colibri-emmc.dtsi"
#include "imx7-colibri-iris.dtsi"

/ {
	model = "Toradex Colibri iMX7D 1GB on Iris Carrier Board";
	compatible = "toradex,colibri-imx7d-emmc-iris",
		     "toradex,colibri-imx7d-emmc",
		     "fsl,imx7d";
};

/* Colibri USBH */
&usbotg2 {
	disable-over-current;
	status = "okay";
};
