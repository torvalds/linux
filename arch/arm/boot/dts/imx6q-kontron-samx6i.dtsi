// SPDX-License-Identifier: GPL-2.0 OR X11
/*
 * Copyright 2019 (C) Pengutronix, Marco Felsch <kernel@pengutronix.de>
 */

#include "imx6q.dtsi"
#include "imx6qdl-kontron-samx6i.dtsi"

/ {
	model = "Kontron SMARC sAMX6i Quad/Dual";
	compatible = "kontron,imx6q-samx6i", "fsl,imx6q";
};
