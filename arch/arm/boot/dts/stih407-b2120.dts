/*
 * Copyright (C) 2014 STMicroelectronics (R&D) Limited.
 * Author: Giuseppe Cavallaro <peppe.cavallaro@st.com>
 *
 * This program is free software; you can redistribute it and/or modify
 * it under the terms of the GNU General Public License version 2 as
 * published by the Free Software Foundation.
 */
/dts-v1/;
#include "stih407-clock.dtsi"
#include "stih407-family.dtsi"
#include "stihxxx-b2120.dtsi"
/ {
	model = "STiH407 B2120";
	compatible = "st,stih407-b2120", "st,stih407";

	chosen {
		bootargs = "console=ttyAS0,115200 clk_ignore_unused";
		linux,stdout-path = &sbc_serial0;
	};

	memory {
		device_type = "memory";
		reg = <0x40000000 0x80000000>;
	};

	aliases {
		ttyAS0 = &sbc_serial0;
	};

};
