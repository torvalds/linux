// SPDX-License-Identifier: GPL-2.0 OR X11
/*
 * Copyright 2013 Boundary Devices, Inc.
 * Copyright 2012 Freescale Semiconductor, Inc.
 * Copyright 2011 Linaro Ltd.
 */

/dts-v1/;
#include "imx6dl.dtsi"
#include "imx6qdl-nitrogen6x.dtsi"

/ {
	model = "Boundary Devices i.MX6 DualLite Nitrogen6x Board";
	compatible = "boundary,imx6dl-nitrogen6x", "fsl,imx6dl";
};
