// SPDX-License-Identifier: (GPL-2.0+ OR MIT)
/*
 * Copyright (c) 2019 Fuzhou Rockchip Electronics Co., Ltd
 * Copyright (c) 2019 Vamrs Limited
 * Copyright (c) 2019 Amarula Solutions(India)
 */

/dts-v1/;
#include "rk3288.dtsi"
#include <arm/rockchip-radxa-dalang-carrier.dtsi>
#include "rk3288-vmarc-som.dtsi"

/ {
	model = "Radxa ROCK Pi N8";
	compatible = "radxa,rockpi-n8", "vamrs,rk3288-vmarc-som",
		     "rockchip,rk3288";
};
