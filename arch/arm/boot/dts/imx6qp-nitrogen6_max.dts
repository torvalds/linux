// SPDX-License-Identifier: GPL-2.0 OR X11
/*
 * Copyright 2016 Boundary Devices, Inc.
 */

/dts-v1/;

#include "imx6qp.dtsi"
#include "imx6qdl-nitrogen6_max.dtsi"

/ {
	model = "Boundary Devices i.MX6 Quad Plus Nitrogen6_MAX Board";
	compatible = "boundary,imx6qp-nitrogen6_max", "fsl,imx6qp";
};

&pcie {
	status = "disabled";
};

&sata {
	status = "okay";
};
