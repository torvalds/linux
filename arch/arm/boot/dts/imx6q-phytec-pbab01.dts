// SPDX-License-Identifier: GPL-2.0-or-later
/*
 * Copyright 2013 Christian Hemp, Phytec Messtechnik GmbH
 */

/dts-v1/;
#include "imx6q-phytec-pfla02.dtsi"
#include "imx6qdl-phytec-pbab01.dtsi"

/ {
	model = "Phytec phyFLEX-i.MX6 Quad Carrier-Board";
	compatible = "phytec,imx6q-pbab01", "phytec,imx6q-pfla02", "fsl,imx6q";

	chosen {
		stdout-path = &uart4;
	};
};

&sata {
	status = "okay";
};
