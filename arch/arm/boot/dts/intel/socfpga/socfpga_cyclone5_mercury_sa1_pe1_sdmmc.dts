// SPDX-License-Identifier: GPL-2.0+ OR MIT
/*
 * Copyright (C) 2024 Enclustra GmbH - https://www.enclustra.com
 */

/dts-v1/;

#include "socfpga_cyclone5_mercury_sa1.dtsi"
#include "socfpga_enclustra_mercury_pe1.dtsi"
#include "socfpga_enclustra_mercury_bootmode_sdmmc.dtsi"

/ {
	model = "Enclustra Mercury SA1 on Mercury+ PE1 Base Board";
	compatible = "enclustra,mercury-sa1-pe1", "enclustra,mercury-sa1",
		     "altr,socfpga-cyclone5", "altr,socfpga";
};
