// SPDX-License-Identifier: GPL-2.0+ OR MIT
/*
 * Copyright (C) 2024 Enclustra GmbH - https://www.enclustra.com
 */

/dts-v1/;

#include "socfpga_cyclone5_mercury_sa1.dtsi"
#include "socfpga_enclustra_mercury_st1.dtsi"
#include "socfpga_enclustra_mercury_bootmode_qspi.dtsi"

/ {
	model = "Enclustra Mercury SA1 on Mercury+ ST1 Base Board";
	compatible = "enclustra,mercury-sa1-st1", "enclustra,mercury-sa1",
		     "altr,socfpga-cyclone5", "altr,socfpga";
};
