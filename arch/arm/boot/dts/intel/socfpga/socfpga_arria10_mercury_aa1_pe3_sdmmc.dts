// SPDX-License-Identifier: GPL-2.0+ OR MIT
/*
 * Copyright (C) 2024 Enclustra GmbH - https://www.enclustra.com
 */

/dts-v1/;

#include "socfpga_arria10_mercury_aa1.dtsi"
#include "socfpga_enclustra_mercury_pe3.dtsi"
#include "socfpga_enclustra_mercury_bootmode_sdmmc.dtsi"

/ {
	model = "Enclustra Mercury+ AA1 on Mercury+ PE3 Base Board";
	compatible = "enclustra,mercury-aa1-pe3", "enclustra,mercury-aa1",
		     "altr,socfpga-arria10", "altr,socfpga";
};
