// SPDX-License-Identifier: GPL-2.0+ OR MIT
/*
 * Copyright (C) 2024 Enclustra GmbH - https://www.enclustra.com
 */

/dts-v1/;

#include "socfpga_cyclone5_mercury_sa2.dtsi"
#include "socfpga_enclustra_mercury_pe3.dtsi"
#include "socfpga_enclustra_mercury_bootmode_sdmmc.dtsi"

/ {
	model = "Enclustra Mercury+ SA2 on Mercury+ PE3 Base Board";
	compatible = "enclustra,mercury-sa2-pe3", "enclustra,mercury-sa2",
		     "altr,socfpga-cyclone5", "altr,socfpga";
};
