// SPDX-License-Identifier: GPL-2.0+ OR MIT
/*
 * Copyright (C) 2024 Enclustra GmbH - https://www.enclustra.com
 */

/dts-v1/;

#include "socfpga_arria10_mercury_aa1.dtsi"
#include "socfpga_enclustra_mercury_st1.dtsi"
#include "socfpga_enclustra_mercury_bootmode_qspi.dtsi"

/ {
	model = "Enclustra Mercury+ AA1 on Mercury+ ST1 Base Board";
	compatible = "enclustra,mercury-aa1-st1", "enclustra,mercury-aa1",
		     "altr,socfpga-arria10", "altr,socfpga";
};
