// SPDX-License-Identifier: GPL-2.0-only
/*
 * Copyright (C) 2011 Ilya Yanok, EmCraft Systems
 */
/dts-v1/;

#include "omap34xx.dtsi"

/ {
	model = "TeeJet Mt.Ventoux";
	compatible = "teejet,mt_ventoux", "ti,am3517", "ti,omap3";

	memory@80000000 {
		device_type = "memory";
		reg = <0x80000000 0x10000000>; /* 256 MB */
	};

	/* AM35xx doesn't have IVA */
	soc {
		iva {
			status = "disabled";
		};
	};
};
