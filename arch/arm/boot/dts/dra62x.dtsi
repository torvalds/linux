/*
 * This file is licensed under the terms of the GNU General Public License
 * version 2.  This program is licensed "as is" without any warranty of any
 * kind, whether express or implied.
 */

#include "dm814x.dtsi"

/ {
	compatible = "ti,dra62x";
};

/* Compared to dm814x, dra62x has different offsets for Ethernet */
&mac {
	reg = <0 0x800>,
	      <0x1200 0x100>;
};

&davinci_mdio {
	reg = <0x1000 0x100>;
};

#include "dra62x-clocks.dtsi"
