/*
 * Copyright (C) 2016 Freescale Semiconductor, Inc.
 *
 * This program is free software; you can redistribute it and/or modify
 * it under the terms of the GNU General Public License version 2 as
 * published by the Free Software Foundation.
 */

/ {
	memory: memory {
		linux,usable-memory = <0x10000000 0x20000000
				       0x80000000 0x20000000>;
	};
};
