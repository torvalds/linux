// SPDX-License-Identifier: (GPL-2.0 OR MIT)
//
// Copyright 2013 Freescale Semiconductor, Inc.


#include "vf500.dtsi"

&a5_cpu {
	next-level-cache = <&L2>;
};

&aips0 {
	L2: l2-cache@40006000 {
		compatible = "arm,pl310-cache";
		reg = <0x40006000 0x1000>;
		cache-unified;
		cache-level = <2>;
		arm,data-latency = <3 3 3>;
		arm,tag-latency = <2 2 2>;
	};
};
