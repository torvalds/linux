// SPDX-License-Identifier: GPL-2.0-only
/*
 * Copyright 2013 Sascha Hauer, Pengutronix
 *
 * Copyright 2013-2021 TQ-Systems GmbH
 * Author: Markus Niebel <Markus.Niebel@tq-group.com>
 */

/dts-v1/;

#include "imx6q-tqma6b.dtsi"
#include "imx6qdl-mba6.dtsi"
#include "imx6qdl-mba6b.dtsi"
#include "imx6q-mba6.dtsi"

/ {
	model = "TQ TQMa6Q on MBa6x";
	compatible = "tq,imx6q-mba6x-b", "tq,mba6b",
		     "tq,imx6q-tqma6q-b", "fsl,imx6q";
};
