// SPDX-License-Identifier: (GPL-2.0+ OR MIT)
/*
 * Copyright (c) 2020 Rockchip Electronics Co., Ltd.
 */

/dts-v1/;
#include "rv1109.dtsi"
#include "rv1126-sonoff-ihost.dtsi"

/ {
	model = "Sonoff iHost 2G";
	compatible = "itead,sonoff-ihost", "rockchip,rv1109";
};

&cpu0 {
	cpu-supply = <&vdd_arm>;
};

&cpu1 {
	cpu-supply = <&vdd_arm>;
};
