/*
 * Copyright (C) 2015 Freescale Semiconductor, Inc.
 *
 * This program is free software; you can redistribute it and/or modify
 * it under the terms of the GNU General Public License version 2 as
 * published by the Free Software Foundation.
 */

#include "imx6ul-14x14-ddr3-arm2.dts"

&usdhc1 {
	pinctrl-names = "default", "state_100mhz", "state_200mhz";
	pinctrl-0 = <&pinctrl_usdhc1_8bit>;
	pinctrl-1 = <&pinctrl_usdhc1_8bit_100mhz>;
	pinctrl-2 = <&pinctrl_usdhc1_8bit_200mhz>;
	bus-width = <8>;
	cd-gpios = <>;
	wp-gpios = <>;
	vmmc-supply = <>;
	tuning-step = <2>;
	non-removable;
	status = "okay";
};
