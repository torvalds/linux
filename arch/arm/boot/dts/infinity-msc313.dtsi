// SPDX-License-Identifier: GPL-2.0-or-later
/*
 * Copyright (c) 2020 thingy.jp.
 * Author: Daniel Palmer <daniel@thingy.jp>
 */

#include "infinity.dtsi"

/ {
	memory@20000000 {
		device_type = "memory";
		reg = <0x20000000 0x4000000>;
	};
};
