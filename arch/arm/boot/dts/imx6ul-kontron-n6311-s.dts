// SPDX-License-Identifier: GPL-2.0
/*
 * Copyright (C) 2017 exceet electronics GmbH
 * Copyright (C) 2018 Kontron Electronics GmbH
 */

/dts-v1/;

#include "imx6ul-kontron-n6311-som.dtsi"
#include "imx6ul-kontron-n6x1x-s.dtsi"

/ {
	model = "Kontron N6311 S";
	compatible = "kontron,imx6ul-n6311-s", "kontron,imx6ul-n6311-som",
		     "fsl,imx6ul";
};
