#include "rk3288.dtsi" 
#include "rk3288-pinctrl.dtsi"
#include "../../mach-rockchip/rk_camera_sensor_info.h"
/{
	rk3288_cif_sensor: rk3288_cif_sensor{
			compatible = "rockchip,sensor";
			status = "disabled";
			
	 gc0329{
		is_front = <0>;
		rockchip,power = <&gpio0 GPIO_C1 GPIO_ACTIVE_HIGH>;
		//rockchip,power_pmu_name1 = "rk818_ldo4";
		//rockchip,power_pmu_voltage1 = <2800000>;
		//rockchip,power_pmu_name2 = "rk818_ldo8";
		//rockchip,power_pmu_voltage2 = <1800000>;
		rockchip,powerdown = <&gpio2 GPIO_B4 GPIO_ACTIVE_HIGH>;
		//rockchip,powerdown_pmu = "";
		//rockchip,powerdown_pmu_voltage = <3000000>;
		pwdn_active = <gc0329_PWRDN_ACTIVE>;
		pwr_active = <PWR_ACTIVE_HIGH>;
		mir = <0>;
		flash_attach = <1>;
		//rockchip,flash = <>;
		flash_active = <1>;
		resolution = <gc0329_FULL_RESOLUTION>;
		powerup_sequence = <gc0329_PWRSEQ>;
		orientation = <0>;		
		i2c_add = <gc0329_I2C_ADDR>;
		i2c_rata = <100000>;
		i2c_chl = <3>;
		cif_chl = <0>;
		mclk_rate = <24>;
		};
/*	 ov8858{
		is_front = <0>;
		rockchip,power = <&gpio0 GPIO_C1 GPIO_ACTIVE_HIGH>;
		//rockchip,power_pmu_name1 = "rk818_ldo4";
		//rockchip,power_pmu_voltage1 = <2800000>;
		//rockchip,power_pmu_name2 = "rk818_ldo8";
		//rockchip,power_pmu_voltage2 = <1800000>;
		rockchip,powerdown = <&gpio2 GPIO_B4 GPIO_ACTIVE_HIGH>;
		//rockchip,powerdown_pmu = "";
		//rockchip,powerdown_pmu_voltage = <3000000>;
		pwdn_active = <ov8858_PWRDN_ACTIVE>;
		pwr_active = <PWR_ACTIVE_HIGH>;
		mir = <0>;
		flash_attach = <1>;
		//rockchip,flash = <>;
		flash_active = <1>;
		resolution = <ov8858_FULL_RESOLUTION>;
		powerup_sequence = <ov8858_PWRSEQ>;
		orientation = <0>;		
		i2c_add = <ov8858_I2C_ADDR>;
		i2c_rata = <100000>;
		i2c_chl = <3>;
		cif_chl = <0>;
		mclk_rate = <24>;
		};
*/
	};
};






