/*
 * sama5d36.dtsi - Device Tree Include file for SAMA5D36 SoC
 *
 *  Copyright (C) 2013 Atmel,
 *                2013 Josh Wu <josh.wu@atmel.com>
 *
 * Licensed under GPLv2 or later.
 */
#include "sama5d3.dtsi"
#include "sama5d3_can.dtsi"
#include "sama5d3_emac.dtsi"
#include "sama5d3_gmac.dtsi"
#include "sama5d3_lcd.dtsi"
#include "sama5d3_mci2.dtsi"
#include "sama5d3_tcb1.dtsi"
#include "sama5d3_uart.dtsi"

/ {
	compatible = "atmel,samad36", "atmel,sama5d3", "atmel,sama5";
};
