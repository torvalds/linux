/*
 * Copyright (c) 2017 Fuzhou Rockchip Electronics Co., Ltd
 *
 * This file is dual-licensed: you can use it either under the terms
 * of the GPL or the X11 license, at your option. Note that this dual
 * licensing only applies to this file, and not this project as a
 * whole.
 *
 *  a) This library is free software; you can redistribute it and/or
 *     modify it under the terms of the GNU General Public License as
 *     published by the Free Software Foundation; either version 2 of the
 *     License, or (at your option) any later version.
 *
 *     This library is distributed in the hope that it will be useful,
 *     but WITHOUT ANY WARRANTY; without even the implied warranty of
 *     MERCHANTABILITY or FITNESS FOR A PARTICULAR PURPOSE.  See the
 *     GNU General Public License for more details.
 *
 * Or, alternatively,
 *
 *  b) Permission is hereby granted, free of charge, to any person
 *     obtaining a copy of this software and associated documentation
 *     files (the "Software"), to deal in the Software without
 *     restriction, including without limitation the rights to use,
 *     copy, modify, merge, publish, distribute, sublicense, and/or
 *     sell copies of the Software, and to permit persons to whom the
 *     Software is furnished to do so, subject to the following
 *     conditions:
 *
 *     The above copyright notice and this permission notice shall be
 *     included in all copies or substantial portions of the Software.
 *
 *     THE SOFTWARE IS PROVIDED "AS IS", WITHOUT WARRANTY OF ANY KIND,
 *     EXPRESS OR IMPLIED, INCLUDING BUT NOT LIMITED TO THE WARRANTIES
 *     OF MERCHANTABILITY, FITNESS FOR A PARTICULAR PURPOSE AND
 *     NONINFRINGEMENT. IN NO EVENT SHALL THE AUTHORS OR COPYRIGHT
 *     HOLDERS BE LIABLE FOR ANY CLAIM, DAMAGES OR OTHER LIABILITY,
 *     WHETHER IN AN ACTION OF CONTRACT, TORT OR OTHERWISE, ARISING
 *     FROM, OUT OF OR IN CONNECTION WITH THE SOFTWARE OR THE USE OR
 *     OTHER DEALINGS IN THE SOFTWARE.
 */
#include <dt-bindings/clock/rockchip-ddr.h>
#include <dt-bindings/memory/rk3128-dram.h>

/ {
	ddr_timing: ddr_timing {
		compatible = "rockchip,ddr-timing";
		ddr3_speed_bin = <DDR3_DEFAULT>;
		pd_idle = <0x40>;
		sr_idle = <0x1>;

		auto_pd_dis_freq = <300>;
		auto_sr_dis_freq = <300>;
		ddr3_dll_dis_freq = <300>;
		lpddr2_dll_dis_freq = <300>;
		phy_dll_dis_freq = <266>;

		ddr3_odt_dis_freq = <333>;
		phy_ddr3_odt_disb_freq = <333>;
		ddr3_drv = <DDR3_DS_40ohm>;
		ddr3_odt = <DDR3_ODT_120ohm>;
		phy_ddr3_clk_drv = <PHY_RON_44ohm>;
		phy_ddr3_cmd_drv = <PHY_RON_44ohm>;
		phy_ddr3_dqs_drv = <PHY_RON_44ohm>;
		phy_ddr3_odt = <PHY_RTT_216ohm>;

		lpddr2_drv = <LP2_DS_34ohm>;
		phy_lpddr2_clk_drv = <PHY_RON_44ohm>;
		phy_lpddr2_cmd_drv = <PHY_RON_44ohm>;
		phy_lpddr2_dqs_drv = <PHY_RON_44ohm>;
		ddr_2t = <0>;
	};
};
