// SPDX-License-Identifier: GPL-2.0-only
/*
 *  linux/arch/arm/boot/nspire-clp.dts
 *
 *  Copyright (C) 2013 Daniel Tang <tangrs@tangrs.id.au>
 */
/dts-v1/;

/include/ "nspire-classic.dtsi"

&keypad {
	linux,keymap = <
	0x0000001c 	0x0001001c 	0x00020039
	0x0004002c 	0x00050034 	0x00060015
	0x0007000b 	0x0008002d 	0x01000033
	0x0101004e 	0x01020011 	0x01030004
	0x0104002f 	0x01050003 	0x01060016
	0x01070002 	0x01080014 	0x02000062
	0x0201000c 	0x0202001f 	0x02030007
	0x02040013 	0x02050006 	0x02060010
	0x02070005 	0x02080019 	0x03000027
	0x03010037 	0x03020018 	0x0303000a
	0x03040031 	0x03050009 	0x03060032
	0x03070008 	0x03080026 	0x04000028
	0x04010035 	0x04020025 	0x04040024
	0x04060017 	0x04080023 	0x05000028
	0x05020022 	0x0503001b 	0x05040021
	0x0505001a 	0x05060012 	0x0507006f
	0x05080020 	0x0509002a 	0x0601001c
	0x0602002e 	0x06030068 	0x06040030
	0x0605006d 	0x0606001e 	0x06070001
	0x0608002b 	0x0609000f 	0x07000067
	0x0702006a 	0x0704006c 	0x07060069
	0x0707000e 	0x0708001d 	0x070a000d
	>;
};

/ {
	model = "TI-NSPIRE Clickpad";
	compatible = "ti,nspire-clp";
};
