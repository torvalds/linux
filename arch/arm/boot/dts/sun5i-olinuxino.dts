/*
 * Copyright 2012 Maxime Ripard
 *
 * Maxime Ripard <maxime.ripard@free-electrons.com>
 *
 * The code contained herein is licensed under the GNU General Public
 * License. You may obtain a copy of the GNU General Public License
 * Version 2 or later at the following locations:
 *
 * http://www.opensource.org/licenses/gpl-license.html
 * http://www.gnu.org/copyleft/gpl.html
 */

/dts-v1/;
/include/ "sun5i.dtsi"

/ {
	model = "Olimex A13-Olinuxino";
	compatible = "olimex,a13-olinuxino", "allwinner,sun5i";

	chosen {
		bootargs = "earlyprintk console=ttyS0,115200";
	};

	soc {
		uart1: uart@01c28400 {
			status = "okay";
		};
	};
};
