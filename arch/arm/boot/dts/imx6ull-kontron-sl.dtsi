// SPDX-License-Identifier: GPL-2.0
/*
 * Copyright (C) 2017 exceet electronics GmbH
 * Copyright (C) 2018 Kontron Electronics GmbH
 */

#include "imx6ull.dtsi"
#include "imx6ul-kontron-sl-common.dtsi"

/ {
	model = "Kontron SL i.MX6ULL (N641X SOM)";
	compatible = "kontron,sl-imx6ull", "fsl,imx6ull";
};
