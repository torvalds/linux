// SPDX-License-Identifier: GPL-2.0-only
/*
 * Device Tree Source for DRA7x SoC DSPEVE thermal
 *
 * Copyright (C) 2016 Texas Instruments Incorporated - https://www.ti.com/
 */

#include <dt-bindings/thermal/thermal.h>

dspeve_thermal: dspeve_thermal {
	polling-delay-passive = <250>; /* milliseconds */
	polling-delay = <500>; /* milliseconds */

			/* sensor       ID */
	thermal-sensors = <&bandgap     3>;

	trips {
		dspeve_crit: dspeve_crit {
			temperature = <125000>; /* milliCelsius */
			hysteresis = <2000>; /* milliCelsius */
			type = "critical";
		};
	};
};
