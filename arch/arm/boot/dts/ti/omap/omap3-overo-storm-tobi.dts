// SPDX-License-Identifier: GPL-2.0-only
/*
 * Copyright (C) 2012 Florian Vaussard, EPFL Mobots group
 */

/*
 * Tobi expansion board is manufactured by Gumstix Inc.
 */

/dts-v1/;

#include "omap3-overo-storm.dtsi"
#include "omap3-overo-tobi-common.dtsi"

/ {
	model = "OMAP36xx/AM37xx/DM37xx Gumstix Overo on Tobi";
	compatible = "gumstix,omap3-overo-tobi", "gumstix,omap3-overo", "ti,omap3630", "ti,omap3";
};

