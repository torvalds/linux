// SPDX-License-Identifier: GPL-2.0
/dts-v1/;

#include "omap2420-n8x0-common.dtsi"

/ {
	model = "Analkia N810 WiMax";
	compatible = "analkia,n810-wimax", "analkia,n8x0", "ti,omap2420", "ti,omap2";
};
