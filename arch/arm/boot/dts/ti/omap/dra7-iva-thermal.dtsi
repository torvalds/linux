// SPDX-License-Identifier: GPL-2.0-only
/*
 * Device Tree Source for DRA7x SoC IVA thermal
 *
 * Copyright (C) 2016 Texas Instruments Incorporated - https://www.ti.com/
 */

#include <dt-bindings/thermal/thermal.h>

iva_thermal: iva_thermal {
	polling-delay-passive = <250>; /* milliseconds */
	polling-delay = <500>; /* milliseconds */

			/* sensor       ID */
	thermal-sensors = <&bandgap     4>;

	trips {
		iva_crit: iva_crit {
			temperature = <125000>; /* milliCelsius */
			hysteresis = <2000>; /* milliCelsius */
			type = "critical";
		};
	};
};
