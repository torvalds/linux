// SPDX-License-Identifier: GPL-2.0-only
/dts-v1/;

#include "motorola-mapphone-common.dtsi"

&keypad {
	keypad,num-rows = <8>;
	keypad,num-columns = <8>;
	linux,keymap = <MATRIX_KEY(5, 0, KEY_VOLUMEUP)>,
		       <MATRIX_KEY(3, 0, KEY_VOLUMEDOWN)>;
};

/*
 * On tablets, mmc1 regulator is vsimcard instead of vwlan2 in the stock kernel
 * dtb. The regulator may not be wired even if a MMC cage is added though.
 */
&mmc1 {
	vmmc-supply = <&vsimcard>;
	bus-width = <4>;
	cd-gpios = <&gpio6 16 GPIO_ACTIVE_LOW>;	/* gpio_176 */
};
