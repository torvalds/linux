// SPDX-License-Identifier: GPL-2.0-only
/dts-v1/;

#include "motorola-mapphone-mz607-mz617.dtsi"

/ {
	model = "Motorola Xyboard MZ617";
	compatible = "motorola,xyboard-mz617", "ti,omap4430", "ti,omap4";

	chosen {
		stdout-path = &uart3;
	};

	aliases {
		display1 = &hdmi0;
	};
};
