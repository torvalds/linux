/*
* Copyright (C) 2015 Freescale Semiconductor, Inc.
*
* This program is free software; you can redistribute it and/or modify
* it under the terms of the GNU General Public License version 2 as
* published by the Free Software Foundation.
*/

#include "imx7d-12x12-lpddr3-arm2.dts"

&fec1 {
	status = "disabled";
};

&flexcan1 {
	status = "okay";
};

&flexcan2 {
	status = "okay";
};

&sai1 {
	status = "disabled";
};
