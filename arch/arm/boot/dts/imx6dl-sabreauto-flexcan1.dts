/*
 * Copyright (C) 2013 Freescale Semiconductor, Inc.
 *
 * This program is free software; you can redistribute it and/or modify
 * it under the terms of the GNU General Public License version 2 as
 * published by the Free Software Foundation.
 */

#include "imx6dl-sabreauto.dts"

&can1{
	status = "okay";
};

&fec {
	/* pin conflict with flexcan1 */
	status = "disabled";
};
