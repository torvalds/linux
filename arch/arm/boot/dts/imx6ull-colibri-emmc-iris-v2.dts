// SPDX-License-Identifier: GPL-2.0-or-later OR MIT
/*
 * Copyright 2022 Toradex
 */

/dts-v1/;

#include "imx6ull-colibri-emmc-nonwifi.dtsi"
#include "imx6ull-colibri-iris-v2.dtsi"

/ {
	model = "Toradex Colibri iMX6ULL 1G (eMMC) on Colibri Iris V2";
	compatible = "toradex,colibri-imx6ull-iris-v2",
		     "toradex,colibri-imx6ull-emmc",
		     "toradex,colibri-imx6ull",
		     "fsl,imx6ull";
};
