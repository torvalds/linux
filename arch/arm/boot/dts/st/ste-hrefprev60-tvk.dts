// SPDX-License-Identifier: GPL-2.0-or-later
/*
 * Copyright 2012 ST-Ericsson AB
 */

/dts-v1/;
#include "ste-db8500.dtsi"
#include "ste-hrefprev60.dtsi"
#include "ste-href-tvk1281618-r2.dtsi"

/ {
	model = "ST-Ericsson HREF (pre-v60) and TVK1281618 R2 UIB";
	compatible = "st-ericsson,mop500", "st-ericsson,u8500";

	/* ST6G3244ME level translator for 1.8/2.9 V */
	vmmci: regulator-gpio {
		compatible = "regulator-gpio";

		regulator-min-microvolt = <1800000>;
		regulator-max-microvolt = <2900000>;
		regulator-name = "mmci-reg";
		regulator-type = "voltage";

		startup-delay-us = <100>;

		states = <1800000 0x1
			  2900000 0x0>;

		gpios = <&tc3589x_gpio 18 GPIO_ACTIVE_HIGH>;
		enable-gpios = <&tc3589x_gpio 17 GPIO_ACTIVE_HIGH>;
		enable-active-high;
	};
};
