// SPDX-License-Identifier: (GPL-2.0+ OR BSD-3-Clause)
/*
 * Copyright (C) 2020 Marek Vasut
 */
/dts-v1/;
/plugin/;

&spi2 {
	pinctrl-names = "default";
	pinctrl-0 = <&spi2_pins_a>;
	status = "okay";
	cs-gpios = <&gpioi 0 0>;
	#address-cells = <1>;
	#size-cells = <0>;

	eeprom@0 {
		compatible = "microchip,25aa010a", "atmel,at25";
		reg = <0>;
		address-width = <8>;
		pagesize = <16>;
		size = <128>;
		spi-max-frequency = <5000000>;
	};
};
