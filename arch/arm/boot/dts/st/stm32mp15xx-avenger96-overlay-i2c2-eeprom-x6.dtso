// SPDX-License-Identifier: (GPL-2.0+ OR BSD-3-Clause)
/*
 * Copyright (C) 2020 Marek Vasut
 */
/dts-v1/;
/plugin/;

&i2c2 {
	#address-cells = <1>;
	#size-cells = <0>;

	eeprom@56 {
		compatible = "atmel,24c04";
		reg = <0x56>;
		pagesize = <16>;
	};
};
