/*
 * Device Tree Source for UniPhier Reference Daughter Board
 *
 * Copyright (C) 2015-2017 Socionext Inc.
 *   Author: Masahiro Yamada <yamada.masahiro@socionext.com>
 *
 * SPDX-License-Identifier: (GPL-2.0+ OR MIT)
 */

&i2c0 {
	eeprom@50 {
		compatible = "microchip,24lc128";
		reg = <0x50>;
		pagesize = <64>;
	};
};
