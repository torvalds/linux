/*
 * Copyright (C) 2017 Texas Instruments Incorporated - http://www.ti.com/
 *
 * This program is free software; you can redistribute it and/or modify
 * it under the terms of the GNU General Public License version 2 as
 * published by the Free Software Foundation.
 */

#include "dra74x.dtsi"

/ {
	compatible = "ti,dra762", "ti,dra7";

	ocp {
		emif1: emif@4c000000 {
			compatible = "ti,emif-dra7xx";
			reg = <0x4c000000 0x200>;
			interrupts = <GIC_SPI 105 IRQ_TYPE_LEVEL_HIGH>;
			status = "disabled";
		};
	};
};

/* MCAN interrupts are hard-wired to irqs 67, 68 */
&crossbar_mpu {
	ti,irqs-skip = <10 67 68 133 139 140>;
};
