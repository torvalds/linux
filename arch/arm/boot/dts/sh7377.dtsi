/*
 * Device Tree Source for the sh7377 SoC
 *
 * Copyright (C) 2012 Renesas Solutions Corp.
 *
 * This file is licensed under the terms of the GNU General Public License
 * version 2.  This program is licensed "as is" without any warranty of any
 * kind, whether express or implied.
 */

/include/ "skeleton.dtsi"

/ {
	compatible = "renesas,sh7377";

	cpus {
		cpu@0 {
			compatible = "arm,cortex-a8";
		};
	};
};
