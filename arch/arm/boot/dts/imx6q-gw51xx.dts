// SPDX-License-Identifier: GPL-2.0-or-later
/*
 * Copyright 2013 Gateworks Corporation
 */

/dts-v1/;
#include "imx6q.dtsi"
#include "imx6qdl-gw51xx.dtsi"

/ {
	model = "Gateworks Ventana i.MX6 Dual/Quad GW51XX";
	compatible = "gw,imx6q-gw51xx", "gw,ventana", "fsl,imx6q";
};
