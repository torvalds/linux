// SPDX-License-Identifier: (GPL-2.0+ OR MIT)
/*
 * Copyright (c) 2022 Rockchip Electronics Co., Ltd.
 */

/dts-v1/;

#include "rv1106.dtsi"
#include "rv1106-evb-v10.dtsi"

/ {
	model = "Rockchip RV1106G EVB1 V10 Board";
	compatible = "rockchip,rv1106g-evb1-v10", "rockchip,rv1106";
};

&emmc {
	status = "disabled";
};

&sfc {
	status = "okay";

	flash@0 {
		compatible = "jedec,spi-nor";
		reg = <0>;
		spi-max-frequency = <80000000>;
		spi-rx-bus-width = <4>;
		spi-tx-bus-width = <1>;
	};
};
