/*
 * sama5d31.dtsi - Device Tree Include file for SAMA5D31 SoC
 *
 *  Copyright (C) 2013 Boris BREZILLON <b.brezillon@overkiz.com>
 *
 * Licensed under GPLv2 or later.
 */
#include "sama5d3.dtsi"
#include "sama5d3_lcd.dtsi"
#include "sama5d3_emac.dtsi"
#include "sama5d3_mci2.dtsi"
#include "sama5d3_uart.dtsi"

/ {
	compatible = "atmel,samad31", "atmel,sama5d3", "atmel,sama5";
};
