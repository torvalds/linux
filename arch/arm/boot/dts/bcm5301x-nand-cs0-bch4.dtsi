// SPDX-License-Identifier: GPL-2.0-or-later OR MIT
/*
 * Copyright 2016 Luxul Inc.
 */

#include "bcm5301x-nand-cs0.dtsi"

&nandcs {
	nand-ecc-algo = "bch";
	nand-ecc-strength = <4>;
	nand-ecc-step-size = <512>;
};
