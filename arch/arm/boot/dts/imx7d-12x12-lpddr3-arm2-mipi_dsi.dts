/*
 * Copyright (C) 2015 Freescale Semiconductor, Inc.
 *
 * This program is free software; you can redistribute it and/or modify
 * it under the terms of the GNU General Public License version 2 as
 * published by the Free Software Foundation.
 */

#include "imx7d-12x12-lpddr3-arm2.dts"

/ {
	mipi_dsi_reset: mipi-dsi-reset {
		compatible = "gpio-reset";
		reset-gpios = <&gpio4 17 GPIO_ACTIVE_LOW>;
		reset-delay-us = <50>;
		#reset-cells = <0>;
	};
};

&lcdif {
	disp-dev = "mipi_dsi_samsung";
};

&mipi_dsi {
	lcd_panel = "TRULY-WVGA";
	disp-power-on-supply = <&reg_mipi_dsi_pwr_on>;
	resets = <&mipi_dsi_reset>;
	status = "okay";
};
