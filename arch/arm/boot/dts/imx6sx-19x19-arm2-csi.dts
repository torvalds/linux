/*
 * Copyright (C) 2014 Freescale Semiconductor, Inc.
 *
 * This program is free software; you can redistribute it and/or modify
 * it under the terms of the GNU General Public License version 2 as
 * published by the Free Software Foundation.
 */

#include "imx6sx-19x19-arm2.dts"

&esai {
	/* pin conflict with sai */
	status = "disabled";
};

&sai1 {
	status = "disabled";
};

&i2c2 {
	ov5640: ov5640@3c {
		status = "okay";
	};
};

