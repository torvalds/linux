// SPDX-License-Identifier: ISC
/*
 * Device Tree file for Intel XScale Network Processors
 * in the IXP 43x series. This series has 64 interrupts and adds a few more
 * peripherals over the 42x series.
 */
#include "intel-ixp4xx.dtsi"

/ {
	soc {
		pci@c0000000 {
			compatible = "intel,ixp43x-pci";
		};

		interrupt-controller@c8003000 {
			compatible = "intel,ixp43x-interrupt";
		};
	};
};
