// SPDX-License-Identifier: GPL-2.0-or-later
// Copyright 2019 IBM Corp.

/dts-v1/;

#include "aspeed-ast2600-evb-tee.dts"

/ {
	model = "AST2600 PCIe EHCI to USB vHub EVB";
};

&vhub {
	status = "okay";
	pinctrl-names = "default";
	pinctrl-0 = <&pinctrl_usb2adp_default>;
};
