

&rk616 {
	compatible = "rockchip,rk616";
		
	#address-cells = <1>;
	#size-cells = <1>;

	rk616,scl_rate = <100000>;
	rk616,lcd0_func = <INPUT>;
	rk616,lcd1_func = <UNUSED>;
	rk616,lvds_ch_nr = <1>;

};
