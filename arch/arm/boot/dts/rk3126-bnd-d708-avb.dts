// SPDX-License-Identifier: (GPL-2.0+ OR MIT)
/*
 * Copyright (c) 2017 Fuzhou Rockchip Electronics Co., Ltd
 */

/dts-v1/;
#include "rk3126-bnd-d708.dtsi"

/ {
	model = "Rockchip RK3126 bnd-d708 board";
	compatible = "rockchip,rk3126";
};

