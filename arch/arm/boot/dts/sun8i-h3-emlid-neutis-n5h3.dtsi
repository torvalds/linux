// SPDX-License-Identifier: GPL-2.0-or-later OR MIT
/*
 * DTSI for Emlid Neutis N5 SoM.
 *
 * Copyright (C) 2019 Georgii Staroselskii <georgii.staroselskii@emlid.com>
 */

/dts-v1/;

#include "sun8i-h3.dtsi"
#include <arm/sunxi-h3-h5-emlid-neutis.dtsi>
