/*
 * Copyright (C) 2015 Freescale Semiconductor, Inc.
 *
 * This program is free software; you can redistribute it and/or modify
 * it under the terms of the GNU General Public License version 2 as
 * published by the Free Software Foundation.
 */
#include "imx7d-sdb-reva.dts"

&sii902x {
	status = "disabled";
};

&ecspi3 {
	status = "okay";

	tsc2046 {
		interrupts = <13 0>;
		pendown-gpio = <&gpio2 13 0>;
	};
};
