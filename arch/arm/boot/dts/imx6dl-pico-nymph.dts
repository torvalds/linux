// SPDX-License-Identifier: GPL-2.0 OR MIT
//
// Copyright 2018 Technexion Ltd.
//
// Author: Wig Cheng <wig.cheng@technexion.com>
//	   Richard Hu <richard.hu@technexion.com>
//	   Tapani Utriainen <tapani@technexion.com>

/dts-v1/;

#include "imx6dl.dtsi"
#include "imx6qdl-pico-pi.dtsi"

/ {
	model = "TechNexion PICO-IMX6 DualLite/Solo Board and Nymph baseboard";
	compatible = "technexion,imx6dl-pico-nymph", "fsl,imx6dl";
};
