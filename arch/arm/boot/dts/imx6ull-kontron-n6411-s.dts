// SPDX-License-Identifier: GPL-2.0
/*
 * Copyright (C) 2017 exceet electronics GmbH
 * Copyright (C) 2019 Kontron Electronics GmbH
 */

/dts-v1/;

#include "imx6ull-kontron-n6411-som.dtsi"
#include "imx6ul-kontron-n6x1x-s.dtsi"

/ {
	model = "Kontron N6411 S";
	compatible = "kontron,imx6ull-n6411-s", "kontron,imx6ull-n6411-som",
		     "fsl,imx6ull";
};
