// SPDX-License-Identifier: GPL-2.0-or-later
/*
 * Copyright 2012 ST-Ericsson AB
 */

/dts-v1/;
#include "ste-db8500.dtsi"
#include "ste-hrefprev60.dtsi"
#include "ste-href-tvk1281618-r2.dtsi"

/ {
	model = "ST-Ericsson HREF (pre-v60) and TVK1281618 UIB";
	compatible = "st-ericsson,mop500", "st-ericsson,u8500";
};
