// SPDX-License-Identifier: GPL-2.0-or-later OR MIT
/*
 * Copyright (c) 2014 Protonic Holland
 */

/dts-v1/;
#include "imx6qp.dtsi"
#include "imx6qdl-vicut1.dtsi"

/ {
	model = "Kverneland UT1P Board";
	compatible = "kvg,vicutp", "fsl,imx6qp";
};
