/*
 * Copyright 2015 Freescale Semiconductor, Inc.
 *
 * The code contained herein is licensed under the GNU General Public
 * License. You may obtain a copy of the GNU General Public License
 * Version 2 or later at the following locations:
 *
 * http://www.opensource.org/licenses/gpl-license.html
 * http://www.gnu.org/copyleft/gpl.html
 */

#include "imx6qp-sabresd.dts"

&hdmi_video {
	pinctrl-names = "default";
	pinctrl-0 = <&pinctrl_hdmi_hdcp>;
	fsl,hdcp;
};

&i2c2 {
	status = "disable";
};
