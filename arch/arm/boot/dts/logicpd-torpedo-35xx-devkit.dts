// SPDX-License-Identifier: GPL-2.0-only

/dts-v1/;

#include "omap34xx.dtsi"
#include "logicpd-torpedo-som.dtsi"
#include "logicpd-torpedo-baseboard.dtsi"
#include "omap-gpmc-smsc9221.dtsi"

/ {
	model = "LogicPD Zoom OMAP35xx Torpedo Development Kit";
	compatible = "logicpd,dm3730-torpedo-devkit", "ti,omap3";
};
