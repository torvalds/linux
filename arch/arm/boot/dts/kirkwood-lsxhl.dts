// SPDX-License-Identifier: GPL-2.0
/dts-v1/;

#include "kirkwood-lsxl.dtsi"

/ {
	model = "Buffalo Linkstation LS-XHL";
	compatible = "buffalo,lsxhl", "buffalo,lsxl", "marvell,kirkwood-88f6281", "marvell,kirkwood";

	memory {
		device_type = "memory";
		reg = <0x00000000 0x10000000>;
	};

	ocp@f1000000 {
		serial@12000 {
			status = "okay";
		};
	};
};
