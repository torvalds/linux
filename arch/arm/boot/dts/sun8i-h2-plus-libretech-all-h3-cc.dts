// SPDX-License-Identifier: (GPL-2.0+ OR MIT)
/*
 * Copyright (C) 2018 Chen-Yu Tsai <wens@csie.org>
 */

/dts-v1/;
#include "sun8i-h3.dtsi"
#include "sunxi-libretech-all-h3-cc.dtsi"

/ {
	model = "Libre Computer Board ALL-H3-CC H2+";
	compatible = "libretech,all-h3-cc-h2-plus", "allwinner,sun8i-h2-plus";
};
