/*
 * Copyright 2013 Christian Hemp, Phytec Messtechnik GmbH
 *
 * The code contained herein is licensed under the GNU General Public
 * License. You may obtain a copy of the GNU General Public License
 * Version 2 or later at the following locations:
 *
 * http://www.opensource.org/licenses/gpl-license.html
 * http://www.gnu.org/copyleft/gpl.html
 */

#include "imx6dl.dtsi"
#include "imx6qdl-phytec-pfla02.dtsi"

/ {
	model = "Phytec phyFLEX-i.MX6 DualLite/Solo";
	compatible = "phytec,imx6dl-pfla02", "fsl,imx6dl";

	memory {
		reg = <0x10000000 0x20000000>;
	};
};
