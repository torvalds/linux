// SPDX-License-Identifier: GPL-2.0-or-later
/*
 * Copyright (c) 2020 thingy.jp.
 * Author: Daniel Palmer <daniel@thingy.jp>
 */

/dts-v1/;
#include "mstar-infinity2m-ssd202d.dtsi"

/ {
	model = "SSD201_HT_V2";
	compatible = "honestar,ssd201htv2", "mstar,infinity2m";

	aliases {
		serial0 = &pm_uart;
	};

	chosen {
		stdout-path = "serial0:115200n8";
	};
};

&pm_uart {
	status = "okay";
};
