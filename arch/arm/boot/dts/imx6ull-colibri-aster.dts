// SPDX-License-Identifier: GPL-2.0-or-later OR MIT
/*
 * Copyright 2017-2022 Toradex
 */

/dts-v1/;

#include "imx6ull-colibri-nonwifi.dtsi"
#include "imx6ull-colibri-aster.dtsi"

/ {
	model = "Toradex Colibri iMX6ULL 256/512MB on Colibri Aster";
	compatible = "toradex,colibri-imx6ull-aster",
		     "toradex,colibri-imx6ull",
		     "fsl,imx6ull";
};

&atmel_mxt_ts {
	status = "okay";
};
