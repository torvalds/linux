/*
 * Copyright (C) 2014 Freescale Semiconductor, Inc.
 *
 * This program is free software; you can redistribute it and/or modify
 * it under the terms of the GNU General Public License version 2 as
 * published by the Free Software Foundation.
 */

#include "imx6dl-sabresd.dts"

&fec {
	pinctrl-0 = <&pinctrl_enet &pinctrl_enet_irq>;
	interrupts-extended = <&gpio1 6 0x04>, <&intc 0 119 0x04>;
};

&i2c3 {
	status = "disabled";
};
