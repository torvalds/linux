// SPDX-License-Identifier: GPL-2.0
/*
 * This include file covers the common peripherals and configuration between
 * bcm2835, bcm2836 and bcm2837 implementations that interact with RPi's
 * firmware interface.
 */

#include <dt-bindings/power/raspberrypi-power.h>

&v3d {
	power-domains = <&power RPI_POWER_DOMAIN_V3D>;
};
