/*
 * Copyright (C) 2015 Freescale Semiconductor, Inc.
 *
 * This program is free software; you can redistribute it and/or modify
 * it under the terms of the GNU General Public License version 2 as
 * published by the Free Software Foundation.
 */

#include "imx7d-12x12-lpddr3-arm2.dts"

&epdc {
        status = "disabled";
};

&ecspi1{
        status = "okay";
};

/*
 * pin conflict with ecspi1
 * default hog setting conflicts with ECSPI1 MOSI and MISO
 * EPDC PWRCTRL conflicts with ECSPI1 CS pin
 */
&iomuxc {
	pinctrl-0 = <&pinctrl_hog_1>;
};
