/*
 * Copyright (C) 2017 Chen-Yu Tsai <wens@csie.org>
 *
 * SPDX-License-Identifier: (GPL-2.0+ OR MIT)
 */

/dts-v1/;
#include "sun8i-h3.dtsi"
#include "sunxi-libretech-all-h3-cc.dtsi"

/ {
	model = "Libre Computer Board ALL-H3-CC H3";
	compatible = "libretech,all-h3-cc-h3", "allwinner,sun8i-h3";
};
