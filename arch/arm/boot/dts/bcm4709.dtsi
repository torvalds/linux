// SPDX-License-Identifier: GPL-2.0-or-later OR MIT
/*
 * Copyright (C) 2016 Rafał Miłecki <rafal@milecki.pl>
 */

#include "bcm4708.dtsi"

&uart0 {
	clock-frequency = <125000000>;
	status = "okay";
};
