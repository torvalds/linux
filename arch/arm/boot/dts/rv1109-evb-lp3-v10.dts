// SPDX-License-Identifier: (GPL-2.0+ OR MIT)
/*
 * Copyright (c) 2019 Fuzhou Rockchip Electronics Co., Ltd.
 */

/dts-v1/;

#include "rv1109.dtsi"
#include "rv11xx-evb-v10.dtsi"

/ {
	model = "Rockchip RV1109 EVB LPDDR3 Board";
	compatible = "rockchip,rv1109-evb-lp3-v10", "rockchip,rv1109";

	chosen {
		bootargs = "earlycon=uart8250,mmio32,0xff570000 console=ttyFIQ0 root=PARTUUID=614e0000-0000 rootfstype=ext4 rootwait snd_aloop.index=7";
	};
};
