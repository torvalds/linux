// SPDX-License-Identifier: (GPL-2.0 or MIT)
//
// Copyright (C) 2018 emtrion GmbH
//

/dts-v1/;
#include "imx6dl.dtsi"
#include "imx6qdl-emcon.dtsi"
#include "imx6qdl-emcon-avari.dtsi"

/ {
	model = "emtrion SoM emCON-MX6 Solo/Dual-Lite Avari";
	compatible = "emtrion,emcon-mx6-avari", "fsl,imx6dl";
};
