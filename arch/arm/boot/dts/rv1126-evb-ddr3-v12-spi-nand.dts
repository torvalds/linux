// SPDX-License-Identifier: (GPL-2.0+ OR MIT)
/*
 * Copyright (c) 2020 Rockchip Electronics Co., Ltd.
 */

/dts-v1/;
#include "rv1126-evb-ddr3-v12.dts"

/ {
	model = "Rockchip RV1126 EVB DDR3 Board";
	compatible = "rockchip,rv1126-evb-ddr3-v12-spi-nand", "rockchip,rv1126";

	chosen {
		bootargs = "earlycon=uart8250,mmio32,0xff570000 console=ttyFIQ0 ubi.mtd=2 root=ubi0:rootfs rootfstype=ubifs snd_aloop.index=7";
	};
};

