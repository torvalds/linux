// SPDX-License-Identifier: (GPL-2.0 OR MIT)
/*
 * Copyright 2018 Toradex AG
 */

/dts-v1/;

#include "imx6ull-colibri-wifi.dtsi"
#include "imx6ull-colibri-eval-v3.dtsi"

/ {
	model = "Toradex Colibri iMX6ULL 512MB on Colibri Evaluation Board V3";
	compatible = "toradex,colibri-imx6ull-wifi-eval", "fsl,imx6ull";
};
