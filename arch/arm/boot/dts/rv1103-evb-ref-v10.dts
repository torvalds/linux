// SPDX-License-Identifier: (GPL-2.0+ OR MIT)
/*
 * Copyright (c) 2022 Rockchip Electronics Co., Ltd.
 */

/dts-v1/;

#include "rv1103.dtsi"
#include "rv1103-evb-v10.dtsi"

/ {
	model = "Rockchip RV1103 EVB REF V10 Board";
	compatible = "rockchip,rv1103-evb-ref-v10", "rockchip,rv1103";

	chosen {
		bootargs = "earlycon=uart8250,mmio32,0xff4c0000 console=ttyFIQ0 root=PARTUUID=614e0000-0000 rootfstype=ext4 rootwait snd_soc_core.prealloc_buffer_size_kbytes=16";
	};
};
