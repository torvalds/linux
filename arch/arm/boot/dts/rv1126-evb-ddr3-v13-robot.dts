// SPDX-License-Identifier: (GPL-2.0+ OR MIT)
/*
 * Copyright (c) 2020 Rockchip Electronics Co., Ltd.
 */
/dts-v1/;
#include "rv1126.dtsi"
#include "rv1126-evb-v13.dtsi"
#include "rv1126-evb-v10-robot.dtsi"

/ {
	model = "Rockchip RV1126 EVB DDR3 V13 Board For Robot";
	compatible = "rockchip,rv1126-evb-ddr3-v13-robot", "rockchip,rv1126";

	chosen {
		bootargs = "console=ttyFIQ0 root=PARTUUID=614e0000-0000 rootwait snd_aloop.index=7";
	};
};
