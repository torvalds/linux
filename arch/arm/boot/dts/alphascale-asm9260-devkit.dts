/*
 * Copyright 2014 Oleksij Rempel <linux@rempel-privat.de>
 *
 * Licensed under the X11 license or the GPL v2 (or later)
 */

/dts-v1/;
#include "alphascale-asm9260.dtsi"

/ {
	model = "Alphascale asm9260 Development Kit";
	compatible = "alphascale,asm9260devkit", "alphascale,asm9260";
};
