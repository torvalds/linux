// SPDX-License-Identifier: GPL-2.0
/*
 * Copyright 2019 Gateworks Corporation
 */

/dts-v1/;

#include "imx6dl.dtsi"
#include "imx6qdl-gw5910.dtsi"

/ {
	model = "Gateworks Ventana i.MX6 DualLite/Solo GW5910";
	compatible = "gw,imx6dl-gw5910", "gw,ventana", "fsl,imx6dl";
};
