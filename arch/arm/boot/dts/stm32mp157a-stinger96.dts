// SPDX-License-Identifier: (GPL-2.0+ OR MIT)
/*
 * Copyright (C) 2020 Manivannan Sadhasivam
 */

/dts-v1/;
#include "stm32mp157a-stinger96.dtsi"

/ {
	model = "Shiratech STM32MP157A Stinger96 board";
	compatible = "shiratech,stm32mp157a-stinger96", "st,stm32mp157";
};
