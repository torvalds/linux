// SPDX-License-Identifier: (GPL-2.0+ OR MIT)

/ {
	/delete-node/ cif_isp0;
	/delete-node/ isp;

	isp: isp@ff910000 {
		compatible = "rockchip,rk3288-rkisp1";
		reg = <0x0 0xff910000 0x0 0x4000>;
		interrupts = <GIC_SPI 14 IRQ_TYPE_LEVEL_HIGH>;
		clocks = <&cru SCLK_ISP>, <&cru ACLK_ISP>,
			 <&cru HCLK_ISP>, <&cru PCLK_ISP_IN>,
			 <&cru SCLK_ISP_JPE>;
		clock-names = "clk_isp", "aclk_isp",
			      "hclk_isp", "pclk_isp_in",
			      "sclk_isp_jpe";
		assigned-clocks = <&cru SCLK_ISP>, <&cru SCLK_ISP_JPE>;
		assigned-clock-rates = <400000000>, <400000000>;
		power-domains = <&power RK3288_PD_VIO>;
		iommus = <&isp_mmu>;
		status = "disabled";
	};
};
