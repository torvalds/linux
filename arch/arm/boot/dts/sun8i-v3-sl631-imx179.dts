// SPDX-License-Identifier: (GPL-2.0+ OR X11)
/*
 * Copyright 2020 Paul Kocialkowski <contact@paulk.fr>
 */

#include "sun8i-v3-sl631.dtsi"

/ {
	model = "SL631 Action Camera with IMX179";
	compatible = "allwinner,sl631-imx179", "allwinner,sl631",
		     "allwinner,sun8i-v3";
};
