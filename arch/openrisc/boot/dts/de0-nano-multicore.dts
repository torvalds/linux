// SPDX-License-Identifier: GPL-2.0

#include <dt-bindings/gpio/gpio.h>
#include <dt-bindings/leds/common.h>

/dts-v1/;

#include "simple-smp.dtsi"
#include "de0-nano-common.dtsi"

/ {
	model = "Terasic DE0 Nano - Multicore";
};

&cpu0 {
	clock-frequency = <50000000>;
};

&cpu1 {
	clock-frequency = <50000000>;
};

&serial0 {
	clock-frequency = <50000000>;
};
