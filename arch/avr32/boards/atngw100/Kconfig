## arch/avr32/boards/atngw100/Kconfig
```kconfig
# NGW100 customization

if BOARD_ATNGW100

choice
	prompt "Select an NGW100 add-on board to support"
	default BOARD_ATNGW100_ADDON_NONE

config BOARD_ATNGW100_ADDON_NONE
	bool "None"

config BOARD_ATNGW100_EVKLCD10X
	bool "EVKLCD10X addon board"
	help
	  This enables support for the EVKLCD100 (QVGA) or EVKLCD101 (VGA)
	  addon board for the NGW100. By enabling this the LCD controller and
	  AC97 controller is added as platform devices.

	  This choice disables the detect pin and the write-protect pin for the
	  MCI platform device, since it conflicts with the LCD platform device.
	  The MCI pins can be reenabled by editing the "add device function" but
	  this may break the setup for other displays that use these pins.

config BOARD_ATNGW100_MRMT
	bool "Mediama RMT1/2 add-on board"
	help
	  This enables support for the Mediama RMT1 or RMT2 board.
	  RMT provides LCD support, AC97 codec and other
	  optional peripherals to the Atmel NGW100.

	  This choice disables the detect pin and the write-protect pin for the
	  MCI platform device, since it conflicts with the LCD platform device.
	  The MCI pins can be reenabled by editing the "add device function" but
	  this may break the setup for other displays that use these pins.

endchoice

choice
	prompt "LCD panel resolution on EVKLCD10X"
	depends on BOARD_ATNGW100_EVKLCD10X
	default BOARD_ATNGW100_EVKLCD10X_VGA

config BOARD_ATNGW100_EVKLCD10X_QVGA
	bool "QVGA (320x240)"

config BOARD_ATNGW100_EVKLCD10X_VGA
	bool "VGA (640x480)"

config BOARD_ATNGW100_EVKLCD10X_POW_QVGA
	bool "Powertip QVGA (320x240)"

endchoice

if BOARD_ATNGW100_MRMT
source	"arch/avr32/boards/atngw100/Kconfig_mrmt"
endif

endif	# BOARD_ATNGW100
```

## arch/avr32/boards/atstk1000/Kconfig
```kconfig
# STK1000 customization

if BOARD_ATSTK1000

choice
	prompt "ATSTK1000 CPU daughterboard type"
	default BOARD_ATSTK1002

config BOARD_ATSTK1002
	bool "ATSTK1002"
	select CPU_AT32AP7000

config BOARD_ATSTK1003
	bool "ATSTK1003"
	select CPU_AT32AP7001

config BOARD_ATSTK1004
	bool "ATSTK1004"
	select CPU_AT32AP7002

config BOARD_ATSTK1006
	bool "ATSTK1006"
	select CPU_AT32AP7000

endchoice


config BOARD_ATSTK100X_CUSTOM
	bool "Non-default STK1002/STK1003/STK1004 jumper settings"
	help
	  You will normally leave the jumpers on the CPU card at their
	  default settings.  If you need to use certain peripherals,
	  you will need to change some of those jumpers.

if BOARD_ATSTK100X_CUSTOM

config BOARD_ATSTK100X_SW1_CUSTOM
	bool "SW1: use SSC1 (not SPI0)"
	help
	  This also prevents using the external DAC as an audio interface,
	  and means you can't initialize the on-board QVGA display.

config BOARD_ATSTK100X_SW2_CUSTOM
	bool "SW2: use IRDA or TIMER0 (not UART-A, MMC/SD, and PS2-A)"
	help
	  If you change this you'll want an updated boot loader putting
	  the console on UART-C not UART-A.

config BOARD_ATSTK100X_SW3_CUSTOM
	bool "SW3: use TIMER1 (not SSC0 and GCLK)"
	help
	  This also prevents using the external DAC as an audio interface.

config BOARD_ATSTK100X_SW4_CUSTOM
	bool "SW4: use ISI/Camera (not GPIOs, SPI1, and PS2-B)"
	help
	  To use the camera interface you'll need a custom card (on the
	  PCI-format connector) connect a video sensor.

config BOARD_ATSTK1002_SW5_CUSTOM
	bool "SW5: use MACB1 (not LCDC)"
	depends on BOARD_ATSTK1002

config BOARD_ATSTK1002_SW6_CUSTOM
	bool "SW6: more GPIOs (not MACB0)"
	depends on BOARD_ATSTK1002

endif	# custom

config BOARD_ATSTK100X_SPI1
	bool "Configure SPI1 controller"
	depends on !BOARD_ATSTK100X_SW4_CUSTOM
	help
	  All the signals for the second SPI controller are available on
	  GPIO lines and accessed through the J1 jumper block.  Say "y"
	  here to configure that SPI controller.

config BOARD_ATSTK1000_J2_LED
	bool
	default BOARD_ATSTK1000_J2_LED8 || BOARD_ATSTK1000_J2_RGB

choice
	prompt "LEDs connected to J2:"
	depends on LEDS_GPIO && !BOARD_ATSTK100X_SW4_CUSTOM
	optional
	help
	  Select this if you have jumpered the J2 jumper block to the
	  LED0..LED7 amber leds, or to the RGB leds, using a ten-pin
	  IDC cable.  A default "heartbeat" trigger is provided, but
	  you can of course override this.

config BOARD_ATSTK1000_J2_LED8
	bool "LED0..LED7"
	help
	  Select this if J2 is jumpered to LED0..LED7 amber leds.

config BOARD_ATSTK1000_J2_RGB
	bool "RGB leds"
	help
	  Select this if J2 is jumpered to the RGB leds.

endchoice

config BOARD_ATSTK1000_EXTDAC
	bool
	depends on !BOARD_ATSTK100X_SW1_CUSTOM && !BOARD_ATSTK100X_SW3_CUSTOM
	default y

endif	# stk 1000
```

## arch/avr32/boards/favr-32/Kconfig
```kconfig
# Favr-32 customization

if BOARD_FAVR_32

config BOARD_FAVR32_ABDAC_RATE
	int "DAC target rate"
	default 44100
	range 32000 50000
	help
	  Specify the target rate the internal DAC should try to match. This
	  will use PLL1 to generate a frequency as close as possible to this
	  rate.

	  Must be within the range 32000 to 50000, which should be suitable to
	  generate most other frequencies in power of 2 steps.

	  Ex:
		48000 will also suit 24000 and 12000
		44100 will also suit 22050 and 11025
		32000 will also suit 16000 and 8000

endif # BOARD_FAVR_32
```

## arch/avr32/boards/hammerhead/Kconfig
```kconfig
# Hammerhead customization

if BOARD_HAMMERHEAD

config BOARD_HAMMERHEAD_USB
	bool "Philips ISP116x-hcd USB support"
	help
	  This enables USB support for Hammerheads internal ISP116x
	  controller from Philips.

	  Choose 'Y' here if you want to have your board USB driven.

config BOARD_HAMMERHEAD_LCD
	bool "Atmel AT91/AT32 LCD support"
	help
	  This enables LCD support for the Hammerhead board. You may
	  also add support for framebuffer devices (AT91/AT32 LCD Controller)
	  and framebuffer console support to get the most out of your LCD.

	  Choose 'Y' here if you have ordered a Corona daugther board and
	  want to have support for your Hantronix HDA-351T-LV LCD.

config BOARD_HAMMERHEAD_SND
	bool "Atmel AC97 Sound support"
	help
	  This enables Sound support for the Hammerhead board. You may
	  also go trough the ALSA settings to get it working.

	  Choose 'Y' here if you have ordered a Corona daugther board and
	  want to make your board funky.

config BOARD_HAMMERHEAD_FPGA
	bool "Hammerhead FPGA Support"
	default y
	help
	  This adds support for the Cyclone III FPGA from Altera
	  found on Miromico's Hammerhead board.

	  Choose 'Y' here if you want to have FPGA support enabled.
	  You will have to choose the "Hammerhead FPGA Device Support" in
	  Device Drivers->Misc to be able to use FPGA functionality.

endif	# BOARD_ATNGW100
```

## arch/avr32/configs/atngw100_mrmt_defconfig
```kconfig
CONFIG_EXPERIMENTAL=y
# CONFIG_LOCALVERSION_AUTO is not set
CONFIG_SYSVIPC=y
CONFIG_POSIX_MQUEUE=y
CONFIG_BSD_PROCESS_ACCT=y
CONFIG_BSD_PROCESS_ACCT_V3=y
CONFIG_LOG_BUF_SHIFT=14
CONFIG_SYSFS_DEPRECATED_V2=y
CONFIG_BLK_DEV_INITRD=y
CONFIG_CC_OPTIMIZE_FOR_SIZE=y
# CONFIG_SYSCTL_SYSCALL is not set
# CONFIG_BASE_FULL is not set
# CONFIG_SLUB_DEBUG is not set
CONFIG_MODULES=y
CONFIG_MODULE_UNLOAD=y
CONFIG_MODULE_FORCE_UNLOAD=y
# CONFIG_BLK_DEV_BSG is not set
# CONFIG_IOSCHED_DEADLINE is not set
# CONFIG_OWNERSHIP_TRACE is not set
CONFIG_PM=y
# CONFIG_SUSPEND is not set
CONFIG_CPU_FREQ=y
CONFIG_CPU_FREQ_GOV_POWERSAVE=y
CONFIG_CPU_FREQ_GOV_USERSPACE=y
CONFIG_CPU_FREQ_GOV_ONDEMAND=y
CONFIG_CPU_FREQ_AT32AP=y
CONFIG_NET=y
CONFIG_PACKET=y
CONFIG_UNIX=y
CONFIG_INET=y
CONFIG_IP_PNP=y
CONFIG_IP_PNP_DHCP=y
CONFIG_SYN_COOKIES=y
# CONFIG_INET_XFRM_MODE_TRANSPORT is not set
# CONFIG_INET_XFRM_MODE_TUNNEL is not set
# CONFIG_INET_XFRM_MODE_BEET is not set
# CONFIG_INET_LRO is not set
# CONFIG_IPV6 is not set
CONFIG_BT=m
CONFIG_BT_L2CAP=m
CONFIG_BT_RFCOMM=m
CONFIG_BT_RFCOMM_TTY=y
CONFIG_BT_HIDP=m
CONFIG_BT_HCIUART=m
CONFIG_BT_HCIUART_H4=y
CONFIG_BT_HCIUART_BCSP=y
CONFIG_UEVENT_HELPER_PATH="/sbin/hotplug"
# CONFIG_PREVENT_FIRMWARE_BUILD is not set
# CONFIG_FW_LOADER is not set
CONFIG_MTD=y
CONFIG_MTD_PARTITIONS=y
CONFIG_MTD_CMDLINE_PARTS=y
CONFIG_MTD_CHAR=y
CONFIG_MTD_BLOCK=y
CONFIG_MTD_CFI=y
CONFIG_MTD_CFI_AMDSTD=y
CONFIG_MTD_PHYSMAP=y
CONFIG_MTD_DATAFLASH=y
CONFIG_BLK_DEV_LOOP=y
CONFIG_ATMEL_PWM=y
CONFIG_NETDEVICES=y
CONFIG_NET_ETHERNET=y
CONFIG_MACB=y
# CONFIG_NETDEV_1000 is not set
# CONFIG_NETDEV_10000 is not set
# CONFIG_INPUT_MOUSEDEV is not set
CONFIG_INPUT_EVDEV=y
# CONFIG_KEYBOARD_ATKBD is not set
CONFIG_KEYBOARD_GPIO=y
# CONFIG_INPUT_MOUSE is not set
CONFIG_INPUT_TOUCHSCREEN=y
CONFIG_TOUCHSCREEN_ADS7846=m
# CONFIG_SERIO is not set
CONFIG_VT_HW_CONSOLE_BINDING=y
CONFIG_SERIAL_ATMEL=y
CONFIG_SERIAL_ATMEL_CONSOLE=y
# CONFIG_LEGACY_PTYS is not set
# CONFIG_HW_RANDOM is not set
CONFIG_I2C=y
CONFIG_I2C_CHARDEV=y
CONFIG_I2C_GPIO=y
CONFIG_SPI=y
CONFIG_SPI_ATMEL=y
CONFIG_SPI_SPIDEV=y
CONFIG_WATCHDOG=y
CONFIG_AT32AP700X_WDT=y
CONFIG_FB=y
CONFIG_FB_ATMEL=y
CONFIG_BACKLIGHT_LCD_SUPPORT=y
CONFIG_LCD_CLASS_DEVICE=y
CONFIG_BACKLIGHT_CLASS_DEVICE=y
CONFIG_SOUND=m
CONFIG_SND=m
CONFIG_SND_MIXER_OSS=m
CONFIG_SND_PCM_OSS=m
# CONFIG_SND_SUPPORT_OLD_API is not set
# CONFIG_SND_VERBOSE_PROCFS is not set
CONFIG_SND_ATMEL_AC97C=m
# CONFIG_SND_SPI is not set
CONFIG_USB_GADGET=m
CONFIG_USB_GADGET_DEBUG_FILES=y
CONFIG_USB_FILE_STORAGE=m
CONFIG_USB_G_SERIAL=m
CONFIG_MMC=y
CONFIG_MMC_ATMELMCI=y
CONFIG_NEW_LEDS=y
CONFIG_LEDS_CLASS=y
CONFIG_LEDS_ATMEL_PWM=y
CONFIG_LEDS_GPIO=y
CONFIG_LEDS_TRIGGERS=y
CONFIG_LEDS_TRIGGER_TIMER=y
CONFIG_LEDS_TRIGGER_HEARTBEAT=y
CONFIG_RTC_CLASS=y
CONFIG_RTC_DRV_S35390A=m
CONFIG_RTC_DRV_AT32AP700X=m
CONFIG_DMADEVICES=y
CONFIG_UIO=y
CONFIG_EXT2_FS=y
CONFIG_EXT2_FS_XATTR=y
CONFIG_EXT3_FS=y
# CONFIG_EXT3_DEFAULTS_TO_ORDERED is not set
# CONFIG_DNOTIFY is not set
CONFIG_MSDOS_FS=y
CONFIG_VFAT_FS=y
CONFIG_FAT_DEFAULT_CODEPAGE=850
CONFIG_NTFS_FS=m
CONFIG_NTFS_RW=y
CONFIG_TMPFS=y
CONFIG_CONFIGFS_FS=y
CONFIG_JFFS2_FS=y
CONFIG_NFS_FS=y
CONFIG_NFS_V3=y
CONFIG_ROOT_NFS=y
CONFIG_SMB_FS=m
CONFIG_SMB_NLS_DEFAULT=y
CONFIG_CIFS=m
CONFIG_CIFS_STATS=y
CONFIG_CIFS_WEAK_PW_HASH=y
CONFIG_CIFS_XATTR=y
CONFIG_CIFS_POSIX=y
CONFIG_NLS_CODEPAGE_437=y
CONFIG_NLS_CODEPAGE_850=y
CONFIG_NLS_ISO8859_1=y
CONFIG_NLS_UTF8=y
CONFIG_MAGIC_SYSRQ=y
CONFIG_DEBUG_FS=y
CONFIG_DEBUG_KERNEL=y
CONFIG_DETECT_HUNG_TASK=y
CONFIG_FRAME_POINTER=y
# CONFIG_RCU_CPU_STALL_DETECTOR is not set
CONFIG_CRC_CCITT=y
```

## arch/avr32/configs/atstk1002_defconfig
```kconfig
CONFIG_EXPERIMENTAL=y
# CONFIG_LOCALVERSION_AUTO is not set
CONFIG_SYSVIPC=y
CONFIG_POSIX_MQUEUE=y
CONFIG_LOG_BUF_SHIFT=14
CONFIG_RELAY=y
CONFIG_BLK_DEV_INITRD=y
CONFIG_CC_OPTIMIZE_FOR_SIZE=y
# CONFIG_SYSCTL_SYSCALL is not set
# CONFIG_BASE_FULL is not set
# CONFIG_COMPAT_BRK is not set
CONFIG_PROFILING=y
CONFIG_OPROFILE=m
# CONFIG_KPROBES is not set
CONFIG_MODULES=y
CONFIG_MODULE_UNLOAD=y
# CONFIG_BLK_DEV_BSG is not set
# CONFIG_IOSCHED_DEADLINE is not set
CONFIG_NO_HZ=y
CONFIG_HIGH_RES_TIMERS=y
# CONFIG_OWNERSHIP_TRACE is not set
CONFIG_NMI_DEBUGGING=y
CONFIG_PM=y
CONFIG_CPU_FREQ=y
# CONFIG_CPU_FREQ_STAT is not set
CONFIG_CPU_FREQ_DEFAULT_GOV_ONDEMAND=y
CONFIG_CPU_FREQ_GOV_USERSPACE=y
CONFIG_CPU_FREQ_AT32AP=y
CONFIG_CORE_DUMP_DEFAULT_ELF_HEADERS=y
CONFIG_NET=y
CONFIG_PACKET=y
CONFIG_UNIX=y
CONFIG_XFRM_USER=m
CONFIG_NET_KEY=m
CONFIG_INET=y
CONFIG_IP_PNP=y
CONFIG_IP_PNP_DHCP=y
CONFIG_NET_IPIP=m
CONFIG_NET_IPGRE_DEMUX=m
CONFIG_NET_IPGRE=m
CONFIG_INET_AH=m
CONFIG_INET_ESP=m
CONFIG_INET_XFRM_MODE_TRANSPORT=m
CONFIG_INET_XFRM_MODE_TUNNEL=m
CONFIG_INET_XFRM_MODE_BEET=m
# CONFIG_INET_LRO is not set
CONFIG_INET6_AH=m
CONFIG_INET6_ESP=m
CONFIG_INET6_IPCOMP=m
CONFIG_IPV6_TUNNEL=m
CONFIG_BRIDGE=m
CONFIG_UEVENT_HELPER_PATH="/sbin/hotplug"
# CONFIG_PREVENT_FIRMWARE_BUILD is not set
# CONFIG_FW_LOADER is not set
CONFIG_MTD=y
CONFIG_MTD_PARTITIONS=y
CONFIG_MTD_CMDLINE_PARTS=y
CONFIG_MTD_CHAR=y
CONFIG_MTD_BLOCK=y
CONFIG_MTD_CFI=y
CONFIG_MTD_CFI_AMDSTD=y
CONFIG_MTD_PHYSMAP=y
CONFIG_MTD_UBI=y
CONFIG_BLK_DEV_LOOP=m
CONFIG_BLK_DEV_NBD=m
CONFIG_BLK_DEV_RAM=m
CONFIG_MISC_DEVICES=y
CONFIG_ATMEL_PWM=m
CONFIG_ATMEL_TCLIB=y
CONFIG_ATMEL_SSC=m
# CONFIG_SCSI_PROC_FS is not set
CONFIG_BLK_DEV_SD=m
CONFIG_BLK_DEV_SR=m
# CONFIG_SCSI_LOWLEVEL is not set
CONFIG_ATA=m
# CONFIG_SATA_PMP is not set
CONFIG_PATA_AT32=m
CONFIG_NETDEVICES=y
CONFIG_TUN=m
CONFIG_NET_ETHERNET=y
CONFIG_MACB=y
# CONFIG_NETDEV_1000 is not set
# CONFIG_NETDEV_10000 is not set
CONFIG_PPP=m
CONFIG_PPP_ASYNC=m
CONFIG_PPP_DEFLATE=m
CONFIG_PPP_BSDCOMP=m
CONFIG_INPUT=m
CONFIG_INPUT_EVDEV=m
# CONFIG_KEYBOARD_ATKBD is not set
CONFIG_KEYBOARD_GPIO=m
# CONFIG_MOUSE_PS2 is not set
CONFIG_MOUSE_GPIO=m
# CONFIG_SERIO is not set
# CONFIG_VT is not set
# CONFIG_DEVKMEM is not set
CONFIG_SERIAL_ATMEL=y
CONFIG_SERIAL_ATMEL_CONSOLE=y
# CONFIG_LEGACY_PTYS is not set
# CONFIG_HW_RANDOM is not set
CONFIG_I2C=m
CONFIG_I2C_CHARDEV=m
CONFIG_I2C_GPIO=m
CONFIG_SPI=y
CONFIG_SPI_ATMEL=y
CONFIG_SPI_SPIDEV=m
CONFIG_GPIO_SYSFS=y
# CONFIG_HWMON is not set
CONFIG_WATCHDOG=y
CONFIG_AT32AP700X_WDT=y
CONFIG_FB=y
CONFIG_FB_ATMEL=y
CONFIG_BACKLIGHT_LCD_SUPPORT=y
CONFIG_LCD_CLASS_DEVICE=y
CONFIG_LCD_LTV350QV=y
# CONFIG_BACKLIGHT_CLASS_DEVICE is not set
CONFIG_SOUND=m
CONFIG_SND=m
CONFIG_SND_MIXER_OSS=m
CONFIG_SND_PCM_OSS=m
# CONFIG_SND_SUPPORT_OLD_API is not set
# CONFIG_SND_VERBOSE_PROCFS is not set
CONFIG_SND_AT73C213=m
# CONFIG_HID_SUPPORT is not set
CONFIG_USB_GADGET=y
CONFIG_USB_ZERO=m
CONFIG_USB_ETH=m
CONFIG_USB_GADGETFS=m
CONFIG_USB_MASS_STORAGE=m
CONFIG_USB_G_SERIAL=m
CONFIG_USB_CDC_COMPOSITE=m
CONFIG_MMC=y
CONFIG_MMC_TEST=m
CONFIG_MMC_ATMELMCI=y
CONFIG_NEW_LEDS=y
CONFIG_LEDS_CLASS=y
CONFIG_LEDS_ATMEL_PWM=m
CONFIG_LEDS_GPIO=m
CONFIG_LEDS_TRIGGERS=y
CONFIG_LEDS_TRIGGER_TIMER=m
CONFIG_LEDS_TRIGGER_HEARTBEAT=m
CONFIG_RTC_CLASS=y
CONFIG_RTC_DRV_AT32AP700X=y
CONFIG_DMADEVICES=y
CONFIG_EXT2_FS=y
CONFIG_EXT3_FS=y
# CONFIG_EXT3_DEFAULTS_TO_ORDERED is not set
# CONFIG_EXT3_FS_XATTR is not set
CONFIG_EXT4_FS=y
# CONFIG_EXT4_FS_XATTR is not set
# CONFIG_DNOTIFY is not set
CONFIG_FUSE_FS=m
CONFIG_MSDOS_FS=m
CONFIG_VFAT_FS=m
CONFIG_FAT_DEFAULT_CODEPAGE=850
CONFIG_PROC_KCORE=y
CONFIG_TMPFS=y
CONFIG_CONFIGFS_FS=y
CONFIG_JFFS2_FS=y
CONFIG_UBIFS_FS=y
CONFIG_NFS_FS=y
CONFIG_NFS_V3=y
CONFIG_ROOT_NFS=y
CONFIG_CIFS=m
CONFIG_NLS_CODEPAGE_437=m
CONFIG_NLS_CODEPAGE_850=m
CONFIG_NLS_ISO8859_1=m
CONFIG_NLS_UTF8=m
CONFIG_MAGIC_SYSRQ=y
CONFIG_DEBUG_FS=y
CONFIG_DEBUG_KERNEL=y
CONFIG_DETECT_HUNG_TASK=y
CONFIG_FRAME_POINTER=y
```
