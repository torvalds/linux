// SPDX-License-Identifier: GPL-2.0-only
/*
 * Copyright (C) 2013 Synopsys, Inc. (www.synopsys.com)
 *
 * ARC HS38 Virtual Development Kit, SMP version (VDK)
 */
/dts-v1/;

/include/ "vdk_axc003_idu.dtsi"
/include/ "vdk_axs10x_mb.dtsi"

/ {
	model = "snps,vdk_archs-smp";
	compatible = "snps,axs103";

	chosen {
		bootargs = "earlycon=uart8250,mmio32,0xe0022000,115200n8 console=tty0 console=ttyS3,115200n8 consoleblank=0 video=640x480-24";
	};
};
