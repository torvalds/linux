// SPDX-License-Identifier: GPL-2.0-only
/*
 * Copyright (C) 2013-15 Synopsys, Inc. (www.synopsys.com)
 *
 * ARC AXS101 S/W development platform
 */
/dts-v1/;

/include/ "axc001.dtsi"
/include/ "axs10x_mb.dtsi"

/ {
	model = "snps,axs101";
	compatible = "snps,axs101", "snps,arc-sdp";

	chosen {
		bootargs = "earlycon=uart8250,mmio32,0xe0022000,115200n8 console=tty0 console=ttyS3,115200n8 consoleblank=0 print-fatal-signals=1";
	};
};
