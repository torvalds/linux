## arch/h8300/Kconfig.cpu
```kconfig
config CPU_H8300H
	bool

config CPU_H8S
	bool

config H83069
	bool
	select CPU_H8300H
	select H8300_TMR16
	select RENESAS_H8300H_INTC

config H8S2678
	bool
	select CPU_H8S
	select H8300_TPU
	select RENESAS_H8S_INTC

config RAMKERNEL
	bool

config ROMKERNEL
	bool

menu "Processor type and features"

choice
prompt "H8/300 platform"

config H8300_AE3068
	bool "AE-3068/69"
	select H83069
	select RAMKERNEL
	help
	  AKI-H8/3068F / AKI-H8/3069F Flashmicom LAN Board Support
	  More Information. (Japanese Only)
	  <http://akizukidenshi.com/catalog/default.aspx>
	  AE-3068/69 Evaluation Board Support
	  More Information.
	  <http://www.microtronique.com/ae3069lan.htm>

config H8300_H8MAX
	bool "H8MAX"
	select H83069
	select RAMKERNEL
	select HAVE_IDE
	help
	  H8MAX Evaluation Board Support
	  More Information. (Japanese Only)
	  <http://strawberry-linux.com/h8/index.html>

config H8300_KANEBEBE
	bool "KaneBebe"
	select H83069
	select RAMKERNEL
	help
	  KaneBebe Evalition Board Support
	  More Information. (Japanese Only)
	  <http://www.nissin-tech.com/2009/10/uclinuxkane-bebe-h83069f.html>

config H8300H_SIM
	bool "H8/300H GDB Simulator"
	select H83069
	select ROMKERNEL
	help
	  GDB Simulator Support
	  More Information.
	  <http://sourceware.org/sid/>

config H8S_EDOSK2674
	bool "EDOSK-2674"
	select H8S2678
	select RAMKERNEL
	help
	  Renesas EDOSK-2674 Evaluation Board Support
	  More Information.
	  <http://www.azpower.com/H8-uClinux/index.html>
	  <http://www.renesas.eu/products/tools/introductory_evaluation_tools/evaluation_development_os_kits/edosk2674r/edosk2674r_software_tools_root.jsp>

config H8S_SIM
	bool "H8S GDB Simulator"
	select H8S2678
	select ROMKERNEL
	help
	  GDB Simulator Support
	  More Information.
	  <http://sourceware.org/sid/>

endchoice

config H8300_BUILTIN_DTB
        string "Builtin DTB"
	default ""

config OFFSET
        hex "Load offset"
	default 0

endmenu
```

## arch/h8300/Kconfig.debug
```kconfig
menu "Kernel hacking"

source "lib/Kconfig.debug"

config FULLDEBUG
	bool "Full Symbolic/Source Debugging support"
	help
	  Enable debugging symbols on kernel build.

config HIGHPROFILE
	bool "Use fast second timer for profiling"
	help
	  Use a fast secondary clock to produce profiling information.

config NO_KERNEL_MSG
	bool "Suppress Kernel BUG Messages"
	help
	  Do not output any debug BUG messages within the kernel.

config GDB_MAGICPRINT
	bool "Message Output for GDB MagicPrint service"
	depends on (H8300H_SIM || H8S_SIM)
	help
	  kernel messages output useing MagicPrint service from GDB

config SYSCALL_PRINT
	bool "SystemCall trace print"
	help
	  outout history of systemcall

config GDB_DEBUG
   	bool "Use gdb stub"
	depends on (!H8300H_SIM && !H8S_SIM)
	help
	  gdb stub exception support

config SH_STANDARD_BIOS
	bool "Use gdb protocol serial console"
	depends on (!H8300H_SIM && !H8S_SIM)
	help
	  serial console output using GDB protocol.
	  Require eCos/RedBoot

config DEFAULT_CMDLINE
	bool "Use buildin commandline"
	default n
	help
	  buildin kernel commandline enabled.

config KERNEL_COMMAND
	string "Buildin commmand string"
	depends on DEFAULT_CMDLINE
	help
	  buildin kernel commandline strings.

config BLKDEV_RESERVE
	bool "BLKDEV Reserved Memory"
	default n
	help
	  Reserved BLKDEV area.

config CONFIG_BLKDEV_RESERVE_ADDRESS
	hex 'start address'
	depends on BLKDEV_RESERVE
	help
	  BLKDEV start address.

endmenu
```

## arch/h8300/Kconfig.ide
```kconfig
# uClinux H8/300 Target Board Selection Menu (IDE)

if (H8300H_AKI3068NET)
menu "IDE Extra configuration"

config H8300_IDE_BASE
	hex "IDE register base address"
	depends on IDE
	default 0
	help
	  IDE registers base address

config H8300_IDE_ALT
	hex "IDE register alternate address"
	depends on IDE
	default 0
	help
	  IDE alternate registers address

config H8300_IDE_IRQ
	int "IDE IRQ no"
	depends on IDE
	default 0
	help
	  IDE use IRQ no
endmenu
endif

if (H8300H_H8MAX)
config H8300_IDE_BASE
	hex
	depends on IDE
	default 0x200000

config H8300_IDE_ALT
	hex
	depends on IDE
	default 0x60000c

config H8300_IDE_IRQ
	int
	depends on IDE
	default 5
endif
```

## arch/h8300/configs/h8300h-sim_defconfig
```kconfig
# CONFIG_LOCALVERSION_AUTO is yest set
# CONFIG_USELIB is yest set
CONFIG_CC_OPTIMIZE_FOR_SIZE=y
# CONFIG_UID16 is yest set
# CONFIG_SYSFS_SYSCALL is yest set
# CONFIG_KALLSYMS is yest set
# CONFIG_BASE_FULL is yest set
# CONFIG_FUTEX is yest set
# CONFIG_EPOLL is yest set
# CONFIG_SIGNALFD is yest set
# CONFIG_TIMERFD is yest set
# CONFIG_EVENTFD is yest set
# CONFIG_AIO is yest set
# CONFIG_ADVISE_SYSCALLS is yest set
CONFIG_EMBEDDED=y
# CONFIG_VM_EVENT_COUNTERS is yest set
# CONFIG_COMPAT_BRK is yest set
CONFIG_SLOB=y
# CONFIG_BLOCK is yest set
CONFIG_H8300H_SIM=y
CONFIG_H8300_BUILTIN_DTB="h8300h_sim"
# CONFIG_BINFMT_SCRIPT is yest set
CONFIG_BINFMT_FLAT=y
# CONFIG_COREDUMP is yest set
# CONFIG_UEVENT_HELPER is yest set
# CONFIG_STANDALONE is yest set
# CONFIG_PREVENT_FIRMWARE_BUILD is yest set
# CONFIG_FW_LOADER is yest set
# CONFIG_ALLOW_DEV_COREDUMP is yest set
# CONFIG_INPUT is yest set
# CONFIG_SERIO is yest set
# CONFIG_VT is yest set
# CONFIG_UNIX98_PTYS is yest set
# CONFIG_LEGACY_PTYS is yest set
# CONFIG_DEVKMEM is yest set
CONFIG_SERIAL_SH_SCI=y
CONFIG_SERIAL_SH_SCI_EARLYCON=y
# CONFIG_HW_RANDOM is yest set
# CONFIG_HWMON is yest set
# CONFIG_USB_SUPPORT is yest set
# CONFIG_FILE_LOCKING is yest set
# CONFIG_DNOTIFY is yest set
# CONFIG_INOTIFY_USER is yest set
# CONFIG_PROC_FS is yest set
# CONFIG_SYSFS is yest set
# CONFIG_MISC_FILESYSTEMS is yest set
CONFIG_DEBUG_INFO=y
# CONFIG_ENABLE_MUST_CHECK is yest set
```

## arch/h8300/defconfig
```kconfig
CONFIG_EXPERIMENTAL=y
# CONFIG_LOCALVERSION_AUTO is not set
CONFIG_LOG_BUF_SHIFT=14
CONFIG_EMBEDDED=y
# CONFIG_UID16 is not set
# CONFIG_SYSCTL_SYSCALL is not set
# CONFIG_KALLSYMS is not set
# CONFIG_HOTPLUG is not set
# CONFIG_BASE_FULL is not set
# CONFIG_FUTEX is not set
# CONFIG_EPOLL is not set
# CONFIG_SIGNALFD is not set
# CONFIG_TIMERFD is not set
# CONFIG_EVENTFD is not set
# CONFIG_VM_EVENT_COUNTERS is not set
# CONFIG_COMPAT_BRK is not set
CONFIG_SLOB=y
# CONFIG_BLK_DEV_BSG is not set
# CONFIG_IOSCHED_DEADLINE is not set
# CONFIG_IOSCHED_CFQ is not set
CONFIG_H83007=y
CONFIG_BINFMT_FLAT=y
CONFIG_BINFMT_ZFLAT=y
CONFIG_BINFMT_MISC=y
# CONFIG_PREVENT_FIRMWARE_BUILD is not set
CONFIG_MTD=y
CONFIG_MTD_PARTITIONS=y
CONFIG_MTD_REDBOOT_PARTS=y
CONFIG_MTD_CHAR=y
CONFIG_MTD_RAM=y
CONFIG_MTD_ROM=y
CONFIG_MTD_UCLINUX=y
# CONFIG_BLK_DEV is not set
# CONFIG_INPUT is not set
# CONFIG_SERIO is not set
# CONFIG_HWMON is not set
# CONFIG_USB_SUPPORT is not set
# CONFIG_DNOTIFY is not set
CONFIG_ROMFS_FS=y
# CONFIG_ENABLE_WARN_DEPRECATED is not set
# CONFIG_ENABLE_MUST_CHECK is not set
# CONFIG_CRC32 is not set
```

## arch/hexagon/Kconfig
```kconfig
# SPDX-License-Identifier: GPL-2.0
# Hexagon configuration
comment "Linux Kernel Configuration for Hexagon"

config HEXAGON
	def_bool y
	select ARCH_32BIT_OFF_T
	select ARCH_HAS_SYNC_DMA_FOR_DEVICE
	select ARCH_NO_PREEMPT
	select ARCH_WANT_FRAME_POINTERS
	select DMA_GLOBAL_POOL
	select HAVE_PAGE_SIZE_4KB
	select HAVE_PAGE_SIZE_16KB
	select HAVE_PAGE_SIZE_64KB
	select HAVE_PAGE_SIZE_256KB
	select FRAME_POINTER
	# Other pending projects/to-do items.
	# select HAVE_REGS_AND_STACK_ACCESS_API
	# select HAVE_HW_BREAKPOINT if PERF_EVENTS
	# select ARCH_HAS_CPU_IDLE_WAIT
	# select GPIOLIB
	# select HAVE_CLK
	select GENERIC_ATOMIC64
	select HAVE_PERF_EVENTS
	# GENERIC_ALLOCATOR is used by dma_alloc_coherent()
	select GENERIC_ALLOCATOR
	select GENERIC_IRQ_PROBE
	select GENERIC_IRQ_SHOW
	select HAVE_ARCH_KGDB
	select HAVE_ARCH_TRACEHOOK
	select NEED_SG_DMA_LENGTH
	select GENERIC_IOREMAP
	select GENERIC_SMP_IDLE_THREAD
	select STACKTRACE_SUPPORT
	select GENERIC_CLOCKEVENTS_BROADCAST
	select LOCK_MM_AND_FIND_VMA
	select MODULES_USE_ELF_RELA
	select GENERIC_CPU_DEVICES
	select ARCH_WANT_LD_ORPHAN_WARN
	select TRACE_IRQFLAGS_SUPPORT
	help
	  Qualcomm Hexagon is a processor architecture designed for high
	  performance and low power across a wide variety of applications.

config HEXAGON_PHYS_OFFSET
	def_bool y
	help
	  Platforms that don't load the kernel at zero set this.

config LOCKDEP_SUPPORT
	def_bool y

config EARLY_PRINTK
	def_bool y

config MMU
	def_bool y

config NO_IOPORT_MAP
	def_bool y

config GENERIC_CSUM
	def_bool y

config GENERIC_HWEIGHT
	def_bool y

config STACKTRACE_SUPPORT
	def_bool y
	select STACKTRACE

config GENERIC_BUG
	def_bool y
	depends on BUG

menu "Machine selection"

choice
	prompt "System type"
	default HEXAGON_COMET

config HEXAGON_COMET
	bool "Comet Board"
	help
	  Support for the Comet platform.

endchoice

config HEXAGON_ARCH_VERSION
	int "Architecture version"
	default 2

config CMDLINE
	string "Default kernel command string"
	default ""
	help
	  On some platforms, there is currently no way for the boot loader
	  to pass arguments to the kernel. For these, you should supply some
	  command-line options at build time by entering them here.  At a
	  minimum, you should specify the memory size and the root device
	  (e.g., mem=64M root=/dev/nfs).

config SMP
	bool "Multi-Processing support"
	help
	  Enables SMP support in the kernel.  If unsure, say "Y"

config NR_CPUS
	int "Maximum number of CPUs" if SMP
	range 2 6 if SMP
	default "1" if !SMP
	default "6" if SMP
	help
	  This allows you to specify the maximum number of CPUs which this
	  kernel will support.  The maximum supported value is 6 and the
	  minimum value which makes sense is 2.

	  This is purely to save memory - each supported CPU adds
	  approximately eight kilobytes to the kernel image.

source "kernel/Kconfig.hz"

endmenu
```

## arch/hexagon/configs/comet_defconfig
```kconfig
CONFIG_SMP=y
CONFIG_DEFAULT_MMAP_MIN_ADDR=0
CONFIG_HZ_100=y
CONFIG_CROSS_COMPILE="hexagon-"
CONFIG_LOCALVERSION="-smp"
# CONFIG_LOCALVERSION_AUTO is not set
CONFIG_SYSVIPC=y
CONFIG_POSIX_MQUEUE=y
CONFIG_BSD_PROCESS_ACCT=y
CONFIG_BSD_PROCESS_ACCT_V3=y
CONFIG_TASKSTATS=y
CONFIG_TASK_DELAY_ACCT=y
CONFIG_IKCONFIG=y
CONFIG_IKCONFIG_PROC=y
CONFIG_LOG_BUF_SHIFT=18
CONFIG_BLK_DEV_INITRD=y
CONFIG_EMBEDDED=y
# CONFIG_VM_EVENT_COUNTERS is not set
# CONFIG_BLK_DEV_BSG is not set
CONFIG_UEVENT_HELPER_PATH="/sbin/hotplug"
# CONFIG_STANDALONE is not set
CONFIG_CONNECTOR=y
CONFIG_BLK_DEV_LOOP=y
CONFIG_BLK_DEV_NBD=y
CONFIG_NETDEVICES=y
CONFIG_MII=y
CONFIG_PHYLIB=y
CONFIG_NET_ETHERNET=y
# CONFIG_NETDEV_1000 is not set
# CONFIG_NETDEV_10000 is not set
# CONFIG_INPUT_MOUSEDEV is not set
# CONFIG_INPUT_KEYBOARD is not set
# CONFIG_INPUT_MOUSE is not set
# CONFIG_SERIO is not set
# CONFIG_CONSOLE_TRANSLATIONS is not set
CONFIG_LEGACY_PTY_COUNT=64
# CONFIG_HW_RANDOM is not set
CONFIG_SPI=y
CONFIG_SPI_DEBUG=y
CONFIG_SPI_BITBANG=y
# CONFIG_HWMON is not set
# CONFIG_VGA_CONSOLE is not set
# CONFIG_HID_SUPPORT is not set
# CONFIG_USB_SUPPORT is not set
CONFIG_EXT2_FS=y
CONFIG_EXT2_FS_XATTR=y
CONFIG_EXT2_FS_POSIX_ACL=y
CONFIG_EXT2_FS_SECURITY=y
CONFIG_EXT3_FS=y
# CONFIG_EXT3_DEFAULTS_TO_ORDERED is not set
CONFIG_EXT3_FS_POSIX_ACL=y
CONFIG_EXT3_FS_SECURITY=y
CONFIG_QUOTA=y
CONFIG_PROC_KCORE=y
CONFIG_TMPFS=y
CONFIG_TMPFS_POSIX_ACL=y
# CONFIG_MISC_FILESYSTEMS is not set
CONFIG_NFS_FS=y
CONFIG_NFS_V3=y
CONFIG_NFS_V3_ACL=y
# CONFIG_CORE_DUMP_DEFAULT_ELF_HEADERS is not set
CONFIG_NET=y
CONFIG_PACKET=y
CONFIG_UNIX=y
CONFIG_INET=y
# CONFIG_INET_XFRM_MODE_TRANSPORT is not set
# CONFIG_INET_XFRM_MODE_TUNNEL is not set
# CONFIG_INET_XFRM_MODE_BEET is not set
# CONFIG_INET_LRO is not set
# CONFIG_INET_DIAG is not set
# CONFIG_IPV6 is not set
CONFIG_CRYPTO_MD5=y
# CONFIG_CRYPTO_ANSI_CPRNG is not set
# CONFIG_CRYPTO_HW is not set
CONFIG_CRC_CCITT=y
CONFIG_CRC16=y
CONFIG_CRC_T10DIF=y
CONFIG_LIBCRC32C=y
CONFIG_FRAME_WARN=0
CONFIG_MAGIC_SYSRQ=y
CONFIG_DEBUG_FS=y
# CONFIG_SCHED_DEBUG is not set
```
