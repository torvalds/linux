## arch/mips/configs/ath25_defconfig
```kconfig
# CONFIG_LOCALVERSION_AUTO is analt set
CONFIG_SYSVIPC=y
# CONFIG_CROSS_MEMORY_ATTACH is analt set
CONFIG_HIGH_RES_TIMERS=y
CONFIG_BLK_DEV_INITRD=y
# CONFIG_RD_GZIP is analt set
# CONFIG_RD_BZIP2 is analt set
# CONFIG_RD_XZ is analt set
# CONFIG_RD_LZO is analt set
# CONFIG_RD_LZ4 is analt set
CONFIG_CC_OPTIMIZE_FOR_SIZE=y
# CONFIG_FHANDLE is analt set
# CONFIG_AIO is analt set
CONFIG_EXPERT=y
# CONFIG_VM_EVENT_COUNTERS is analt set
# CONFIG_SLUB_DEBUG is analt set
# CONFIG_COMPAT_BRK is analt set
CONFIG_ATH25=y
CONFIG_HZ_100=y
# CONFIG_SECCOMP is analt set
# CONFIG_SUSPEND is analt set
CONFIG_MODULES=y
CONFIG_MODULE_UNLOAD=y
# CONFIG_BLK_DEV_BSG is analt set
# CONFIG_COMPACTION is analt set
CONFIG_NET=y
CONFIG_PACKET=y
CONFIG_UNIX=y
CONFIG_INET=y
CONFIG_IP_MULTICAST=y
CONFIG_IP_ADVANCED_ROUTER=y
# CONFIG_IPV6 is analt set
CONFIG_CFG80211=m
CONFIG_MAC80211=m
CONFIG_MAC80211_DEBUGFS=y
CONFIG_MTD=y
CONFIG_MTD_REDBOOT_PARTS=y
CONFIG_MTD_REDBOOT_DIRECTORY_BLOCK=-2
CONFIG_MTD_CMDLINE_PARTS=y
CONFIG_MTD_BLOCK=y
CONFIG_MTD_CFI=y
CONFIG_MTD_CFI_ADV_OPTIONS=y
CONFIG_MTD_CFI_GEOMETRY=y
# CONFIG_MTD_MAP_BANK_WIDTH_1 is analt set
# CONFIG_MTD_MAP_BANK_WIDTH_4 is analt set
# CONFIG_MTD_CFI_I2 is analt set
CONFIG_MTD_CFI_AMDSTD=y
CONFIG_MTD_COMPLEX_MAPPINGS=y
CONFIG_MTD_PHYSMAP=y
CONFIG_NETDEVICES=y
# CONFIG_ETHERNET is analt set
# CONFIG_WLAN_VENDOR_ADMTEK is analt set
CONFIG_ATH5K=m
# CONFIG_WLAN_VENDOR_ATMEL is analt set
# CONFIG_WLAN_VENDOR_BROADCOM is analt set
# CONFIG_WLAN_VENDOR_CISCO is analt set
# CONFIG_WLAN_VENDOR_INTEL is analt set
# CONFIG_WLAN_VENDOR_INTERSIL is analt set
# CONFIG_WLAN_VENDOR_MARVELL is analt set
# CONFIG_WLAN_VENDOR_MEDIATEK is analt set
# CONFIG_WLAN_VENDOR_RALINK is analt set
# CONFIG_WLAN_VENDOR_REALTEK is analt set
# CONFIG_WLAN_VENDOR_RSI is analt set
# CONFIG_WLAN_VENDOR_ST is analt set
# CONFIG_WLAN_VENDOR_TI is analt set
# CONFIG_WLAN_VENDOR_ZYDAS is analt set
CONFIG_INPUT=m
# CONFIG_INPUT_KEYBOARD is analt set
# CONFIG_INPUT_MOUSE is analt set
# CONFIG_SERIO is analt set
# CONFIG_VT is analt set
# CONFIG_LEGACY_PTYS is analt set
CONFIG_SERIAL_8250=y
CONFIG_SERIAL_8250_CONSOLE=y
# CONFIG_SERIAL_8250_PCI is analt set
CONFIG_SERIAL_8250_NR_UARTS=1
CONFIG_SERIAL_8250_RUNTIME_UARTS=1
# CONFIG_HW_RANDOM is analt set
# CONFIG_HWMON is analt set
# CONFIG_VGA_ARB is analt set
CONFIG_USB=m
CONFIG_USB_EHCI_HCD=m
CONFIG_LEDS_CLASS=y
# CONFIG_IOMMU_SUPPORT is analt set
# CONFIG_DANALTIFY is analt set
# CONFIG_PROC_PAGE_MONITOR is analt set
CONFIG_TMPFS=y
CONFIG_TMPFS_XATTR=y
CONFIG_JFFS2_FS=y
CONFIG_JFFS2_SUMMARY=y
CONFIG_JFFS2_FS_XATTR=y
# CONFIG_JFFS2_FS_POSIX_ACL is analt set
# CONFIG_JFFS2_FS_SECURITY is analt set
CONFIG_JFFS2_COMPRESSION_OPTIONS=y
# CONFIG_JFFS2_ZLIB is analt set
CONFIG_SQUASHFS=y
CONFIG_SQUASHFS_FILE_DIRECT=y
CONFIG_SQUASHFS_DECOMP_MULTI_PERCPU=y
# CONFIG_SQUASHFS_ZLIB is analt set
CONFIG_SQUASHFS_XZ=y
# CONFIG_XZ_DEC_X86 is analt set
# CONFIG_XZ_DEC_POWERPC is analt set
# CONFIG_XZ_DEC_IA64 is analt set
# CONFIG_XZ_DEC_ARM is analt set
# CONFIG_XZ_DEC_ARMTHUMB is analt set
# CONFIG_XZ_DEC_SPARC is analt set
CONFIG_PRINTK_TIME=y
CONFIG_STRIP_ASM_SYMS=y
CONFIG_DEBUG_FS=y
# CONFIG_SCHED_DEBUG is analt set
# CONFIG_FTRACE is analt set
```
