## arch/metag/Kconfig.soc
```kconfig
choice
	prompt "SoC Type"
	default META21_FPGA

config META12_FPGA
	bool "Meta 1.2 FPGA"
	select METAG_META12
	help
	  This is a Meta 1.2 FPGA bitstream, just a bare CPU.

config META21_FPGA
	bool "Meta 2.1 FPGA"
	select METAG_META21
	help
	  This is a Meta 2.1 FPGA bitstream, just a bare CPU.

config SOC_TZ1090
	bool "Toumaz Xenif TZ1090 SoC (Comet)"
	select ARCH_WANT_OPTIONAL_GPIOLIB
	select IMGPDC_IRQ
	select METAG_LNKGET_AROUND_CACHE
	select METAG_META21
	select METAG_SMP_WRITE_REORDERING
	select PINCTRL
	select PINCTRL_TZ1090
	select PINCTRL_TZ1090_PDC
	help
	  This is a Toumaz Technology Xenif TZ1090 (A.K.A. Comet) SoC containing
	  a 2-threaded HTP.

endchoice

menu "SoC configuration"

if METAG_META21

# Meta 2.x specific options

config METAG_META21_MMU
	bool "Meta 2.x MMU mode"
	default y
	help
	  Use the Meta 2.x MMU in extended mode.

config METAG_UNALIGNED
	bool "Meta 2.x unaligned access checking"
	default y
	help
	  All memory accesses will be checked for alignment and an exception
	  raised on unaligned accesses. This feature does cost performance
	  but without it there will be no notification of this type of error.

config METAG_USER_TCM
	bool "Meta on-chip memory support for userland"
	select GENERIC_ALLOCATOR
	default y
	help
	  Allow the on-chip memories of Meta SoCs to be used by user
	  applications.

endif

config METAG_HALT_ON_PANIC
	bool "Halt the core on panic"
	help
	  Halt the core when a panic occurs. This is useful when running
	  pre-production silicon or in an FPGA environment.

endmenu
```

## arch/metag/configs/meta2_smp_defconfig
```kconfig
# CONFIG_LOCALVERSION_AUTO is not set
# CONFIG_SWAP is not set
CONFIG_SYSVIPC=y
CONFIG_LOG_BUF_SHIFT=13
CONFIG_SYSFS_DEPRECATED=y
CONFIG_SYSFS_DEPRECATED_V2=y
CONFIG_KALLSYMS_ALL=y
# CONFIG_ELF_CORE is not set
CONFIG_SLAB=y
# CONFIG_BLK_DEV_BSG is not set
CONFIG_PARTITION_ADVANCED=y
# CONFIG_MSDOS_PARTITION is not set
# CONFIG_IOSCHED_DEADLINE is not set
# CONFIG_IOSCHED_CFQ is not set
CONFIG_METAG_L2C=y
CONFIG_FLATMEM_MANUAL=y
CONFIG_METAG_HALT_ON_PANIC=y
CONFIG_SMP=y
CONFIG_METAG_DA=y
CONFIG_HZ_100=y
CONFIG_DEVTMPFS=y
# CONFIG_STANDALONE is not set
# CONFIG_PREVENT_FIRMWARE_BUILD is not set
# CONFIG_FW_LOADER is not set
CONFIG_BLK_DEV_RAM=y
CONFIG_BLK_DEV_RAM_COUNT=1
CONFIG_BLK_DEV_RAM_SIZE=16384
# CONFIG_INPUT is not set
# CONFIG_SERIO is not set
# CONFIG_VT is not set
# CONFIG_LEGACY_PTYS is not set
CONFIG_DA_TTY=y
CONFIG_DA_CONSOLE=y
# CONFIG_DEVKMEM is not set
# CONFIG_HW_RANDOM is not set
# CONFIG_HWMON is not set
# CONFIG_USB_SUPPORT is not set
# CONFIG_DNOTIFY is not set
CONFIG_TMPFS=y
# CONFIG_MISC_FILESYSTEMS is not set
# CONFIG_SCHED_DEBUG is not set
CONFIG_DEBUG_INFO=y
```

## arch/metag/mm/Kconfig
```kconfig
menu "Memory management options"

config PAGE_OFFSET
	hex "Kernel page offset address"
	default "0x40000000"
	help
	  This option allows you to set the virtual address at which the
	  kernel will be mapped to.
endmenu

config KERNEL_4M_PAGES
	bool "Map kernel with 4MB pages"
	depends on METAG_META21_MMU
	default y
	help
	  Map the kernel with large pages to reduce TLB pressure.

choice
	prompt "User page size"
	default PAGE_SIZE_4K

config PAGE_SIZE_4K
	bool "4kB"
	help
	  This is the default page size used by all Meta cores.

config PAGE_SIZE_8K
	bool "8kB"
	depends on METAG_META21_MMU
	help
	  This enables 8kB pages as supported by Meta 2.x and later MMUs.

config PAGE_SIZE_16K
	bool "16kB"
	depends on METAG_META21_MMU
	help
	  This enables 16kB pages as supported by Meta 2.x and later MMUs.

endchoice

config NUMA
	bool "Non Uniform Memory Access (NUMA) Support"
	select ARCH_WANT_NUMA_VARIABLE_LOCALITY
	help
	  Some Meta systems have MMU-mappable on-chip memories with
	  lower latencies than main memory. This enables support for
	  these blocks by binding them to nodes and allowing
	  memory policies to be used for prioritizing and controlling
	  allocation behaviour.

config FORCE_MAX_ZONEORDER
	int "Maximum zone order"
	range 10 32
	default "10"
	help
	  The kernel memory allocator divides physically contiguous memory
	  blocks into "zones", where each zone is a power of two number of
	  pages.  This option selects the largest power of two that the kernel
	  keeps in the memory allocator.  If you need to allocate very large
	  blocks of physically contiguous memory, then you may need to
	  increase this value.

	  This config option is actually maximum order plus one. For example,
	  a value of 11 means that the largest free memory block is 2^10 pages.

	  The page size is not necessarily 4KB.  Keep this in mind
	  when choosing a value for this option.

config METAG_L2C
	bool "Level 2 Cache Support"
	depends on METAG_META21
	help
	  Press y here to enable support for the Meta Level 2 (L2) cache. This
	  will enable the cache at start up if it hasn't already been enabled
	  by the bootloader.

	  If the bootloader enables the L2 you must press y here to ensure the
	  kernel takes the appropriate actions to keep the cache coherent.

config NODES_SHIFT
	int
	default "1"
	depends on NEED_MULTIPLE_NODES

config ARCH_FLATMEM_ENABLE
	def_bool y
	depends on !NUMA

config ARCH_SPARSEMEM_ENABLE
	def_bool y
	select SPARSEMEM_STATIC

config ARCH_SPARSEMEM_DEFAULT
	def_bool y

config ARCH_POPULATES_NODE_MAP
	def_bool y

config ARCH_SELECT_MEMORY_MODEL
	def_bool y

config SYS_SUPPORTS_HUGETLBFS
	def_bool y
	depends on METAG_META21_MMU

choice
	prompt "HugeTLB page size"
	depends on METAG_META21_MMU && HUGETLB_PAGE
	default HUGETLB_PAGE_SIZE_1M

config HUGETLB_PAGE_SIZE_8K
	bool "8kB"
	depends on PAGE_SIZE_4K

config HUGETLB_PAGE_SIZE_16K
	bool "16kB"
	depends on PAGE_SIZE_4K || PAGE_SIZE_8K

config HUGETLB_PAGE_SIZE_32K
	bool "32kB"

config HUGETLB_PAGE_SIZE_64K
	bool "64kB"

config HUGETLB_PAGE_SIZE_128K
	bool "128kB"

config HUGETLB_PAGE_SIZE_256K
	bool "256kB"

config HUGETLB_PAGE_SIZE_512K
	bool "512kB"

config HUGETLB_PAGE_SIZE_1M
	bool "1MB"

config HUGETLB_PAGE_SIZE_2M
	bool "2MB"

config HUGETLB_PAGE_SIZE_4M
	bool "4MB"

endchoice

config METAG_COREMEM
	bool
	default y if SUSPEND

source "mm/Kconfig"
```

## arch/microblaze/Kconfig
```kconfig
# SPDX-License-Identifier: GPL-2.0-only
config MICROBLAZE
	def_bool y
	select ARCH_32BIT_OFF_T
	select ARCH_NO_SWAP
	select ARCH_HAS_DMA_PREP_COHERENT
	select ARCH_HAS_GCOV_PROFILE_ALL
	select ARCH_HAS_SYNC_DMA_FOR_CPU
	select ARCH_HAS_SYNC_DMA_FOR_DEVICE
	select ARCH_MIGHT_HAVE_PC_PARPORT
	select ARCH_WANT_IPC_PARSE_VERSION
	select BUILDTIME_TABLE_SORT
	select TIMER_OF
	select CLONE_BACKWARDS3
	select COMMON_CLK
	select DMA_DIRECT_REMAP
	select GENERIC_ATOMIC64
	select GENERIC_CPU_DEVICES
	select GENERIC_IDLE_POLL_SETUP
	select GENERIC_IRQ_PROBE
	select GENERIC_IRQ_SHOW
	select GENERIC_PCI_IOMAP
	select GENERIC_SCHED_CLOCK
	select HAVE_ARCH_HASH
	select HAVE_ARCH_KGDB
	select HAVE_ARCH_SECCOMP
	select HAVE_DEBUG_KMEMLEAK
	select HAVE_DMA_CONTIGUOUS
	select HAVE_DYNAMIC_FTRACE
	select HAVE_FTRACE_MCOUNT_RECORD
	select HAVE_FUNCTION_GRAPH_TRACER
	select HAVE_FUNCTION_TRACER
	select HAVE_PCI
	select IRQ_DOMAIN
	select XILINX_INTC
	select MODULES_USE_ELF_RELA
	select OF
	select OF_EARLY_FLATTREE
	select PCI_DOMAINS_GENERIC if PCI
	select PCI_SYSCALL if PCI
	select CPU_NO_EFFICIENT_FFS
	select MMU_GATHER_NO_RANGE
	select SPARSE_IRQ
	select ZONE_DMA
	select TRACE_IRQFLAGS_SUPPORT
	select GENERIC_IRQ_MULTI_HANDLER

# Endianness selection
choice
	prompt "Endianness selection"
	default CPU_LITTLE_ENDIAN
	help
	  microblaze architectures can be configured for either little or
	  big endian formats. Be sure to select the appropriate mode.

config CPU_BIG_ENDIAN
	bool "Big endian"

config CPU_LITTLE_ENDIAN
	bool "Little endian"

endchoice

config ARCH_HAS_ILOG2_U32
	def_bool n

config ARCH_HAS_ILOG2_U64
	def_bool n

config GENERIC_HWEIGHT
	def_bool y

config GENERIC_CALIBRATE_DELAY
	def_bool y

config GENERIC_CSUM
	def_bool y

config STACKTRACE_SUPPORT
	def_bool y

config LOCKDEP_SUPPORT
	def_bool y

source "arch/microblaze/Kconfig.platform"

menu "Processor type and features"

source "kernel/Kconfig.hz"

config MMU
	def_bool y

comment "Boot options"

config CMDLINE_BOOL
	bool "Default bootloader kernel arguments"

config CMDLINE
	string "Default kernel command string"
	depends on CMDLINE_BOOL
	default "console=ttyUL0,115200"
	help
	  On some architectures there is currently no way for the boot loader
	  to pass arguments to the kernel. For these architectures, you should
	  supply some command-line options at build time by entering them
	  here.

config CMDLINE_FORCE
	bool "Force default kernel command string"
	depends on CMDLINE_BOOL
	default n
	help
	  Set this to have arguments from the default kernel command string
	  override those passed by the boot loader.

endmenu

menu "Kernel features"

config NR_CPUS
	int
	default "1"

config ADVANCED_OPTIONS
	bool "Prompt for advanced kernel configuration options"
	help
	  This option will enable prompting for a variety of advanced kernel
	  configuration options.  These options can cause the kernel to not
	  work if they are set incorrectly, but can be used to optimize certain
	  aspects of kernel memory management.

	  Unless you know what you are doing, say N here.

comment "Default settings for advanced configuration options are used"
	depends on !ADVANCED_OPTIONS

config HIGHMEM
	bool "High memory support"
	select KMAP_LOCAL
	help
	  The address space of Microblaze processors is only 4 Gigabytes large
	  and it has to accommodate user address space, kernel address
	  space as well as some memory mapped IO. That means that, if you
	  have a large amount of physical memory and/or IO, not all of the
	  memory can be "permanently mapped" by the kernel. The physical
	  memory that is not permanently mapped is called "high memory".

	  If unsure, say n.

config LOWMEM_SIZE_BOOL
	bool "Set maximum low memory"
	depends on ADVANCED_OPTIONS
	help
	  This option allows you to set the maximum amount of memory which
	  will be used as "low memory", that is, memory which the kernel can
	  access directly, without having to set up a kernel virtual mapping.
	  This can be useful in optimizing the layout of kernel virtual
	  memory.

	  Say N here unless you know what you are doing.

config LOWMEM_SIZE
	hex "Maximum low memory size (in bytes)" if LOWMEM_SIZE_BOOL
	default "0x30000000"

config MANUAL_RESET_VECTOR
	hex "Microblaze reset vector address setup"
	default "0x0"
	help
	  Set this option to have the kernel override the CPU Reset vector.
	  If zero, no change will be made to the MicroBlaze reset vector at
	  address 0x0.
	  If non-zero, a jump instruction to this address, will be written
	  to the reset vector at address 0x0.
	  If you are unsure, set it to default value 0x0.

config KERNEL_START_BOOL
	bool "Set custom kernel base address"
	depends on ADVANCED_OPTIONS
	help
	  This option allows you to set the kernel virtual address at which
	  the kernel will map low memory (the kernel image will be linked at
	  this address).  This can be useful in optimizing the virtual memory
	  layout of the system.

	  Say N here unless you know what you are doing.

config KERNEL_START
	hex "Virtual address of kernel base" if KERNEL_START_BOOL
	default "0xc0000000"

config TASK_SIZE_BOOL
	bool "Set custom user task size"
	depends on ADVANCED_OPTIONS
	help
	  This option allows you to set the amount of virtual address space
	  allocated to user tasks.  This can be useful in optimizing the
	  virtual memory layout of the system.

	  Say N here unless you know what you are doing.

config TASK_SIZE
	hex "Size of user task space" if TASK_SIZE_BOOL
	default "0x80000000"

config MB_MANAGER
	bool "Support for Microblaze Manager"
	depends on ADVANCED_OPTIONS
	help
	  This option enables API for configuring the MicroBlaze manager
	  control register, which is consumed by the break handler to
	  block the break.

	  Say N here unless you know what you are doing.

endmenu
```

## arch/microblaze/Kconfig.debug
```kconfig
# SPDX-License-Identifier: GPL-2.0-only
# For a description of the syntax of this configuration file,
# see Documentation/kbuild/kconfig-language.rst.

config TRACE_IRQFLAGS_SUPPORT
	def_bool y
```

## arch/microblaze/Kconfig.platform
```kconfig
# SPDX-License-Identifier: GPL-2.0-only
# For a description of the syntax of this configuration file,
# see Documentation/kbuild/kconfig-language.rst.
#
# Platform selection Kconfig menu for MicroBlaze targets
#

menu "Platform options"

config OPT_LIB_FUNCTION
	bool "Optimized lib function"
	default y
	help
	  Turns on optimized library functions (memcpy and memmove).
	  They are optimized by using word alignment. This will work
	  fine if both source and destination are aligned on the same
	  boundary. However, if they are aligned on different boundaries
	  shifts will be necessary. This might result in bad performance
	  on MicroBlaze systems without a barrel shifter.

config OPT_LIB_ASM
	bool "Optimized lib function ASM"
	depends on OPT_LIB_FUNCTION && (XILINX_MICROBLAZE0_USE_BARREL = 1)
	depends on CPU_BIG_ENDIAN
	default n
	help
	  Turns on optimized library functions (memcpy and memmove).
	  They are written in assembly.

# Definitions for MICROBLAZE0
comment "Definitions for MICROBLAZE0"

config KERNEL_BASE_ADDR
	hex "Physical address where Linux Kernel is"
	default "0x90000000"
	help
	  BASE Address for kernel

config XILINX_MICROBLAZE0_FAMILY
	string "Targeted FPGA family"
	default "virtex5"

config XILINX_MICROBLAZE0_USE_MSR_INSTR
	int "USE_MSR_INSTR range (0:1)"
	default 0

config XILINX_MICROBLAZE0_USE_PCMP_INSTR
	int "USE_PCMP_INSTR range (0:1)"
	default 0

config XILINX_MICROBLAZE0_USE_BARREL
	int "USE_BARREL range (0:1)"
	default 0

config XILINX_MICROBLAZE0_USE_DIV
	int "USE_DIV range (0:1)"
	default 0

config XILINX_MICROBLAZE0_USE_HW_MUL
	int "USE_HW_MUL values (0=NONE, 1=MUL32, 2=MUL64)"
	default 0

config XILINX_MICROBLAZE0_USE_FPU
	int "USE_FPU values (0=NONE, 1=BASIC, 2=EXTENDED)"
	default 0

config XILINX_MICROBLAZE0_HW_VER
	string "Core version number"
	default "7.10.d"

endmenu
```
