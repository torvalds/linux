## arch/mips/au1000/Kconfig
```kconfig
choice
	prompt "Machine type"
	depends on MACH_ALCHEMY
	default MIPS_DB1000

config MIPS_MTX1
	bool "4G Systems MTX-1 board"
	select DMA_NONCOHERENT
	select HW_HAS_PCI
	select RESOURCES_64BIT if PCI
	select SOC_AU1500
	select SYS_SUPPORTS_LITTLE_ENDIAN

config MIPS_BOSPORUS
	bool "Alchemy Bosporus board"
	select SOC_AU1500
	select DMA_NONCOHERENT
	select SYS_SUPPORTS_LITTLE_ENDIAN

config MIPS_DB1000
	bool "Alchemy DB1000 board"
	select SOC_AU1000
	select DMA_NONCOHERENT
	select HW_HAS_PCI
	select RESOURCES_64BIT if PCI
	select SYS_SUPPORTS_LITTLE_ENDIAN

config MIPS_DB1100
	bool "Alchemy DB1100 board"
	select SOC_AU1100
	select DMA_NONCOHERENT
	select SYS_SUPPORTS_LITTLE_ENDIAN

config MIPS_DB1200
	bool "Alchemy DB1200 board"
	select SOC_AU1200
	select DMA_COHERENT
	select MIPS_DISABLE_OBSOLETE_IDE
	select SYS_SUPPORTS_LITTLE_ENDIAN

config MIPS_DB1500
	bool "Alchemy DB1500 board"
	select SOC_AU1500
	select DMA_NONCOHERENT
	select HW_HAS_PCI
	select MIPS_DISABLE_OBSOLETE_IDE
	select RESOURCES_64BIT if PCI
	select SYS_SUPPORTS_BIG_ENDIAN
	select SYS_SUPPORTS_LITTLE_ENDIAN

config MIPS_DB1550
	bool "Alchemy DB1550 board"
	select SOC_AU1550
	select HW_HAS_PCI
	select DMA_NONCOHERENT
	select MIPS_DISABLE_OBSOLETE_IDE
	select RESOURCES_64BIT if PCI
	select SYS_SUPPORTS_LITTLE_ENDIAN

config MIPS_MIRAGE
	bool "Alchemy Mirage board"
	select DMA_NONCOHERENT
	select SOC_AU1500
	select SYS_SUPPORTS_LITTLE_ENDIAN

config MIPS_PB1000
	bool "Alchemy PB1000 board"
	select SOC_AU1000
	select DMA_NONCOHERENT
	select HW_HAS_PCI
	select RESOURCES_64BIT if PCI
	select SWAP_IO_SPACE
	select SYS_SUPPORTS_LITTLE_ENDIAN

config MIPS_PB1100
	bool "Alchemy PB1100 board"
	select SOC_AU1100
	select DMA_NONCOHERENT
	select HW_HAS_PCI
	select RESOURCES_64BIT if PCI
	select SWAP_IO_SPACE
	select SYS_SUPPORTS_LITTLE_ENDIAN

config MIPS_PB1200
	bool "Alchemy PB1200 board"
	select SOC_AU1200
	select DMA_NONCOHERENT
	select MIPS_DISABLE_OBSOLETE_IDE
	select RESOURCES_64BIT if PCI
	select SYS_SUPPORTS_LITTLE_ENDIAN

config MIPS_PB1500
	bool "Alchemy PB1500 board"
	select SOC_AU1500
	select DMA_NONCOHERENT
	select HW_HAS_PCI
	select RESOURCES_64BIT if PCI
	select SYS_SUPPORTS_LITTLE_ENDIAN

config MIPS_PB1550
	bool "Alchemy PB1550 board"
	select SOC_AU1550
	select DMA_NONCOHERENT
	select HW_HAS_PCI
	select MIPS_DISABLE_OBSOLETE_IDE
	select RESOURCES_64BIT if PCI
	select SYS_SUPPORTS_LITTLE_ENDIAN

config MIPS_XXS1500
	bool "MyCable XXS1500 board"
	select DMA_NONCOHERENT
	select SOC_AU1500
	select SYS_SUPPORTS_LITTLE_ENDIAN

endchoice

config SOC_AU1000
	bool
	select SOC_AU1X00

config SOC_AU1100
	bool
	select SOC_AU1X00

config SOC_AU1500
	bool
	select SOC_AU1X00

config SOC_AU1550
	bool
	select SOC_AU1X00

config SOC_AU1200
	bool
	select SOC_AU1X00

config SOC_AU1X00
	bool
	select 64BIT_PHYS_ADDR
	select IRQ_CPU
	select SYS_HAS_CPU_MIPS32_R1
	select SYS_SUPPORTS_32BIT_KERNEL
	select SYS_SUPPORTS_APM_EMULATION
	select SYS_SUPPORTS_KGDB
```

## arch/mips/basler/excite/Kconfig
```kconfig
config BASLER_EXCITE_PROTOTYPE
	bool "Support for pre-release units"
	depends on BASLER_EXCITE
	default n
	help
	  Pre-series (prototype) units are different from later ones in
	  some ways. Select this option if you have one of these. Please
	  note that a kernel built with this option selected will not be
	  able to run on normal units.
```

## arch/mips/bcm47xx/Kconfig
```kconfig
# SPDX-License-Identifier: GPL-2.0
if BCM47XX

config BCM47XX_SSB
	bool "SSB Support for Broadcom BCM47XX"
	select SYS_HAS_CPU_BMIPS32_3300
	select SSB
	select SSB_HOST_SOC
	select SSB_DRIVER_MIPS
	select SSB_DRIVER_EXTIF
	select SSB_EMBEDDED
	select SSB_B43_PCI_BRIDGE if PCI
	select SSB_DRIVER_PCICORE if PCI
	select SSB_PCICORE_HOSTMODE if PCI
	select SSB_DRIVER_GPIO
	default y
	help
	  Add support for old Broadcom BCM47xx boards with Sonics Silicon Backplane support.

	  This will generate an image with support for SSB and MIPS32 R1 instruction set.

config BCM47XX_BCMA
	bool "BCMA Support for Broadcom BCM47XX"
	select SYS_HAS_CPU_MIPS32_R2
	select SYS_SUPPORTS_HIGHMEM
	select CPU_MIPSR2_IRQ_VI
	select BCMA
	select BCMA_HOST_SOC
	select BCMA_DRIVER_MIPS
	select BCMA_DRIVER_PCI_HOSTMODE if PCI
	select BCMA_DRIVER_GPIO
	default y
	help
	  Add support for new Broadcom BCM47xx boards with Broadcom specific Advanced Microcontroller Bus.

	  This will generate an image with support for BCMA and MIPS32 R2 instruction set.

endif
```

## arch/mips/bcm63xx/Kconfig
```kconfig
# SPDX-License-Identifier: GPL-2.0
menu "CPU support"
	depends on BCM63XX

config BCM63XX_CPU_3368
	bool "support 3368 CPU"
	select SYS_HAS_CPU_BMIPS4350
	select HAVE_PCI

config BCM63XX_CPU_6328
	bool "support 6328 CPU"
	select SYS_HAS_CPU_BMIPS4350
	select HAVE_PCI

config BCM63XX_CPU_6338
	bool "support 6338 CPU"
	select SYS_HAS_CPU_BMIPS32_3300
	select HAVE_PCI

config BCM63XX_CPU_6345
	bool "support 6345 CPU"
	select SYS_HAS_CPU_BMIPS32_3300

config BCM63XX_CPU_6348
	bool "support 6348 CPU"
	select SYS_HAS_CPU_BMIPS32_3300
	select HAVE_PCI

config BCM63XX_CPU_6358
	bool "support 6358 CPU"
	select SYS_HAS_CPU_BMIPS4350
	select HAVE_PCI

config BCM63XX_CPU_6362
	bool "support 6362 CPU"
	select SYS_HAS_CPU_BMIPS4350
	select HAVE_PCI

config BCM63XX_CPU_6368
	bool "support 6368 CPU"
	select SYS_HAS_CPU_BMIPS4350
	select HAVE_PCI
endmenu

source "arch/mips/bcm63xx/boards/Kconfig"
```

## arch/mips/bcm63xx/boards/Kconfig
```kconfig
# SPDX-License-Identifier: GPL-2.0
choice
	prompt "Board support"
	depends on BCM63XX
	default BOARD_BCM963XX

config BOARD_BCM963XX
       bool "Generic Broadcom 963xx boards"
	select SSB
       help

endchoice
```

## arch/mips/bmips/Kconfig
```kconfig
if BMIPS_GENERIC

choice
	prompt "Built-in device tree"
	help
	  Legacy bootloaders do not pass a DTB pointer to the kernel, so
	  if a "wrapper" is not being used, the kernel will need to include
	  a device tree that matches the target board.

	  The builtin DTB will only be used if the firmware does not supply
	  a valid DTB.

config DT_NONE
	bool "None"

config DT_BCM93384WVG
	bool "BCM93384WVG Zephyr CPU"
	select BUILTIN_DTB

config DT_BCM93384WVG_VIPER
	bool "BCM93384WVG Viper CPU (EXPERIMENTAL)"
	select BUILTIN_DTB

config DT_BCM96358NB4SER
	bool "BCM96358NB4SER"
	select BUILTIN_DTB

config DT_BCM96368MVWG
	bool "BCM96368MVWG"
	select BUILTIN_DTB

config DT_BCM9EJTAGPRB
	bool "BCM9EJTAGPRB"
	select BUILTIN_DTB

config DT_BCM97125CBMB
	bool "BCM97125CBMB"
	select BUILTIN_DTB

config DT_BCM97346DBSMB
	bool "BCM97346DBSMB"
	select BUILTIN_DTB

config DT_BCM97358SVMB
	bool "BCM97358SVMB"
	select BUILTIN_DTB

config DT_BCM97360SVMB
	bool "BCM97360SVMB"
	select BUILTIN_DTB

config DT_BCM97362SVMB
	bool "BCM97362SVMB"
	select BUILTIN_DTB

config DT_BCM97420C
	bool "BCM97420C"
	select BUILTIN_DTB

config DT_BCM97425SVMB
	bool "BCM97425SVMB"
	select BUILTIN_DTB

config DT_BCM97435SVMB
	bool "BCM97435SVMB"
	select BUILTIN_DTB

endchoice

endif
```

## arch/mips/cavium-octeon/Kconfig
```kconfig
# SPDX-License-Identifier: GPL-2.0
if CPU_CAVIUM_OCTEON

config CAVIUM_CN63XXP1
	bool "Enable CN63XXP1 errata workarounds"
	default "n"
	help
	  The CN63XXP1 chip requires build time workarounds to
	  function reliably, select this option to enable them.  These
	  workarounds will cause a slight decrease in performance on
	  non-CN63XXP1 hardware, so it is recommended to select "n"
	  unless it is known the workarounds are needed.

config CAVIUM_OCTEON_CVMSEG_SIZE
	int "Number of L1 cache lines reserved for CVMSEG memory"
	range 0 54
	default 0 if !CAVIUM_OCTEON_SOC
	default 1 if CAVIUM_OCTEON_SOC
	help
	  CVMSEG LM is a segment that accesses portions of the dcache as a
	  local memory; the larger CVMSEG is, the smaller the cache is.
	  This selects the size of CVMSEG LM, which is in cache blocks. The
	  legally range is from zero to 54 cache blocks (i.e. CVMSEG LM is
	  between zero and 6192 bytes).

config CRYPTO_SHA256_OCTEON
	tristate
	default CRYPTO_LIB_SHA256
	select CRYPTO_ARCH_HAVE_LIB_SHA256
	select CRYPTO_LIB_SHA256_GENERIC

endif # CPU_CAVIUM_OCTEON

if CAVIUM_OCTEON_SOC

config CAVIUM_OCTEON_LOCK_L2
	bool "Lock often used kernel code in the L2"
	default "y"
	help
	  Enable locking parts of the kernel into the L2 cache.

config CAVIUM_OCTEON_LOCK_L2_TLB
	bool "Lock the TLB handler in L2"
	depends on CAVIUM_OCTEON_LOCK_L2
	default "y"
	help
	  Lock the low level TLB fast path into L2.

config CAVIUM_OCTEON_LOCK_L2_EXCEPTION
	bool "Lock the exception handler in L2"
	depends on CAVIUM_OCTEON_LOCK_L2
	default "y"
	help
	  Lock the low level exception handler into L2.

config CAVIUM_OCTEON_LOCK_L2_LOW_LEVEL_INTERRUPT
	bool "Lock the interrupt handler in L2"
	depends on CAVIUM_OCTEON_LOCK_L2
	default "y"
	help
	  Lock the low level interrupt handler into L2.

config CAVIUM_OCTEON_LOCK_L2_INTERRUPT
	bool "Lock the 2nd level interrupt handler in L2"
	depends on CAVIUM_OCTEON_LOCK_L2
	default "y"
	help
	  Lock the 2nd level interrupt handler in L2.

config CAVIUM_OCTEON_LOCK_L2_MEMCPY
	bool "Lock memcpy() in L2"
	depends on CAVIUM_OCTEON_LOCK_L2
	default "y"
	help
	  Lock the kernel's implementation of memcpy() into L2.

config CAVIUM_RESERVE32
	int "Memory to reserve for user processes shared region (MB)"
	range 0 1536
	default "0"
	help
	  Reserve a shared memory region for user processes to use for hardware
	  memory buffers. This is required for 32bit applications to be able to
	  send and receive packets directly. Applications access this memory by
	  memory mapping /dev/mem for the addresses in /proc/octeon_info. For
	  optimal performance with HugeTLBs, keep this size an even number of
	  megabytes.

config OCTEON_ILM
	tristate "Module to measure interrupt latency using Octeon CIU Timer"
	help
	  This driver is a module to measure interrupt latency using the
	  the CIU Timers on Octeon.

	  To compile this driver as a module, choose M here.  The module
	  will be called octeon-ilm

endif # CAVIUM_OCTEON_SOC
```

## arch/mips/cobalt/Kconfig
```kconfig
config EARLY_PRINTK
	bool "Early console support"
	depends on MIPS_COBALT
	help
	  Provide early console support by direct access to the
	  on board UART. The UART must have been previously
	  initialised by the boot loader.
```

## arch/mips/configs/ar7_defconfig
```kconfig
CONFIG_AR7=y
CONFIG_HIGH_RES_TIMERS=y
CONFIG_HZ_100=y
CONFIG_KEXEC=y
# CONFIG_SECCOMP is not set
CONFIG_EXPERIMENTAL=y
# CONFIG_LOCALVERSION_AUTO is not set
CONFIG_KERNEL_LZMA=y
CONFIG_SYSVIPC=y
CONFIG_BSD_PROCESS_ACCT=y
CONFIG_TINY_RCU=y
CONFIG_LOG_BUF_SHIFT=14
CONFIG_SYSFS_DEPRECATED_V2=y
CONFIG_RELAY=y
CONFIG_BLK_DEV_INITRD=y
CONFIG_RD_LZMA=y
CONFIG_EXPERT=y
# CONFIG_KALLSYMS is not set
# CONFIG_ELF_CORE is not set
# CONFIG_PCSPKR_PLATFORM is not set
# CONFIG_VM_EVENT_COUNTERS is not set
# CONFIG_COMPAT_BRK is not set
CONFIG_SLAB=y
CONFIG_MODULES=y
CONFIG_MODULE_UNLOAD=y
# CONFIG_LBDAF is not set
# CONFIG_BLK_DEV_BSG is not set
# CONFIG_IOSCHED_CFQ is not set
CONFIG_NET=y
CONFIG_PACKET=y
CONFIG_UNIX=y
CONFIG_INET=y
CONFIG_IP_MULTICAST=y
CONFIG_IP_ADVANCED_ROUTER=y
CONFIG_IP_MULTIPLE_TABLES=y
CONFIG_IP_ROUTE_MULTIPATH=y
CONFIG_IP_ROUTE_VERBOSE=y
CONFIG_IP_MROUTE=y
CONFIG_ARPD=y
CONFIG_SYN_COOKIES=y
# CONFIG_INET_XFRM_MODE_TRANSPORT is not set
# CONFIG_INET_XFRM_MODE_TUNNEL is not set
# CONFIG_INET_XFRM_MODE_BEET is not set
# CONFIG_INET_LRO is not set
# CONFIG_INET_DIAG is not set
CONFIG_TCP_CONG_ADVANCED=y
# CONFIG_TCP_CONG_BIC is not set
# CONFIG_TCP_CONG_CUBIC is not set
CONFIG_TCP_CONG_WESTWOOD=y
# CONFIG_TCP_CONG_HTCP is not set
# CONFIG_IPV6 is not set
CONFIG_NETFILTER=y
# CONFIG_BRIDGE_NETFILTER is not set
CONFIG_NF_CONNTRACK=m
CONFIG_NF_CONNTRACK_MARK=y
CONFIG_NF_CONNTRACK_FTP=m
CONFIG_NF_CONNTRACK_IRC=m
CONFIG_NF_CONNTRACK_TFTP=m
CONFIG_NETFILTER_XT_TARGET_NOTRACK=m
CONFIG_NETFILTER_XT_TARGET_TCPMSS=m
CONFIG_NETFILTER_XT_MATCH_LIMIT=m
CONFIG_NETFILTER_XT_MATCH_MAC=m
CONFIG_NETFILTER_XT_MATCH_MULTIPORT=m
CONFIG_NETFILTER_XT_MATCH_STATE=m
CONFIG_NF_CONNTRACK_IPV4=m
CONFIG_IP_NF_IPTABLES=m
CONFIG_IP_NF_FILTER=m
CONFIG_IP_NF_TARGET_REJECT=m
CONFIG_IP_NF_TARGET_LOG=m
CONFIG_NF_NAT=m
CONFIG_IP_NF_TARGET_MASQUERADE=m
CONFIG_IP_NF_MANGLE=m
CONFIG_IP_NF_RAW=m
CONFIG_ATM=m
CONFIG_ATM_BR2684=m
CONFIG_ATM_BR2684_IPFILTER=y
CONFIG_BRIDGE=y
CONFIG_VLAN_8021Q=y
CONFIG_NET_SCHED=y
CONFIG_NET_CLS_ACT=y
CONFIG_NET_ACT_POLICE=y
CONFIG_HAMRADIO=y
CONFIG_CFG80211=m
CONFIG_MAC80211=m
CONFIG_MAC80211_RC_PID=y
CONFIG_MAC80211_RC_DEFAULT_PID=y
CONFIG_UEVENT_HELPER_PATH="/sbin/hotplug"
# CONFIG_FIRMWARE_IN_KERNEL is not set
CONFIG_MTD=y
CONFIG_MTD_PARTITIONS=y
CONFIG_MTD_CHAR=y
CONFIG_MTD_BLOCK=y
CONFIG_MTD_CFI=y
CONFIG_MTD_CFI_INTELEXT=y
CONFIG_MTD_CFI_AMDSTD=y
CONFIG_MTD_CFI_STAA=y
CONFIG_MTD_COMPLEX_MAPPINGS=y
CONFIG_MTD_PHYSMAP=y
CONFIG_NETDEVICES=y
CONFIG_FIXED_PHY=y
CONFIG_NET_ETHERNET=y
CONFIG_MII=y
CONFIG_CPMAC=y
# CONFIG_NETDEV_1000 is not set
# CONFIG_NETDEV_10000 is not set
CONFIG_PPP=m
CONFIG_PPP_MULTILINK=y
CONFIG_PPP_FILTER=y
CONFIG_PPP_ASYNC=m
CONFIG_PPPOE=m
CONFIG_PPPOATM=m
# CONFIG_INPUT is not set
# CONFIG_SERIO is not set
# CONFIG_VT is not set
# CONFIG_DEVKMEM is not set
CONFIG_SERIAL_8250=y
CONFIG_SERIAL_8250_CONSOLE=y
CONFIG_SERIAL_8250_NR_UARTS=2
CONFIG_SERIAL_8250_RUNTIME_UARTS=2
# CONFIG_LEGACY_PTYS is not set
CONFIG_HW_RANDOM=y
CONFIG_GPIO_SYSFS=y
# CONFIG_HWMON is not set
CONFIG_WATCHDOG=y
CONFIG_AR7_WDT=y
# CONFIG_USB_SUPPORT is not set
CONFIG_NEW_LEDS=y
CONFIG_LEDS_CLASS=y
CONFIG_LEDS_GPIO=y
CONFIG_LEDS_TRIGGERS=y
CONFIG_LEDS_TRIGGER_TIMER=y
CONFIG_LEDS_TRIGGER_HEARTBEAT=y
CONFIG_LEDS_TRIGGER_DEFAULT_ON=y
# CONFIG_DNOTIFY is not set
CONFIG_PROC_KCORE=y
# CONFIG_PROC_PAGE_MONITOR is not set
CONFIG_TMPFS=y
CONFIG_JFFS2_FS=y
CONFIG_JFFS2_SUMMARY=y
CONFIG_JFFS2_COMPRESSION_OPTIONS=y
CONFIG_SQUASHFS=y
CONFIG_PARTITION_ADVANCED=y
CONFIG_BSD_DISKLABEL=y
# CONFIG_ENABLE_MUST_CHECK is not set
CONFIG_STRIP_ASM_SYMS=y
CONFIG_DEBUG_FS=y
CONFIG_SYSCTL_SYSCALL_CHECK=y
CONFIG_CMDLINE_BOOL=y
CONFIG_CMDLINE="rootfstype=squashfs,jffs2"
CONFIG_CRYPTO=y
# CONFIG_CRYPTO_ANSI_CPRNG is not set
# CONFIG_CRYPTO_HW is not set
```
