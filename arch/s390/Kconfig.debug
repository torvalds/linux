## arch/s390/Kconfig.debug
```kconfig
# SPDX-License-Identifier: GPL-2.0

config EARLY_PRINTK
	def_bool y

config DEBUG_ENTRY
	bool "Debug low-level entry code"
	depends on DEBUG_KERNEL
	help
	  This option enables sanity checks in s390 low-level entry code.
	  Some of these sanity checks may slow down kernel entries and
	  exits or otherwise impact performance.

	  If unsure, say N.

config STRICT_MM_TYPECHECKS
	bool "Strict Memory Management Type Checks"
	depends on DEBUG_KERNEL
	help
	  Enable strict type checking for memory management types like pte_t
	  and pmd_t. This generates slightly worse code and should be used
	  for debug builds.

	  If unsure, say N.

config CIO_INJECT
	bool "CIO Inject interfaces"
	depends on DEBUG_KERNEL && DEBUG_FS
	help
	  This option provides a debugging facility to inject certain artificial events
	  and instruction responses to the CIO layer of Linux kernel. The newly created
	  debugfs user-interfaces will be at /sys/kernel/debug/s390/cio/*
```
