## arch/sh/boards/mach-rsk/Kconfig
```kconfig
# SPDX-License-Identifier: GPL-2.0
if SH_RSK

choice
	prompt "RSK+ options"
	default SH_RSK7203

config SH_RSK7201
	bool "RSK7201"
	depends on CPU_SUBTYPE_SH7201

config SH_RSK7203
	bool "RSK7203"
	select GPIOLIB
	depends on CPU_SUBTYPE_SH7203

config SH_RSK7264
	bool "RSK2+SH7264"
	select GPIOLIB
	depends on CPU_SUBTYPE_SH7264

config SH_RSK7269
	bool "RSK2+SH7269"
	select GPIOLIB
	depends on CPU_SUBTYPE_SH7269

endchoice

endif
```

## arch/sh/boards/mach-sdk7780/Kconfig
```kconfig
if SH_SDK7780

choice
	prompt "SDK7780 options"
	default SH_SDK7780_BASE

config SH_SDK7780_BASE
	bool "SDK7780 with base-board support"
	depends on CPU_SUBTYPE_SH7780
	help
	  Selecting this option will enable support for the expansion
	  baseboard devices. If in doubt, say Y.

endchoice

endif
```

## arch/sh/boards/magicpanelr2/Kconfig
```kconfig
if SH_MAGIC_PANEL_R2

menu "Magic Panel R2 options"

config SH_MAGIC_PANEL_R2_VERSION
	int SH_MAGIC_PANEL_R2_VERSION
	default "3"
	help
	  Set the version of the Magic Panel R2

endmenu

endif
```

## arch/sh/boards/renesas/hs7751rvoip/Kconfig
```kconfig
if SH_HS7751RVOIP

menu "HS7751RVoIP options"

config HS7751RVOIP_CODEC
	bool "Support VoIP Codec section"
	help
	  Selecting this option will support CODEC section.

endmenu

endif
```

## arch/sh/boards/renesas/r7780rp/Kconfig
```kconfig
if SH_R7780RP

menu "R7780RP options"

config SH_R7780MP
	bool "R7780MP board support"
	default y
	help
	  Selecting this option will enable support for the mass-production
	  version of the R7780RP. If in doubt, say Y.

endmenu

endif
```

## arch/sh/boards/renesas/rts7751r2d/Kconfig
```kconfig
if SH_RTS7751R2D

menu "RTS7751R2D Board Revision"

config RTS7751R2D_PLUS
	bool "R2D-PLUS"
	help
	  Selecting this option will configure the kernel for R2D-PLUS.

	  R2D-PLUS is the smaller of the two R2D board versions, equipped
	  with a single PCI slot.

config RTS7751R2D_1
	bool "R2D-1"
	help
	  Selecting this option will configure the kernel for R2D-1.

	  R2D-1 is the larger of the two R2D board versions, equipped
	  with two PCI slots.
endmenu

endif
```

## arch/sh/cchips/Kconfig
```kconfig
menu "Companion Chips"

config VOYAGERGX
	bool "VoyagerGX chip support"
	depends on SH_RTS7751R2D
	help
	  Selecting this option will support Silicon Motion, Inc. SM501.
	  Designed to complement needs for the embedded industry, it
	  provides video and 2D capability. To reduce system cost a
	  wide variety of include I/O is supported, including analog RGB
	  and digital LCD Panel interface, 8-bit parallel interface, USB,
	  UART, IrDA, Zoom Video, AC97 or I2S, SSP, PWM, and I2C. There
	  are additional GPIO bits that can be used to interface to
	  external as well.

# A board must have defined HD6446X_SERIES in order to see these
config HD6446X_SERIES
	bool "HD6446x support"
	default n

choice
	prompt "HD6446x options"
	depends on HD6446X_SERIES
	default HD64461

config HD64461
	bool "Hitachi HD64461 companion chip support"
	depends on CPU_SUBTYPE_SH7709
	---help---
	  The Hitachi HD64461 provides an interface for
	  the SH7709 CPU, supporting a LCD controller,
	  CRT color controller, IrDA up to 4 Mbps, and a
	  PCMCIA controller supporting 2 slots.

	  More information is available at
	  <http://semiconductor.hitachi.com/windowsce/superh/sld013.htm>.

	  Say Y if you want support for the HD64461.
	  Otherwise, say N.

config HD64465
	bool "Hitachi HD64465 companion chip support"
	depends on CPU_SUBTYPE_SH7750
	---help---
	  The Hitachi HD64465 provides an interface for
	  the SH7750 CPU, supporting a LCD controller,
	  CRT color controller, IrDA, USB, PCMCIA,
	  keyboard controller, and a printer interface.

	  More information is available at
	  <http://global.hitachi.com/New/cnews/E/1998/981019B.html>.

	  Say Y if you want support for the HD64465.
	  Otherwise, say N.

endchoice

# These will also be split into the Kconfig's below
config HD64461_IRQ
	int "HD64461 IRQ"
	depends on HD64461
	default "36"
	help
	  The default setting of the HD64461 IRQ is 36.

	  Do not change this unless you know what you are doing.

config HD64461_IOBASE
	hex "HD64461 start address"
	depends on HD64461
	default "0xb0000000"

config HD64461_ENABLER
	bool "HD64461 PCMCIA enabler"
	depends on HD64461
	help
	  Say Y here if you want to enable PCMCIA support
	  via the HD64461 companion chip.
	  Otherwise, say N.

config HD64465_IOBASE
	hex "HD64465 start address"
	depends on HD64465
	default "0xb0000000"
	help
	  The default setting of the HD64465 IO base address is 0xb0000000.

	  Do not change this unless you know what you are doing.

config HD64465_IRQ
	int "HD64465 IRQ"
	depends on HD64465
	default "5"
	help
	  The default setting of the HD64465 IRQ is 5.

	  Do not change this unless you know what you are doing.

endmenu
```

## arch/sh/configs/ap325rxa_defconfig
```kconfig
CONFIG_EXPERIMENTAL=y
# CONFIG_LOCALVERSION_AUTO is not set
CONFIG_SYSVIPC=y
CONFIG_BSD_PROCESS_ACCT=y
CONFIG_LOG_BUF_SHIFT=14
CONFIG_SYSFS_DEPRECATED_V2=y
# CONFIG_KALLSYMS is not set
CONFIG_SLAB=y
CONFIG_MODULES=y
CONFIG_MODULE_UNLOAD=y
# CONFIG_BLK_DEV_BSG is not set
CONFIG_CPU_SUBTYPE_SH7723=y
CONFIG_MEMORY_SIZE=0x08000000
CONFIG_FLATMEM_MANUAL=y
CONFIG_SH_AP325RXA=y
# CONFIG_SH_TIMER_CMT is not set
CONFIG_HIGH_RES_TIMERS=y
CONFIG_SECCOMP=y
CONFIG_PREEMPT=y
CONFIG_CMDLINE_OVERWRITE=y
CONFIG_CMDLINE="console=tty1 console=ttySC5,38400 root=/dev/nfs ip=dhcp"
CONFIG_NET=y
CONFIG_PACKET=y
CONFIG_UNIX=y
CONFIG_INET=y
CONFIG_IP_ADVANCED_ROUTER=y
CONFIG_IP_PNP=y
CONFIG_IP_PNP_DHCP=y
# CONFIG_INET_XFRM_MODE_TRANSPORT is not set
# CONFIG_INET_XFRM_MODE_TUNNEL is not set
# CONFIG_INET_XFRM_MODE_BEET is not set
# CONFIG_INET_LRO is not set
# CONFIG_IPV6 is not set
CONFIG_UEVENT_HELPER_PATH="/sbin/hotplug"
CONFIG_MTD=y
CONFIG_MTD_CONCAT=y
CONFIG_MTD_PARTITIONS=y
CONFIG_MTD_CMDLINE_PARTS=y
CONFIG_MTD_CHAR=y
CONFIG_MTD_BLOCK=y
CONFIG_MTD_CFI=y
CONFIG_MTD_CFI_AMDSTD=y
CONFIG_MTD_PHYSMAP=y
CONFIG_MTD_NAND=y
CONFIG_MTD_NAND_SH_FLCTL=y
CONFIG_MTD_UBI=y
CONFIG_BLK_DEV_RAM=y
CONFIG_BLK_DEV_RAM_COUNT=4
CONFIG_SCSI=y
CONFIG_BLK_DEV_SD=y
CONFIG_NETDEVICES=y
CONFIG_SMSC_PHY=y
CONFIG_NET_ETHERNET=y
CONFIG_SMSC911X=y
# CONFIG_NETDEV_1000 is not set
# CONFIG_NETDEV_10000 is not set
# CONFIG_INPUT_MOUSEDEV is not set
# CONFIG_INPUT_KEYBOARD is not set
# CONFIG_INPUT_MOUSE is not set
# CONFIG_SERIO is not set
CONFIG_VT_HW_CONSOLE_BINDING=y
CONFIG_SERIAL_SH_SCI=y
CONFIG_SERIAL_SH_SCI_NR_UARTS=6
CONFIG_SERIAL_SH_SCI_CONSOLE=y
CONFIG_HW_RANDOM=y
CONFIG_I2C=y
CONFIG_I2C_CHARDEV=y
CONFIG_I2C_SH_MOBILE=y
CONFIG_SPI=y
CONFIG_SPI_GPIO=y
# CONFIG_HWMON is not set
CONFIG_MEDIA_SUPPORT=y
CONFIG_VIDEO_DEV=y
# CONFIG_VIDEO_ALLOW_V4L1 is not set
# CONFIG_MEDIA_TUNER_CUSTOMISE is not set
CONFIG_VIDEO_HELPER_CHIPS_AUTO=y
CONFIG_SOC_CAMERA=y
CONFIG_SOC_CAMERA_PLATFORM=y
CONFIG_SOC_CAMERA_OV772X=y
CONFIG_VIDEO_SH_MOBILE_CEU=y
# CONFIG_RADIO_ADAPTERS is not set
CONFIG_FB=y
CONFIG_FB_SH_MOBILE_LCDC=y
CONFIG_FRAMEBUFFER_CONSOLE=y
CONFIG_LOGO=y
# CONFIG_HID_SUPPORT is not set
# CONFIG_USB_SUPPORT is not set
CONFIG_MMC=y
CONFIG_MMC_SPI=y
CONFIG_RTC_CLASS=y
CONFIG_RTC_DRV_PCF8563=y
CONFIG_UIO=y
CONFIG_UIO_PDRV_GENIRQ=y
CONFIG_EXT2_FS=y
CONFIG_EXT2_FS_XATTR=y
CONFIG_EXT2_FS_POSIX_ACL=y
CONFIG_EXT2_FS_SECURITY=y
CONFIG_EXT3_FS=y
# CONFIG_EXT3_DEFAULTS_TO_ORDERED is not set
CONFIG_EXT3_FS_POSIX_ACL=y
CONFIG_EXT3_FS_SECURITY=y
CONFIG_VFAT_FS=y
CONFIG_PROC_KCORE=y
CONFIG_TMPFS=y
CONFIG_NFS_FS=y
CONFIG_NFS_V3=y
CONFIG_ROOT_NFS=y
CONFIG_NFSD=y
CONFIG_NFSD_V3=y
CONFIG_NLS_CODEPAGE_437=y
CONFIG_NLS_CODEPAGE_932=y
CONFIG_NLS_ISO8859_1=y
# CONFIG_ENABLE_MUST_CHECK is not set
# CONFIG_RCU_CPU_STALL_DETECTOR is not set
CONFIG_SYSCTL_SYSCALL_CHECK=y
CONFIG_CRYPTO=y
CONFIG_CRYPTO_CBC=y
# CONFIG_CRYPTO_ANSI_CPRNG is not set
CONFIG_CRC_T10DIF=y
```
