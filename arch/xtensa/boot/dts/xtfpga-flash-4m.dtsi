/ {
	flash: flash@f8000000 {
		#address-cells = <1>;
		#size-cells = <1>;
		compatible = "cfi-flash";
		reg = <0xf8000000 0x00400000>;
		bank-width = <2>;
		device-width = <2>;
		partition@0x0 {
			label = "boot loader area";
			reg = <0x00000000 0x003f0000>;
		};
		partition@0x3f0000 {
			label = "boot environment";
			reg = <0x003f0000 0x00010000>;
		};
        };
};
