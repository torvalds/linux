// SPDX-License-Identifier: GPL-2.0
/dts-v1/;
/include/ "xtfpga.dtsi"
/include/ "xtfpga-flash-128m.dtsi"

/ {
	compatible = "cdns,xtensa-kc705";
	chosen {
		bootargs = "earlycon=uart8250,mmio32,0x9d050020,115200n8 console=ttyS0,115200n8 ip=dhcp root=/dev/nfs rw debug";
	};
	memory@0 {
		device_type = "memory";
		reg = <0x60000000 0x10000000>;
	};
	soc {
		ranges = <0x00000000 0x90000000 0x10000000>;
	};
};
