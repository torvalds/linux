## arch/x86/Kconfig.assembler
```kconfig
# SPDX-License-Identifier: GPL-2.0
# Copyright (C) 2020 Jason A. Donenfeld <Jason@zx2c4.com>. All Rights Reserved.

config AS_WRUSS
	def_bool $(as-instr64,wrussq %rax$(comma)(%rbx))
	help
	  Supported by binutils >= 2.31 and LLVM integrated assembler
```
