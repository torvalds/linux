## arch/x86/lib/crypto/Kconfig
```kconfig
# SPDX-License-Identifier: GPL-2.0-only

config CRYPTO_BLAKE2S_X86
	bool "Hash functions: BLAKE2s (SSSE3/AVX-512)"
	depends on 64BIT
	select CRYPTO_LIB_BLAKE2S_GENERIC
	select CRYPTO_ARCH_HAVE_LIB_BLAKE2S
	help
	  BLAKE2s cryptographic hash function (RFC 7693)

	  Architecture: x86_64 using:
	  - SSSE3 (Supplemental SSE3)
	  - AVX-512 (Advanced Vector Extensions-512)

config CRYPTO_CHACHA20_X86_64
	tristate
	depends on 64BIT
	default CRYPTO_LIB_CHACHA
	select CRYPTO_LIB_CHACHA_GENERIC
	select CRYPTO_ARCH_HAVE_LIB_CHACHA

config CRYPTO_POLY1305_X86_64
	tristate
	depends on 64BIT
	default CRYPTO_LIB_POLY1305
	select CRYPTO_ARCH_HAVE_LIB_POLY1305

config CRYPTO_SHA256_X86_64
	tristate
	depends on 64BIT
	default CRYPTO_LIB_SHA256
	select CRYPTO_ARCH_HAVE_LIB_SHA256
	select CRYPTO_ARCH_HAVE_LIB_SHA256_SIMD
	select CRYPTO_LIB_SHA256_GENERIC
```

## arch/x86/ras/Kconfig
```kconfig
# SPDX-License-Identifier: GPL-2.0
config RAS_CEC
	bool "Correctable Errors Collector"
	depends on X86_MCE && MEMORY_FAILURE && DEBUG_FS
	---help---
	  This is a small cache which collects correctable memory errors per 4K
	  page PFN and counts their repeated occurrence. Once the counter for a
	  PFN overflows, we try to soft-offline that page as we take it to mean
	  that it has reached a relatively high error count and would probably
	  be best if we don't use it anymore.

	  Bear in mind that this is absolutely useless if your platform doesn't
	  have ECC DIMMs and doesn't have DRAM ECC checking enabled in the BIOS.

config RAS_CEC_DEBUG
	bool "CEC debugging machinery"
	default n
	depends on RAS_CEC
	help
	  Add extra files to (debugfs)/ras/cec to test the correctable error
	  collector feature. "pfn" is a writable file that allows user to
	  simulate an error in a particular page frame. "array" is a read-only
	  file that dumps out the current state of all pages logged so far.
```

## arch/x86/um/Kconfig
```kconfig
# SPDX-License-Identifier: GPL-2.0

menu "Host processor type and features"

source "arch/x86/Kconfig.cpu"

endmenu

config UML_X86
	def_bool y
	select ARCH_BINFMT_ELF_EXTRA_PHDRS if X86_32
	select DCACHE_WORD_ACCESS
	select HAVE_EFFICIENT_UNALIGNED_ACCESS

config 64BIT
	bool "64-bit kernel" if "$(SUBARCH)" = "x86"
	default "$(SUBARCH)" != "i386"

config X86_32
	def_bool !64BIT
	select ARCH_32BIT_OFF_T
	select ARCH_WANT_IPC_PARSE_VERSION
	select MODULES_USE_ELF_REL
	select CLONE_BACKWARDS
	select OLD_SIGSUSPEND3
	select OLD_SIGACTION

config X86_64
	def_bool 64BIT
	select MODULES_USE_ELF_RELA

config ARCH_HAS_SC_SIGNALS
	def_bool !64BIT

config ARCH_REUSE_HOST_VSYSCALL_AREA
	def_bool !64BIT

config GENERIC_HWEIGHT
	def_bool y
```

## arch/x86/xen/Kconfig
```kconfig
# SPDX-License-Identifier: GPL-2.0
#
# This Kconfig describes xen options
#

config XEN
	bool "Xen guest support"
	depends on PARAVIRT
	select PARAVIRT_CLOCK
	depends on X86_64 || (X86_32 && X86_PAE)
	depends on X86_LOCAL_APIC && X86_TSC
	help
	  This is the Linux Xen port.  Enabling this will allow the
	  kernel to boot in a paravirtualized environment under the
	  Xen hypervisor.

config XEN_PV
	bool "Xen PV guest support"
	default y
	depends on XEN
	select XEN_HAVE_PVMMU
	select XEN_HAVE_VPMU
	help
	  Support running as a Xen PV guest.

config XEN_PV_SMP
	def_bool y
	depends on XEN_PV && SMP

config XEN_DOM0
	bool "Xen PV Dom0 support"
	default y
	depends on XEN_PV && PCI_XEN && SWIOTLB_XEN
	depends on X86_IO_APIC && ACPI && PCI
	help
	  Support running as a Xen PV Dom0 guest.

config XEN_PVHVM
	bool "Xen PVHVM guest support"
	default y
	depends on XEN && PCI && X86_LOCAL_APIC
	help
	  Support running as a Xen PVHVM guest.

config XEN_PVHVM_SMP
	def_bool y
	depends on XEN_PVHVM && SMP

config XEN_512GB
	bool "Limit Xen pv-domain memory to 512GB"
	depends on XEN_PV && X86_64
	default y
	help
	  Limit paravirtualized user domains to 512GB of RAM.

	  The Xen tools and crash dump analysis tools might not support
	  pv-domains with more than 512 GB of RAM. This option controls the
	  default setting of the kernel to use only up to 512 GB or more.
	  It is always possible to change the default via specifying the
	  boot parameter "xen_512gb_limit".

config XEN_SAVE_RESTORE
       bool
       depends on XEN
       select HIBERNATE_CALLBACKS
       default y

config XEN_DEBUG_FS
	bool "Enable Xen debug and tuning parameters in debugfs"
	depends on XEN && DEBUG_FS
	default n
	help
	  Enable statistics output and various tuning options in debugfs.
	  Enabling this option may incur a significant performance overhead.

config XEN_PVH
	bool "Support for running as a PVH guest"
	depends on XEN && XEN_PVHVM && ACPI
	def_bool n
```
