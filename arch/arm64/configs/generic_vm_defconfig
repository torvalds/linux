## arch/arm64/crypto/Kconfig
```kconfig
# SPDX-License-Identifier: GPL-2.0

menu "Accelerated Cryptographic Algorithms for CPU (arm64)"

config CRYPTO_GHASH_ARM64_CE
	tristate "Hash functions: GHASH (ARMv8 Crypto Extensions)"
	depends on KERNEL_MODE_NEON
	select CRYPTO_HASH
	select CRYPTO_GF128MUL
	select CRYPTO_LIB_AES
	select CRYPTO_AEAD
	help
	  GCM GHASH function (NIST SP800-38D)

	  Architecture: arm64 using:
	  - ARMv8 Crypto Extensions

config CRYPTO_NHPOLY1305_NEON
	tristate "Hash functions: NHPoly1305 (NEON)"
	depends on KERNEL_MODE_NEON
	select CRYPTO_NHPOLY1305
	help
	  NHPoly1305 hash function (Adiantum)

	  Architecture: arm64 using:
	  - NEON (Advanced SIMD) extensions

config CRYPTO_POLY1305_NEON
	tristate "Hash functions: Poly1305 (NEON)"
	depends on KERNEL_MODE_NEON
	select CRYPTO_HASH
	select CRYPTO_ARCH_HAVE_LIB_POLY1305
	help
	  Poly1305 authenticator algorithm (RFC7539)

	  Architecture: arm64 using:
	  - NEON (Advanced SIMD) extensions

config CRYPTO_SHA1_ARM64_CE
	tristate "Hash functions: SHA-1 (ARMv8 Crypto Extensions)"
	depends on KERNEL_MODE_NEON
	select CRYPTO_HASH
	select CRYPTO_SHA1
	help
	  SHA-1 secure hash algorithm (FIPS 180)

	  Architecture: arm64 using:
	  - ARMv8 Crypto Extensions

config CRYPTO_SHA256_ARM64
	tristate "Hash functions: SHA-224 and SHA-256"
	select CRYPTO_HASH
	help
	  SHA-224 and SHA-256 secure hash algorithms (FIPS 180)

	  Architecture: arm64

config CRYPTO_SHA2_ARM64_CE
	tristate "Hash functions: SHA-224 and SHA-256 (ARMv8 Crypto Extensions)"
	depends on KERNEL_MODE_NEON
	select CRYPTO_HASH
	select CRYPTO_SHA256_ARM64
	help
	  SHA-224 and SHA-256 secure hash algorithms (FIPS 180)

	  Architecture: arm64 using:
	  - ARMv8 Crypto Extensions

config CRYPTO_SHA512_ARM64
	tristate "Hash functions: SHA-384 and SHA-512"
	select CRYPTO_HASH
	help
	  SHA-384 and SHA-512 secure hash algorithms (FIPS 180)

	  Architecture: arm64

config CRYPTO_SHA512_ARM64_CE
	tristate "Hash functions: SHA-384 and SHA-512 (ARMv8 Crypto Extensions)"
	depends on KERNEL_MODE_NEON
	select CRYPTO_HASH
	select CRYPTO_SHA512_ARM64
	help
	  SHA-384 and SHA-512 secure hash algorithms (FIPS 180)

	  Architecture: arm64 using:
	  - ARMv8 Crypto Extensions

config CRYPTO_SHA3_ARM64
	tristate "Hash functions: SHA-3 (ARMv8.2 Crypto Extensions)"
	depends on KERNEL_MODE_NEON
	select CRYPTO_HASH
	select CRYPTO_SHA3
	help
	  SHA-3 secure hash algorithms (FIPS 202)

	  Architecture: arm64 using:
	  - ARMv8.2 Crypto Extensions

config CRYPTO_SM3_NEON
	tristate "Hash functions: SM3 (NEON)"
	depends on KERNEL_MODE_NEON
	select CRYPTO_HASH
	select CRYPTO_SM3
	help
	  SM3 (ShangMi 3) secure hash function (OSCCA GM/T 0004-2012)

	  Architecture: arm64 using:
	  - NEON (Advanced SIMD) extensions

config CRYPTO_SM3_ARM64_CE
	tristate "Hash functions: SM3 (ARMv8.2 Crypto Extensions)"
	depends on KERNEL_MODE_NEON
	select CRYPTO_HASH
	select CRYPTO_SM3
	help
	  SM3 (ShangMi 3) secure hash function (OSCCA GM/T 0004-2012)

	  Architecture: arm64 using:
	  - ARMv8.2 Crypto Extensions

config CRYPTO_POLYVAL_ARM64_CE
	tristate "Hash functions: POLYVAL (ARMv8 Crypto Extensions)"
	depends on KERNEL_MODE_NEON
	select CRYPTO_POLYVAL
	help
	  POLYVAL hash function for HCTR2

	  Architecture: arm64 using:
	  - ARMv8 Crypto Extensions

config CRYPTO_AES_ARM64
	tristate "Ciphers: AES, modes: ECB, CBC, CTR, CTS, XCTR, XTS"
	select CRYPTO_AES
	help
	  Block ciphers: AES cipher algorithms (FIPS-197)
	  Length-preserving ciphers: AES with ECB, CBC, CTR, CTS,
	    XCTR, and XTS modes
	  AEAD cipher: AES with CBC, ESSIV, and SHA-256
	    for fscrypt and dm-crypt

	  Architecture: arm64

config CRYPTO_AES_ARM64_CE
	tristate "Ciphers: AES (ARMv8 Crypto Extensions)"
	depends on ARM64 && KERNEL_MODE_NEON
	select CRYPTO_ALGAPI
	select CRYPTO_LIB_AES
	help
	  Block ciphers: AES cipher algorithms (FIPS-197)

	  Architecture: arm64 using:
	  - ARMv8 Crypto Extensions

config CRYPTO_AES_ARM64_CE_BLK
	tristate "Ciphers: AES, modes: ECB/CBC/CTR/XTS (ARMv8 Crypto Extensions)"
	depends on KERNEL_MODE_NEON
	select CRYPTO_SKCIPHER
	select CRYPTO_AES_ARM64_CE
	help
	  Length-preserving ciphers: AES cipher algorithms (FIPS-197)
	  with block cipher modes:
	  - ECB (Electronic Codebook) mode (NIST SP800-38A)
	  - CBC (Cipher Block Chaining) mode (NIST SP800-38A)
	  - CTR (Counter) mode (NIST SP800-38A)
	  - XTS (XOR Encrypt XOR with ciphertext stealing) mode (NIST SP800-38E
	    and IEEE 1619)

	  Architecture: arm64 using:
	  - ARMv8 Crypto Extensions

config CRYPTO_AES_ARM64_NEON_BLK
	tristate "Ciphers: AES, modes: ECB/CBC/CTR/XTS (NEON)"
	depends on KERNEL_MODE_NEON
	select CRYPTO_SKCIPHER
	select CRYPTO_LIB_AES
	help
	  Length-preserving ciphers: AES cipher algorithms (FIPS-197)
	  with block cipher modes:
	  - ECB (Electronic Codebook) mode (NIST SP800-38A)
	  - CBC (Cipher Block Chaining) mode (NIST SP800-38A)
	  - CTR (Counter) mode (NIST SP800-38A)
	  - XTS (XOR Encrypt XOR with ciphertext stealing) mode (NIST SP800-38E
	    and IEEE 1619)

	  Architecture: arm64 using:
	  - NEON (Advanced SIMD) extensions

config CRYPTO_CHACHA20_NEON
	tristate "Ciphers: ChaCha (NEON)"
	depends on KERNEL_MODE_NEON
	select CRYPTO_SKCIPHER
	select CRYPTO_LIB_CHACHA_GENERIC
	select CRYPTO_ARCH_HAVE_LIB_CHACHA
	help
	  Length-preserving ciphers: ChaCha20, XChaCha20, and XChaCha12
	  stream cipher algorithms

	  Architecture: arm64 using:
	  - NEON (Advanced SIMD) extensions

config CRYPTO_AES_ARM64_BS
	tristate "Ciphers: AES, modes: ECB/CBC/CTR/XCTR/XTS modes (bit-sliced NEON)"
	depends on KERNEL_MODE_NEON
	select CRYPTO_SKCIPHER
	select CRYPTO_AES_ARM64_NEON_BLK
	select CRYPTO_LIB_AES
	help
	  Length-preserving ciphers: AES cipher algorithms (FIPS-197)
	  with block cipher modes:
	  - ECB (Electronic Codebook) mode (NIST SP800-38A)
	  - CBC (Cipher Block Chaining) mode (NIST SP800-38A)
	  - CTR (Counter) mode (NIST SP800-38A)
	  - XCTR mode for HCTR2
	  - XTS (XOR Encrypt XOR with ciphertext stealing) mode (NIST SP800-38E
	    and IEEE 1619)

	  Architecture: arm64 using:
	  - bit-sliced algorithm
	  - NEON (Advanced SIMD) extensions

config CRYPTO_SM4_ARM64_CE
	tristate "Ciphers: SM4 (ARMv8.2 Crypto Extensions)"
	depends on KERNEL_MODE_NEON
	select CRYPTO_ALGAPI
	select CRYPTO_SM4
	help
	  Block ciphers: SM4 cipher algorithms (OSCCA GB/T 32907-2016)

	  Architecture: arm64 using:
	  - ARMv8.2 Crypto Extensions
	  - NEON (Advanced SIMD) extensions

config CRYPTO_SM4_ARM64_CE_BLK
	tristate "Ciphers: SM4, modes: ECB/CBC/CFB/CTR (ARMv8 Crypto Extensions)"
	depends on KERNEL_MODE_NEON
	select CRYPTO_SKCIPHER
	select CRYPTO_SM4
	help
	  Length-preserving ciphers: SM4 cipher algorithms (OSCCA GB/T 32907-2016)
	  with block cipher modes:
	  - ECB (Electronic Codebook) mode (NIST SP800-38A)
	  - CBC (Cipher Block Chaining) mode (NIST SP800-38A)
	  - CFB (Cipher Feedback) mode (NIST SP800-38A)
	  - CTR (Counter) mode (NIST SP800-38A)

	  Architecture: arm64 using:
	  - ARMv8 Crypto Extensions
	  - NEON (Advanced SIMD) extensions

config CRYPTO_SM4_ARM64_NEON_BLK
	tristate "Ciphers: SM4, modes: ECB/CBC/CFB/CTR (NEON)"
	depends on KERNEL_MODE_NEON
	select CRYPTO_SKCIPHER
	select CRYPTO_SM4
	help
	  Length-preserving ciphers: SM4 cipher algorithms (OSCCA GB/T 32907-2016)
	  with block cipher modes:
	  - ECB (Electronic Codebook) mode (NIST SP800-38A)
	  - CBC (Cipher Block Chaining) mode (NIST SP800-38A)
	  - CFB (Cipher Feedback) mode (NIST SP800-38A)
	  - CTR (Counter) mode (NIST SP800-38A)

	  Architecture: arm64 using:
	  - NEON (Advanced SIMD) extensions

config CRYPTO_AES_ARM64_CE_CCM
	tristate "AEAD cipher: AES in CCM mode (ARMv8 Crypto Extensions)"
	depends on ARM64 && KERNEL_MODE_NEON
	select CRYPTO_ALGAPI
	select CRYPTO_AES_ARM64_CE
	select CRYPTO_AEAD
	select CRYPTO_LIB_AES
	help
	  AEAD cipher: AES cipher algorithms (FIPS-197) with
	  CCM (Counter with Cipher Block Chaining-Message Authentication Code)
	  authenticated encryption mode (NIST SP800-38C)

	  Architecture: arm64 using:
	  - ARMv8 Crypto Extensions
	  - NEON (Advanced SIMD) extensions

config CRYPTO_CRCT10DIF_ARM64_CE
	tristate "CRCT10DIF (PMULL)"
	depends on KERNEL_MODE_NEON && CRC_T10DIF
	select CRYPTO_HASH
	help
	  CRC16 CRC algorithm used for the T10 (SCSI) Data Integrity Field (DIF)

	  Architecture: arm64 using
	  - PMULL (Polynomial Multiply Long) instructions

endmenu
```

## arch/arm64/gunyah/Kconfig
```kconfig
# SPDX-License-Identifier: GPL-2.0-only

menu "Gunyah arm64 drivers"
config GH_ARM64_DRV
	tristate "Gunyah arm64 support"
	depends on ARM64
	help
	  Gunyah drivers need arch specific support. Add support for
	  ARM64 features required by Gunyah virtualizaton drivers. All
	  arm64 specific features like GIC and reset reasons are handled
	  by drivers under this config.
endmenu
```

## arch/arm64/kvm/Kconfig
```kconfig
# SPDX-License-Identifier: GPL-2.0
#
# KVM configuration
#

source "virt/kvm/Kconfig"

menuconfig VIRTUALIZATION
	bool "Virtualization"
	help
	  Say Y here to get to see options for using your Linux host to run
	  other operating systems inside virtual machines (guests).
	  This option alone does not add any kernel code.

	  If you say N, all options in this submenu will be skipped and
	  disabled.

if VIRTUALIZATION

menuconfig KVM
	bool "Kernel-based Virtual Machine (KVM) support"
	depends on AS_HAS_ARMV8_4
	select KVM_COMMON
	select KVM_GENERIC_HARDWARE_ENABLING
	select KVM_GENERIC_MMU_NOTIFIER
	select HAVE_KVM_CPU_RELAX_INTERCEPT
	select KVM_MMIO
	select KVM_GENERIC_DIRTYLOG_READ_PROTECT
	select KVM_XFER_TO_GUEST_WORK
	select KVM_VFIO
	select HAVE_KVM_DIRTY_RING_ACQ_REL
	select NEED_KVM_DIRTY_RING_WITH_BITMAP
	select HAVE_KVM_MSI
	select HAVE_KVM_IRQCHIP
	select HAVE_KVM_IRQ_ROUTING
	select HAVE_KVM_IRQ_BYPASS
	select HAVE_KVM_READONLY_MEM
	select HAVE_KVM_VCPU_RUN_PID_CHANGE
	select SCHED_INFO
	select GUEST_PERF_EVENTS if PERF_EVENTS
	help
	  Support hosting virtualized guest machines.

	  If unsure, say N.

config NVHE_EL2_DEBUG
	bool "Debug mode for non-VHE EL2 object"
	depends on KVM
	help
	  Say Y here to enable the debug mode for the non-VHE KVM EL2 object.
	  Failure reports will BUG() in the hypervisor. This is intended for
	  local EL2 hypervisor development.

	  If unsure, say N.

config PROTECTED_NVHE_STACKTRACE
	bool "Protected KVM hypervisor stacktraces"
	depends on NVHE_EL2_DEBUG
	default n
	help
	  Say Y here to enable pKVM hypervisor stacktraces on hyp_panic()

	  If using protected nVHE mode, but cannot afford the associated
	  memory cost (less than 0.75 page per CPU) of pKVM stacktraces,
	  say N.

	  If unsure, or not using protected nVHE (pKVM), say N.

config PTDUMP_STAGE2_DEBUGFS
	bool "Present the stage-2 pagetables to debugfs"
	depends on KVM
	depends on DEBUG_KERNEL
	depends on DEBUG_FS
	depends on GENERIC_PTDUMP
	select PTDUMP_CORE
	default n
	help
	  Say Y here if you want to show the stage-2 kernel pagetables
	  layout in a debugfs file. This information is only useful for kernel developers
	  who are working in architecture specific areas of the kernel.
	  It is probably not a good idea to enable this feature in a production
	  kernel.

	  If in doubt, say N.

endif # VIRTUALIZATION
```
