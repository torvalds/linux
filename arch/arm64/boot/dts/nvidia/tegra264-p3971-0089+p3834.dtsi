// SPDX-License-Identifier: GPL-2.0-only OR BSD-2-Clause

#include "tegra264-p3971-0089.dtsi"

/ {
	aliases {
		serial0 = &{/bus@0/serial@c4e0000};
		serial1 = &{/bus@0/serial@c5a0000};
	};

	chosen {
		stdout-path = "serial0:115200n8";
	};
};
