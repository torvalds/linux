// SPDX-License-Identifier: GPL-2.0
/dts-v1/;

#include "tegra194-p3668-0000.dtsi"
#include "tegra194-p3509-0000.dtsi"

/ {
	model = "NVIDIA Jetson Xavier NX Developer Kit (SD-card)";
	compatible = "nvidia,p3509-0000+p3668-0000", "nvidia,tegra194";
};
