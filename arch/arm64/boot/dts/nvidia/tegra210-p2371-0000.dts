// SPDX-License-Identifier: GPL-2.0
/dts-v1/;

#include "tegra210-p2530.dtsi"
#include "tegra210-p2595.dtsi"

/ {
	model = "NVIDIA Tegra210 P2371 (P2530/P2595) reference design";
	compatible = "nvidia,p2371-0000", "nvidia,tegra210";
};
