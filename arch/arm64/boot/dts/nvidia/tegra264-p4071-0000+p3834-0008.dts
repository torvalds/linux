// SPDX-License-Identifier: GPL-2.0-only OR BSD-2-Clause
/dts-v1/;

// module files must be included first
#include "tegra264-p3834-0008.dtsi"
#include "tegra264-p4071-0000+p3834.dtsi"

/ {
	model = "NVIDIA Jetson AGX Thor Developer Kit";
	compatible = "nvidia,p4071-0000+p3834-0008", "nvidia,p3834-0008", "nvidia,tegra264";

	bus@a800000000 {
		/* PCIe C2 to enable Ethernet */
		pci@8420000 {
			status = "okay";
		};

		/* PCIe C5 to enable NVME */
		pci@8480000 {
			status = "okay";
		};
	};
};
