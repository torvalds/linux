// SPDX-License-Identifier: GPL-2.0
/dts-v1/;

#include "tegra234-p3768-0000+p3767.dtsi"

/ {
	compatible = "nvidia,p3768-0000+p3767-0000", "nvidia,p3767-0000", "nvidia,tegra234";
	model = "NVIDIA Jetson Orin NX Engineering Reference Developer Kit";

	bus@0 {
		hda@3510000 {
			nvidia,model = "NVIDIA Jetson Orin NX HDA";
		};
	};

	sound {
		label = "NVIDIA Jetson Orin NX APE";
	};
};
