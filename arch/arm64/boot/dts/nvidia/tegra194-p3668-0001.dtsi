// SPDX-License-Identifier: GPL-2.0
#include "tegra194-p3668.dtsi"

/ {
	model = "NVIDIA Jetson Xavier NX (eMMC)";
	compatible = "nvidia,p3668-0001", "nvidia,tegra194";

	aliases {
		mmc0 = "/bus@0/mmc@3460000";
	};

	bus@0 {
		/* SDMMC4 (eMMC) */
		mmc@3460000 {
			status = "okay";
			bus-width = <8>;
			non-removable;

			vqmmc-supply = <&vdd_1v8ls>;
			vmmc-supply = <&vdd_emmc_3v3>;
		};
	};
};
