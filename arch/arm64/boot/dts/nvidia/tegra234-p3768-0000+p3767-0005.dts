// SPDX-License-Identifier: GPL-2.0
/dts-v1/;

#include "tegra234-p3768-0000+p3767.dtsi"

/ {
	compatible = "nvidia,p3768-0000+p3767-0005", "nvidia,p3767-0005", "nvidia,tegra234";
	model = "NVIDIA Jetson Orin Nano Developer Kit";

	bus@0 {
		hda@3510000 {
			nvidia,model = "NVIDIA Jetson Orin Nano HDA";
		};
	};

	sound {
		label = "NVIDIA Jetson Orin Nano APE";
	};
};
