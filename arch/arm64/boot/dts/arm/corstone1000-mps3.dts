// SPDX-License-Identifier: GPL-2.0 or MIT
/*
 * Copyright (c) 2022, Arm Limited. All rights reserved.
 * Copyright (c) 2022, Linaro Limited. All rights reserved.
 *
 */

/dts-v1/;

#include "corstone1000.dtsi"

/ {
	model = "ARM Corstone1000 FPGA MPS3 board";
	compatible = "arm,corstone1000-mps3";

	smsc: ethernet@4010000 {
		compatible = "smsc,lan9220", "smsc,lan9115";
		reg = <0x40100000 0x10000>;
		phy-mode = "mii";
		interrupts = <GIC_SPI 116 IRQ_TYPE_LEVEL_HIGH>;
		reg-io-width = <2>;
		smsc,irq-push-pull;
	};

	usb_host: usb@40200000 {
		compatible = "nxp,usb-isp1763";
		reg = <0x40200000 0x100000>;
		interrupts = <GIC_SPI 114 IRQ_TYPE_LEVEL_HIGH>;
		bus-width = <16>;
		dr_mode = "host";
	};
};
