/ {
	hi6220-ion {
		compatible = "hisilicon,hi6220-ion";
		heap_sys_user@0 {
			heap-name = "sys_user";
			heap-id   = <0x0>;
			heap-base = <0x0>;
			heap-size = <0x0>;
			heap-type = "ion_system";
		};
		heap_sys_contig@0 {
			heap-name = "sys_contig";
			heap-id   = <0x1>;
			heap-base = <0x0>;
			heap-size = <0x0>;
			heap-type = "ion_system_contig";
		};
	};

};
