// SPDX-License-Identifier: GPL-2.0
/{
	gpu: mali@E82C0000 {
		compatible = "arm,malit6xx", "arm,mali-midgard";
		#cooling-cells = <3>; /* min followed by max */
		gpu_outstanding = <0x0>;
		reg = <0x0 0xE82C0000 0x0 0x4000>;
		interrupts = <0 258 4 0 259 4 0 260 4>;
		interrupt-names = "JOB", "MMU", "GPU";
		operating-points = <
			/* <frequency> <voltage>*/
			178000  650000
			400000	700000
			533000	800000
			807000	900000
			960000	1000000
			1037000 1100000
		>;
	};
};
