// SPDX-License-Identifier: BSD-3-Clause
/*
 * Copyright (c) 2021, Konrad Dybcio <konrad.dybcio@somainline.org>
 */

#include "msm8996-sony-xperia-tone-dora.dts"
#include "pmi8996.dtsi"

/ {
	model = "Sony Xperia X Performance (PMI8996)";
};
