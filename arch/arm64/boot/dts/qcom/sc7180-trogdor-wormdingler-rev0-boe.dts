// SPDX-License-Identifier: (GPL-2.0+ OR MIT)
/*
 * Google Wormdingler board device tree source
 *
 * Copyright 2021 Google LLC.
 *
 * SKU: 0x10 => 16
 *  - bits 7..4: Panel ID: 0x1 (BOE)
 */

/dts-v1/;

#include "sc7180-trogdor-wormdingler-rev0.dtsi"

/ {
	model = "Google Wormdingler rev0 BOE panel board";
	compatible = "google,wormdingler-rev0-sku16", "qcom,sc7180";
};

&panel {
	compatible = "boe,tv110c9m-ll3";
};
