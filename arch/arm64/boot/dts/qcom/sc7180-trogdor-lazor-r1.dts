// SPDX-License-Identifier: (GPL-2.0+ OR MIT)
/*
 * Google Lazor board device tree source
 *
 * Copyright 2020 Google LLC.
 */

/dts-v1/;

#include "sc7180-trogdor.dtsi"
#include "sc7180-trogdor-ti-sn65dsi86.dtsi"
#include "sc7180-trogdor-lazor.dtsi"
#include "sc7180-trogdor-rt5682i-sku.dtsi"

/ {
	model = "Google Lazor (rev1 - 2)";
	compatible = "google,lazor-rev1", "google,lazor-rev2", "qcom,sc7180";
};


&usb_hub_2_x {
	 vdd-supply = <&pp3300_l7c>;
};

&usb_hub_3_x {
	 vdd-supply = <&pp3300_l7c>;
};
