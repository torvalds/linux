// SPDX-License-Identifier: (GPL-2.0+ OR MIT)
/*
 * Google Lazor Limozeen board device tree source
 *
 * Copyright 2021 Google LLC.
 */

/dts-v1/;

#include "sc7180-trogdor.dtsi"
#include "sc7180-trogdor-parade-ps8640.dtsi"
#include "sc7180-trogdor-lazor.dtsi"
#include "sc7180-trogdor-lte-sku.dtsi"
#include "sc7180-trogdor-rt5682i-sku.dtsi"

/ {
	model = "Google Lazor Limozeen without Touchscreen (rev9)";
	compatible = "google,lazor-rev9-sku6", "google,lazor-rev9-sku18", "qcom,sc7180";
};

/delete-node/ &ap_ts;

&panel {
	compatible = "edp-panel";
};

&sdhc_2 {
	status = "okay";
};
