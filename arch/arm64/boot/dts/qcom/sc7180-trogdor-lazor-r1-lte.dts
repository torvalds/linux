// SPDX-License-Identifier: (GPL-2.0+ OR MIT)
/*
 * Google Lazor board device tree source
 *
 * Copyright 2020 Google LLC.
 */

#include "sc7180-trogdor-lazor-r1.dts"
#include "sc7180-trogdor-lte-sku.dtsi"

/ {
	model = "Google Lazor (rev1 - 2) with LTE";
	compatible = "google,lazor-rev1-sku0", "google,lazor-rev2-sku0", "qcom,sc7180";
};

&ap_sar_sensor_i2c {
	status = "okay";
};

&keyboard_backlight {
	status = "okay";
};
