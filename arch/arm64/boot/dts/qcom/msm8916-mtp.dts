// SPDX-License-Identifier: GPL-2.0-only
/*
 * Copyright (c) 2014-2015, The Linux Foundation. All rights reserved.
 */

/dts-v1/;

#include "msm8916-pm8916.dtsi"

/ {
	model = "Qualcomm Technologies, Inc. MSM 8916 MTP";
	compatible = "qcom,msm8916-mtp", "qcom,msm8916";
	chassis-type = "handset";

	aliases {
		serial0 = &blsp_uart2;
		usid0 = &pm8916_0;
	};

	chosen {
		stdout-path = "serial0";
	};
};

&blsp_uart2 {
	pinctrl-0 = <&blsp_uart2_console_default>;
	pinctrl-1 = <&blsp_uart2_console_sleep>;
	pinctrl-names = "default", "sleep";
	status = "okay";
};
