// SPDX-License-Identifier: (GPL-2.0+ OR MIT)
/*
 * Google Mrbland board device tree source
 *
 * Copyright 2021 Google LLC.
 *
 * SKU: 0x0 => 0
 *  - bits 7..4: Panel ID: 0x0 (AUO)
 */

/dts-v1/;

#include "sc7180-trogdor-mrbland-rev0.dtsi"

/ {
	model = "Google Mrbland rev0 AUO panel board";
	compatible = "google,mrbland-rev0-sku0", "qcom,sc7180";
};

&panel {
	compatible = "auo,b101uan08.3";
};
