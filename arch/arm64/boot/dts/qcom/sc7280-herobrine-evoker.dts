// SPDX-License-Identifier: (GPL-2.0+ OR MIT)
/*
 * Google Evoker board device tree source
 *
 * Copyright 2022 Google LLC.
 */

/dts-v1/;

#include "sc7280-herobrine-evoker.dtsi"
#include "sc7280-herobrine-wifi-sku.dtsi"

/ {
	model = "Google Evoker";
	compatible = "google,evoker", "qcom,sc7280";
};
