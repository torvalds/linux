// SPDX-License-Identifier: GPL-2.0
/*
 * SDM850 SoC device tree source
 *
 * Copyright (c) 2020, The Linux Foundation. All rights reserved.
 */

#include "sdm845.dtsi"

&cpu4_opp_table {
	cpu4_opp33: opp-2841600000 {
		opp-hz = /bits/ 64 <2841600000>;
		opp-peak-kBps = <7216000 25497600>;
	};

	cpu4_opp34: opp-2956800000 {
		opp-hz = /bits/ 64 <2956800000>;
		opp-peak-kBps = <7216000 25497600>;
		turbo-mode;
	};
};
