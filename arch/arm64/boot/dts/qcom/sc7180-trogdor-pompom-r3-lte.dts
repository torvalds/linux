// SPDX-License-Identifier: (GPL-2.0+ OR MIT)
/*
 * Google Pompom board device tree source
 *
 * Copyright 2021 Google LLC.
 */

#include "sc7180-trogdor-pompom-r3.dts"
#include "sc7180-trogdor-lte-sku.dtsi"

/ {
	model = "Google Pompom (rev3+) with LTE";
	compatible = "google,pompom-sku0", "qcom,sc7180";
};
