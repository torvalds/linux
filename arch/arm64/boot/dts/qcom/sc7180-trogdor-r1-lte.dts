// SPDX-License-Identifier: (GPL-2.0+ OR MIT)
/*
 * Google Trogdor board device tree source
 *
 * Copyright 2020 Google LLC.
 */

#include "sc7180-trogdor-r1.dts"
#include "sc7180-trogdor-lte-sku.dtsi"

/ {
	model = "Google Trogdor (rev1+) with LTE";
	compatible = "google,trogdor-sku0", "qcom,sc7180";
};
