// SPDX-License-Identifier: (GPL-2.0+ OR MIT)
/*
 * Google Wormdingler board device tree source
 *
 * Copyright 2021 Google LLC.
 *
 * SKU: 0x0 => 0
 *  - bits 7..4: Panel ID: 0x0 (INX)
 */

/dts-v1/;

#include "sc7180-trogdor-wormdingler-rev0.dtsi"

/ {
	model = "Google Wormdingler rev0 INX panel board";
	compatible = "google,wormdingler-rev0-sku0", "qcom,sc7180";
};

&panel {
	compatible = "innolux,hj110iz-01a";
};
