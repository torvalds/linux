// SPDX-License-Identifier: GPL-2.0-only

/dts-v1/;

#include "sm8250-samsung-common.dtsi"

/ {
	model = "Samsung Galaxy S20 FE";
	compatible = "samsung,r8q", "qcom,sm8250";
	chassis-type = "handset";
};

&adsp {
	firmware-name = "qcom/sm8250/Samsung/r8q/adsp.mbn";
	status = "okay";
};

&cdsp {
	firmware-name = "qcom/sm8250/Samsung/r8q/cdsp.mbn";
	status = "okay";
};

&slpi {
	firmware-name = "qcom/sm8250/Samsung/r8q/slpi.mbn";
	status = "okay";
};
