// SPDX-License-Identifier: (GPL-2.0+ OR MIT)
/*
 * Google Wormdingler board device tree source
 *
 * Copyright 2021 Google LLC.
 *
 * SKU: 0x401 => 1025
 *  - bits 11..8: Panel ID: 0x4 (BOE)
 */

/dts-v1/;

#include "sc7180-trogdor-wormdingler.dtsi"
#include "sc7180-trogdor-rt5682s-sku.dtsi"

/ {
	model = "Google Wormdingler rev1+ (BOE, rt5682s)";
	compatible = "google,wormdingler-sku1025", "qcom,sc7180";
};

&mdss_dsi0_phy {
	qcom,phy-rescode-offset-top = /bits/ 8 <31 31 31 31 (-32)>;
	qcom,phy-rescode-offset-bot = /bits/ 8 <31 31 31 31 (-32)>;
	qcom,phy-drive-ldo-level = <450>;
};

&panel {
	compatible = "boe,tv110c9m-ll3";
};
