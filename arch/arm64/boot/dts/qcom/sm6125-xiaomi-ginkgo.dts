// SPDX-License-Identifier: BSD-3-Clause
/*
 * Copyright (c) 2025, Gabriel Gonzales <semfault@disroot.org>
 */
/dts-v1/;

#include "sm6125-xiaomi-ginkgo-common.dtsi"

/ {
	model = "Xiaomi Redmi Note 8";
	compatible = "xiaomi,ginkgo", "qcom,sm6125";
};
