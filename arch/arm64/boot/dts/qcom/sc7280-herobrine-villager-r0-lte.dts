// SPDX-License-Identifier: (GPL-2.0+ OR MIT)
/*
 * Google Villager board device tree source
 *
 * Copyright 2022 Google LLC.
 */

#include "sc7280-herobrine-villager-r0.dts"
#include "sc7280-herobrine-lte-sku.dtsi"

/ {
	model = "Google Villager (rev0) with LTE";
	compatible = "google,villager-rev0-sku0", "qcom,sc7280";
};
