// SPDX-License-Identifier: BSD-3-Clause
/*
 * Copyright (c) 2021, Konrad Dybcio <konrad.dybcio@somainline.org>
 */

/dts-v1/;

#include "sm8350-sony-xperia-sagami.dtsi"

/ {
	model = "Sony Xperia 1 III";
	compatible = "sony,pdx215-generic", "qcom,sm8350";
};
