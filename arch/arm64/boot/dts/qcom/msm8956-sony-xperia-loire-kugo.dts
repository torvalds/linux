// SPDX-License-Identifier: BSD-3-Clause
/*
 * Copyright (c) 2016-2022, AngeloGioacchino Del Regno
 *                          <angelogioacchino.delregno@somainline.org>
 * Copyright (c) 2022, Konrad Dybcio <konrad.dybcio@somainline.org>
 * Copyright (c) 2022, Marijn Suijten <marijn.suijten@somainline.org>
 */

/dts-v1/;

#include "msm8956-sony-xperia-loire.dtsi"

/ {
	model = "Sony Xperia X Compact";
	compatible = "sony,kugo-row", "qcom,msm8956";
	chassis-type = "handset";
};

&blsp2_i2c2 {
	status = "okay";

	/* FUSB301 USB-C Controller */
};

&blsp2_i2c4 {
	status = "okay";

	/* ST STMVL53L0 ToF @ 29 */
	/* AMS TCS349 RGBCIR @ 72 */
};

&pm8950_l1 {
	regulator-min-microvolt = <1100000>;
	regulator-max-microvolt = <1300000>;
};
