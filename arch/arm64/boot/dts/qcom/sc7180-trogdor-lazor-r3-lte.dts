// SPDX-License-Identifier: (GPL-2.0+ OR MIT)
/*
 * Google Lazor board device tree source
 *
 * Copyright 2020 Google LLC.
 */

/dts-v1/;

#include "sc7180.dtsi"
#include "sc7180-trogdor-ti-sn65dsi86.dtsi"
#include "sc7180-trogdor-lazor.dtsi"
#include "sc7180-trogdor-lte-sku.dtsi"

/ {
	model = "Google Lazor (rev3 - 8) with LTE";
	compatible = "google,lazor-rev3-sku0", "google,lazor-rev4-sku0",
		"google,lazor-rev5-sku0", "google,lazor-rev6-sku0",
		"google,lazor-rev7-sku0", "google,lazor-rev8-sku0",
		"qcom,sc7180";
};

&ap_sar_sensor {
	status = "okay";
};

&ap_sar_sensor_i2c {
	status = "okay";
};

&keyboard_backlight {
	status = "okay";
};
