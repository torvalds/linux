// SPDX-License-Identifier: GPL-2.0
/*
 * Copyright (c) 2021, Konrad Dybcio <konrad.dybcio@somainline.org>
 */

 /*
  * PMI8996 is a slight modification of PMI8994 with
  * some notable changes, like being the first PMIC
  * whose the bootloader has to check to continue booting
  * and a change to a LABIBB parameter.
  */

/ {
	qcom,pmic-id = <0x20009 0x10013 0 0>;
};
