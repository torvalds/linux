// SPDX-License-Identifier: (GPL-2.0+ OR MIT)
/*
 * Google Quackingstick board device tree source
 *
 * Copyright 2021 Google LLC.
 *
 * SKU: 0x601 => 1537
 *  - bits 11..8: Panel ID: 0x6 (AUO)
 */

#include "sc7180-trogdor-quackingstick.dtsi"

/ {
	model = "Google Quackingstick (rev0+)";
	compatible = "google,quackingstick-sku1537", "qcom,sc7180";
};

&mdss_dsi0_phy {
	qcom,phy-rescode-offset-top = /bits/ 8 <(-13) (-13) (-13) (-13) (-13)>;
	qcom,phy-rescode-offset-bot = /bits/ 8 <(-13) (-13) (-13) (-13) (-13)>;
	qcom,phy-drive-ldo-level = <375>;
};

&panel {
	compatible = "auo,b101uan08.3";
};
