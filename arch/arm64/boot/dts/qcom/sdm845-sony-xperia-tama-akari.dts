// SPDX-License-Identifier: BSD-3-Clause
/*
 * Copyright (c) 2021, Konrad Dybcio <konrad.dybcio@somainline.org>
 */

/dts-v1/;

#include "sdm845-sony-xperia-tama.dtsi"

/ {
	model = "Sony Xperia XZ2";
	compatible = "sony,akari-row", "qcom,sdm845";
};
