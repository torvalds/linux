// SPDX-License-Identifier: BSD-3-Clause
/*
 * Copyright (c) Qualcomm Technologies, Inc. and/or its subsidiaries.

 * Talos specific modifications required to boot in EL2.
 */

/dts-v1/;
/plugin/;

&gpu_zap_shader {
	status = "disabled";
};

&remoteproc_adsp {
	iommus = <&apps_smmu 0x1720 0x0>;
};

&remoteproc_cdsp {
	iommus = <&apps_smmu 0x1080 0x0>;
};

&venus {
	status = "disabled";
};
