// SPDX-License-Identifier: BSD-3-Clause
/*
 * Copyright (c) 2023 Jianhua Lu <lujianhua000@gmail.com>
 */

/dts-v1/;

#include "sm8250-xiaomi-elish-common.dtsi"

/ {
	model = "Xiaomi Mi Pad 5 Pro (BOE)";
	compatible = "xiaomi,elish", "qcom,sm8250";
};

&display_panel {
	compatible = "xiaomi,elish-boe-nt36523", "novatek,nt36523";
	status = "okay";
};
