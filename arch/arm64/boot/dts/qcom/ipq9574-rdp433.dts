// SPDX-License-Identifier: (GPL-2.0+ OR BSD-3-Clause)
/*
 * IPQ9574 RDP433 board device tree source
 *
 * Copyright (c) 2020-2021 The Linux Foundation. All rights reserved.
 * Copyright (c) 2023 Qualcomm Innovation Center, Inc. All rights reserved.
 */

/dts-v1/;

#include "ipq9574-rdp-common.dtsi"
#include "ipq9574-rdp433-common.dtsi"

/ {
	model = "Qualcomm Technologies, Inc. IPQ9574/AP-AL02-C7";
	compatible = "qcom,ipq9574-ap-al02-c7", "qcom,ipq9574";
};

&qpic_nand {
	status = "okay";
};
