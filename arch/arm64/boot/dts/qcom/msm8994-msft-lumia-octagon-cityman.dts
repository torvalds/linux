// SPDX-License-Identifier: BSD-3-Clause
/*
 * Copyright (c) 2020, Konrad Dybcio <konrad.dybcio@somainline.org>
 * Copyright (c) 2020, Gustave Monce <gustave.monce@outlook.com>
 */

/dts-v1/;

#include "msm8994.dtsi"
#include "msm8994-msft-lumia-octagon.dtsi"

/ {
	model = "Microsoft Lumia 950 XL";
	compatible = "microsoft,cityman", "qcom,msm8994";
	chassis-type = "handset";
};
