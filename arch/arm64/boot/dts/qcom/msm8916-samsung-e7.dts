// SPDX-License-Identifier: GPL-2.0-only

/dts-v1/;

#include "msm8916-samsung-e2015-common.dtsi"

/*
 * NOTE: The original firmware from Samsung can only boot ARM32 kernels on some
 * variants.
 * Unfortunately, the firmware is signed and cannot be replaced easily.
 * There seems to be no way to boot ARM64 kernels on 32-bit devices at the
 * moment, even though the hardware would support it.
 *
 * However, it is possible to use this device tree by compiling an ARM32 kernel
 * instead. For clarity and build testing this device tree is maintained next
 * to the other MSM8916 device trees. However, it is actually used through
 * arch/arm/boot/dts/qcom-msm8916-samsung-e7.dts
 */

/ {
	model = "Samsung Galaxy E7";
	compatible = "samsung,e7", "qcom,msm8916";
	chassis-type = "handset";
};

&battery {
	charge-term-current-microamp = <200000>;
	constant-charge-current-max-microamp = <1500000>;
	constant-charge-voltage-max-microvolt = <4350000>;
};


&pm8916_l17 {
	regulator-min-microvolt = <3000000>;
	regulator-max-microvolt = <3000000>;
};
