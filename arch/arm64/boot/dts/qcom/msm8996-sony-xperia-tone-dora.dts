// SPDX-License-Identifier: BSD-3-Clause
/*
 * Copyright (c) 2021, AngeloGioacchino Del Regno
 *                     <angelogioacchino.delregno@somainline.org>
 * Copyright (c) 2021, Konrad Dybcio <konrad.dybcio@somainline.org>
 */

/dts-v1/;

#include "msm8996-sony-xperia-tone.dtsi"

/ {
	model = "Sony Xperia X Performance";
	compatible = "sony,dora-row", "qcom,msm8996";
};

/delete-node/ &tof_sensor;
/delete-node/ &pm8994_l11;
/delete-node/ &pm8994_l14;

&usb_detect {
	pins = "gpio24";
};

&usb3_id {
	id-gpio = <&tlmm 24 GPIO_ACTIVE_LOW>;
};
