// SPDX-License-Identifier: (GPL-2.0+ OR MIT)
/*
 * Google Pazquel board device tree source
 *
 * Copyright 2022 Google LLC.
 */

/dts-v1/;

#include "sc7180-trogdor.dtsi"
#include "sc7180-trogdor-parade-ps8640.dtsi"
#include "sc7180-trogdor-pazquel360.dtsi"

/ {
	model = "Google Pazquel (Parade,WIFI-only)";
	compatible = "google,pazquel-sku21", "qcom,sc7180";
};
