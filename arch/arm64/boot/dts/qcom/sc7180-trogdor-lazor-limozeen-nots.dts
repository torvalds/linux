// SPDX-License-Identifier: (GPL-2.0+ OR MIT)
/*
 * Google Lazor Limozeen board device tree source
 *
 * Copyright 2020 Google LLC.
 */

/dts-v1/;

#include "sc7180-trogdor-lazor.dtsi"
#include "sc7180-trogdor-lte-sku.dtsi"

/ {
	model = "Google Lazor Limozeen without Touchscreen";
	compatible = "google,lazor-sku6", "google,lazor-sku5", "qcom,sc7180";
};

/delete-node/&ap_ts;

&panel {
	compatible = "innolux,n116bca-ea1", "innolux,n116bge";
};

&sdhc_2 {
	status = "okay";
};
