// SPDX-License-Identifier: (GPL-2.0+ OR MIT)
/*
 * Google Mrbland board device tree source
 *
 * Copyright 2021 Google LLC.
 *
 * SKU: 0x600 => 1536
 *  - bits 11..8: Panel ID: 0x6 (AUO)
 */

/dts-v1/;

#include "sc7180-trogdor-mrbland.dtsi"

/ {
	model = "Google Mrbland rev1+ AUO panel board";
	compatible = "google,mrbland-sku1536", "qcom,sc7180";
};

&panel {
	compatible = "auo,b101uan08.3";
};
