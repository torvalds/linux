// SPDX-License-Identifier: BSD-3-Clause
/*
 * Copyright (c) 2026, Barnabas Czeman
 */
/dts-v1/;

#include "sm6125-xiaomi-ginkgo-common.dtsi"

/ {
	model = "Xiaomi Redmi Note 8T";
	compatible = "xiaomi,willow", "qcom,sm6125";

};

/* Difference from Redmi Note 8 it have NFC */
