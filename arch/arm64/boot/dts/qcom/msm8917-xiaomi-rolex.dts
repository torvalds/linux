// SPDX-License-Identifier: GPL-2.0-only
/*
 * Copyright (c) 2026, Barnabas Czeman
 */

/dts-v1/;

#include "msm8917-xiaomi-wingtech.dtsi"

/ {
	model = "Xiaomi Redmi 4A (rolex)";
	compatible = "xiaomi,rolex", "qcom,msm8917";

	qcom,board-id = <0x1000b 1>;
};
