// SPDX-License-Identifier: (GPL-2.0+ OR MIT)
/*
 * Google Lazor board device tree source
 *
 * Copyright 2020 Google LLC.
 */

#include "sc7180-trogdor-lazor-r1.dts"

/ {
	model = "Google Lazor (rev1 - 2) with KB Backlight";
	compatible = "google,lazor-rev1-sku2", "google,lazor-rev2-sku2", "qcom,sc7180";
};

&keyboard_backlight {
	status = "okay";
};
