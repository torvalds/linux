// SPDX-License-Identifier: BSD-3-Clause
/*
 * Copyright (c) 2025, Linaro Limited
 */

#include "x1e78100-lenovo-thinkpad-t14s.dtsi"

/ {
	model = "Lenovo ThinkPad T14s Gen 6 (OLED)";
	compatible = "lenovo,thinkpad-t14s-oled", "lenovo,thinkpad-t14s",
		     "qcom,x1e78100", "qcom,x1e80100";
};

&panel {
	compatible = "samsung,atna40yk20", "samsung,atna33xc20";
	enable-gpios = <&pmc8380_3_gpios 4 GPIO_ACTIVE_HIGH>;

	pinctrl-0 = <&edp_bl_en>;
	pinctrl-names = "default";
};
