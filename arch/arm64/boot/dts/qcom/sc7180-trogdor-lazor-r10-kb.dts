// SPDX-License-Identifier: (GPL-2.0+ OR MIT)
/*
 * Google Lazor board device tree source
 *
 * Copyright 2023 Google LLC.
 */

/dts-v1/;

#include "sc7180-trogdor.dtsi"
#include "sc7180-trogdor-parade-ps8640.dtsi"
#include "sc7180-trogdor-lazor.dtsi"
#include "sc7180-lite.dtsi"
#include "sc7180-trogdor-rt5682s-sku.dtsi"

/ {
	model = "Google Lazor (rev10+) with KB Backlight";
	compatible = "google,lazor-sku2", "qcom,sc7180";
};

&pwmleds {
	status = "okay";
};
