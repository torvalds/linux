// SPDX-License-Identifier: (GPL-2.0+ OR MIT)
/*
 * Google Villager board device tree source
 *
 * Copyright 2022 Google LLC.
 */

#include "sc7280-herobrine-villager-r1.dts"
#include "sc7280-herobrine-lte-sku.dtsi"

/ {
	model = "Google Villager (rev1+) with LTE";
	compatible = "google,villager-sku512", "qcom,sc7280";
};
