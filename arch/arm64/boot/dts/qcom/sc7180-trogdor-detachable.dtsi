// SPDX-License-Identifier: (GPL-2.0+ OR MIT)
/*
 * Google Trogdor dts fragment for detachables
 *
 * Copyright 2024 Google LLC.
 */

/* This file must be included after sc7180-trogdor.dtsi to modify cros_ec */
&cros_ec {
	keyboard-controller {
		compatible = "google,cros-ec-keyb-switches";
	};
};
