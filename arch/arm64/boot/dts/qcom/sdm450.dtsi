// SPDX-License-Identifier: BSD-3-Clause
/* Copyright (c) 2023, Luca Weiss <luca@z3ntu.xyz> */

#include "msm8953.dtsi"

&gpu_opp_table {
	/delete-node/ opp-650000000;

	opp-600000000 {
		opp-hz = /bits/ 64 <600000000>;
		opp-supported-hw = <0xff>;
		opp-avg-kBps = <0>, <50000>;
		opp-peak-kBps = <7449600>, <500000>;
		required-opps = <&rpmpd_opp_turbo>;
	};
};
