// SPDX-License-Identifier: BSD-3-Clause
/*
 * Copyright (c) 2020, Konrad Dybcio <konrad.dybcio@somainline.org>
 */

/dts-v1/;

#include "msm8994-sony-xperia-kitakami.dtsi"

/ {
	model = "Sony Xperia Z5 Premium";
	compatible = "sony,satsuki-row", "qcom,msm8994";
};

&pm8994_l14 {
	regulator-min-microvolt = <1850000>;
	regulator-max-microvolt = <1850000>;
};
