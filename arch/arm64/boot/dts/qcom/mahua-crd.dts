// SPDX-License-Identifier: BSD-3-Clause
/*
 * Copyright (c) Qualcomm Technologies, Inc. and/or its subsidiaries.
 */

/dts-v1/;

#include "mahua.dtsi"
#include "glymur-crd.dtsi"

/delete-node/ &pmcx0102_d_e0;
/delete-node/ &pmcx0102_d0_thermal;
/delete-node/ &pmh0104_i_e0;
/delete-node/ &pmh0104_i0_thermal;
/delete-node/ &pmh0104_j_e0;
/delete-node/ &pmh0104_j0_thermal;

/ {
	model = "Qualcomm Technologies, Inc. Mahua CRD";
	compatible = "qcom,mahua-crd", "qcom,mahua";
};

&tcsr {
	vdda-qrefrpt0-0p9-supply = <&vreg_l2f_e1_0p83>;
	vdda-qrefrpt1-0p9-supply = <&vreg_l2f_e1_0p83>;
	vdda-qrefrpt2-0p9-supply = <&vreg_l2f_e1_0p83>;
	vdda-qrefrpt3-0p9-supply = <&vreg_l1f_e1_0p82>;
	vdda-qrefrpt4-0p9-supply = <&vreg_l2h_e0_0p72>;
	vdda-qrefrpt5-0p9-supply = <&vreg_l2h_e0_0p72>;
	vdda-qrefrx0-0p9-supply = <&vreg_l2f_e1_0p83>;
	vdda-qrefrx1-0p9-supply = <&vreg_l2f_e1_0p83>;
	vdda-qrefrx2-0p9-supply = <&vreg_l2f_e1_0p83>;
	vdda-qrefrx3-0p9-supply = <&vreg_l2h_e0_0p72>;
	vdda-qreftx1-0p9-supply = <&vreg_l1f_e1_0p82>;
	vdda-refgen3-0p9-supply = <&vreg_l1f_e1_0p82>;
	vdda-refgen3-1p2-supply = <&vreg_l4f_e1_1p08>;
};
