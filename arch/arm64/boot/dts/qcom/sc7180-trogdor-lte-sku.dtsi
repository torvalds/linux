// SPDX-License-Identifier: (GPL-2.0+ OR MIT)
/*
 * Google Trogdor dts fragment for LTE SKUs
 *
 * Copyright 2020 Google LLC.
 */

&ap_sar_sensor {
	label = "proximity-wifi-lte";
};

&mpss_mem {
	reg = <0x0 0x86000000 0x0 0x8c00000>;
};

&remoteproc_mpss {
	firmware-name = "qcom/sc7180-trogdor/modem/mba.mbn",
			"qcom/sc7180-trogdor/modem/qdsp6sw.mbn";
};
