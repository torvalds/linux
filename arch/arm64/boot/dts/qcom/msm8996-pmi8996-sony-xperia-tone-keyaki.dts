// SPDX-License-Identifier: BSD-3-Clause
/*
 * Copyright (c) 2021, Konrad Dybcio <konrad.dybcio@somainline.org>
 */

#include "msm8996-sony-xperia-tone-keyaki.dts"
#include "pmi8996.dtsi"

/ {
	model = "Sony Xperia XZs (PMI8996)";
};
