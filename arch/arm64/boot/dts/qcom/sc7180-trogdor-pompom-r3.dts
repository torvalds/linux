// SPDX-License-Identifier: (GPL-2.0+ OR MIT)
/*
 * Google Pompom board device tree source
 *
 * Copyright 2021 Google LLC.
 */

/dts-v1/;

#include "sc7180-trogdor-pompom.dtsi"

/ {
	model = "Google Pompom (rev3+)";
	compatible = "google,pompom", "qcom,sc7180";
};
