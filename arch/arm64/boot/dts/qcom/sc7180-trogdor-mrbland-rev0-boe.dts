// SPDX-License-Identifier: (GPL-2.0+ OR MIT)
/*
 * Google Mrbland board device tree source
 *
 * Copyright 2021 Google LLC.
 *
 * SKU: 0x10 => 16
 *  - bits 7..4: Panel ID: 0x1 (BOE)
 */

/dts-v1/;

#include "sc7180-trogdor-mrbland-rev0.dtsi"

/ {
	model = "Google Mrbland rev0 BOE panel board";
	compatible = "google,mrbland-rev0-sku16", "qcom,sc7180";
};

&panel {
	compatible = "boe,tv101wum-n53";
};
