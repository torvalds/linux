// SPDX-License-Identifier: (GPL-2.0+ OR MIT)
/*
 * Google Zombie board device tree source
 *
 * Copyright 2022 Google LLC.
 */

/dts-v1/;

#include "sc7280-herobrine-zombie.dtsi"
#include "sc7280-herobrine-lte-sku.dtsi"
#include "sc7280-herobrine-nvme-sku.dtsi"

/ {
	model = "Google Zombie with LTE and NVMe";
	compatible = "google,zombie-sku514", "qcom,sc7280";
};
