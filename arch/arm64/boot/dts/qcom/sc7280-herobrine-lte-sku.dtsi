// SPDX-License-Identifier: (GPL-2.0+ OR MIT)
/*
 * Google Herobrine dts fragment for LTE SKUs
 *
 * Copyright 2022 Google LLC.
 */
/* Modem setup is different on Chrome setups than typical Qualcomm setup */

&remoteproc_mpss {
	compatible = "qcom,sc7280-mss-pil";
	iommus = <&apps_smmu 0x124 0x0>, <&apps_smmu 0x488 0x7>;
	interconnects = <&mc_virt MASTER_LLCC 0 &mc_virt SLAVE_EBI1 0>;
	memory-region = <&mba_mem>, <&mpss_mem>;
	firmware-name = "qcom/sc7280-herobrine/modem/mba.mbn",
			"qcom/sc7280-herobrine/modem/qdsp6sw.mbn";
	status = "okay";
};
