// SPDX-License-Identifier: BSD-3-Clause
/*
 * Copyright (c) 2022, Lux Aliaga <they@mint.lgbt>
 */

/dts-v1/;

#include "sm6225.dtsi"
#include <dt-bindings/gpio/gpio.h>
#include <dt-bindings/input/input.h>
#include <dt-bindings/input/gpio-keys.h>

/ {
	/* required for bootloader to select correct board */
	qcom,board-id = <0x10022 0x00>;
	qcom,msm-id = <0x206 0x10000>;

	model = "Xiaoxin Pad 2022";
	compatible = "lenovo,tb128fu", "qcom,sm6225";
	chassis-type = "tablet";

	chosen {
		bootargs = "earlycon=tty0 console=tty0 PMOS_NOSPLASH clk_ignore_unused pd_ignore_unused";

		#address-cells = <2>;
		#size-cells = <2>;
		ranges;

		stdout-path = "framebuffer0";
		framebuffer0: framebuffer@5c000000 {
			compatible = "simple-framebuffer";
			reg = <0 0x5c000000 0 (2000 * 1200 * 4)>;
			width = <1200>;
			height = <2000>;
			stride = <(1200 * 4)>;
			format = "a8r8g8b8";
			status = "okay";
		};
	};
};
