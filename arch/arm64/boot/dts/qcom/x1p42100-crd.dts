// SPDX-License-Identifier: BSD-3-Clause
/*
 * Copyright (c) 2025 Qualcomm Innovation Center, Inc. All rights reserved.
 */

/dts-v1/;

#include "x1p42100.dtsi"
#include "x1-crd.dtsi"

/delete-node/ &pmc8380_6;
/delete-node/ &pmc8380_6_thermal;

/ {
	model = "Qualcomm Technologies, Inc. X1P42100 CRD";
	compatible = "qcom,x1p42100-crd", "qcom,x1p42100";
};

&gpu_zap_shader {
	firmware-name = "qcom/x1p42100/gen71500_zap.mbn";
};
