// SPDX-License-Identifier: GPL-2.0-only
/* Copyright (c) 2020 The Linux Foundation. All rights reserved.
 */
/dts-v1/;

#include "ipq8074-hk10.dtsi"

/ {
	model = "Qualcomm Technologies, Inc. IPQ8074/AP-HK10-C1";
	compatible = "qcom,ipq8074-hk10-c1", "qcom,ipq8074";
};
