// SPDX-License-Identifier: (GPL-2.0+ OR MIT)
/*
 * Google Villager board device tree source
 *
 * Copyright 2022 Google LLC.
 */

/dts-v1/;

#include "sc7280-herobrine-villager.dtsi"
#include "sc7280-herobrine-lte-sku.dtsi"

/ {
	model = "Google Villager (rev0)";
	compatible = "google,villager-rev0", "qcom,sc7280";
};
