// SPDX-License-Identifier: BSD-3-Clause
/*
 * Copyright (c) 2025 Qualcomm Innovation Center, Inc. All rights reserved.
 * Copyright (c) 2025 Aleksandrs Vinarskis <alex.vinarskis@gmail.com>
 */

/dts-v1/;

#include "x1p42100-asus-zenbook-a14.dtsi"

/ {
	model = "ASUS Zenbook A14 (UX3407QA)";
	compatible = "asus,zenbook-a14-ux3407qa-oled", "asus,zenbook-a14-ux3407qa", "qcom,x1p42100";
};

&panel {
	compatible = "samsung,atna40ct06", "samsung,atna33xc20";
	enable-gpios = <&pmc8380_3_gpios 4 GPIO_ACTIVE_HIGH>;

	pinctrl-0 = <&edp_bl_en>;
	pinctrl-names = "default";
};
