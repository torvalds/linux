// SPDX-License-Identifier: BSD-3-Clause
/*
 * Copyright (c) 2020, Konrad Dybcio
 */

/dts-v1/;

#include "msm8992.dtsi"
#include "pm8994.dtsi"
#include "pmi8994.dtsi"
#include <dt-bindings/gpio/gpio.h>
#include <dt-bindings/input/gpio-keys.h>

/ {
	model = "Microsoft Lumia 950";
	compatible = "microsoft,talkman", "qcom,msm8992";

	/* Most Lumia 950 users use GRUB to load their kernels,
	 * hence there is no need for msm-id and friends.
	 */

	/* This enables graphical output via bootloader-enabled display.
	 * acpi=no is required due to WP platforms having ACPI support, but
	 * only for Windows-based OSes.
	 */
	chosen {
		bootargs = "earlycon=efifb console=efifb acpi=no";

		#address-cells = <2>;
		#size-cells = <2>;
		ranges;
	};
};

&sdhc_1 {
	status = "okay";

	mmc-hs200-1_8v;
};
