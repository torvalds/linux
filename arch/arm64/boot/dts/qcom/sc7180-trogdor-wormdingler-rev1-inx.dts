// SPDX-License-Identifier: (GPL-2.0+ OR MIT)
/*
 * Google Wormdingler board device tree source
 *
 * Copyright 2021 Google LLC.
 *
 * SKU: 0x0000 => 0
 *  - bits 11..8: Panel ID: 0x0 (INX)
 */

/dts-v1/;

#include "sc7180-trogdor-wormdingler.dtsi"
#include "sc7180-trogdor-rt5682i-sku.dtsi"

/ {
	model = "Google Wormdingler rev1+ INX panel board";
	compatible = "google,wormdingler-sku0", "qcom,sc7180";
};

&panel {
	compatible = "innolux,hj110iz-01a";
};
