// SPDX-License-Identifier: BSD-3-Clause
/*
 * Copyright (c) 2024, Antony Kurniawan S. <postmarketos@smankusors.com>
 */
/dts-v1/;

#include "msm8953-asus-common.dtsi"

/ {
	compatible = "asus,zenfone3", "asus,ze520kl", "qcom,msm8953";
	model = "Asus Zenfone 3 (ZE520KL)";
};

&battery {
	charge-full-design-microamp-hours = <2530000>;
};

&sound_card {
	model = "asus-ze520kl";
};
