// SPDX-License-Identifier: (GPL-2.0+ OR MIT)
/*
 * Google Kingoftown board device tree source
 *
 * Copyright 2021 Google LLC.
 */

/dts-v1/;

#include "sc7180-trogdor.dtsi"
#include "sc7180-trogdor-parade-ps8640.dtsi"
#include "sc7180-trogdor-kingoftown.dtsi"

/ {
	model = "Google Kingoftown (rev1+)";
	compatible = "google,kingoftown", "qcom,sc7180";
};
