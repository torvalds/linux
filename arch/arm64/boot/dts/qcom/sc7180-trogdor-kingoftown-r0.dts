// SPDX-License-Identifier: (GPL-2.0+ OR MIT)
/*
 * Google Kingoftown board device tree source
 *
 * Copyright 2021 Google LLC.
 */

/dts-v1/;

#include "sc7180-trogdor.dtsi"
#include "sc7180-trogdor-ti-sn65dsi86.dtsi"
#include "sc7180-trogdor-kingoftown.dtsi"

/ {
	model = "Google Kingoftown (rev0)";
	compatible = "google,kingoftown-rev0", "qcom,sc7180";
};

/*
 * In rev1+, the enable pin of pp3300_fp_tp will be tied to pp1800_l10a
 * power rail instead, since kingoftown does not have FP.
 */
&pp3300_fp_tp {
	gpio = <&tlmm 74 GPIO_ACTIVE_HIGH>;
	enable-active-high;

	pinctrl-names = "default";
	pinctrl-0 = <&en_fp_rails>;
};

&tlmm {
	en_fp_rails: en-fp-rails-state {
		pins = "gpio74";
		function = "gpio";
		drive-strength = <2>;
		bias-disable;
	};
};
