// SPDX-License-Identifier: BSD-3-Clause
/*
 * Copyright (c) 2022, Konrad Dybcio <konrad.dybcio@somainline.org>
 * Copyright (c) 2022, Linaro Limited
 */

/dts-v1/;

#include "sm8450-sony-xperia-nagara.dtsi"

/ {
	model = "Sony Xperia 5 IV";
	compatible = "sony,pdx224", "qcom,sm8450";

	imx563_vdig_vreg: imx563-vdig-regulator {
		compatible = "regulator-fixed";
		regulator-name = "imx563_vdig_vreg";
		gpio = <&tlmm 22 GPIO_ACTIVE_HIGH>;
		enable-active-high;
	};
};
