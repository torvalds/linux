// SPDX-License-Identifier: BSD-3-Clause
/*
 * Copyright (c) 2023, Linaro Limited
 */

/dts-v1/;

#include "lemans-auto.dtsi"

#include "lemans-pmics.dtsi"
#include "lemans-ride-common.dtsi"
#include "lemans-ride-ethernet-aqr115c.dtsi"

/ {
	model = "Qualcomm SA8775P Ride Rev3";
	compatible = "qcom,sa8775p-ride-r3", "qcom,sa8775p";
};
