// SPDX-License-Identifier: (GPL-2.0+ OR MIT)
/*
 * Google Wormdingler board device tree source
 *
 * Copyright 2021 Google LLC.
 *
 * SKU: 0x400 => 1024
 *  - bits 11..8: Panel ID: 0x4 (BOE)
 */

/dts-v1/;

#include "sc7180-trogdor-wormdingler.dtsi"

/ {
	model = "Google Wormdingler rev1+ BOE panel board";
	compatible = "google,wormdingler-sku1024", "qcom,sc7180";
};

&mdss_dsi0_phy {
	qcom,phy-rescode-offset-top = /bits/ 8 <31 31 31 31 (-32)>;
	qcom,phy-rescode-offset-bot = /bits/ 8 <31 31 31 31 (-32)>;
	qcom,phy-drive-ldo-level = <450>;
};

&panel {
	compatible = "boe,tv110c9m-ll3";
};
