// SPDX-License-Identifier: BSD-3-Clause
/*
 * Copyright (c) 2020, Konrad Dybcio <konrad.dybcio@somainline.org>
 */

/dts-v1/;

#include "msm8994-sony-xperia-kitakami.dtsi"

/ {
	model = "Sony Xperia Z3+/Z4";
	compatible = "sony,ivy-row", "qcom,msm8994";
};

&pm8994_l3 {
	regulator-min-microvolt = <1000000>;
	regulator-max-microvolt = <1000000>;
};

&pm8994_l17 {
	regulator-min-microvolt = <2700000>;
	regulator-max-microvolt = <2700000>;
};

/delete-node/ &pm8994_l19;
/delete-node/ &pm8994_l32;
