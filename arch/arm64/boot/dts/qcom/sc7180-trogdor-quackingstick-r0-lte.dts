// SPDX-License-Identifier: (GPL-2.0+ OR MIT)
/*
 * Google Quackingstick board device tree source
 *
 * Copyright 2021 Google LLC.
 *
 * SKU: 0x600 => 1536
 *  - bits 11..8: Panel ID: 0x6 (AUO)
 */

#include "sc7180-trogdor-quackingstick-r0.dts"
#include "sc7180-trogdor-lte-sku.dtsi"

/ {
	model = "Google Quackingstick (rev0+) with LTE";
	compatible = "google,quackingstick-sku1536", "qcom,sc7180";
};

&ap_sar_sensor {
	compatible = "semtech,sx9324";
	semtech,ph0-pin = <3 1 3>;
	semtech,ph1-pin = <2 1 2>;
	semtech,ph2-pin = <3 3 1>;
	semtech,ph3-pin = <1 3 3>;
	semtech,ph01-resolution = <1024>;
	semtech,ph23-resolution = <1024>;
	semtech,startup-sensor = <1>;
	semtech,ph01-proxraw-strength = <3>;
	semtech,ph23-proxraw-strength = <3>;
	semtech,avg-pos-strength = <256>;

	/delete-property/ svdd-supply;
	vdd-supply = <&pp1800_prox>;
};

&ap_sar_sensor_i2c {
	status = "okay";
};
