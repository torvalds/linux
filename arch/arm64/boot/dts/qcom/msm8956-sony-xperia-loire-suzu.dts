// SPDX-License-Identifier: BSD-3-Clause
/*
 * Copyright (c) 2016-2022, AngeloGioacchino Del Regno
 *                          <angelogioacchino.delregno@somainline.org>
 * Copyright (c) 2022, Konrad Dybcio <konrad.dybcio@somainline.org>
 * Copyright (c) 2022, Marijn Suijten <marijn.suijten@somainline.org>
 */

/dts-v1/;

#include "msm8956-sony-xperia-loire.dtsi"

/ {
	model = "Sony Xperia X";
	compatible = "sony,suzu-row", "qcom,msm8956";
	chassis-type = "handset";
};
