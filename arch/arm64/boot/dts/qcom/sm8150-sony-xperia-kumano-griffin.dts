// SPDX-License-Identifier: BSD-3-Clause
/*
 * Copyright (c) 2021, Konrad Dybcio <konrad.dybcio@somainline.org>
 */

/dts-v1/;

#include "sm8150-sony-xperia-kumano.dtsi"

/ {
	model = "Sony Xperia 1";
	compatible = "sony,griffin-generic", "qcom,sm8150";
	chassis-type = "handset";
};
