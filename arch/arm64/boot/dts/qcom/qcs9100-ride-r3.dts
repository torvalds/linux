// SPDX-License-Identifier: BSD-3-Clause
/*
 * Copyright (c) 2024, Qualcomm Innovation Center, Inc. All rights reserved.
 */
/dts-v1/;

#include "lemans.dtsi"
#include "lemans-pmics.dtsi"

#include "lemans-ride-common.dtsi"
#include "lemans-ride-ethernet-aqr115c.dtsi"

/ {
	model = "Qualcomm Technologies, Inc. Lemans Ride Rev3";
	compatible = "qcom,qcs9100-ride-r3", "qcom,qcs9100", "qcom,sa8775p";
};
