// SPDX-License-Identifier: (GPL-2.0+ OR MIT)
/*
 * Google Pazquel board device tree source
 *
 * Copyright 2021 Google LLC.
 */

/dts-v1/;

#include "sc7180-trogdor.dtsi"
#include "sc7180-trogdor-ti-sn65dsi86.dtsi"
#include "sc7180-trogdor-pazquel.dtsi"
#include "sc7180-trogdor-lte-sku.dtsi"

/ {
	model = "Google Pazquel (TI,LTE)";
	compatible = "google,pazquel-sku0", "google,pazquel-sku2", "qcom,sc7180";
};

&ap_sar_sensor_i2c {
	status = "okay";
};
