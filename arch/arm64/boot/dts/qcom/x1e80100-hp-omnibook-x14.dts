// SPDX-License-Identifier: BSD-3-Clause
/*
 * Copyright (c) 2023 Qualcomm Innovation Center, Inc. All rights reserved.
 * Copyright (c) 2024, Xilin Wu <wuxilin123@gmail.com>
 */

/dts-v1/;

#include "x1e80100.dtsi"
#include "x1e80100-pmics.dtsi"
#include "x1-hp-omnibook-x14.dtsi"

/ {
	model = "HP Omnibook X 14-fe0";
	compatible = "hp,omnibook-x14", "qcom,x1e80100";
	chassis-type = "laptop";
};

&gpu_zap_shader {
	firmware-name = "qcom/x1e80100/hp/omnibook-x14/qcdxkmsuc8380.mbn";
};

&remoteproc_adsp {
	firmware-name = "qcom/x1e80100/hp/omnibook-x14/qcadsp8380.mbn",
			"qcom/x1e80100/hp/omnibook-x14/adsp_dtbs.elf";

	status = "okay";
};

&remoteproc_cdsp {
	firmware-name = "qcom/x1e80100/hp/omnibook-x14/qccdsp8380.mbn",
			"qcom/x1e80100/hp/omnibook-x14/cdsp_dtbs.elf";

	status = "okay";
};
