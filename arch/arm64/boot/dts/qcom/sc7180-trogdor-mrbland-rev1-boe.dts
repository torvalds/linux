// SPDX-License-Identifier: (GPL-2.0+ OR MIT)
/*
 * Google Mrbland board device tree source
 *
 * Copyright 2021 Google LLC.
 *
 * SKU: 0x300 => 768
 *  - bits 11..8: Panel ID: 0x3 (BOE)
 */

/dts-v1/;

#include "sc7180-trogdor-mrbland.dtsi"

/ {
	model = "Google Mrbland (rev1 - 2) BOE panel board";
	/* Uses ID 768 on rev1 and 1024 on rev2+ */
	compatible = "google,mrbland-sku1024", "google,mrbland-sku768",
		"qcom,sc7180";
};

&panel {
	compatible = "boe,tv101wum-n53";
};
