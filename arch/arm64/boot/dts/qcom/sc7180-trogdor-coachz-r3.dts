// SPDX-License-Identifier: (GPL-2.0+ OR MIT)
/*
 * Google CoachZ board device tree source
 *
 * Copyright 2021 Google LLC.
 */

/dts-v1/;

#include "sc7180-trogdor-coachz.dtsi"

/ {
	model = "Google CoachZ (rev3+)";
	compatible = "google,coachz", "qcom,sc7180";
};
