// SPDX-License-Identifier: GPL-2.0-only
/*
 * Copyright (c) Qualcomm Technologies, Inc. and/or its subsidiaries.
 */

/dts-v1/;

#include "msm8996pro.dtsi"
#include "apq8096-db820c.dtsi"

/ {
	model = "Qualcomm Technologies, Inc. DB820c";
	compatible = "arrow,apq8096sg-db820c", "arrow,apq8096-db820c",
		"qcom,apq8096-sbc", "qcom,apq8096sg", "qcom,apq8096";
};
