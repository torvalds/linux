// SPDX-License-Identifier: (GPL-2.0+ OR MIT)
/*
 * Google Herobrine board device tree source
 *
 * Copyright 2021 Google LLC.
 */

#include "sc7280-herobrine.dtsi"

/ {
	model = "Google Herobrine";
	compatible = "google,herobrine",
		     "qcom,sc7280";
};
