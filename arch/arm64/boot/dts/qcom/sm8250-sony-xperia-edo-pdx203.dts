// SPDX-License-Identifier: BSD-3-Clause
/*
 * Copyright (c) 2021, Konrad Dybcio <konrad.dybcio@somainline.org>
 */

/dts-v1/;

#include "sm8250-sony-xperia-edo.dtsi"

/ {
	model = "Sony Xperia 1 II";
	compatible = "sony,pdx203-generic", "qcom,sm8250";
};

/delete-node/ &vreg_l7f_1p8;
