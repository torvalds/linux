// SPDX-License-Identifier: (GPL-2.0-or-later OR BSD-3-Clause)
/*
 * Copyright (C) 2025-2026 Marek Vasut <marex@nabladev.com>
 */

/dts-v1/;

#include "stm32mp255.dtsi"
#include "stm32mp25xc.dtsi"
#include "stm32mp25xx-dhcos-som.dtsi"

/ {
	model = "DH electronics STM32MP25xx DHCOS Breakout Board";
	compatible = "dh,stm32mp251a-dhcos-bb", "dh,stm32mp251a-dhcos-som", "st,stm32mp251";
};
