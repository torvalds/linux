// SPDX-License-Identifier: (GPL-2.0+ OR MIT)
/*
 * Copyright (c) 2020 Fuzhou Rockchip Electronics Co., Ltd
 * Copyright (c) 2020 Engicam srl
 * Copyright (c) 2020 Amarula Solutions
 * Copyright (c) 2020 Amarula Solutions(India)
 */

/dts-v1/;
#include "px30.dtsi"
#include "px30-engicam-ctouch2.dtsi"
#include "px30-engicam-px30-core.dtsi"

/ {
	model = "Engicam PX30.Core C.TOUCH 2.0";
	compatible = "engicam,px30-core-ctouch2", "engicam,px30-core",
		     "rockchip,px30";

	chosen {
		stdout-path = "serial2:115200n8";
	};
};
