// SPDX-License-Identifier: (GPL-2.0+ OR MIT)
/*
 * Copyright (c) 2023 Rockchip Electronics Co., Ltd.
 *
 */

/dts-v1/;
#include "rk3568-toybrick-sd0.dtsi"
#include "rk3568-linux.dtsi"
//#include "rk3568-toybrick-sd0-mipi-tx0.dtsi"
/delete-node/ &board_id;
/ {
	model = "Rockchip RK3568 Toybrick SD0 Board";
	compatible = "rockchip,rk3568-toybrick-sd0-linux","rockchip,rk3568";
};
