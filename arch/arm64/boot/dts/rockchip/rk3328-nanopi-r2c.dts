// SPDX-License-Identifier: GPL-2.0-or-later OR MIT
/*
 * Copyright (c) 2021 FriendlyElec Computer Tech. Co., Ltd.
 * (http://www.friendlyarm.com)
 *
 * Copyright (c) 2021-2023 Tianling Shen <cnsztl@gmail.com>
 */

/dts-v1/;

#include "rk3328-nanopi-r2c.dtsi"

/ {
	model = "FriendlyElec NanoPi R2C";
	compatible = "friendlyarm,nanopi-r2c", "rockchip,rk3328";
};
