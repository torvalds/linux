// SPDX-License-Identifier: (GPL-2.0+ OR MIT)
/*
 * Copyright (c) 2017 T-Chip Intelligent Technology Co., Ltd
 */

/dts-v1/;

#include <dt-bindings/input/input.h>
#include "rk3328-roc.dtsi"

/ {
	model = "Firefly ROC-RK3328-CC";
	compatible = "firefly,roc-rk3328-cc", "rockchip,rk3328";
};

&rk805 {
	interrupt-parent = <&gpio1>;
	interrupts = <24 IRQ_TYPE_LEVEL_LOW>;
};

&vcc_host1_5v {
	gpio = <&gpio1 RK_PD2 GPIO_ACTIVE_HIGH>;
};

&vcc_sdio {
	gpios = <&grf_gpio 0 GPIO_ACTIVE_HIGH>;
};
