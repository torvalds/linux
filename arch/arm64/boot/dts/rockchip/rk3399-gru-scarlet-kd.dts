// SPDX-License-Identifier: (GPL-2.0+ OR MIT)
/*
 * Google Gru-Scarlet Rev3+ (SKU-7/Kingdisplay) board device tree source
 *
 * Copyright 2018 Google, Inc
 */

/dts-v1/;

#include "rk3399-gru-scarlet.dtsi"

/ {
	model = "Google Scarlet";
	compatible = "google,scarlet-rev15-sku7", "google,scarlet-rev15",
		     "google,scarlet-rev14-sku7", "google,scarlet-rev14",
		     "google,scarlet-rev13-sku7", "google,scarlet-rev13",
		     "google,scarlet-rev12-sku7", "google,scarlet-rev12",
		     "google,scarlet-rev11-sku7", "google,scarlet-rev11",
		     "google,scarlet-rev10-sku7", "google,scarlet-rev10",
		     "google,scarlet-rev9-sku7",  "google,scarlet-rev9",
		     "google,scarlet-rev8-sku7",  "google,scarlet-rev8",
		     "google,scarlet-rev7-sku7",  "google,scarlet-rev7",
		     "google,scarlet-rev6-sku7",  "google,scarlet-rev6",
		     "google,scarlet-rev5-sku7",  "google,scarlet-rev5",
		     "google,scarlet-rev4-sku7",  "google,scarlet-rev4",
		     "google,scarlet-rev3-sku7",  "google,scarlet-rev3",
		     "google,scarlet", "google,gru", "rockchip,rk3399";
};

&mipi_panel {
	compatible = "kingdisplay,kd097d04";
	power-supply = <&pp3300_s0>;
};
