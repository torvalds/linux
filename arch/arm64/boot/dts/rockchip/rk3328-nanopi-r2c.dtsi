// SPDX-License-Identifier: GPL-2.0-or-later OR MIT
/*
 * Copyright (c) 2021 FriendlyElec Computer Tech. Co., Ltd.
 * (http://www.friendlyarm.com)
 *
 * Copyright (c) 2021-2023 Tianling Shen <cnsztl@gmail.com>
 */

/dts-v1/;

#include "rk3328-nanopi-r2.dtsi"

&gmac2io {
	phy-handle = <&yt8521s>;
	tx_delay = <0x22>;
	rx_delay = <0x12>;
	status = "okay";

	mdio {
		yt8521s: ethernet-phy@3 {
			compatible = "ethernet-phy-ieee802.3-c22";
			reg = <3>;

			motorcomm,clk-out-frequency-hz = <125000000>;
			motorcomm,keep-pll-enabled;
			motorcomm,auto-sleep-disabled;

			pinctrl-0 = <&eth_phy_reset_pin>;
			pinctrl-names = "default";
			reset-assert-us = <10000>;
			reset-deassert-us = <50000>;
			reset-gpios = <&gpio1 RK_PC2 GPIO_ACTIVE_LOW>;
		};
	};
};
