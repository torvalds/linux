// SPDX-License-Identifier: (GPL-2.0+ OR MIT)
/*
 * Copyright (c) 2018 Fuzhou Rockchip Electronics Co., Ltd
 */

#include "px30-evb-ext-rk618.dtsi"

/ {
	model = "Rockchip PX30 EVB EXT RK618 board";
	compatible = "rockchip,px30-evb-ext-rk618-avb", "rockchip,px30";
};
