// SPDX-License-Identifier: (GPL-2.0+ OR MIT)
/*
 * Copyright (c) 2021 Rockchip Electronics Co., Ltd.
 *
 */

/dts-v1/;

#include "rk3588-evb3-lp5.dtsi"
#include "rk3588-android.dtsi"
#include "rk3588-evb3-imx415.dtsi"

/ {
	model = "Rockchip RK3588 EVB3 LP5 V10 Board";
	compatible = "rockchip,rk3588-evb3-lp5-v10", "rockchip,rk3588";
};
