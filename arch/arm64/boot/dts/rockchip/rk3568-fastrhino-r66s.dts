// SPDX-License-Identifier: GPL-2.0-or-later OR MIT

#include "rk3568-fastrhino-r66s.dtsi"

/ {
	model = "Lunzn FastRhino R66S";
	compatible = "lunzn,fastrhino-r66s", "rockchip,rk3568";

	aliases {
		mmc0 = &sdmmc0;
	};
};

&pmu_io_domains {
	vccio3-supply = <&vccio_sd>;
};

&sdmmc0 {
	bus-width = <4>;
	cap-mmc-highspeed;
	cap-sd-highspeed;
	disable-wp;
	max-frequency = <150000000>;
	no-sdio;
	no-mmc;
	pinctrl-names = "default";
	pinctrl-0 = <&sdmmc0_bus4 &sdmmc0_clk &sdmmc0_cmd &sdmmc0_det>;
	vmmc-supply = <&vcc3v3_sd>;
	vqmmc-supply = <&vccio_sd>;
	status = "okay";
};
