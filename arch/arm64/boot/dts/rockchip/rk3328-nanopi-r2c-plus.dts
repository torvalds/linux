// SPDX-License-Identifier: GPL-2.0-or-later OR MIT
/*
 * Copyright (c) 2021 FriendlyElec Computer Tech. Co., Ltd.
 * (http://www.friendlyarm.com)
 *
 * Copyright (c) 2023 Tianling Shen <cnsztl@gmail.com>
 */

/dts-v1/;

#include "rk3328-nanopi-r2c.dtsi"

/ {
	model = "FriendlyElec NanoPi R2C Plus";
	compatible = "friendlyarm,nanopi-r2c-plus", "rockchip,rk3328";

	aliases {
		mmc1 = &emmc;
	};
};

&emmc {
	bus-width = <8>;
	cap-mmc-highspeed;
	max-frequency = <150000000>;
	mmc-ddr-1_8v;
	mmc-hs200-1_8v;
	non-removable;
	pinctrl-names = "default";
	pinctrl-0 = <&emmc_clk &emmc_cmd &emmc_bus8>;
	vmmc-supply = <&vcc_io_33>;
	vqmmc-supply = <&vcc18_emmc>;
	status = "okay";
};
