// SPDX-License-Identifier: (GPL-2.0+ OR MIT)
/*
 * Copyright (c) 2019 Akash Gajjar <Akash_Gajjar@mentor.com>
 * Copyright (c) 2019 Pragnesh Patel <Pragnesh_Patel@mentor.com>
 */

/dts-v1/;
#include "rk3399-rock-pi-4.dtsi"
#include "rk3399-op1-opp.dtsi"

/ {
	model = "Radxa ROCK Pi 4A+";
	compatible = "radxa,rockpi4a-plus", "radxa,rockpi4", "rockchip,rk3399";
};

&es8316 {
	pinctrl-0 = <&hp_detect &hp_int>;
	pinctrl-names = "default";
	interrupt-parent = <&gpio1>;
	interrupts = <RK_PA1 IRQ_TYPE_LEVEL_HIGH>;
};

&sound {
	hp-det-gpio = <&gpio1 RK_PA0 GPIO_ACTIVE_HIGH>;
};
