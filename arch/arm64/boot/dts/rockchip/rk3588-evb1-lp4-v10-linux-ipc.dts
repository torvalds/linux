// SPDX-License-Identifier: (GPL-2.0+ OR MIT)
/*
 * Copyright (c) 2022 Rockchip Electronics Co., Ltd.
 *
 */

/dts-v1/;

#include "rk3588-evb1-lp4.dtsi"
#include "rk3588-evb1-imx415.dtsi"
#include "rk3588-ipc.dtsi"

/ {
	model = "Rockchip RK3588 EVB1 LP4 V10 Board";
	compatible = "rockchip,rk3588-evb1-lp4-v10-linux-ipc", "rockchip,rk3588";
};
