// SPDX-License-Identifier: (GPL-2.0+ OR MIT)
/*
 * Copyright (c) 2023 Rockchip Electronics Co., Ltd
 */

#include <dt-bindings/input/input.h>
#include "rk3308-evb-v11.dtsi"

/ {
	model = "Rockchip RK3308 EVB V13";
	compatible = "rockchip,rk3308-evb-v13", "rockchip,rk3308";

	/delete-node/ wireless-wlan;
	wireless-wlan {
		compatible = "wlan-platdata";
		rockchip,grf = <&grf>;
		pinctrl-names = "default";
		pinctrl-0 = <&wifi_wake_host>, <&rtc_32k>;
		wifi_chip_type = "ap6256";
		WIFI,host_wake_irq = <&gpio2 RK_PB4 GPIO_ACTIVE_HIGH>;
		status = "okay";
	};
};
