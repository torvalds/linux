// SPDX-License-Identifier: (GPL-2.0+ OR MIT)

/dts-v1/;

#include "rk3588s-nanopi-r6.dtsi"

/ {
	model = "FriendlyElec NanoPi R6S";
	compatible = "friendlyarm,nanopi-r6s", "rockchip,rk3588s";
};

&lan2_led {
	label = "lan2_led";
};
