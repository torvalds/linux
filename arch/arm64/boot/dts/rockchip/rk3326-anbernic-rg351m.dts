// SPDX-License-Identifier: (GPL-2.0+ OR MIT)
/*
 * Copyright (c) 2019 Hardkernel Co., Ltd
 * Copyright (c) 2020 Theobroma Systems Design und Consulting GmbH
 * Copyright (c) 2022 Maya Matuszczyk <maccraft123mc@gmail.com>
 */

/dts-v1/;
#include "rk3326-anbernic-rg351m.dtsi"

/ {
	model = "Anbernic RG351M";
	compatible = "anbernic,rg351m", "rockchip,rk3326";
};

&internal_display {
	compatible = "elida,kd35t133";
	iovcc-supply = <&vcc_lcd>;
	rotation = <270>;
	vdd-supply = <&vcc_lcd>;
};
