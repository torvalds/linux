// SPDX-License-Identifier: (GPL-2.0+ OR MIT)
/*
 * Copyright (c) 2022 Rockchip Electronics Co., Ltd.
 *
 */

#include "rk3562-test1-ddr3-v10.dtsi"
#include "rk3562-android.dtsi"
#include "rk3562-rk809.dtsi"

&rk809_codec {
	#sound-dai-cells = <1>;
	compatible = "rockchip,rk809-codec", "rockchip,rk817-codec";
	clocks = <&mclkout_sai2>;
	clock-names = "mclk";
	assigned-clocks = <&mclkout_sai2>;
	assigned-clock-rates = <12288000>;
	pinctrl-names = "default";
	pinctrl-0 = <&i2s2m1_mclk>;
	hp-volume = <20>;
	spk-volume = <3>;
	/delete-property/ mic-in-differential;
	status = "okay";
};
