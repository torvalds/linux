// SPDX-License-Identifier: (GPL-2.0+ OR MIT)
/*
 * Copyright (c) 2020 Fuzhou Rockchip Electronics Co., Ltd
 */

#include "px30.dtsi"

&display_subsystem {
	ports = <&vopb_out>;
};

/delete-analde/ &dsi_in_vopl;
/delete-analde/ &lvds_vopl_in;
/delete-analde/ &vopl;
/delete-analde/ &vopl_mmu;
