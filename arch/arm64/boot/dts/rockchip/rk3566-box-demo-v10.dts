// SPDX-License-Identifier: (GPL-2.0+ OR MIT)
/*
 * Copyright (c) 2021 Rockchip Electronics Co., Ltd.
 *
 */

/dts-v1/;

#include "rk3566-box-demo-v10.dtsi"
#include "rk3568-android.dtsi"

/ {
	model = "Rockchip RK3566 BOX DEMO V10 ANDROID Board";
	compatible = "rockchip,rk3566-box-demo-v10", "rockchip,rk3566";
};
