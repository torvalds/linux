// SPDX-License-Identifier: (GPL-2.0 OR MIT)
/*
 * Copyright (C) 2025 Michael Opdenacker <michael.opdenacker@rootcommit.com>
 */

/dts-v1/;

#include "rk3566-tinker-board-3.dtsi"

/ {
	model = "Asus Tinker Board 3S";
	compatible = "asus,rk3566-tinker-board-3s", "rockchip,rk3566";

	aliases {
		mmc0 = &sdhci;
	};
};

&sdhci {
	bus-width = <8>;
	cap-mmc-highspeed;
	max-frequency = <200000000>;
	mmc-hs200-1_8v;
	non-removable;
	pinctrl-names = "default";
	pinctrl-0 = <&emmc_bus8 &emmc_clk &emmc_cmd &emmc_datastrobe>;
	vmmc-supply = <&vcc_3v3>;
	vqmmc-supply = <&vcc_1v8>;
	status = "okay";
};
