// SPDX-License-Identifier: (GPL-2.0+ OR MIT)
/*
 * Copyright (c) 2021 Rockchip Electronics Co., Ltd.
 *
 */

/dts-v1/;

#include "rk3588-evb6-lp4.dtsi"
#include "rk3588-android.dtsi"

/ {
	model = "Rockchip RK3588 EVB6 LP4 V10 Board";
	compatible = "rockchip,rk3588-evb6-lp4-v10", "rockchip,rk3588";
};
