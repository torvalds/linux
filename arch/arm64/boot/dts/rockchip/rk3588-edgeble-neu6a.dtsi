// SPDX-License-Identifier: (GPL-2.0+ OR MIT)
/*
 * Copyright (c) 2022 Edgeble AI Technologies Pvt. Ltd.
 */

#include "rk3588-edgeble-neu6a-common.dtsi"

/ {
	compatible = "edgeble,neural-compute-module-6a", "rockchip,rk3588";
};
