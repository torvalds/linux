// SPDX-License-Identifier: (GPL-2.0+ OR MIT)
/*
 * Copyright (c) 2020 David Bauer <mail@david-bauer.net>
 */

/dts-v1/;

#include "rk3328-nanopi-r2s.dtsi"

/ {
	model = "FriendlyElec NanoPi R2S";
	compatible = "friendlyarm,nanopi-r2s", "rockchip,rk3328";
};
