// SPDX-License-Identifier: (GPL-2.0+ OR MIT)
/*
 * Copyright (c) 2026 Cherry Embedded Solutions GmbH
 *
 * Device Tree Overlay for CAN1-CAN2-UART4 adapter for the Mezzanine connector
 * on RK3588 Jaguar.
 *
 * This adapter has two CAN transceivers and one RS232 transceiver.
 */

/dts-v1/;
/plugin/;

&can1 {
	status = "okay";
};

&can2 {
	status = "okay";
};

/* RS232 */
&uart4 {
	/* ST3232B only guarantees 250Kbps */
	status = "okay";
};
