// SPDX-License-Identifier: (GPL-2.0+ OR MIT)
/*
 * Copyright (c) 2021 Rockchip Electronics Co., Ltd.
 *
 */

/dts-v1/;

#include "rk3588-nvr-demo.dtsi"
#include "rk3588-linux.dtsi"

/ {
	model = "Rockchip RK3588 NVR DEMO LP4 V10 Board";
	compatible = "rockchip,rk3588-nvr-demo-v10", "rockchip,rk3588";
};
