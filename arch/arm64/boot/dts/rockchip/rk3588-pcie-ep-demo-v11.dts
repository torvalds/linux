// SPDX-License-Identifier: (GPL-2.0+ OR MIT)
/*
 * Copyright (c) 2023 Rockchip Electronics Co., Ltd.
 *
 */

/dts-v1/;

#include "rk3588-pcie-ep-demo.dtsi"
#include "rk3588-android.dtsi"

/ {
	model = "Rockchip RK3588 PCIE EP Demo V11 Board";
	compatible = "rockchip,rk3588-pcie-ep-demo-v11", "rockchip,rk3588";
};
