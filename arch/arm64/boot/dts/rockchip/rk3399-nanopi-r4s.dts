// SPDX-License-Identifier: (GPL-2.0+ OR MIT)
/*
 * Copyright (c) 2020 FriendlyElec Computer Tech. Co., Ltd.
 */

/dts-v1/;

#include "rk3399-nanopi-r4s.dtsi"

/ {
	model = "FriendlyElec NanoPi R4S";
	compatible = "friendlyarm,nanopi-r4s", "rockchip,rk3399";
};
