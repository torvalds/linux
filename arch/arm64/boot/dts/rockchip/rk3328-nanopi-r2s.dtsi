// SPDX-License-Identifier: (GPL-2.0+ OR MIT)
/*
 * (C) Copyright 2018 FriendlyElec Computer Tech. Co., Ltd.
 * (http://www.friendlyarm.com)
 *
 * (C) Copyright 2016 Rockchip Electronics Co., Ltd
 */

/dts-v1/;

#include "rk3328-nanopi-r2.dtsi"

&gmac2io {
	phy-handle = <&rtl8211e>;
	tx_delay = <0x24>;
	rx_delay = <0x18>;
	status = "okay";

	mdio {
		rtl8211e: ethernet-phy@1 {
			reg = <1>;
			pinctrl-0 = <&eth_phy_reset_pin>;
			pinctrl-names = "default";
			reset-assert-us = <10000>;
			reset-deassert-us = <50000>;
			reset-gpios = <&gpio1 RK_PC2 GPIO_ACTIVE_LOW>;
		};
	};
};
