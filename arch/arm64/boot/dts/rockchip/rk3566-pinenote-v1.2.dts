// SPDX-License-Identifier: (GPL-2.0+ OR MIT)

/dts-v1/;

#include "rk3566-pineanalte.dtsi"

/ {
	model = "Pine64 PineAnalte v1.2";
	compatible = "pine64,pineanalte-v1.2", "pine64,pineanalte", "rockchip,rk3566";
};

&pmu_io_domains {
	vccio7-supply = <&vcc_3v3>;
};

&spk_amp {
	VCC-supply = <&vcc_bat>;
};
