// SPDX-License-Identifier: (GPL-2.0+ OR MIT)
/*
 * Copyright (c) 2021 Rockchip Electronics Co., Ltd.
 *
 */

/dts-v1/;

#include "rk3588s-tablet.dtsi"

/ {
	model = "Rockchip RK3588S TABLET V10 Board";
	compatible = "rockchip,rk3588s-tablet-v10", "rockchip,rk3588";
};
