// SPDX-License-Identifier: (GPL-2.0+ OR MIT)
/*
 * FriendlyElec NanoPi M4 board device tree source
 *
 * Copyright (c) 2018 FriendlyElec Computer Tech. Co., Ltd.
 * (http://www.friendlyarm.com)
 *
 * Copyright (c) 2018 Collabora Ltd.
 * Copyright (c) 2019 Arm Ltd.
 */

/dts-v1/;

#include "rk3399-nanopi-m4.dtsi"

/ {
	model = "FriendlyElec NanoPi M4";
	compatible = "friendlyarm,nanopi-m4", "rockchip,rk3399";
};

&u2phy0_host {
	phy-supply = <&vcc5v0_usb1>;
};
