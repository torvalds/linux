// SPDX-License-Identifier: (GPL-2.0+ OR MIT)
/*
 * Copyright (c) 2018 Fuzhou Rockchip Electronics Co., Ltd.
 */

/dts-v1/;
#include "rk3399-sapphire.dtsi"

/ {
	model = "Sapphire-RK3399 Board";
	compatible = "rockchip,rk3399-sapphire", "rockchip,rk3399";
};
