/*
 * Copyright (c) 2017 Fuzhou Rockchip Electronics Co., Ltd
 *
 * SPDX-License-Identifier: (GPL-2.0+ OR MIT)
 */

#include "../../../../drivers/soc/rockchip/rk_camera_sensor_info.h"
/{
	cif_sensor: cif_sensor {
		compatible = "rockchip,sensor";
		status = "disabled";

		gc2145_b {
			is_front = <0>;
			powerdown-gpios = <&gpio2 RK_PB5 GPIO_ACTIVE_HIGH>;
			pwdn_active = <gc2145_PWRDN_ACTIVE>;
			pwr_active = <PWR_ACTIVE_HIGH>;
			rockchip,power_pmu_name1 = "vcc2v8_dvp";
			rockchip,power_pmu_voltage1 = <2800000>;
			rockchip,power_pmu_name2 = "vcc1v8_dvp";
			rockchip,power_pmu_voltage2 = <1800000>;
			mir = <0>;
			flash_attach = <0>;
			resolution = <gc2145_FULL_RESOLUTION>;
			powerup_sequence = <gc2145_PWRSEQ>;
			orientation = <90>;
			i2c_add = <gc2145_I2C_ADDR>;
			i2c_chl = <2>;
			cif_chl = <0>;
			mclk_rate = <24>;
		};

		gc0312_f {
			is_front = <1>;
			powerdown-gpios = <&gpio2 RK_PB6 GPIO_ACTIVE_HIGH>;
			pwdn_active = <gc0312_PWRDN_ACTIVE>;
			pwr_active = <PWR_ACTIVE_HIGH>;
			rockchip,power_pmu_name1 = "vcc2v8_dvp";
			rockchip,power_pmu_voltage1 = <2800000>;
			rockchip,power_pmu_name2 = "vcc1v8_dvp";
			rockchip,power_pmu_voltage2 = <1800000>;
			mir = <0>;
			flash_attach = <0>;
			resolution = <gc0312_FULL_RESOLUTION>;
			powerup_sequence = <gc0312_PWRSEQ>;
			orientation = <270>;
			i2c_add = <gc0312_I2C_ADDR>;
			i2c_chl = <2>;
			cif_chl = <0>;
			mclk_rate = <24>;
		};
	};
};

