// SPDX-License-Identifier: (GPL-2.0+ OR MIT)
/*
 * Copyright (c) 2022 Rockchip Electronics Co., Ltd.
 *
 */

/dts-v1/;

#include "rk3588-h0.dtsi"
#include "rk3588-h0-imx415.dtsi"
#include "rk3588-linux.dtsi"

/ {
	model = "Rockchip RK3588 H0 V10 Board";
	compatible = "rockchip,rk3588-h0-v10", "rockchip,rk3588";
};
