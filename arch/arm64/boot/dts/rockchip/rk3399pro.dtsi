// SPDX-License-Identifier: (GPL-2.0+ OR MIT)
// Copyright (c) 2019 Fuzhou Rockchip Electronics Co., Ltd.

#include "rk3399.dtsi"

/ {
	compatible = "rockchip,rk3399pro";
};

/* Default to enabled since AP talk to NPU part over pcie */
&pcie_phy {
	status = "okay";
};

/* Default to enabled since AP talk to NPU part over pcie */
&pcie0 {
	ep-gpios = <&gpio0 RK_PB4 GPIO_ACTIVE_HIGH>;
	num-lanes = <4>;
	pinctrl-names = "default";
	pinctrl-0 = <&pcie_clkreqn_cpm>;
	status = "okay";
};
