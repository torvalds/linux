// SPDX-License-Identifier: (GPL-2.0+ OR MIT)
/*
 * Copyright (c) 2018 Fuzhou Rockchip Electronics Co., Ltd
 */

&cluster0_opp {
	rockchip,high-temp = <70000>;
	rockchip,high-temp-max-volt = <1125000>;
	opp-1512000000 {
		opp-hz = /bits/ 64 <1512000000>;
		opp-microvolt = <1150000 1150000 1250000>;
		clock-latency-ns = <40000>;
	};
};

&cluster1_opp {
	rockchip,high-temp = <70000>;
	rockchip,high-temp-max-volt = <1200000>;
	opp-2016000000 {
		opp-hz = /bits/ 64 <2016000000>;
		opp-microvolt = <1250000 1250000 1250000>;
		clock-latency-ns = <40000>;
	};
};
