// SPDX-License-Identifier: (GPL-2.0+ OR MIT)
/*
 * Copyright (c) 2022 Rockchip Electronics Co., Ltd.
 *
 */

#include "rk3528-evb1-ddr4-v10.dtsi"
#include "rk3528-android.dtsi"

/ {
	model = "Rockchip rk3528 evb4 board";
	compatible = "rockchip,rk3528-evb4-ddr4-v10", "rockchip,rk3528";
};

&sdmmc {
	status = "okay";
};
