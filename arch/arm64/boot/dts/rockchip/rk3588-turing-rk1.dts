// SPDX-License-Identifier: (GPL-2.0+ OR MIT)
/*
 * This device tree covers the common case where the RK1 is used as a
 * "compute node" system, where the carrier board is functioning more like a
 * generic backplane (with no non-autoenumerable peripherals of its own) than
 * like a device that the SoM is meant to enable.
 *
 * Copyright (c) 2023 Sam Edwards <CFSworks@gmail.com>
 */

/dts-v1/;
#include "rk3588-turing-rk1.dtsi"

/ {
	model = "Turing Machines RK1";
	compatible = "turing,rk1", "rockchip,rk3588";

	chosen {
		stdout-path = "serial9:115200n8";
	};
};
