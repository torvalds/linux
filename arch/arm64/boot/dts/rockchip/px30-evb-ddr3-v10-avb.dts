// SPDX-License-Identifier: (GPL-2.0+ OR MIT)
/*
 * Copyright (c) 2017-2019 Fuzhou Rockchip Electronics Co., Ltd
 */

/dts-v1/;
#include "px30-evb-ddr3-v10.dtsi"

/ {
	model = "Rockchip PX30 evb ddr3 board";
	compatible = "rockchip,px30-evb-ddr3-v10-avb", "rockchip,px30";
};

&chosen {
	bootargs_ext = "androidboot.boot_devices=ff390000.dwmmc,ff3b0000.nandc";
};
