// SPDX-License-Identifier: (GPL-2.0+ OR MIT)
/*
 * Based on rk3328-nanopi-r2s.dts, which is:
 *   Copyright (c) 2020 David Bauer <mail@david-bauer.net>
 */

/dts-v1/;

#include "rk3328-orangepi-r1-plus.dtsi"

/ {
	model = "Xunlong Orange Pi R1 Plus";
	compatible = "xunlong,orangepi-r1-plus", "rockchip,rk3328";
};

&gmac2io {
	phy-handle = <&rtl8211e>;
	phy-mode = "rgmii";
	tx_delay = <0x24>;
	rx_delay = <0x18>;
	status = "okay";

	mdio {
		rtl8211e: ethernet-phy@1 {
			reg = <1>;
			pinctrl-0 = <&eth_phy_reset_pin>;
			pinctrl-names = "default";
			reset-assert-us = <10000>;
			reset-deassert-us = <50000>;
			reset-gpios = <&gpio1 RK_PC2 GPIO_ACTIVE_LOW>;
		};
	};
};
