// SPDX-License-Identifier: (GPL-2.0+ OR MIT)
/*
 * Copyright (c) 2020 Rockchip Electronics Co., Ltd.
 *
 */

#include "rk3568-evb1-ddr4-v10.dtsi"
#include "rk3568-android.dtsi"
/{
	model = "Rockchip RK3568 EVB7 DDR4 V10 Board";
	compatible = "rockchip,rk3568-evb7-ddr4-v10", "rockchip,rk3568";
};
