// SPDX-License-Identifier: (GPL-2.0+ OR MIT)
/*
 * Copyright (c) 2021 Rockchip Electronics Co., Ltd.
 *
 */

/dts-v1/;

#include "rk3588-toybrick-x0.dtsi"
#include "rk3588-linux.dtsi"
//#include "rk3588-toybrick-imx258.dtsi"
/ {
	model = "Rockchip RK3588 TOYBRICK X10 Board";
	compatible = "rockchip,rk3588-toybrick-x10-linux", "rockchip,rk3588";
};
