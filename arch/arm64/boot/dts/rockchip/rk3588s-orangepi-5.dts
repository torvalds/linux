// SPDX-License-Identifier: (GPL-2.0+ OR MIT)

/dts-v1/;

#include "rk3588s-orangepi-5.dtsi"

/ {
	model = "Xunlong Orange Pi 5";
	compatible = "xunlong,orangepi-5", "rockchip,rk3588s";

	vcc3v3_pcie20: regulator-vcc3v3-pcie20 {
		compatible = "regulator-fixed";
		enable-active-high;
		gpios = <&gpio0 RK_PC5 GPIO_ACTIVE_HIGH>;
		regulator-name = "vcc3v3_pcie20";
		regulator-boot-on;
		regulator-min-microvolt = <3300000>;
		regulator-max-microvolt = <3300000>;
		startup-delay-us = <50000>;
		vin-supply = <&vcc5v0_sys>;
	};
};

&pcie2x1l2 {
	reset-gpios = <&gpio3 RK_PD1 GPIO_ACTIVE_HIGH>;
	vpcie3v3-supply = <&vcc3v3_pcie20>;
	status = "okay";
};

&sfc {
	status = "okay";
};
