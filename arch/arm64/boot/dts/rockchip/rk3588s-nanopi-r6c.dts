// SPDX-License-Identifier: (GPL-2.0+ OR MIT)

/dts-v1/;

#include "rk3588s-nanopi-r6.dtsi"

/ {
	model = "FriendlyElec NanoPi R6C";
	compatible = "friendlyarm,nanopi-r6c", "rockchip,rk3588s";
};

&lan2_led {
	label = "user_led";
};
