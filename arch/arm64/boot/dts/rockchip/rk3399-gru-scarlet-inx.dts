// SPDX-License-Identifier: (GPL-2.0+ OR MIT)
/*
 * Google Gru-Scarlet Rev4+ (SKU-6/Innolux) board device tree source
 *
 * Copyright 2018 Google, Inc
 */

/dts-v1/;

#include "rk3399-gru-scarlet.dtsi"

/ {
	model = "Google Scarlet";
	compatible = "google,scarlet-rev15-sku2", "google,scarlet-rev15-sku4",
		     "google,scarlet-rev15-sku6", "google,scarlet-rev15",
		     "google,scarlet-rev14-sku2", "google,scarlet-rev14-sku4",
		     "google,scarlet-rev14-sku6", "google,scarlet-rev14",
		     "google,scarlet-rev13-sku2", "google,scarlet-rev13-sku4",
		     "google,scarlet-rev13-sku6", "google,scarlet-rev13",
		     "google,scarlet-rev12-sku2", "google,scarlet-rev12-sku4",
		     "google,scarlet-rev12-sku6", "google,scarlet-rev12",
		     "google,scarlet-rev11-sku2", "google,scarlet-rev11-sku4",
		     "google,scarlet-rev11-sku6", "google,scarlet-rev11",
		     "google,scarlet-rev10-sku2", "google,scarlet-rev10-sku4",
		     "google,scarlet-rev10-sku6", "google,scarlet-rev10",
		     "google,scarlet-rev9-sku2",  "google,scarlet-rev9-sku4",
		     "google,scarlet-rev9-sku6",  "google,scarlet-rev9",
		     "google,scarlet-rev8-sku2",  "google,scarlet-rev8-sku4",
		     "google,scarlet-rev8-sku6",  "google,scarlet-rev8",
		     "google,scarlet-rev7-sku2",  "google,scarlet-rev7-sku4",
		     "google,scarlet-rev7-sku6",  "google,scarlet-rev7",
		     "google,scarlet-rev6-sku2",  "google,scarlet-rev6-sku4",
		     "google,scarlet-rev6-sku6",  "google,scarlet-rev6",
		     "google,scarlet-rev5-sku2",  "google,scarlet-rev5-sku4",
		     "google,scarlet-rev5-sku6",  "google,scarlet-rev5",
		     "google,scarlet-rev4-sku2",  "google,scarlet-rev4-sku4",
		     "google,scarlet-rev4-sku6",  "google,scarlet-rev4",
		     "google,scarlet", "google,gru", "rockchip,rk3399";
};

&mipi_panel {
	compatible = "innolux,p097pfg";
	avdd-supply = <&ppvarp_lcd>;
	avee-supply = <&ppvarn_lcd>;
};
