// SPDX-License-Identifier: GPL-2.0 OR BSD-3-Clause
/*
 * Samsung's Exynos 2200 SoC pin-mux and pin-config device tree source
 *
 * Copyright (c) 2025, Ivaylo Ivanov <ivo.ivanov.ivanov1@gmail.com>
 */

#include <dt-bindings/interrupt-controller/arm-gic.h>
#include "exynos-pinctrl.h"

&pinctrl_alive {
	gpa0: gpa0-gpio-bank {
		gpio-controller;
		#gpio-cells = <2>;

		interrupt-controller;
		#interrupt-cells = <2>;
		interrupt-parent = <&gic>;
		interrupts = <GIC_SPI 0 IRQ_TYPE_LEVEL_HIGH 0>,
			     <GIC_SPI 1 IRQ_TYPE_LEVEL_HIGH 0>,
			     <GIC_SPI 2 IRQ_TYPE_LEVEL_HIGH 0>,
			     <GIC_SPI 3 IRQ_TYPE_LEVEL_HIGH 0>,
			     <GIC_SPI 4 IRQ_TYPE_LEVEL_HIGH 0>,
			     <GIC_SPI 5 IRQ_TYPE_LEVEL_HIGH 0>,
			     <GIC_SPI 6 IRQ_TYPE_LEVEL_HIGH 0>,
			     <GIC_SPI 7 IRQ_TYPE_LEVEL_HIGH 0>;
	};

	gpa1: gpa1-gpio-bank {
		gpio-controller;
		#gpio-cells = <2>;

		interrupt-controller;
		#interrupt-cells = <2>;
		interrupt-parent = <&gic>;
		interrupts = <GIC_SPI 8 IRQ_TYPE_LEVEL_HIGH 0>,
			     <GIC_SPI 9 IRQ_TYPE_LEVEL_HIGH 0>,
			     <GIC_SPI 10 IRQ_TYPE_LEVEL_HIGH 0>,
			     <GIC_SPI 11 IRQ_TYPE_LEVEL_HIGH 0>,
			     <GIC_SPI 12 IRQ_TYPE_LEVEL_HIGH 0>,
			     <GIC_SPI 13 IRQ_TYPE_LEVEL_HIGH 0>,
			     <GIC_SPI 14 IRQ_TYPE_LEVEL_HIGH 0>,
			     <GIC_SPI 15 IRQ_TYPE_LEVEL_HIGH 0>;
	};

	gpa2: gpa2-gpio-bank {
		gpio-controller;
		#gpio-cells = <2>;

		interrupt-controller;
		#interrupt-cells = <2>;
		interrupt-parent = <&gic>;
		interrupts = <GIC_SPI 16 IRQ_TYPE_LEVEL_HIGH 0>,
			     <GIC_SPI 17 IRQ_TYPE_LEVEL_HIGH 0>,
			     <GIC_SPI 18 IRQ_TYPE_LEVEL_HIGH 0>,
			     <GIC_SPI 19 IRQ_TYPE_LEVEL_HIGH 0>,
			     <GIC_SPI 20 IRQ_TYPE_LEVEL_HIGH 0>,
			     <GIC_SPI 21 IRQ_TYPE_LEVEL_HIGH 0>,
			     <GIC_SPI 22 IRQ_TYPE_LEVEL_HIGH 0>,
			     <GIC_SPI 23 IRQ_TYPE_LEVEL_HIGH 0>;
	};

	gpa3: gpa3-gpio-bank {
		gpio-controller;
		#gpio-cells = <2>;

		interrupt-controller;
		#interrupt-cells = <2>;
		interrupt-parent = <&gic>;
		interrupts = <GIC_SPI 24 IRQ_TYPE_LEVEL_HIGH 0>,
			     <GIC_SPI 25 IRQ_TYPE_LEVEL_HIGH 0>,
			     <GIC_SPI 26 IRQ_TYPE_LEVEL_HIGH 0>,
			     <GIC_SPI 27 IRQ_TYPE_LEVEL_HIGH 0>,
			     <GIC_SPI 28 IRQ_TYPE_LEVEL_HIGH 0>,
			     <GIC_SPI 29 IRQ_TYPE_LEVEL_HIGH 0>,
			     <GIC_SPI 30 IRQ_TYPE_LEVEL_HIGH 0>,
			     <GIC_SPI 31 IRQ_TYPE_LEVEL_HIGH 0>;
	};

	gpa4: gpa4-gpio-bank {
		gpio-controller;
		#gpio-cells = <2>;

		interrupt-controller;
		#interrupt-cells = <2>;
		interrupt-parent = <&gic>;
		interrupts = <GIC_SPI 32 IRQ_TYPE_LEVEL_HIGH 0>,
			     <GIC_SPI 33 IRQ_TYPE_LEVEL_HIGH 0>;
	};

	gpq0: gpq0-gpio-bank {
		gpio-controller;
		#gpio-cells = <2>;
	};

	gpq1: gpq1-gpio-bank {
		gpio-controller;
		#gpio-cells = <2>;
	};

	gpq2: gpq2-gpio-bank {
		gpio-controller;
		#gpio-cells = <2>;
	};

	bt_hostwake: bt-hostwake-pins {
		samsung,pins = "gpa0-3";
		samsung,pin-function = <EXYNOS_PIN_FUNC_F>;
		samsung,pin-pud = <EXYNOS_PIN_PULL_DOWN>;
	};

	uart1_bus: uart1-bus-pins {
		samsung,pins = "gpq0-3", "gpq0-2", "gpq0-1", "gpq0-0";
		samsung,pin-function = <EXYNOS_PIN_FUNC_2>;
		samsung,pin-pud = <EXYNOS_PIN_PULL_UP>;
	};

	wlan_host_wake: wlan-host-wake-pins {
		samsung,pins = "gpa0-2";
		samsung,pin-function = <EXYNOS_PIN_FUNC_F>;
		samsung,pin-pud = <EXYNOS_PIN_PULL_DOWN>;
	};
};

&pinctrl_cmgp {
	gpm0: gpm0-gpio-bank {
		gpio-controller;
		#gpio-cells = <2>;

		interrupt-controller;
		#interrupt-cells = <2>;
		interrupt-parent = <&gic>;
		interrupts = <GIC_SPI 128 IRQ_TYPE_LEVEL_HIGH 0>,
			     <GIC_SPI 129 IRQ_TYPE_LEVEL_HIGH 0>;
	};

	gpm1: gpm1-gpio-bank {
		gpio-controller;
		#gpio-cells = <2>;

		interrupt-controller;
		#interrupt-cells = <2>;
		interrupt-parent = <&gic>;
		interrupts = <GIC_SPI 130 IRQ_TYPE_LEVEL_HIGH 0>,
			     <GIC_SPI 131 IRQ_TYPE_LEVEL_HIGH 0>;
	};

	gpm2: gpm2-gpio-bank {
		gpio-controller;
		#gpio-cells = <2>;

		interrupt-controller;
		#interrupt-cells = <2>;
		interrupt-parent = <&gic>;
		interrupts = <GIC_SPI 132 IRQ_TYPE_LEVEL_HIGH 0>,
			     <GIC_SPI 133 IRQ_TYPE_LEVEL_HIGH 0>;
	};

	gpm3: gpm3-gpio-bank {
		gpio-controller;
		#gpio-cells = <2>;

		interrupt-controller;
		#interrupt-cells = <2>;
		interrupt-parent = <&gic>;
		interrupts = <GIC_SPI 134 IRQ_TYPE_LEVEL_HIGH 0>,
			     <GIC_SPI 135 IRQ_TYPE_LEVEL_HIGH 0>;
	};

	gpm4: gpm4-gpio-bank {
		gpio-controller;
		#gpio-cells = <2>;

		interrupt-controller;
		#interrupt-cells = <2>;
		interrupt-parent = <&gic>;
		interrupts = <GIC_SPI 136 IRQ_TYPE_LEVEL_HIGH 0>,
			     <GIC_SPI 137 IRQ_TYPE_LEVEL_HIGH 0>;
	};

	gpm5: gpm5-gpio-bank {
		gpio-controller;
		#gpio-cells = <2>;

		interrupt-controller;
		#interrupt-cells = <2>;
		interrupt-parent = <&gic>;
		interrupts = <GIC_SPI 138 IRQ_TYPE_LEVEL_HIGH 0>,
			     <GIC_SPI 139 IRQ_TYPE_LEVEL_HIGH 0>;
	};

	gpm6: gpm6-gpio-bank {
		gpio-controller;
		#gpio-cells = <2>;

		interrupt-controller;
		#interrupt-cells = <2>;
		interrupt-parent = <&gic>;
		interrupts = <GIC_SPI 140 IRQ_TYPE_LEVEL_HIGH 0>,
			     <GIC_SPI 141 IRQ_TYPE_LEVEL_HIGH 0>;
	};

	gpm7: gpm7-gpio-bank {
		gpio-controller;
		#gpio-cells = <2>;

		interrupt-controller;
		#interrupt-cells = <2>;
		interrupt-parent = <&gic>;
		interrupts = <GIC_SPI 142 IRQ_TYPE_LEVEL_HIGH 0>,
			     <GIC_SPI 143 IRQ_TYPE_LEVEL_HIGH 0>;
	};

	gpm8: gpm8-gpio-bank {
		gpio-controller;
		#gpio-cells = <2>;

		interrupt-controller;
		#interrupt-cells = <2>;
		interrupt-parent = <&gic>;
		interrupts = <GIC_SPI 144 IRQ_TYPE_LEVEL_HIGH 0>,
			     <GIC_SPI 145 IRQ_TYPE_LEVEL_HIGH 0>;
	};

	gpm9: gpm9-gpio-bank {
		gpio-controller;
		#gpio-cells = <2>;

		interrupt-controller;
		#interrupt-cells = <2>;
		interrupt-parent = <&gic>;
		interrupts = <GIC_SPI 146 IRQ_TYPE_LEVEL_HIGH 0>,
			     <GIC_SPI 147 IRQ_TYPE_LEVEL_HIGH 0>;
	};

	gpm10: gpm10-gpio-bank {
		gpio-controller;
		#gpio-cells = <2>;

		interrupt-controller;
		#interrupt-cells = <2>;
		interrupt-parent = <&gic>;
		interrupts = <GIC_SPI 148 IRQ_TYPE_LEVEL_HIGH 0>,
			     <GIC_SPI 149 IRQ_TYPE_LEVEL_HIGH 0>;
	};

	gpm11: gpm11-gpio-bank {
		gpio-controller;
		#gpio-cells = <2>;

		interrupt-controller;
		#interrupt-cells = <2>;
		interrupt-parent = <&gic>;
		interrupts = <GIC_SPI 150 IRQ_TYPE_LEVEL_HIGH 0>,
			     <GIC_SPI 151 IRQ_TYPE_LEVEL_HIGH 0>;
	};

	gpm12: gpm12-gpio-bank {
		gpio-controller;
		#gpio-cells = <2>;

		interrupt-controller;
		#interrupt-cells = <2>;
		interrupts = <GIC_SPI 152 IRQ_TYPE_LEVEL_HIGH 0>,
			     <GIC_SPI 153 IRQ_TYPE_LEVEL_HIGH 0>;
	};

	gpm13: gpm13-gpio-bank {
		gpio-controller;
		#gpio-cells = <2>;

		interrupt-controller;
		#interrupt-cells = <2>;
		interrupt-parent = <&gic>;
		interrupts = <GIC_SPI 154 IRQ_TYPE_LEVEL_HIGH 0>,
			     <GIC_SPI 155 IRQ_TYPE_LEVEL_HIGH 0>;
	};

	gpm14: gpm14-gpio-bank {
		gpio-controller;
		#gpio-cells = <2>;

		interrupt-controller;
		#interrupt-cells = <2>;
		interrupt-parent = <&gic>;
		interrupts = <GIC_SPI 156 IRQ_TYPE_LEVEL_HIGH 0>;
	};

	gpm15: gpm15-gpio-bank {
		gpio-controller;
		#gpio-cells = <2>;

		interrupt-controller;
		#interrupt-cells = <2>;
		interrupt-parent = <&gic>;
		interrupts = <GIC_SPI 157 IRQ_TYPE_LEVEL_HIGH 0>;
	};

	gpm16: gpm16-gpio-bank {
		gpio-controller;
		#gpio-cells = <2>;

		interrupt-controller;
		#interrupt-cells = <2>;
		interrupt-parent = <&gic>;
		interrupts = <GIC_SPI 158 IRQ_TYPE_LEVEL_HIGH 0>;
	};

	gpm17: gpm17-gpio-bank {
		gpio-controller;
		#gpio-cells = <2>;

		interrupt-controller;
		#interrupt-cells = <2>;
		interrupt-parent = <&gic>;
		interrupts = <GIC_SPI 159 IRQ_TYPE_LEVEL_HIGH 0>;
	};

	gpm20: gpm20-gpio-bank {
		gpio-controller;
		#gpio-cells = <2>;

		interrupt-controller;
		#interrupt-cells = <2>;
		interrupt-parent = <&gic>;
		interrupts = <GIC_SPI 162 IRQ_TYPE_LEVEL_HIGH 0>;
	};

	gpm21: gpm21-gpio-bank {
		gpio-controller;
		#gpio-cells = <2>;

		interrupt-controller;
		#interrupt-cells = <2>;
		interrupt-parent = <&gic>;
		interrupts = <GIC_SPI 163 IRQ_TYPE_LEVEL_HIGH 0>;
	};

	gpm22: gpm22-gpio-bank {
		gpio-controller;
		#gpio-cells = <2>;

		interrupt-controller;
		#interrupt-cells = <2>;
		interrupt-parent = <&gic>;
		interrupts = <GIC_SPI 164 IRQ_TYPE_LEVEL_HIGH 0>;
	};

	gpm23: gpm23-gpio-bank {
		gpio-controller;
		#gpio-cells = <2>;

		interrupt-controller;
		#interrupt-cells = <2>;
		interrupt-parent = <&gic>;
		interrupts = <GIC_SPI 165 IRQ_TYPE_LEVEL_HIGH 0>;
	};

	gpm24: gpm24-gpio-bank {
		gpio-controller;
		#gpio-cells = <2>;

		interrupt-controller;

		#interrupt-cells = <2>;
		interrupt-parent = <&gic>;
		interrupts = <GIC_SPI 166 IRQ_TYPE_LEVEL_HIGH 0>;
	};

	hsi2c24_bus: hsi2c24-bus-pins {
		samsung,pins = "gpm0-0", "gpm0-1";
		samsung,pin-function = <EXYNOS_PIN_FUNC_2>;
		samsung,pin-pud = <EXYNOS_PIN_PULL_NONE>;
		samsung,pin-drv = <EXYNOS7_PIN_DRV_LV1>;
	};

	hsi2c25_bus: hsi2c25-bus-pins {
		samsung,pins = "gpm1-0", "gpm1-1";
		samsung,pin-function = <EXYNOS_PIN_FUNC_3>;
		samsung,pin-pud = <EXYNOS_PIN_PULL_NONE>;
		samsung,pin-drv = <EXYNOS7_PIN_DRV_LV1>;
	};

	hsi2c26_bus: hsi2c26-bus-pins {
		samsung,pins = "gpm2-0", "gpm2-1";
		samsung,pin-function = <EXYNOS_PIN_FUNC_2>;
		samsung,pin-pud = <EXYNOS_PIN_PULL_NONE>;
		samsung,pin-drv = <EXYNOS7_PIN_DRV_LV1>;
	};

	hsi2c27_bus: hsi2c27-bus-pins {
		samsung,pins = "gpm3-0", "gpm3-1";
		samsung,pin-function = <EXYNOS_PIN_FUNC_3>;
		samsung,pin-pud = <EXYNOS_PIN_PULL_NONE>;
		samsung,pin-drv = <EXYNOS7_PIN_DRV_LV1>;
	};

	hsi2c28_bus: hsi2c28-bus-pins {
		samsung,pins = "gpm4-0", "gpm4-1";
		samsung,pin-function = <EXYNOS_PIN_FUNC_2>;
		samsung,pin-pud = <EXYNOS_PIN_PULL_NONE>;
		samsung,pin-drv = <EXYNOS7_PIN_DRV_LV1>;
	};

	hsi2c29_bus: hsi2c29-bus-pins {
		samsung,pins = "gpm5-0", "gpm5-1";
		samsung,pin-function = <EXYNOS_PIN_FUNC_3>;
		samsung,pin-pud = <EXYNOS_PIN_PULL_NONE>;
		samsung,pin-drv = <EXYNOS7_PIN_DRV_LV1>;
	};

	hsi2c30_bus: hsi2c30-bus-pins {
		samsung,pins = "gpm6-0", "gpm6-1";
		samsung,pin-function = <EXYNOS_PIN_FUNC_2>;
		samsung,pin-pud = <EXYNOS_PIN_PULL_NONE>;
		samsung,pin-drv = <EXYNOS7_PIN_DRV_LV1>;
	};

	hsi2c31_bus: hsi2c31-bus-pins {
		samsung,pins = "gpm7-0", "gpm7-1";
		samsung,pin-function = <EXYNOS_PIN_FUNC_3>;
		samsung,pin-pud = <EXYNOS_PIN_PULL_NONE>;
		samsung,pin-drv = <EXYNOS7_PIN_DRV_LV1>;
	};

	hsi2c32_bus: hsi2c32-bus-pins {
		samsung,pins = "gpm8-0", "gpm8-1";
		samsung,pin-function = <EXYNOS_PIN_FUNC_2>;
		samsung,pin-pud = <EXYNOS_PIN_PULL_NONE>;
		samsung,pin-drv = <EXYNOS7_PIN_DRV_LV1>;
	};

	hsi2c33_bus: hsi2c33-bus-pins {
		samsung,pins = "gpm9-0", "gpm9-1";
		samsung,pin-function = <EXYNOS_PIN_FUNC_3>;
		samsung,pin-pud = <EXYNOS_PIN_PULL_NONE>;
		samsung,pin-drv = <EXYNOS7_PIN_DRV_LV1>;
	};

	hsi2c34_bus: hsi2c34-bus-pins {
		samsung,pins = "gpm10-0", "gpm10-1";
		samsung,pin-function = <EXYNOS_PIN_FUNC_2>;
		samsung,pin-pud = <EXYNOS_PIN_PULL_NONE>;
		samsung,pin-drv = <EXYNOS7_PIN_DRV_LV1>;
	};

	hsi2c35_bus: hsi2c35-bus-pins {
		samsung,pins = "gpm11-0", "gpm11-1";
		samsung,pin-function = <EXYNOS_PIN_FUNC_3>;
		samsung,pin-pud = <EXYNOS_PIN_PULL_NONE>;
		samsung,pin-drv = <EXYNOS7_PIN_DRV_LV1>;
	};

	hsi2c36_bus: hsi2c36-bus-pins {
		samsung,pins = "gpm12-0", "gpm12-1";
		samsung,pin-function = <EXYNOS_PIN_FUNC_2>;
		samsung,pin-pud = <EXYNOS_PIN_PULL_NONE>;
		samsung,pin-drv = <EXYNOS7_PIN_DRV_LV1>;
	};

	hsi2c37_bus: hsi2c37-bus-pins {
		samsung,pins = "gpm13-0", "gpm13-1";
		samsung,pin-function = <EXYNOS_PIN_FUNC_3>;
		samsung,pin-pud = <EXYNOS_PIN_PULL_NONE>;
		samsung,pin-drv = <EXYNOS7_PIN_DRV_LV1>;
	};

	hsi2c38_bus: hsi2c38-bus-pins {
		samsung,pins = "gpm23-0", "gpm24-0";
		samsung,pin-function = <EXYNOS_PIN_FUNC_2>;
		samsung,pin-pud = <EXYNOS_PIN_PULL_NONE>;
		samsung,pin-drv = <EXYNOS7_PIN_DRV_LV1>;
	};

	spi12_bus: spi12-bus-pins {
		samsung,pins = "gpm0-0", "gpm0-1", "gpm1-0";
		samsung,pin-function = <EXYNOS_PIN_FUNC_2>;
		samsung,pin-pud = <EXYNOS_PIN_PULL_NONE>;
		samsung,pin-drv = <EXYNOS7_PIN_DRV_LV1>;
	};

	spi12_cs: spi12-cs-pins {
		samsung,pins = "gpm1-1";
		samsung,pin-function = <EXYNOS_PIN_FUNC_OUTPUT>;
		samsung,pin-pud = <EXYNOS_PIN_PULL_NONE>;
		samsung,pin-drv = <EXYNOS7_PIN_DRV_LV1>;
	};

	spi12_cs_func: spi12-cs-func-pins {
		samsung,pins = "gpm1-1";
		samsung,pin-function = <EXYNOS_PIN_FUNC_2>;
		samsung,pin-pud = <EXYNOS_PIN_PULL_NONE>;
		samsung,pin-drv = <EXYNOS7_PIN_DRV_LV1>;
	};

	spi13_bus: spi13-bus-pins {
		samsung,pins = "gpm2-0", "gpm2-1", "gpm3-0";
		samsung,pin-function = <EXYNOS_PIN_FUNC_2>;
		samsung,pin-pud = <EXYNOS_PIN_PULL_NONE>;
		samsung,pin-drv = <EXYNOS7_PIN_DRV_LV1>;
	};

	spi13_cs: spi13-cs-pins {
		samsung,pins = "gpm3-1";
		samsung,pin-function = <EXYNOS_PIN_FUNC_OUTPUT>;
		samsung,pin-pud = <EXYNOS_PIN_PULL_NONE>;
		samsung,pin-drv = <EXYNOS7_PIN_DRV_LV1>;
	};

	spi13_cs_func: spi13-cs-func-pins {
		samsung,pins = "gpm3-1";
		samsung,pin-function = <EXYNOS_PIN_FUNC_2>;
		samsung,pin-pud = <EXYNOS_PIN_PULL_NONE>;
		samsung,pin-drv = <EXYNOS7_PIN_DRV_LV1>;
	};

	spi14_bus: spi14-bus-pins {
		samsung,pins = "gpm4-0", "gpm4-1", "gpm5-0";
		samsung,pin-function = <EXYNOS_PIN_FUNC_2>;
		samsung,pin-pud = <EXYNOS_PIN_PULL_NONE>;
		samsung,pin-drv = <EXYNOS7_PIN_DRV_LV1>;
	};

	spi14_cs: spi14-cs-pins {
		samsung,pins = "gpm5-1";
		samsung,pin-function = <EXYNOS_PIN_FUNC_OUTPUT>;
		samsung,pin-pud = <EXYNOS_PIN_PULL_NONE>;
		samsung,pin-drv = <EXYNOS7_PIN_DRV_LV1>;
	};

	spi14_cs_func: spi14-cs-func-pins {
		samsung,pins = "gpm5-1";
		samsung,pin-function = <EXYNOS_PIN_FUNC_2>;
		samsung,pin-pud = <EXYNOS_PIN_PULL_NONE>;
		samsung,pin-drv = <EXYNOS7_PIN_DRV_LV1>;
	};

	spi15_bus: spi15-bus-pins {
		samsung,pins = "gpm6-0", "gpm6-1", "gpm7-0";
		samsung,pin-function = <EXYNOS_PIN_FUNC_2>;
		samsung,pin-pud = <EXYNOS_PIN_PULL_NONE>;
		samsung,pin-drv = <EXYNOS7_PIN_DRV_LV1>;
	};

	spi15_cs: spi15-cs-pins {
		samsung,pins = "gpm7-1";
		samsung,pin-function = <EXYNOS_PIN_FUNC_OUTPUT>;
		samsung,pin-pud = <EXYNOS_PIN_PULL_NONE>;
		samsung,pin-drv = <EXYNOS7_PIN_DRV_LV1>;
	};

	spi15_cs_func: spi15-cs-func-pins {
		samsung,pins = "gpm7-1";
		samsung,pin-function = <EXYNOS_PIN_FUNC_2>;
		samsung,pin-pud = <EXYNOS_PIN_PULL_NONE>;
		samsung,pin-drv = <EXYNOS7_PIN_DRV_LV1>;
	};

	spi16_bus: spi16-bus-pins {
		samsung,pins = "gpm8-0", "gpm8-1", "gpm9-0";
		samsung,pin-function = <EXYNOS_PIN_FUNC_2>;
		samsung,pin-pud = <EXYNOS_PIN_PULL_NONE>;
		samsung,pin-drv = <EXYNOS7_PIN_DRV_LV1>;
	};

	spi16_cs: spi16-cs-pins {
		samsung,pins = "gpm9-1";
		samsung,pin-function = <EXYNOS_PIN_FUNC_OUTPUT>;
		samsung,pin-pud = <EXYNOS_PIN_PULL_NONE>;
		samsung,pin-drv = <EXYNOS7_PIN_DRV_LV1>;
	};

	spi16_cs_func: spi16-cs-func-pins {
		samsung,pins = "gpm9-1";
		samsung,pin-function = <EXYNOS_PIN_FUNC_2>;
		samsung,pin-pud = <EXYNOS_PIN_PULL_NONE>;
		samsung,pin-drv = <EXYNOS7_PIN_DRV_LV1>;
	};

	spi17_bus: spi17-bus-pins {
		samsung,pins = "gpm10-0", "gpm10-1", "gpm11-0";
		samsung,pin-function = <EXYNOS_PIN_FUNC_2>;
		samsung,pin-pud = <EXYNOS_PIN_PULL_NONE>;
		samsung,pin-drv = <EXYNOS7_PIN_DRV_LV1>;
	};

	spi17_cs: spi17-cs-pins {
		samsung,pins = "gpm11-1";
		samsung,pin-function = <EXYNOS_PIN_FUNC_OUTPUT>;
		samsung,pin-pud = <EXYNOS_PIN_PULL_NONE>;
		samsung,pin-drv = <EXYNOS7_PIN_DRV_LV1>;
	};

	spi17_cs_func: spi17-cs-func-pins {
		samsung,pins = "gpm11-1";
		samsung,pin-function = <EXYNOS_PIN_FUNC_2>;
		samsung,pin-pud = <EXYNOS_PIN_PULL_NONE>;
		samsung,pin-drv = <EXYNOS7_PIN_DRV_LV1>;
	};

	spi18_bus: spi18-bus-pins {
		samsung,pins = "gpm12-0", "gpm12-1", "gpm13-0";
		samsung,pin-function = <EXYNOS_PIN_FUNC_2>;
		samsung,pin-pud = <EXYNOS_PIN_PULL_NONE>;
		samsung,pin-drv = <EXYNOS7_PIN_DRV_LV1>;
	};

	spi18_cs: spi18-cs-pins {
		samsung,pins = "gpm13-1";
		samsung,pin-function = <EXYNOS_PIN_FUNC_OUTPUT>;
		samsung,pin-pud = <EXYNOS_PIN_PULL_NONE>;
		samsung,pin-drv = <EXYNOS7_PIN_DRV_LV1>;
	};

	spi18_cs_func: spi18-cs-func-pins {
		samsung,pins = "gpm13-1";
		samsung,pin-function = <EXYNOS_PIN_FUNC_2>;
		samsung,pin-pud = <EXYNOS_PIN_PULL_NONE>;
		samsung,pin-drv = <EXYNOS7_PIN_DRV_LV1>;
	};

	uart14_bus_single: uart14-bus-single-pins {
		samsung,pins = "gpm0-0", "gpm0-1", "gpm2-0", "gpm2-1";
		samsung,pin-function = <EXYNOS_PIN_FUNC_2>;
		samsung,pin-pud = <EXYNOS_PIN_PULL_NONE>;
	};

	uart14_bus_dual: uart14-bus-dual-pins {
		samsung,pins = "gpm0-0", "gpm0-1";
		samsung,pin-function = <EXYNOS_PIN_FUNC_2>;
		samsung,pin-pud = <EXYNOS_PIN_PULL_NONE>;
	};

	uart15_bus_single: uart15-bus-single-pins {
		samsung,pins = "gpm3-0", "gpm3-1", "gpm4-0", "gpm4-1";
		samsung,pin-function = <EXYNOS_PIN_FUNC_2>;
		samsung,pin-pud = <EXYNOS_PIN_PULL_NONE>;
	};

	uart15_bus_dual: uart15-bus-dual-pins {
		samsung,pins = "gpm3-0", "gpm3-1";
		samsung,pin-function = <EXYNOS_PIN_FUNC_2>;
		samsung,pin-pud = <EXYNOS_PIN_PULL_NONE>;
	};

	uart16_bus_single: uart16-bus-single-pins {
		samsung,pins = "gpm5-0", "gpm5-1", "gpm6-0", "gpm6-1";
		samsung,pin-function = <EXYNOS_PIN_FUNC_2>;
		samsung,pin-pud = <EXYNOS_PIN_PULL_NONE>;
	};

	uart16_bus_dual: uart16-bus-dual-pins {
		samsung,pins = "gpm5-0", "gpm5-1";
		samsung,pin-function = <EXYNOS_PIN_FUNC_2>;
		samsung,pin-pud = <EXYNOS_PIN_PULL_NONE>;
	};

	uart17_bus_single: uart17-bus-single-pins {
		samsung,pins = "gpm7-0", "gpm7-1", "gpm8-0", "gpm8-1";
		samsung,pin-function = <EXYNOS_PIN_FUNC_2>;
		samsung,pin-pud = <EXYNOS_PIN_PULL_NONE>;
	};

	uart17_bus_dual: uart17-bus-dual-pins {
		samsung,pins = "gpm7-0", "gpm7-1";
		samsung,pin-function = <EXYNOS_PIN_FUNC_2>;
		samsung,pin-pud = <EXYNOS_PIN_PULL_NONE>;
	};

	uart18_bus_single: uart18-bus-single-pins {
		samsung,pins = "gpm8-0", "gpm8-1", "gpm9-0", "gpm9-1";
		samsung,pin-function = <EXYNOS_PIN_FUNC_2>;
		samsung,pin-pud = <EXYNOS_PIN_PULL_NONE>;
	};

	uart18_bus_dual: uart18-bus-dual-pins {
		samsung,pins = "gpm8-0", "gpm8-1";
		samsung,pin-function = <EXYNOS_PIN_FUNC_2>;
		samsung,pin-pud = <EXYNOS_PIN_PULL_NONE>;
	};

	uart19_bus_single: uart19-bus-single-pins {
		samsung,pins = "gpm10-0", "gpm10-1", "gpm11-0", "gpm11-1";
		samsung,pin-function = <EXYNOS_PIN_FUNC_2>;
		samsung,pin-pud = <EXYNOS_PIN_PULL_NONE>;
	};

	uart19_bus_dual: uart19-bus-dual-pins {
		samsung,pins = "gpm12-0", "gpm12-1";
		samsung,pin-function = <EXYNOS_PIN_FUNC_2>;
		samsung,pin-pud = <EXYNOS_PIN_PULL_NONE>;
	};

	uart20_bus_single: uart20-bus-single-pins {
		samsung,pins = "gpm13-0", "gpm13-1", "gpm14-0", "gpm14-1";
		samsung,pin-function = <EXYNOS_PIN_FUNC_2>;
		samsung,pin-pud = <EXYNOS_PIN_PULL_NONE>;
	};

	uart20_bus_dual: uart20-bus-dual-pins {
		samsung,pins = "gpm13-0", "gpm13-1";
		samsung,pin-function = <EXYNOS_PIN_FUNC_2>;
		samsung,pin-pud = <EXYNOS_PIN_PULL_NONE>;
	};

};

&pinctrl_hsi1 {
	gpf0: gpf0-gpio-bank {
		gpio-controller;
		#gpio-cells = <2>;
		interrupt-controller;
		#interrupt-cells = <2>;
	};

	pcie0_clkreq: pcie0-clkreq-pins {
		samsung,pins = "gpf0-0";
		samsung,pin-function = <EXYNOS_PIN_FUNC_2>;
		samsung,pin-pud = <EXYNOS_PIN_PULL_UP>;
		samsung,pin-drv = <EXYNOS7_PIN_DRV_LV4>;
		samsung,pin-con-pdn = <EXYNOS_PIN_PDN_PREV>;
		samsung,pin-pud-pdn = <EXYNOS_PIN_PULL_UP>;
	};

	pcie0_perst: pcie0-perst-pins {
		samsung,pins = "gpf0-1";
		samsung,pin-function = <EXYNOS_PIN_FUNC_OUTPUT>;
		samsung,pin-drv = <EXYNOS7_PIN_DRV_LV4>;
		samsung,pin-con-pdn = <EXYNOS_PIN_PDN_PREV>;
	};

	pcie1_clkreq: pcie1-clkreq-pins {
		samsung,pins = "gpf0-2";
		samsung,pin-function = <EXYNOS_PIN_FUNC_2>;
		samsung,pin-pud = <EXYNOS_PIN_PULL_UP>;
		samsung,pin-drv = <EXYNOS7_PIN_DRV_LV4>;
		samsung,pin-con-pdn = <EXYNOS_PIN_PDN_PREV>;
		samsung,pin-pud-pdn = <EXYNOS_PIN_PULL_UP>;
	};

	pcie1_perst: pcie1-perst-pins {
		samsung,pins = "gpf0-3";
		samsung,pin-function = <EXYNOS_PIN_FUNC_OUTPUT>;
		samsung,pin-drv = <EXYNOS7_PIN_DRV_LV4>;
		samsung,pin-con-pdn = <EXYNOS_PIN_PDN_PREV>;
	};
};

&pinctrl_hsi1ufs {
	gpf2: gpf2-gpio-bank {
		gpio-controller;
		#gpio-cells = <2>;
		interrupt-controller;
		#interrupt-cells = <2>;
	};

	ufs_rst_n: ufs-rst-n-pins {
		samsung,pins = "gpf2-1";
		samsung,pin-function = <EXYNOS_PIN_FUNC_2>;
		samsung,pin-pud = <EXYNOS_PIN_PULL_NONE>;
		samsung,pin-con-pdn = <EXYNOS_PIN_PDN_PREV>;
		samsung,pin-pud-pdn = <EXYNOS_PIN_PULL_NONE>;
	};

	ufs_refclk_out: ufs-refclk-out-pins {
		samsung,pins = "gpf2-0";
		samsung,pin-function = <EXYNOS_PIN_FUNC_2>;
		samsung,pin-pud = <EXYNOS_PIN_PULL_NONE>;
		samsung,pin-con-pdn = <EXYNOS_PIN_PDN_PREV>;
		samsung,pin-drv = <EXYNOS7_PIN_DRV_LV3>;
		samsung,pin-pud-pdn = <EXYNOS_PIN_PULL_NONE>;
	};
};

&pinctrl_peric0 {
	gpb0: gpb0-gpio-bank {
		gpio-controller;
		#gpio-cells = <2>;
		interrupt-controller;
		#interrupt-cells = <2>;
	};

	gpb1: gpb1-gpio-bank {
		gpio-controller;
		#gpio-cells = <2>;
		interrupt-controller;
		#interrupt-cells = <2>;
	};

	gpb2: gpb2-gpio-bank {
		gpio-controller;
		#gpio-cells = <2>;
		interrupt-controller;
		#interrupt-cells = <2>;
	};

	gpb3: gpb3-gpio-bank {
		gpio-controller;
		#gpio-cells = <2>;
		interrupt-controller;
		#interrupt-cells = <2>;
	};

	gpc0: gpc0-gpio-bank {
		gpio-controller;
		#gpio-cells = <2>;
		interrupt-controller;
		#interrupt-cells = <2>;
	};

	gpc1: gpc1-gpio-bank {
		gpio-controller;
		#gpio-cells = <2>;
		interrupt-controller;
		#interrupt-cells = <2>;
	};

	gpc2: gpc2-gpio-bank {
		gpio-controller;
		#gpio-cells = <2>;
		interrupt-controller;
		#interrupt-cells = <2>;
	};

	gpg1: gpg1-gpio-bank {
		gpio-controller;
		#gpio-cells = <2>;
		interrupt-controller;
		#interrupt-cells = <2>;
	};

	gpg2: gpg2-gpio-bank {
		gpio-controller;
		#gpio-cells = <2>;
		interrupt-controller;
		#interrupt-cells = <2>;
	};

	gpp4: gpp4-gpio-bank {
		gpio-controller;
		#gpio-cells = <2>;
		interrupt-controller;
		#interrupt-cells = <2>;
	};

	aud_i2s0_bus: aud-i2s0-bus-pins {
		samsung,pins = "gpb0-0", "gpb0-1", "gpb0-2", "gpb0-3";
		samsung,pin-function = <EXYNOS_PIN_FUNC_2>;
		samsung,pin-pud = <EXYNOS_PIN_PULL_NONE>;
	};

	aud_i2s1_bus: aud-i2s1-bus-pins {
		samsung,pins = "gpb1-0", "gpb1-1", "gpb1-2", "gpb1-3";
		samsung,pin-function = <EXYNOS_PIN_FUNC_2>;
		samsung,pin-pud = <EXYNOS_PIN_PULL_NONE>;
	};

	aud_i2s2_bus: aud-i2s2-bus-pins {
		samsung,pins = "gpb2-0", "gpb2-1", "gpb2-2", "gpb2-3";
		samsung,pin-function = <EXYNOS_PIN_FUNC_2>;
		samsung,pin-pud = <EXYNOS_PIN_PULL_NONE>;
	};

	aud_i2s3_bus: aud-i2s3-bus-pins {
		samsung,pins = "gpb3-0", "gpb3-1", "gpb3-2", "gpb3-3";
		samsung,pin-function = <EXYNOS_PIN_FUNC_2>;
		samsung,pin-pud = <EXYNOS_PIN_PULL_NONE>;
	};

	aud_i2s3_pci: aud-i2s3-pci-pins {
		samsung,pins = "gpb3-0", "gpb3-1";
		samsung,pin-function = <EXYNOS_PIN_FUNC_3>;
		samsung,pin-pud = <EXYNOS_PIN_PULL_NONE>;
	};

	aud_dsd_bus: aud-dsd-bus-pins {
		samsung,pins = "gpb1-0", "gpb1-1", "gpb1-2";
		samsung,pin-function = <EXYNOS_PIN_FUNC_3>;
		samsung,pin-pud = <EXYNOS_PIN_PULL_NONE>;
	};

	decon_0_te: decon-0-te-pins {
		samsung,pins = "gpg2-0";
		samsung,pin-function = <EXYNOS_PIN_FUNC_F>;
	};

	hsi2c8_bus: hsi2c8-bus-pins {
		samsung,pins = "gpp4-0", "gpp4-1";
		samsung,pin-function = <EXYNOS_PIN_FUNC_2>;
		samsung,pin-pud = <EXYNOS_PIN_PULL_UP>;
		samsung,pin-drv = <EXYNOS7_PIN_DRV_LV1>;
	};

	hsi2c9_bus: hsi2c9-bus-pins {
		samsung,pins = "gpp4-2", "gpp4-3";
		samsung,pin-function = <EXYNOS_PIN_FUNC_3>;
		samsung,pin-pud = <EXYNOS_PIN_PULL_UP>;
		samsung,pin-drv = <EXYNOS7_PIN_DRV_LV1>;
	};

	i3c0_bus: i3c0-bus-pins {
		samsung,pins = "gpc0-0", "gpc0-1";
		samsung,pin-function = <EXYNOS_PIN_FUNC_2>;
		samsung,pin-pud = <EXYNOS_PIN_PULL_UP>;
		samsung,pin-drv = <EXYNOS7_PIN_DRV_LV1>;
	};

	i3c1_bus: i3c1-bus-pins {
		samsung,pins = "gpc1-0", "gpc1-1";
		samsung,pin-function = <EXYNOS_PIN_FUNC_2>;
		samsung,pin-pud = <EXYNOS_PIN_PULL_UP>;
		samsung,pin-drv = <EXYNOS7_PIN_DRV_LV1>;
	};

	i3c2_bus: i3c2-bus-pins {
		samsung,pins = "gpc2-0", "gpc2-1";
		samsung,pin-function = <EXYNOS_PIN_FUNC_2>;
		samsung,pin-pud = <EXYNOS_PIN_PULL_NONE>;
		samsung,pin-drv = <EXYNOS7_PIN_DRV_LV1>;
		samsung,pin-con-pdn = <EXYNOS_PIN_PDN_PREV>;
		samsung,pin-pud-pdn = <EXYNOS_PIN_PULL_NONE>;
	};

	spi4_bus: spi4-bus-pins {
		samsung,pins = "gpp4-2", "gpp4-1", "gpp4-0";
		samsung,pin-function = <EXYNOS_PIN_FUNC_2>;
		samsung,pin-pud = <EXYNOS_PIN_PULL_NONE>;
		samsung,pin-drv = <EXYNOS7_PIN_DRV_LV1>;
	};

	spi4_cs: spi4-cs-pins {
		samsung,pins = "gpp4-3";
		samsung,pin-function = <EXYNOS_PIN_FUNC_OUTPUT>;
		samsung,pin-pud = <EXYNOS_PIN_PULL_NONE>;
		samsung,pin-drv = <EXYNOS7_PIN_DRV_LV1>;
	};

	spi4_cs_func: spi4-cs-func-pins {
		samsung,pins = "gpp4-3";
		samsung,pin-function = <EXYNOS_PIN_FUNC_2>;
		samsung,pin-pud = <EXYNOS_PIN_PULL_NONE>;
		samsung,pin-drv = <EXYNOS7_PIN_DRV_LV1>;
	};

	uart6_bus_single: uart6-bus-single-pins {
		samsung,pins = "gpp4-0", "gpp4-1", "gpp4-2", "gpp4-3";
		samsung,pin-function = <EXYNOS_PIN_FUNC_2>;
		samsung,pin-pud = <EXYNOS_PIN_PULL_NONE>;
	};

	uart6_bus_dual: uart6-bus-dual-pins {
		samsung,pins = "gpp4-0", "gpp4-1";
		samsung,pin-function = <EXYNOS_PIN_FUNC_2>;
		samsung,pin-pud = <EXYNOS_PIN_PULL_NONE>;
	};
};

&pinctrl_peric1 {
	gpp7: gpp7-gpio-bank {
		gpio-controller;
		#gpio-cells = <2>;
		interrupt-controller;
		#interrupt-cells = <2>;
	};

	gpp8: gpp8-gpio-bank {
		gpio-controller;
		#gpio-cells = <2>;
		interrupt-controller;
		#interrupt-cells = <2>;
	};

	gpp9: gpp9-gpio-bank {
		gpio-controller;
		#gpio-cells = <2>;
		interrupt-controller;
		#interrupt-cells = <2>;
	};

	gpp10: gpp10-gpio-bank {
		gpio-controller;
		#gpio-cells = <2>;
		interrupt-controller;
		#interrupt-cells = <2>;
	};

	hsi2c14_bus: hsi2c14-bus-pins {
		samsung,pins = "gpp7-0", "gpp7-1";
		samsung,pin-function = <EXYNOS_PIN_FUNC_2>;
		samsung,pin-pud = <EXYNOS_PIN_PULL_UP>;
		samsung,pin-drv = <EXYNOS7_PIN_DRV_LV1>;
	};

	hsi2c15_bus: hsi2c15-bus-pins {
		samsung,pins = "gpp7-2", "gpp7-3";
		samsung,pin-function = <EXYNOS_PIN_FUNC_3>;
		samsung,pin-pud = <EXYNOS_PIN_PULL_UP>;
		samsung,pin-drv = <EXYNOS7_PIN_DRV_LV1>;
	};

	hsi2c16_bus: hsi2c16-bus-pins {
		samsung,pins = "gpp8-0", "gpp8-1";
		samsung,pin-function = <EXYNOS_PIN_FUNC_2>;
		samsung,pin-pud = <EXYNOS_PIN_PULL_UP>;
		samsung,pin-drv = <EXYNOS7_PIN_DRV_LV1>;
	};

	hsi2c17_bus: hsi2c17-bus-pins {
		samsung,pins = "gpp8-2", "gpp8-3";
		samsung,pin-function = <EXYNOS_PIN_FUNC_3>;
		samsung,pin-pud = <EXYNOS_PIN_PULL_UP>;
		samsung,pin-drv = <EXYNOS7_PIN_DRV_LV1>;
	};

	hsi2c18_bus: hsi2c18-bus-pins {
		samsung,pins = "gpp9-0", "gpp9-1";
		samsung,pin-function = <EXYNOS_PIN_FUNC_2>;
		samsung,pin-pud = <EXYNOS_PIN_PULL_UP>;
		samsung,pin-drv = <EXYNOS7_PIN_DRV_LV1>;
	};

	hsi2c19_bus: hsi2c19-bus-pins {
		samsung,pins = "gpp9-2", "gpp9-3";
		samsung,pin-function = <EXYNOS_PIN_FUNC_3>;
		samsung,pin-pud = <EXYNOS_PIN_PULL_UP>;
		samsung,pin-drv = <EXYNOS7_PIN_DRV_LV1>;
	};

	hsi2c20_bus: hsi2c20-bus-pins {
		samsung,pins = "gpp10-0", "gpp10-1";
		samsung,pin-function = <EXYNOS_PIN_FUNC_2>;
		samsung,pin-pud = <EXYNOS_PIN_PULL_UP>;
		samsung,pin-drv = <EXYNOS7_PIN_DRV_LV1>;
	};

	hsi2c21_bus: hsi2c21-bus-pins {
		samsung,pins = "gpp10-2", "gpp10-3";
		samsung,pin-function = <EXYNOS_PIN_FUNC_3>;
		samsung,pin-pud = <EXYNOS_PIN_PULL_UP>;
		samsung,pin-drv = <EXYNOS7_PIN_DRV_LV1>;
	};

	spi7_bus: spi7-bus-pins {
		samsung,pins = "gpp7-2", "gpp7-1", "gpp7-0";
		samsung,pin-function = <EXYNOS_PIN_FUNC_2>;
		samsung,pin-pud = <EXYNOS_PIN_PULL_NONE>;
		samsung,pin-drv = <EXYNOS7_PIN_DRV_LV1>;
	};

	spi7_cs: spi7-cs-pins {
		samsung,pins = "gpp7-3";
		samsung,pin-function = <EXYNOS_PIN_FUNC_OUTPUT>;
		samsung,pin-pud = <EXYNOS_PIN_PULL_NONE>;
		samsung,pin-drv = <EXYNOS7_PIN_DRV_LV1>;
	};

	spi7_cs_func: spi7-cs-func-pins {
		samsung,pins = "gpp7-3";
		samsung,pin-function = <EXYNOS_PIN_FUNC_2>;
		samsung,pin-pud = <EXYNOS_PIN_PULL_NONE>;
		samsung,pin-drv = <EXYNOS7_PIN_DRV_LV1>;
	};

	spi8_bus: spi8-bus-pins {
		samsung,pins = "gpp8-2", "gpp8-1", "gpp8-0";
		samsung,pin-function = <EXYNOS_PIN_FUNC_2>;
		samsung,pin-pud = <EXYNOS_PIN_PULL_NONE>;
		samsung,pin-drv = <EXYNOS7_PIN_DRV_LV1>;
	};

	spi8_cs: spi8-cs-pins {
		samsung,pins = "gpp8-3";
		samsung,pin-function = <EXYNOS_PIN_FUNC_OUTPUT>;
		samsung,pin-pud = <EXYNOS_PIN_PULL_NONE>;
		samsung,pin-drv = <EXYNOS7_PIN_DRV_LV1>;
	};

	spi8_cs_func: spi8-cs-func-pins {
		samsung,pins = "gpp8-3";
		samsung,pin-function = <EXYNOS_PIN_FUNC_2>;
		samsung,pin-pud = <EXYNOS_PIN_PULL_NONE>;
		samsung,pin-drv = <EXYNOS7_PIN_DRV_LV1>;
	};

	spi9_bus: spi9-bus-pins {
		samsung,pins = "gpp9-2", "gpp9-1", "gpp9-0";
		samsung,pin-function = <EXYNOS_PIN_FUNC_2>;
		samsung,pin-pud = <EXYNOS_PIN_PULL_NONE>;
		samsung,pin-drv = <EXYNOS7_PIN_DRV_LV1>;
	};

	spi9_cs: spi9-cs-pins {
		samsung,pins = "gpp9-3";
		samsung,pin-function = <EXYNOS_PIN_FUNC_OUTPUT>;
		samsung,pin-pud = <EXYNOS_PIN_PULL_NONE>;
		samsung,pin-drv = <EXYNOS7_PIN_DRV_LV1>;
	};

	spi9_cs_func: spi9-cs-func-pins {
		samsung,pins = "gpp9-3";
		samsung,pin-function = <EXYNOS_PIN_FUNC_2>;
		samsung,pin-pud = <EXYNOS_PIN_PULL_NONE>;
		samsung,pin-drv = <EXYNOS7_PIN_DRV_LV1>;
	};

	spi10_bus: spi10-bus-pins {
		samsung,pins = "gpp10-2", "gpp10-1", "gpp10-0";
		samsung,pin-function = <EXYNOS_PIN_FUNC_2>;
		samsung,pin-pud = <EXYNOS_PIN_PULL_NONE>;
		samsung,pin-drv = <EXYNOS7_PIN_DRV_LV1>;
	};

	spi10_cs: spi10-cs-pins {
		samsung,pins = "gpp10-3";
		samsung,pin-function = <EXYNOS_PIN_FUNC_OUTPUT>;
		samsung,pin-pud = <EXYNOS_PIN_PULL_NONE>;
		samsung,pin-drv = <EXYNOS7_PIN_DRV_LV1>;
	};

	spi10_cs_func: spi10-cs-func-pins {
		samsung,pins = "gpp10-3";
		samsung,pin-function = <EXYNOS_PIN_FUNC_2>;
		samsung,pin-pud = <EXYNOS_PIN_PULL_NONE>;
		samsung,pin-drv = <EXYNOS7_PIN_DRV_LV1>;
	};

	uart9_bus_single: uart9-bus-single-pins {
		samsung,pins = "gpp7-3", "gpp7-2", "gpp7-1", "gpp7-0";
		samsung,pin-function = <EXYNOS_PIN_FUNC_2>;
		samsung,pin-pud = <EXYNOS_PIN_PULL_NONE>;
	};

	uart9_bus_dual: uart9-bus-dual-pins {
		samsung,pins = "gpp7-0", "gpp7-1";
		samsung,pin-function = <EXYNOS_PIN_FUNC_2>;
		samsung,pin-pud = <EXYNOS_PIN_PULL_NONE>;
	};

	uart10_bus_single: uart10-bus-single-pins {
		samsung,pins = "gpp8-3", "gpp8-2", "gpp8-1", "gpp8-0";
		samsung,pin-function = <EXYNOS_PIN_FUNC_2>;
		samsung,pin-pud = <EXYNOS_PIN_PULL_NONE>;
	};

	uart10_bus_dual: uart10-bus-dual-pins {
		samsung,pins = "gpp8-0", "gpp8-1";
		samsung,pin-function = <EXYNOS_PIN_FUNC_2>;
		samsung,pin-pud = <EXYNOS_PIN_PULL_NONE>;
	};

	uart11_bus_single: uart11-bus-single-pins {
		samsung,pins = "gpp9-3", "gpp9-2", "gpp9-1", "gpp9-0";
		samsung,pin-function = <EXYNOS_PIN_FUNC_2>;
		samsung,pin-pud = <EXYNOS_PIN_PULL_NONE>;
	};

	uart11_bus_dual: uart11-bus-dual-pins {
		samsung,pins = "gpp9-0", "gpp9-1";
		samsung,pin-function = <EXYNOS_PIN_FUNC_2>;
		samsung,pin-pud = <EXYNOS_PIN_PULL_NONE>;
	};

	uart12_bus_single: uart12-bus-single-pins {
		samsung,pins = "gpp10-3", "gpp10-2", "gpp10-1", "gpp10-0";
		samsung,pin-function = <EXYNOS_PIN_FUNC_2>;
		samsung,pin-pud = <EXYNOS_PIN_PULL_NONE>;
	};

	uart12_bus_dual: uart12-bus-dual-pins {
		samsung,pins = "gpp10-0", "gpp10-1";
		samsung,pin-function = <EXYNOS_PIN_FUNC_2>;
		samsung,pin-pud = <EXYNOS_PIN_PULL_NONE>;
	};

};

&pinctrl_peric2 {
	gpc3: gpc3-gpio-bank {
		gpio-controller;
		#gpio-cells = <2>;
		interrupt-controller;
		#interrupt-cells = <2>;
	};

	gpc4: gpc4-gpio-bank {
		gpio-controller;
		#gpio-cells = <2>;
		interrupt-controller;
		#interrupt-cells = <2>;
	};

	gpc5: gpc5-gpio-bank {
		gpio-controller;
		#gpio-cells = <2>;
		interrupt-controller;
		#interrupt-cells = <2>;
	};

	gpc6: gpc6-gpio-bank {
		gpio-controller;
		#gpio-cells = <2>;
		interrupt-controller;
		#interrupt-cells = <2>;
	};

	gpc7: gpc7-gpio-bank {
		gpio-controller;
		#gpio-cells = <2>;
		interrupt-controller;
		#interrupt-cells = <2>;
	};

	gpc8: gpc8-gpio-bank {
		gpio-controller;
		#gpio-cells = <2>;
		interrupt-controller;
		#interrupt-cells = <2>;
	};

	gpc9: gpc9-gpio-bank {
		gpio-controller;
		#gpio-cells = <2>;
		interrupt-controller;
		#interrupt-cells = <2>;
	};

	gpg0: gpg0-gpio-bank {
		gpio-controller;
		#gpio-cells = <2>;
		interrupt-controller;
		#interrupt-cells = <2>;
	};

	gpp0: gpp0-gpio-bank {
		gpio-controller;
		#gpio-cells = <2>;
		interrupt-controller;
		#interrupt-cells = <2>;
	};

	gpp1: gpp1-gpio-bank {
		gpio-controller;
		#gpio-cells = <2>;
		interrupt-controller;
		#interrupt-cells = <2>;
	};

	gpp2: gpp2-gpio-bank {
		gpio-controller;
		#gpio-cells = <2>;
		interrupt-controller;
		#interrupt-cells = <2>;
	};

	gpp3: gpp3-gpio-bank {
		gpio-controller;
		#gpio-cells = <2>;
		interrupt-controller;
		#interrupt-cells = <2>;
	};

	gpp5: gpp5-gpio-bank {
		gpio-controller;
		#gpio-cells = <2>;
		interrupt-controller;
		#interrupt-cells = <2>;
	};

	gpp6: gpp6-gpio-bank {
		gpio-controller;
		#gpio-cells = <2>;
		interrupt-controller;
		#interrupt-cells = <2>;
	};

	gpp11: gpp11-gpio-bank {
		gpio-controller;
		#gpio-cells = <2>;
		interrupt-controller;
		#interrupt-cells = <2>;
	};

	hsi2c0_bus: hsi2c0-bus-pins {
		samsung,pins = "gpp0-0", "gpp0-1";
		samsung,pin-function = <EXYNOS_PIN_FUNC_2>;
		samsung,pin-pud = <EXYNOS_PIN_PULL_UP>;
		samsung,pin-drv = <EXYNOS7_PIN_DRV_LV1>;
	};

	hsi2c1_bus: hsi2c1-bus-pins {
		samsung,pins = "gpp0-2", "gpp0-3";
		samsung,pin-function = <EXYNOS_PIN_FUNC_3>;
		samsung,pin-pud = <EXYNOS_PIN_PULL_UP>;
		samsung,pin-drv = <EXYNOS7_PIN_DRV_LV1>;
	};

	hsi2c2_bus: hsi2c2-bus-pins {
		samsung,pins = "gpp1-0", "gpp1-1";
		samsung,pin-function = <EXYNOS_PIN_FUNC_2>;
		samsung,pin-pud = <EXYNOS_PIN_PULL_UP>;
		samsung,pin-drv = <EXYNOS7_PIN_DRV_LV1>;
	};

	hsi2c3_bus: hsi2c3-bus-pins {
		samsung,pins = "gpp1-2", "gpp1-3";
		samsung,pin-function = <EXYNOS_PIN_FUNC_3>;
		samsung,pin-pud = <EXYNOS_PIN_PULL_UP>;
		samsung,pin-drv = <EXYNOS7_PIN_DRV_LV1>;
	};

	hsi2c4_bus: hsi2c4-bus-pins {
		samsung,pins = "gpp2-0", "gpp2-1";
		samsung,pin-function = <EXYNOS_PIN_FUNC_2>;
		samsung,pin-pud = <EXYNOS_PIN_PULL_UP>;
		samsung,pin-drv = <EXYNOS7_PIN_DRV_LV1>;
	};

	hsi2c5_bus: hsi2c5-bus-pins {
		samsung,pins = "gpp2-2", "gpp2-3";
		samsung,pin-function = <EXYNOS_PIN_FUNC_3>;
		samsung,pin-pud = <EXYNOS_PIN_PULL_UP>;
		samsung,pin-drv = <EXYNOS7_PIN_DRV_LV1>;
	};

	hsi2c6_bus: hsi2c6-bus-pins {
		samsung,pins = "gpp3-0", "gpp3-1";
		samsung,pin-function = <EXYNOS_PIN_FUNC_2>;
		samsung,pin-pud = <EXYNOS_PIN_PULL_UP>;
		samsung,pin-drv = <EXYNOS7_PIN_DRV_LV1>;
	};

	hsi2c7_bus: hsi2c7-bus-pins {
		samsung,pins = "gpp3-2", "gpp3-3";
		samsung,pin-function = <EXYNOS_PIN_FUNC_3>;
		samsung,pin-pud = <EXYNOS_PIN_PULL_UP>;
		samsung,pin-drv = <EXYNOS7_PIN_DRV_LV1>;
	};

	hsi2c10_bus: hsi2c10-bus-pins {
		samsung,pins = "gpp5-0", "gpp5-1";
		samsung,pin-function = <EXYNOS_PIN_FUNC_2>;
		samsung,pin-pud = <EXYNOS_PIN_PULL_UP>;
		samsung,pin-drv = <EXYNOS7_PIN_DRV_LV1>;
	};

	hsi2c11_bus: hsi2c11-bus-pins {
		samsung,pins = "gpp5-2", "gpp5-3";
		samsung,pin-function = <EXYNOS_PIN_FUNC_3>;
		samsung,pin-pud = <EXYNOS_PIN_PULL_UP>;
		samsung,pin-drv = <EXYNOS7_PIN_DRV_LV1>;
	};

	hsi2c12_bus: hsi2c12-bus-pins {
		samsung,pins = "gpp6-0", "gpp6-1";
		samsung,pin-function = <EXYNOS_PIN_FUNC_2>;
		samsung,pin-pud = <EXYNOS_PIN_PULL_UP>;
		samsung,pin-drv = <EXYNOS7_PIN_DRV_LV1>;
	};

	hsi2c13_bus: hsi2c13-bus-pins {
		samsung,pins = "gpp6-2", "gpp6-3";
		samsung,pin-function = <EXYNOS_PIN_FUNC_3>;
		samsung,pin-pud = <EXYNOS_PIN_PULL_UP>;
		samsung,pin-drv = <EXYNOS7_PIN_DRV_LV1>;
	};

	hsi2c22_bus: hsi2c22-bus-pins {
		samsung,pins = "gpp11-0", "gpp11-1";
		samsung,pin-function = <EXYNOS_PIN_FUNC_2>;
		samsung,pin-pud = <EXYNOS_PIN_PULL_UP>;
		samsung,pin-drv = <EXYNOS7_PIN_DRV_LV1>;
	};

	i3c3_bus: i3c3-bus-pins {
		samsung,pins = "gpc3-0", "gpc3-1";
		samsung,pin-function = <EXYNOS_PIN_FUNC_2>;
		samsung,pin-pud = <EXYNOS_PIN_PULL_UP>;
		samsung,pin-drv = <EXYNOS7_PIN_DRV_LV1>;
	};

	i3c4_bus: i3c4-bus-pins {
		samsung,pins = "gpc4-0", "gpc4-1";
		samsung,pin-function = <EXYNOS_PIN_FUNC_2>;
		samsung,pin-pud = <EXYNOS_PIN_PULL_UP>;
		samsung,pin-drv = <EXYNOS7_PIN_DRV_LV1>;
	};

	i3c5_bus: i3c5-bus-pins {
		samsung,pins = "gpc5-0", "gpc5-1";
		samsung,pin-function = <EXYNOS_PIN_FUNC_2>;
		samsung,pin-pud = <EXYNOS_PIN_PULL_NONE>;
		samsung,pin-drv = <EXYNOS7_PIN_DRV_LV1>;
		samsung,pin-con-pdn = <EXYNOS_PIN_PDN_PREV>;
		samsung,pin-pud-pdn = <EXYNOS_PIN_PULL_NONE>;
	};

	i3c6_bus: i3c6-bus-pins {
		samsung,pins = "gpc6-0", "gpc6-1";
		samsung,pin-function = <EXYNOS_PIN_FUNC_2>;
		samsung,pin-pud = <EXYNOS_PIN_PULL_UP>;
		samsung,pin-drv = <EXYNOS7_PIN_DRV_LV1>;
	};

	i3c7_bus: i3c7-bus-pins {
		samsung,pins = "gpc7-0", "gpc7-1";
		samsung,pin-function = <EXYNOS_PIN_FUNC_2>;
		samsung,pin-pud = <EXYNOS_PIN_PULL_UP>;
		samsung,pin-drv = <EXYNOS7_PIN_DRV_LV1>;
	};

	i3c8_bus: i3c8-bus-pins {
		samsung,pins = "gpc8-0", "gpc8-1";
		samsung,pin-function = <EXYNOS_PIN_FUNC_2>;
		samsung,pin-pud = <EXYNOS_PIN_PULL_UP>;
		samsung,pin-drv = <EXYNOS7_PIN_DRV_LV1>;
	};

	i3c9_bus: i3c9-bus-pins {
		samsung,pins = "gpc9-0", "gpc9-1";
		samsung,pin-function = <EXYNOS_PIN_FUNC_2>;
		samsung,pin-pud = <EXYNOS_PIN_PULL_NONE>;
		samsung,pin-drv = <EXYNOS7_PIN_DRV_LV1>;
		samsung,pin-con-pdn = <EXYNOS_PIN_PDN_PREV>;
		samsung,pin-pud-pdn = <EXYNOS_PIN_PULL_NONE>;
	};

	i3c10_bus: i3c10-bus-pins {
		samsung,pins = "gpp2-2", "gpp2-3";
		samsung,pin-function = <EXYNOS_PIN_FUNC_4>;
		samsung,pin-pud = <EXYNOS_PIN_PULL_UP>;
		samsung,pin-drv = <EXYNOS7_PIN_DRV_LV1>;
	};

	i3c11_bus: i3c11-bus-pins {
		samsung,pins = "gpp3-2", "gpp3-3";
		samsung,pin-function = <EXYNOS_PIN_FUNC_4>;
		samsung,pin-pud = <EXYNOS_PIN_PULL_UP>;
		samsung,pin-drv = <EXYNOS7_PIN_DRV_LV1>;
	};

	hsi2c23_bus: hsi2c23-bus-pins {
		samsung,pins = "gpp11-2", "gpp11-3";
		samsung,pin-function = <EXYNOS_PIN_FUNC_3>;
		samsung,pin-pud = <EXYNOS_PIN_PULL_UP>;
		samsung,pin-drv = <EXYNOS7_PIN_DRV_LV1>;
	};

	spi0_bus: spi0-bus-pins {
		samsung,pins = "gpp0-2", "gpp0-1", "gpp0-0";
		samsung,pin-function = <EXYNOS_PIN_FUNC_2>;
		samsung,pin-pud = <EXYNOS_PIN_PULL_NONE>;
		samsung,pin-drv = <EXYNOS7_PIN_DRV_LV1>;
	};

	spi0_cs: spi0-cs-pins {
		samsung,pins = "gpp0-3";
		samsung,pin-function = <EXYNOS_PIN_FUNC_OUTPUT>;
		samsung,pin-pud = <EXYNOS_PIN_PULL_NONE>;
		samsung,pin-drv = <EXYNOS7_PIN_DRV_LV1>;
	};

	spi0_cs_func: spi0-cs-func-pins {
		samsung,pins = "gpp0-3";
		samsung,pin-function = <EXYNOS_PIN_FUNC_2>;
		samsung,pin-pud = <EXYNOS_PIN_PULL_NONE>;
		samsung,pin-drv = <EXYNOS7_PIN_DRV_LV1>;
	};

	spi1_bus: spi1-bus-pins {
		samsung,pins = "gpp1-2", "gpp1-1", "gpp1-0";
		samsung,pin-function = <EXYNOS_PIN_FUNC_2>;
		samsung,pin-pud = <EXYNOS_PIN_PULL_NONE>;
		samsung,pin-drv = <EXYNOS7_PIN_DRV_LV1>;
	};

	spi1_cs: spi1-cs-pins {
		samsung,pins = "gpp1-3";
		samsung,pin-function = <EXYNOS_PIN_FUNC_OUTPUT>;
		samsung,pin-pud = <EXYNOS_PIN_PULL_NONE>;
		samsung,pin-drv = <EXYNOS7_PIN_DRV_LV1>;
	};

	spi1_cs_func: spi1-cs-func-pins {
		samsung,pins = "gpp1-3";
		samsung,pin-function = <EXYNOS_PIN_FUNC_2>;
		samsung,pin-pud = <EXYNOS_PIN_PULL_NONE>;
		samsung,pin-drv = <EXYNOS7_PIN_DRV_LV1>;
	};

	spi2_bus: spi2-bus-pins {
		samsung,pins = "gpp2-2", "gpp2-1", "gpp2-0";
		samsung,pin-function = <EXYNOS_PIN_FUNC_2>;
		samsung,pin-pud = <EXYNOS_PIN_PULL_NONE>;
		samsung,pin-drv = <EXYNOS7_PIN_DRV_LV1>;
	};

	spi2_cs: spi2-cs-pins {
		samsung,pins = "gpp2-3";
		samsung,pin-function = <EXYNOS_PIN_FUNC_OUTPUT>;
		samsung,pin-pud = <EXYNOS_PIN_PULL_NONE>;
		samsung,pin-drv = <EXYNOS7_PIN_DRV_LV1>;
	};

	spi2_cs_func: spi2-cs-func-pins {
		samsung,pins = "gpp2-3";
		samsung,pin-function = <EXYNOS_PIN_FUNC_2>;
		samsung,pin-pud = <EXYNOS_PIN_PULL_NONE>;
		samsung,pin-drv = <EXYNOS7_PIN_DRV_LV1>;
	};

	spi3_bus: spi3-bus-pins {
		samsung,pins = "gpp3-2", "gpp3-1", "gpp3-0";
		samsung,pin-function = <EXYNOS_PIN_FUNC_2>;
		samsung,pin-pud = <EXYNOS_PIN_PULL_NONE>;
		samsung,pin-drv = <EXYNOS7_PIN_DRV_LV1>;
	};

	spi3_cs: spi3-cs-pins {
		samsung,pins = "gpp3-3";
		samsung,pin-function = <EXYNOS_PIN_FUNC_OUTPUT>;
		samsung,pin-pud = <EXYNOS_PIN_PULL_NONE>;
		samsung,pin-drv = <EXYNOS7_PIN_DRV_LV1>;
	};

	spi3_cs_func: spi3-cs-func-pins {
		samsung,pins = "gpp3-3";
		samsung,pin-function = <EXYNOS_PIN_FUNC_2>;
		samsung,pin-pud = <EXYNOS_PIN_PULL_NONE>;
		samsung,pin-drv = <EXYNOS7_PIN_DRV_LV1>;
	};

	spi5_bus: spi5-bus-pins {
		samsung,pins = "gpp5-2", "gpp5-1", "gpp5-0";
		samsung,pin-function = <EXYNOS_PIN_FUNC_2>;
		samsung,pin-pud = <EXYNOS_PIN_PULL_NONE>;
		samsung,pin-drv = <EXYNOS7_PIN_DRV_LV1>;
	};

	spi5_cs: spi5-cs-pins {
		samsung,pins = "gpp5-3";
		samsung,pin-function = <EXYNOS_PIN_FUNC_OUTPUT>;
		samsung,pin-pud = <EXYNOS_PIN_PULL_NONE>;
		samsung,pin-drv = <EXYNOS7_PIN_DRV_LV1>;
	};

	spi5_cs_func: spi5-cs-func-pins {
		samsung,pins = "gpp5-3";
		samsung,pin-function = <EXYNOS_PIN_FUNC_2>;
		samsung,pin-pud = <EXYNOS_PIN_PULL_NONE>;
		samsung,pin-drv = <EXYNOS7_PIN_DRV_LV1>;
	};

	spi6_bus: spi6-bus-pins {
		samsung,pins = "gpp6-2", "gpp6-1", "gpp6-0";
		samsung,pin-function = <EXYNOS_PIN_FUNC_2>;
		samsung,pin-pud = <EXYNOS_PIN_PULL_NONE>;
		samsung,pin-drv = <EXYNOS7_PIN_DRV_LV1>;
	};

	spi6_cs: spi6-cs-pins {
		samsung,pins = "gpp6-3";
		samsung,pin-function = <EXYNOS_PIN_FUNC_OUTPUT>;
		samsung,pin-pud = <EXYNOS_PIN_PULL_NONE>;
		samsung,pin-drv = <EXYNOS7_PIN_DRV_LV1>;
	};

	spi6_cs_func: spi6-cs-func-pins {
		samsung,pins = "gpp6-3";
		samsung,pin-function = <EXYNOS_PIN_FUNC_2>;
		samsung,pin-pud = <EXYNOS_PIN_PULL_NONE>;
		samsung,pin-drv = <EXYNOS7_PIN_DRV_LV1>;
	};

	spi11_bus: spi11-bus-pins {
		samsung,pins = "gpp11-2", "gpp11-1", "gpp11-0";
		samsung,pin-function = <EXYNOS_PIN_FUNC_2>;
		samsung,pin-pud = <EXYNOS_PIN_PULL_NONE>;
		samsung,pin-drv = <EXYNOS7_PIN_DRV_LV1>;
	};

	spi11_cs: spi11-cs-pins {
		samsung,pins = "gpp11-3";
		samsung,pin-function = <EXYNOS_PIN_FUNC_OUTPUT>;
		samsung,pin-pud = <EXYNOS_PIN_PULL_NONE>;
		samsung,pin-drv = <EXYNOS7_PIN_DRV_LV1>;
	};

	spi11_cs_func: spi11-cs-func-pins {
		samsung,pins = "gpp11-3";
		samsung,pin-function = <EXYNOS_PIN_FUNC_2>;
		samsung,pin-pud = <EXYNOS_PIN_PULL_NONE>;
		samsung,pin-drv = <EXYNOS7_PIN_DRV_LV1>;
	};

	uart0_bus_single: uart0-bus-single-pins {
		samsung,pins = "gpg0-2", "gpg0-3";
		samsung,pin-function = <EXYNOS_PIN_FUNC_3>;
		samsung,pin-pud = <EXYNOS_PIN_PULL_UP>;
	};

	uart2_bus_single: uart2-bus-single-pins {
		samsung,pins = "gpp0-0", "gpp0-1", "gpp0-2", "gpp0-3";
		samsung,pin-function = <EXYNOS_PIN_FUNC_2>;
		samsung,pin-pud = <EXYNOS_PIN_PULL_NONE>;
	};

	uart2_bus_dual: uart2-bus-dual-pins {
		samsung,pins = "gpp0-0", "gpp0-1";
		samsung,pin-function = <EXYNOS_PIN_FUNC_2>;
		samsung,pin-pud = <EXYNOS_PIN_PULL_NONE>;
	};

	uart3_bus_single: uart3-bus-single-pins {
		samsung,pins = "gpp1-0", "gpp1-1", "gpp1-2", "gpp1-3";
		samsung,pin-function = <EXYNOS_PIN_FUNC_2>;
		samsung,pin-pud = <EXYNOS_PIN_PULL_NONE>;
	};

	uart3_bus_dual: uart3-bus-dual-pins {
		samsung,pins = "gpp1-0", "gpp1-1";
		samsung,pin-function = <EXYNOS_PIN_FUNC_2>;
		samsung,pin-pud = <EXYNOS_PIN_PULL_NONE>;
	};

	uart4_bus_single: uart4-bus-single-pins {
		samsung,pins = "gpp2-0", "gpp2-1", "gpp2-2", "gpp2-3";
		samsung,pin-function = <EXYNOS_PIN_FUNC_2>;
		samsung,pin-pud = <EXYNOS_PIN_PULL_NONE>;
	};

	uart4_bus_dual: uart4-bus-dual-pins {
		samsung,pins = "gpp2-0", "gpp2-1";
		samsung,pin-function = <EXYNOS_PIN_FUNC_2>;
		samsung,pin-pud = <EXYNOS_PIN_PULL_NONE>;
	};

	uart5_bus_single: uart5-bus-single-pins {
		samsung,pins = "gpp3-0", "gpp3-1", "gpp3-2", "gpp3-3";
		samsung,pin-function = <EXYNOS_PIN_FUNC_2>;
		samsung,pin-pud = <EXYNOS_PIN_PULL_NONE>;
	};

	uart5_bus_dual: uart5-bus-dual-pins {
		samsung,pins = "gpp3-0", "gpp3-1";
		samsung,pin-function = <EXYNOS_PIN_FUNC_2>;
		samsung,pin-pud = <EXYNOS_PIN_PULL_NONE>;
	};

	uart7_bus_single: uart7-bus-single-pins {
		samsung,pins = "gpp5-0", "gpp5-1", "gpp5-2", "gpp5-3";
		samsung,pin-function = <EXYNOS_PIN_FUNC_2>;
		samsung,pin-pud = <EXYNOS_PIN_PULL_NONE>;
	};

	uart7_bus_dual: uart7-bus-dual-pins {
		samsung,pins = "gpp5-0", "gpp5-1";
		samsung,pin-function = <EXYNOS_PIN_FUNC_2>;
		samsung,pin-pud = <EXYNOS_PIN_PULL_NONE>;
	};

	uart8_bus_single: uart8-bus-single-pins {
		samsung,pins = "gpp6-3", "gpp6-2", "gpp6-1", "gpp6-0";
		samsung,pin-function = <EXYNOS_PIN_FUNC_2>;
		samsung,pin-pud = <EXYNOS_PIN_PULL_NONE>;
	};

	uart8_bus_dual: uart8-bus-dual-pins {
		samsung,pins = "gpp6-0", "gpp6-1";
		samsung,pin-function = <EXYNOS_PIN_FUNC_2>;
		samsung,pin-pud = <EXYNOS_PIN_PULL_NONE>;
	};

	uart13_bus_single: uart13-bus-single-pins {
		samsung,pins = "gpp11-3", "gpp11-2", "gpp11-1", "gpp11-0";
		samsung,pin-function = <EXYNOS_PIN_FUNC_2>;
		samsung,pin-pud = <EXYNOS_PIN_PULL_NONE>;
	};

	uart13_bus_dual: uart13-bus-dual-pins {
		samsung,pins = "gpp11-0", "gpp11-1";
		samsung,pin-function = <EXYNOS_PIN_FUNC_2>;
		samsung,pin-pud = <EXYNOS_PIN_PULL_NONE>;
	};
};

&pinctrl_ufs {
	gpf1: gpf1-gpio-bank {
		gpio-controller;
		#gpio-cells = <2>;
		interrupt-controller;
		#interrupt-cells = <2>;
	};
};

&pinctrl_vts {
	gpv0: gpv0-gpio-bank {
		gpio-controller;
		#gpio-cells = <2>;
		interrupt-controller;
		#interrupt-cells = <2>;
	};

	amic_pdm0_bus: amic-pdm0-bus-pins {
		samsung,pins = "gpv0-3";
		samsung,pin-function = <EXYNOS_PIN_FUNC_3>;
		samsung,pin-pud = <EXYNOS_PIN_PULL_NONE>;
		samsung,pin-con-pdn = <EXYNOS_PIN_PDN_INPUT>;
	};

	amic_pdm1_bus: amic-pdm1-bus-pins {
		samsung,pins = "gpv0-4";
		samsung,pin-function = <EXYNOS_PIN_FUNC_3>;
		samsung,pin-pud = <EXYNOS_PIN_PULL_NONE>;
		samsung,pin-con-pdn = <EXYNOS_PIN_PDN_INPUT>;
	};

	amic_pdm2_bus: amic-pdm2-bus-pins {
		samsung,pins = "gpv0-5";
		samsung,pin-function = <EXYNOS_PIN_FUNC_3>;
		samsung,pin-pud = <EXYNOS_PIN_PULL_NONE>;
		samsung,pin-con-pdn = <EXYNOS_PIN_PDN_INPUT>;
	};

	dmic_bus_clk0: dmic-bus-clk0-pins {
		samsung,pins = "gpv0-0";
		samsung,pin-function = <EXYNOS_PIN_FUNC_2>;
		samsung,pin-pud = <EXYNOS_PIN_PULL_DOWN>;
		samsung,pin-con-pdn = <EXYNOS_PIN_PDN_INPUT>;
	};

	dmic_bus_clk1: dmic-bus-clk1-pins {
		samsung,pins = "gpv0-1";
		samsung,pin-function = <EXYNOS_PIN_FUNC_2>;
		samsung,pin-pud = <EXYNOS_PIN_PULL_DOWN>;
		samsung,pin-con-pdn = <EXYNOS_PIN_PDN_INPUT>;
	};

	dmic_bus_clk2: dmic-bus-clk2-pins {
		samsung,pins = "gpv0-2";
		samsung,pin-function = <EXYNOS_PIN_FUNC_2>;
		samsung,pin-pud = <EXYNOS_PIN_PULL_DOWN>;
		samsung,pin-con-pdn = <EXYNOS_PIN_PDN_INPUT>;
	};

	dmic_pdm0_bus: dmic-pdm0-bus-pins {
		samsung,pins = "gpv0-3";
		samsung,pin-function = <EXYNOS_PIN_FUNC_2>;
		samsung,pin-pud = <EXYNOS_PIN_PULL_DOWN>;
		samsung,pin-con-pdn = <EXYNOS_PIN_PDN_INPUT>;
	};

	dmic_pdm1_bus: dmic-pdm1-bus-pins {
		samsung,pins = "gpv0-4";
		samsung,pin-function = <EXYNOS_PIN_FUNC_2>;
		samsung,pin-pud = <EXYNOS_PIN_PULL_DOWN>;
		samsung,pin-con-pdn = <EXYNOS_PIN_PDN_INPUT>;
	};

	dmic_pdm2_bus: dmic-pdm2-bus-pins {
		samsung,pins = "gpv0-5";
		samsung,pin-function = <EXYNOS_PIN_FUNC_2>;
		samsung,pin-pud = <EXYNOS_PIN_PULL_DOWN>;
		samsung,pin-con-pdn = <EXYNOS_PIN_PDN_INPUT>;
	};
};
