// SPDX-License-Identifier: GPL-2.0-only
/*
 * GS101 SoC pin-mux and pin-config device tree source
 *
 * Copyright 2019-2023 Google LLC
 * Copyright 2023 Linaro Ltd - <peter.griffin@linaro.org>
 */

#include "gs101-pinctrl.h"

&pinctrl_gpio_alive {
	gpa0: gpa0-gpio-bank {
		gpio-controller;
		#gpio-cells = <2>;
		interrupt-controller;
		#interrupt-cells = <2>;
		interrupt-parent = <&gic>;
		interrupts = <GIC_SPI 0 IRQ_TYPE_LEVEL_HIGH 0>,
			     <GIC_SPI 1 IRQ_TYPE_LEVEL_HIGH 0>,
			     <GIC_SPI 2 IRQ_TYPE_LEVEL_HIGH 0>,
			     <GIC_SPI 3 IRQ_TYPE_LEVEL_HIGH 0>,
			     <GIC_SPI 4 IRQ_TYPE_LEVEL_HIGH 0>,
			     <GIC_SPI 5 IRQ_TYPE_LEVEL_HIGH 0>,
			     <GIC_SPI 6 IRQ_TYPE_LEVEL_HIGH 0>,
			     <GIC_SPI 7 IRQ_TYPE_LEVEL_HIGH 0>;
	};

	gpa1: gpa1-gpio-bank {
		gpio-controller;
		#gpio-cells = <2>;
		interrupt-controller;
		#interrupt-cells = <2>;
		interrupt-parent = <&gic>;
		interrupts = <GIC_SPI 8 IRQ_TYPE_LEVEL_HIGH 0>,
			     <GIC_SPI 9 IRQ_TYPE_LEVEL_HIGH 0>,
			     <GIC_SPI 10 IRQ_TYPE_LEVEL_HIGH 0>,
			     <GIC_SPI 11 IRQ_TYPE_LEVEL_HIGH 0>,
			     <GIC_SPI 12 IRQ_TYPE_LEVEL_HIGH 0>,
			     <GIC_SPI 13 IRQ_TYPE_LEVEL_HIGH 0>,
			     <GIC_SPI 14 IRQ_TYPE_LEVEL_HIGH 0>;
	};

	gpa2: gpa2-gpio-bank {
		gpio-controller;
		#gpio-cells = <2>;
		interrupt-controller;
		#interrupt-cells = <2>;
		interrupt-parent = <&gic>;
		interrupts = <GIC_SPI 15 IRQ_TYPE_LEVEL_HIGH 0>,
			     <GIC_SPI 16 IRQ_TYPE_LEVEL_HIGH 0>,
			     <GIC_SPI 17 IRQ_TYPE_LEVEL_HIGH 0>,
			     <GIC_SPI 18 IRQ_TYPE_LEVEL_HIGH 0>,
			     <GIC_SPI 19 IRQ_TYPE_LEVEL_HIGH 0>;
	};

	gpa3: gpa3-gpio-bank {
		gpio-controller;
		#gpio-cells = <2>;
		interrupt-controller;
		#interrupt-cells = <2>;
		interrupt-parent = <&gic>;
		interrupts = <GIC_SPI 20 IRQ_TYPE_LEVEL_HIGH 0>,
			     <GIC_SPI 21 IRQ_TYPE_LEVEL_HIGH 0>,
			     <GIC_SPI 22 IRQ_TYPE_LEVEL_HIGH 0>,
			     <GIC_SPI 23 IRQ_TYPE_LEVEL_HIGH 0>;
	};

	gpa4: gpa4-gpio-bank {
		gpio-controller;
		#gpio-cells = <2>;
		interrupt-controller;
		#interrupt-cells = <2>;
		interrupt-parent = <&gic>;
		interrupts = <GIC_SPI 24 IRQ_TYPE_LEVEL_HIGH 0>,
			     <GIC_SPI 25 IRQ_TYPE_LEVEL_HIGH 0>,
			     <GIC_SPI 26 IRQ_TYPE_LEVEL_HIGH 0>,
			     <GIC_SPI 27 IRQ_TYPE_LEVEL_HIGH 0>;
	};

	gpa5: gpa5-gpio-bank  {
		gpio-controller;
		#gpio-cells = <2>;
		interrupt-controller;
		#interrupt-cells = <2>;
		interrupts = <GIC_SPI 28 IRQ_TYPE_LEVEL_HIGH 0>,
			     <GIC_SPI 29 IRQ_TYPE_LEVEL_HIGH 0>,
			     <GIC_SPI 30 IRQ_TYPE_LEVEL_HIGH 0>,
			     <GIC_SPI 31 IRQ_TYPE_LEVEL_HIGH 0>,
			     <GIC_SPI 32 IRQ_TYPE_LEVEL_HIGH 0>,
			     <GIC_SPI 33 IRQ_TYPE_LEVEL_HIGH 0>,
			     <GIC_SPI 34 IRQ_TYPE_LEVEL_HIGH 0>;
	};

	gpa9: gpa9-gpio-bank  {
		gpio-controller;
		#gpio-cells = <2>;
		interrupt-controller;
		#interrupt-cells = <2>;
		interrupts = <GIC_SPI 35 IRQ_TYPE_LEVEL_HIGH 0>,
			     <GIC_SPI 36 IRQ_TYPE_LEVEL_HIGH 0>,
			     <GIC_SPI 37 IRQ_TYPE_LEVEL_HIGH 0>,
			     <GIC_SPI 38 IRQ_TYPE_LEVEL_HIGH 0>,
			     <GIC_SPI 39 IRQ_TYPE_LEVEL_HIGH 0>,
			     <GIC_SPI 40 IRQ_TYPE_LEVEL_HIGH 0>,
			     <GIC_SPI 41 IRQ_TYPE_LEVEL_HIGH 0>,
			     <GIC_SPI 42 IRQ_TYPE_LEVEL_HIGH 0>;
	};

	gpa10: gpa10-gpio-bank  {
		gpio-controller;
		#gpio-cells = <2>;
		interrupt-controller;
		#interrupt-cells = <2>;
		interrupts = <GIC_SPI 43 IRQ_TYPE_LEVEL_HIGH 0>,
			     <GIC_SPI 44 IRQ_TYPE_LEVEL_HIGH 0>;
	};

	uart15_bus: uart15-bus-pins {
		samsung,pins = "gpa2-3", "gpa2-4";
		samsung,pin-function = <GS101_PIN_FUNC_2>;
		samsung,pin-pud = <GS101_PIN_PULL_NONE>;
	};

	uart16_bus: uart16-bus-pins {
		samsung,pins = "gpa3-0", "gpa3-1", "gpa3-2", "gpa3-3";
		samsung,pin-function = <GS101_PIN_FUNC_2>;
		samsung,pin-pud = <GS101_PIN_PULL_NONE>;
	};

	uart17_bus: uart17-bus-pins {
		samsung,pins = "gpa4-0", "gpa4-1", "gpa4-2", "gpa4-3";
		samsung,pin-function = <GS101_PIN_FUNC_2>;
		samsung,pin-pud = <GS101_PIN_PULL_NONE>;
	};

	spi15_bus: spi15-bus-pins {
		samsung,pins = "gpa4-0", "gpa4-1", "gpa4-2";
		samsung,pin-function = <GS101_PIN_FUNC_2>;
		samsung,pin-pud = <GS101_PIN_PULL_NONE>;
		samsung,pin-drv = <GS101_PIN_DRV_2_5_MA>;
	};

	spi15_cs: spi15-cs-pins {
		samsung,pins = "gpa4-3";
		samsung,pin-function = <GS101_PIN_FUNC_OUTPUT>;
		samsung,pin-pud = <GS101_PIN_PULL_NONE>;
		samsung,pin-drv = <GS101_PIN_DRV_2_5_MA>;
	};
};

&pinctrl_far_alive {
	gpa6: gpa6-gpio-bank {
		gpio-controller;
		#gpio-cells = <2>;
		interrupt-controller;
		#interrupt-cells = <2>;
		interrupt-parent = <&gic>;
		interrupts = <GIC_SPI 45 IRQ_TYPE_LEVEL_HIGH 0>,
			     <GIC_SPI 46 IRQ_TYPE_LEVEL_HIGH 0>,
			     <GIC_SPI 47 IRQ_TYPE_LEVEL_HIGH 0>,
			     <GIC_SPI 48 IRQ_TYPE_LEVEL_HIGH 0>,
			     <GIC_SPI 49 IRQ_TYPE_LEVEL_HIGH 0>,
			     <GIC_SPI 50 IRQ_TYPE_LEVEL_HIGH 0>,
			     <GIC_SPI 51 IRQ_TYPE_LEVEL_HIGH 0>,
			     <GIC_SPI 52 IRQ_TYPE_LEVEL_HIGH 0>;
	};

	gpa7: gpa7-gpio-bank {
		gpio-controller;
		#gpio-cells = <2>;
		interrupt-controller;
		#interrupt-cells = <2>;
		interrupt-parent = <&gic>;
		interrupts = <GIC_SPI 53 IRQ_TYPE_LEVEL_HIGH 0>,
			     <GIC_SPI 54 IRQ_TYPE_LEVEL_HIGH 0>,
			     <GIC_SPI 55 IRQ_TYPE_LEVEL_HIGH 0>,
			     <GIC_SPI 56 IRQ_TYPE_LEVEL_HIGH 0>;
	};

	gpa8: gpa8-gpio-bank {
		gpio-controller;
		#gpio-cells = <2>;
		interrupt-controller;
		#interrupt-cells = <2>;
		interrupt-parent = <&gic>;
		interrupts = <GIC_SPI 57 IRQ_TYPE_LEVEL_HIGH 0>,
			     <GIC_SPI 58 IRQ_TYPE_LEVEL_HIGH 0>,
			     <GIC_SPI 59 IRQ_TYPE_LEVEL_HIGH 0>,
			     <GIC_SPI 60 IRQ_TYPE_LEVEL_HIGH 0>,
			     <GIC_SPI 61 IRQ_TYPE_LEVEL_HIGH 0>,
			     <GIC_SPI 62 IRQ_TYPE_LEVEL_HIGH 0>,
			     <GIC_SPI 63 IRQ_TYPE_LEVEL_HIGH 0>,
			     <GIC_SPI 64 IRQ_TYPE_LEVEL_HIGH 0>;
	};

	gpa11: gpa11-gpio-bank {
		gpio-controller;
		#gpio-cells = <2>;
		interrupt-controller;
		#interrupt-cells = <2>;
		interrupt-parent = <&gic>;
		interrupts = <GIC_SPI 65 IRQ_TYPE_LEVEL_HIGH 0>,
			     <GIC_SPI 66 IRQ_TYPE_LEVEL_HIGH 0>;
	};
};

&pinctrl_gsacore {
	gps0: gps0-gpio-bank {
		gpio-controller;
		#gpio-cells = <2>;
		interrupt-controller;
		#interrupt-cells = <2>;
	};

	gps1: gps1-gpio-bank {
		gpio-controller;
		#gpio-cells = <2>;
		interrupt-controller;
		#interrupt-cells = <2>;
	};

	gps2: gps2-gpio-bank {
		gpio-controller;
		#gpio-cells = <2>;
		interrupt-controller;
		#interrupt-cells = <2>;
	};
};

&pinctrl_gsactrl {
	gps3: gps3-gpio-bank {
		gpio-controller;
		#gpio-cells = <2>;
		interrupt-controller;
		#interrupt-cells = <2>;
	};
};

&pinctrl_hsi1 {
	gph0: gph0-gpio-bank {
		gpio-controller;
		#gpio-cells = <2>;
		interrupt-controller;
		#interrupt-cells = <2>;
	};

	gph1: gph1-gpio-bank {
		gpio-controller;
		#gpio-cells = <2>;
		interrupt-controller;
		#interrupt-cells = <2>;
	};

	pcie0_clkreq: pcie0-clkreq-pins {
		samsung,pins = "gph0-1";
		samsung,pin-function = <GS101_PIN_FUNC_2>;
		samsung,pin-pud = <GS101_PIN_PULL_UP>;
		samsung,pin-drv = <GS101_PIN_DRV_10_MA>;
		samsung,pin-con-pdn = <GS101_PIN_PDN_PREV>;
		samsung,pin-pud-pdn = <GS101_PIN_PULL_UP>;
	};

	pcie0_perst: pcie0-perst-pins {
		samsung,pins = "gph0-0";
		samsung,pin-function = <GS101_PIN_FUNC_OUTPUT>;
		samsung,pin-drv = <GS101_PIN_DRV_10_MA>;
		samsung,pin-con-pdn = <GS101_PIN_PDN_PREV>;
	};
};

&pinctrl_hsi2 {
	gph2: gph2-gpio-bank {
		gpio-controller;
		#gpio-cells = <2>;
		interrupt-controller;
		#interrupt-cells = <2>;
	};

	gph3: gph3-gpio-bank {
		gpio-controller;
		#gpio-cells = <2>;
		interrupt-controller;
		#interrupt-cells = <2>;
	};

	gph4: gph4-gpio-bank {
		gpio-controller;
		#gpio-cells = <2>;
		interrupt-controller;
		#interrupt-cells = <2>;
	};

	sd2_clk: sd2-clk-pins {
		samsung,pins = "gph4-0";
		samsung,pin-function = <GS101_PIN_FUNC_2>;
		samsung,pin-pud = <GS101_PIN_PULL_NONE>;
		samsung,pin-drv = <GS101_PIN_DRV_7_5_MA>;
	};

	sd2_cmd: sd2-cmd-pins {
		samsung,pins = "gph4-1";
		samsung,pin-function = <GS101_PIN_FUNC_2>;
		samsung,pin-pud = <GS101_PIN_PULL_UP>;
		samsung,pin-drv = <GS101_PIN_DRV_7_5_MA>;
	};

	sd2_bus1: sd2-bus-width1-pins {
		samsung,pins = "gph4-2";
		samsung,pin-function = <GS101_PIN_FUNC_2>;
		samsung,pin-pud = <GS101_PIN_PULL_UP>;
		samsung,pin-drv = <GS101_PIN_DRV_7_5_MA>;
	};

	sd2_bus4: sd2-bus-width4-pins {
		samsung,pins = "gph4-3", "gph4-4", "gph4-5";
		samsung,pin-function = <GS101_PIN_FUNC_2>;
		samsung,pin-pud = <GS101_PIN_PULL_UP>;
		samsung,pin-drv = <GS101_PIN_DRV_7_5_MA>;
	};

	sd2_clk_fast_slew_rate_1x: sd2-clk-fast-slew-rate-1x-pins {
		samsung,pins = "gph4-0";
		samsung,pin-function = <GS101_PIN_FUNC_2>;
		samsung,pin-pud = <GS101_PIN_PULL_NONE>;
		samsung,pin-drv = <GS101_PIN_DRV_2_5_MA>;
	};

	sd2_clk_fast_slew_rate_2x: sd2-clk-fast-slew-rate-2x-pins {
		samsung,pins = "gph4-0";
		samsung,pin-function = <GS101_PIN_FUNC_2>;
		samsung,pin-pud = <GS101_PIN_PULL_NONE>;
		samsung,pin-drv = <GS101_PIN_DRV_5_MA>;
	};

	sd2_clk_fast_slew_rate_3x: sd2-clk-fast-slew-rate-3x-pins {
		samsung,pins = "gph4-0";
		samsung,pin-function = <GS101_PIN_FUNC_2>;
		samsung,pin-pud = <GS101_PIN_PULL_NONE>;
		samsung,pin-drv = <GS101_PIN_DRV_7_5_MA>;
	};

	sd2_clk_fast_slew_rate_4x: sd2-clk-fast-slew-rate-4x-pins {
		samsung,pins = "gph4-0";
		samsung,pin-function = <GS101_PIN_FUNC_2>;
		samsung,pin-pud = <GS101_PIN_PULL_NONE>;
		samsung,pin-drv = <GS101_PIN_DRV_10_MA>;
	};

	ufs_rst_n: ufs-rst-n-pins {
		samsung,pins = "gph3-1";
		samsung,pin-function = <GS101_PIN_FUNC_2>;
		samsung,pin-pud = <GS101_PIN_PULL_NONE>;
		samsung,pin-con-pdn = <GS101_PIN_PDN_PREV>;
		samsung,pin-pud-pdn = <GS101_PIN_PULL_NONE>;
	};

	ufs_refclk_out: ufs-refclk-out-pins {
		samsung,pins = "gph3-0";
		samsung,pin-function = <GS101_PIN_FUNC_2>;
		samsung,pin-pud = <GS101_PIN_PULL_NONE>;
		samsung,pin-con-pdn = <GS101_PIN_PDN_PREV>;
		samsung,pin-pud-pdn = <GS101_PIN_PULL_NONE>;
	};

	pcie1_clkreq: pcie1-clkreq-pins {
		samsung,pins = "gph2-1";
		samsung,pin-function = <GS101_PIN_FUNC_2>;
		samsung,pin-pud = <GS101_PIN_PULL_UP>;
		samsung,pin-drv = <GS101_PIN_DRV_10_MA>;
		samsung,pin-con-pdn = <GS101_PIN_PDN_PREV>;
		samsung,pin-pud-pdn = <GS101_PIN_PULL_UP>;
	};

	pcie1_perst: pcie1-perst-pins {
		samsung,pins = "gph2-0";
		samsung,pin-function = <GS101_PIN_FUNC_OUTPUT>;
		samsung,pin-drv = <GS101_PIN_DRV_10_MA>;
		samsung,pin-con-pdn = <GS101_PIN_PDN_PREV>;
	};
};

&pinctrl_peric0 {
	gpp0: gpp0-gpio-bank {
		gpio-controller;
		#gpio-cells = <2>;
		interrupt-controller;
		#interrupt-cells = <2>;
	};

	gpp1: gpp1-gpio-bank {
		gpio-controller;
		#gpio-cells = <2>;
		interrupt-controller;
		#interrupt-cells = <2>;
	};

	gpp2: gpp2-gpio-bank {
		gpio-controller;
		#gpio-cells = <2>;
		interrupt-controller;
		#interrupt-cells = <2>;
	};

	gpp3: gpp3-gpio-bank {
		gpio-controller;
		#gpio-cells = <2>;
		interrupt-controller;
		#interrupt-cells = <2>;
	};

	gpp4: gpp4-gpio-bank {
		gpio-controller;
		#gpio-cells = <2>;
		interrupt-controller;
		#interrupt-cells = <2>;
	};

	gpp5: gpp5-gpio-bank {
		gpio-controller;
		#gpio-cells = <2>;
		interrupt-controller;
		#interrupt-cells = <2>;
	};

	gpp6: gpp6-gpio-bank {
		gpio-controller;
		#gpio-cells = <2>;
		interrupt-controller;
		#interrupt-cells = <2>;
	};

	gpp7: gpp7-gpio-bank {
		gpio-controller;
		#gpio-cells = <2>;
		interrupt-controller;
		#interrupt-cells = <2>;
	};

	gpp8: gpp8-gpio-bank {
		gpio-controller;
		#gpio-cells = <2>;
		interrupt-controller;
		#interrupt-cells = <2>;
	};

	gpp9: gpp9-gpio-bank {
		gpio-controller;
		#gpio-cells = <2>;
		interrupt-controller;
		#interrupt-cells = <2>;
	};

	gpp10: gpp10-gpio-bank {
		gpio-controller;
		#gpio-cells = <2>;
		interrupt-controller;
		#interrupt-cells = <2>;
	};

	gpp11: gpp11-gpio-bank {
		gpio-controller;
		#gpio-cells = <2>;
		interrupt-controller;
		#interrupt-cells = <2>;
	};

	gpp12: gpp12-gpio-bank {
		gpio-controller;
		#gpio-cells = <2>;
		interrupt-controller;
		#interrupt-cells = <2>;
	};

	gpp13: gpp13-gpio-bank {
		gpio-controller;
		#gpio-cells = <2>;
		interrupt-controller;
		#interrupt-cells = <2>;
	};

	gpp14: gpp14-gpio-bank {
		gpio-controller;
		#gpio-cells = <2>;
		interrupt-controller;
		#interrupt-cells = <2>;
	};

	gpp15: gpp15-gpio-bank {
		gpio-controller;
		#gpio-cells = <2>;
		interrupt-controller;
		#interrupt-cells = <2>;
	};

	gpp16: gpp16-gpio-bank {
		gpio-controller;
		#gpio-cells = <2>;
		interrupt-controller;
		#interrupt-cells = <2>;
	};

	gpp17: gpp17-gpio-bank {
		gpio-controller;
		#gpio-cells = <2>;
		interrupt-controller;
		#interrupt-cells = <2>;
	};

	gpp18: gpp18-gpio-bank {
		gpio-controller;
		#gpio-cells = <2>;
		interrupt-controller;
		#interrupt-cells = <2>;
	};

	gpp19: gpp19-gpio-bank {
		gpio-controller;
		#gpio-cells = <2>;
		interrupt-controller;
		#interrupt-cells = <2>;
	};

	/* USI_PERIC0_UART_DBG */
	uart0_bus: uart0-bus-pins {
		samsung,pins = "gpp1-2", "gpp1-3";
		samsung,pin-function = <GS101_PIN_FUNC_2>;
		samsung,pin-pud = <GS101_PIN_PULL_NONE>;
	};

	disp_te_pri_on: disp-te-pri-on-pins {
		samsung,pins = "gpp0-3";
		samsung,pin-function = <GS101_PIN_FUNC_EINT>;
	};

	disp_te_pri_off: disp-te-pri-off-pins {
		samsung,pins = "gpp0-3";
		samsung,pin-function = <GS101_PIN_FUNC_INPUT>;
	};

	disp_te_sec_on: disp-te-sec-on-pins {
		samsung,pins = "gpp0-4";
		samsung,pin-function = <GS101_PIN_FUNC_EINT>;
	};

	disp_te_sec_off: disp-te-sec-off-pins {
		samsung,pins = "gpp0-4";
		samsung,pin-function = <GS101_PIN_FUNC_INPUT>;
	};

	sensor_mclk1_out: sensor-mclk1-out-pins {
		samsung,pins = "gpp3-0";
		samsung,pin-function = <GS101_PIN_FUNC_OUTPUT>;
		samsung,pin-pud = <GS101_PIN_PULL_DOWN>;
		samsung,pin-drv = <GS101_PIN_DRV_5_MA>;
	};

	sensor_mclk1_fn: sensor-mclk1-fn-pins {
		samsung,pins = "gpp3-0";
		samsung,pin-function = <GS101_PIN_FUNC_2>;
		samsung,pin-pud = <GS101_PIN_PULL_NONE>;
		samsung,pin-drv = <GS101_PIN_DRV_5_MA>;
	};

	sensor_mclk2_out: sensor-mclk2-out-pins {
		samsung,pins = "gpp5-0";
		samsung,pin-function = <GS101_PIN_FUNC_OUTPUT>;
		samsung,pin-pud = <GS101_PIN_PULL_DOWN>;
		samsung,pin-drv = <GS101_PIN_DRV_5_MA>;
	};

	sensor_mclk2_fn: sensor-mclk2-fn-pins {
		samsung,pins = "gpp5-0";
		samsung,pin-function = <GS101_PIN_FUNC_2>;
		samsung,pin-pud = <GS101_PIN_PULL_NONE>;
		samsung,pin-drv = <GS101_PIN_DRV_5_MA>;
	};

	sensor_mclk3_out: sensor-mclk3-out-pins {
		samsung,pins = "gpp7-0";
		samsung,pin-function = <GS101_PIN_FUNC_OUTPUT>;
		samsung,pin-pud = <GS101_PIN_PULL_DOWN>;
		samsung,pin-drv = <GS101_PIN_DRV_5_MA>;
	};

	sensor_mclk3_fn: sensor-mclk3-fn-pins {
		samsung,pins = "gpp7-0";
		samsung,pin-function = <GS101_PIN_FUNC_2>;
		samsung,pin-pud = <GS101_PIN_PULL_NONE>;
		samsung,pin-drv = <GS101_PIN_DRV_5_MA>;
	};

	sensor_mclk4_out: sensor-mclk4-out-pins {
		samsung,pins = "gpp9-0";
		samsung,pin-function = <GS101_PIN_FUNC_OUTPUT>;
		samsung,pin-pud = <GS101_PIN_PULL_DOWN>;
		samsung,pin-drv = <GS101_PIN_DRV_5_MA>;
	};

	sensor_mclk4_fn: sensor-mclk4-fn-pins {
		samsung,pins = "gpp9-0";
		samsung,pin-function = <GS101_PIN_FUNC_2>;
		samsung,pin-pud = <GS101_PIN_PULL_NONE>;
		samsung,pin-drv = <GS101_PIN_DRV_5_MA>;
	};

	sensor_mclk5_out: sensor-mclk5-out-pins {
		samsung,pins = "gpp11-0";
		samsung,pin-function = <GS101_PIN_FUNC_OUTPUT>;
		samsung,pin-pud = <GS101_PIN_PULL_DOWN>;
		samsung,pin-drv = <GS101_PIN_DRV_5_MA>;
	};

	sensor_mclk5_fn: sensor-mclk5-fn-pins {
		samsung,pins = "gpp11-0";
		samsung,pin-function = <GS101_PIN_FUNC_2>;
		samsung,pin-pud = <GS101_PIN_PULL_NONE>;
		samsung,pin-drv = <GS101_PIN_DRV_5_MA>;
	};

	sensor_mclk6_out: sensor-mclk6-out-pins {
		samsung,pins = "gpp13-0";
		samsung,pin-function = <GS101_PIN_FUNC_OUTPUT>;
		samsung,pin-pud = <GS101_PIN_PULL_DOWN>;
		samsung,pin-drv = <GS101_PIN_DRV_5_MA>;
	};

	sensor_mclk6_fn: sensor-mclk6-fn-pins {
		samsung,pins = "gpp13-0";
		samsung,pin-function = <GS101_PIN_FUNC_2>;
		samsung,pin-pud = <GS101_PIN_PULL_NONE>;
		samsung,pin-drv = <GS101_PIN_DRV_5_MA>;
	};

	sensor_mclk7_out: sensor-mclk7-out-pins {
		samsung,pins = "gpp15-0";
		samsung,pin-function = <GS101_PIN_FUNC_OUTPUT>;
		samsung,pin-pud = <GS101_PIN_PULL_DOWN>;
		samsung,pin-drv = <GS101_PIN_DRV_5_MA>;
	};

	sensor_mclk7_fn: sensor-mclk7-fn-pins {
		samsung,pins = "gpp15-0";
		samsung,pin-function = <GS101_PIN_FUNC_2>;
		samsung,pin-pud = <GS101_PIN_PULL_NONE>;
		samsung,pin-drv = <GS101_PIN_DRV_5_MA>;
	};

	sensor_mclk8_out: sensor-mclk8-out-pins {
		samsung,pins = "gpp17-0";
		samsung,pin-function = <GS101_PIN_FUNC_OUTPUT>;
		samsung,pin-pud = <GS101_PIN_PULL_DOWN>;
		samsung,pin-drv = <GS101_PIN_DRV_5_MA>;
	};

	sensor_mclk8_fn: sensor-mclk8-fn-pins {
		samsung,pins = "gpp17-0";
		samsung,pin-function = <GS101_PIN_FUNC_2>;
		samsung,pin-pud = <GS101_PIN_PULL_NONE>;
		samsung,pin-drv = <GS101_PIN_DRV_5_MA>;
	};

	hsi2c14_bus: hsi2c14-bus-pins {
		samsung,pins = "gpp18-0", "gpp18-1";
		samsung,pin-function = <GS101_PIN_FUNC_2>;
		samsung,pin-pud = <GS101_PIN_PULL_NONE>;
		samsung,pin-drv = <GS101_PIN_DRV_2_5_MA>;
	};

	uart14_bus_single: uart14-bus-pins {
		samsung,pins = "gpp18-0", "gpp18-1",
			       "gpp18-2", "gpp18-3";
		samsung,pin-function = <GS101_PIN_FUNC_2>;
		samsung,pin-pud = <GS101_PIN_PULL_NONE>;
	};

	spi14_bus: spi14-bus-pins {
		samsung,pins = "gpp18-0", "gpp18-1", "gpp18-2";
		samsung,pin-function = <GS101_PIN_FUNC_2>;
		samsung,pin-pud = <GS101_PIN_PULL_NONE>;
		samsung,pin-drv = <GS101_PIN_DRV_2_5_MA>;
	};

	spi14_cs: spi14-cs-pins {
		samsung,pins = "gpp18-3";
		samsung,pin-function = <GS101_PIN_FUNC_OUTPUT>;
		samsung,pin-pud = <GS101_PIN_PULL_NONE>;
		samsung,pin-drv = <GS101_PIN_DRV_2_5_MA>;
	};

	spi14_cs_func: spi14-cs-func-pins {
		samsung,pins = "gpp18-3";
		samsung,pin-function = <GS101_PIN_FUNC_2>;
		samsung,pin-pud = <GS101_PIN_PULL_NONE>;
		samsung,pin-drv = <GS101_PIN_DRV_2_5_MA>;
	};

	hsi2c8_bus: hsi2c8-bus-pins {
		samsung,pins = "gpp16-0", "gpp16-1";
		samsung,pin-function = <GS101_PIN_FUNC_3>;
		samsung,pin-pud = <GS101_PIN_PULL_NONE>;
		samsung,pin-drv = <GS101_PIN_DRV_2_5_MA>;
		samsung,pin-pud-pdn = <GS101_PIN_PDN_OUT0>;
	};

	uart8_bus_single: uart8-bus-pins {
		samsung,pins = "gpp16-0", "gpp16-1", "gpp16-2",
			       "gpp16-3";
		samsung,pin-function = <GS101_PIN_FUNC_3>;
		samsung,pin-pud = <GS101_PIN_PULL_NONE>;
	};

	spi8_bus: spi8-bus-pins {
		samsung,pins = "gpp16-0", "gpp16-1", "gpp16-2";
		samsung,pin-function = <GS101_PIN_FUNC_3>;
		samsung,pin-pud = <GS101_PIN_PULL_NONE>;
		samsung,pin-drv = <GS101_PIN_DRV_2_5_MA>;
	};

	spi8_cs: spi8-cs-pins {
		samsung,pins = "gpp16-3";
		samsung,pin-function = <GS101_PIN_FUNC_OUTPUT>;
		samsung,pin-pud = <GS101_PIN_PULL_NONE>;
		samsung,pin-drv = <GS101_PIN_DRV_2_5_MA>;
	};

	spi8_cs_func: spi8-cs-func-pins {
		samsung,pins = "gpp16-3";
		samsung,pin-function = <GS101_PIN_FUNC_3>;
		samsung,pin-pud = <GS101_PIN_PULL_NONE>;
		samsung,pin-drv = <GS101_PIN_DRV_2_5_MA>;
	};

	hsi2c7_bus: hsi2c7-bus-pins {
		samsung,pins = "gpp14-0", "gpp14-1";
		samsung,pin-function = <GS101_PIN_FUNC_3>;
		samsung,pin-pud = <GS101_PIN_PULL_NONE>;
		samsung,pin-drv = <GS101_PIN_DRV_2_5_MA>;
	};

	uart7_bus_single: uart7-bus-pins {
		samsung,pins = "gpp14-0", "gpp14-1",
			       "gpp14-2", "gpp14-3";
		samsung,pin-function = <GS101_PIN_FUNC_3>;
		samsung,pin-pud = <GS101_PIN_PULL_NONE>;
	};

	spi7_bus: spi7-bus-pins {
		samsung,pins = "gpp14-0", "gpp14-1", "gpp14-2";
		samsung,pin-function = <GS101_PIN_FUNC_3>;
		samsung,pin-pud = <GS101_PIN_PULL_NONE>;
		samsung,pin-drv = <GS101_PIN_DRV_2_5_MA>;
	};

	spi7_cs: spi7-cs-pins {
		samsung,pins = "gpp14-3";
		samsung,pin-function = <GS101_PIN_FUNC_OUTPUT>;
		samsung,pin-pud = <GS101_PIN_PULL_NONE>;
		samsung,pin-drv = <GS101_PIN_DRV_2_5_MA>;
	};

	spi7_cs_func: spi7-cs-func-pins {
		samsung,pins = "gpp14-3";
		samsung,pin-function = <GS101_PIN_FUNC_3>;
		samsung,pin-pud = <GS101_PIN_PULL_NONE>;
		samsung,pin-drv = <GS101_PIN_DRV_2_5_MA>;
	};

	hsi2c6_bus: hsi2c6-bus-pins {
		samsung,pins = "gpp12-0", "gpp12-1";
		samsung,pin-function = <GS101_PIN_FUNC_3>;
		samsung,pin-pud = <GS101_PIN_PULL_NONE>;
		samsung,pin-drv = <GS101_PIN_DRV_2_5_MA>;
	};

	uart6_bus_single: uart6-bus-pins {
		samsung,pins = "gpp12-0", "gpp12-1",
			       "gpp12-2", "gpp12-3";
		samsung,pin-function = <GS101_PIN_FUNC_3>;
		samsung,pin-pud = <GS101_PIN_PULL_NONE>;
	};

	spi6_bus: spi6-bus-pins {
		samsung,pins = "gpp12-0", "gpp12-1", "gpp12-2";
		samsung,pin-function = <GS101_PIN_FUNC_3>;
		samsung,pin-pud = <GS101_PIN_PULL_NONE>;
		samsung,pin-drv = <GS101_PIN_DRV_2_5_MA>;
	};

	spi6_cs: spi6-cs-pins {
		samsung,pins = "gpp12-3";
		samsung,pin-function = <GS101_PIN_FUNC_OUTPUT>;
		samsung,pin-pud = <GS101_PIN_PULL_NONE>;
		samsung,pin-drv = <GS101_PIN_DRV_2_5_MA>;
	};

	spi6_cs_func: spi6-cs-func-pins {
		samsung,pins = "gpp12-3";
		samsung,pin-function = <GS101_PIN_FUNC_3>;
		samsung,pin-pud = <GS101_PIN_PULL_NONE>;
		samsung,pin-drv = <GS101_PIN_DRV_2_5_MA>;
	};

	hsi2c5_bus: hsi2c5-bus-pins {
		samsung,pins = "gpp10-0", "gpp10-1";
		samsung,pin-function = <GS101_PIN_FUNC_3>;
		samsung,pin-pud = <GS101_PIN_PULL_NONE>;
		samsung,pin-drv = <GS101_PIN_DRV_2_5_MA>;
	};

	uart5_bus_single: uart5-bus-pins {
		samsung,pins = "gpp10-0", "gpp10-1",
			       "gpp10-2", "gpp10-3";
		samsung,pin-function = <GS101_PIN_FUNC_3>;
		samsung,pin-pud = <GS101_PIN_PULL_NONE>;
	};

	spi5_bus: spi5-bus-pins {
		samsung,pins = "gpp10-0", "gpp10-1", "gpp10-2";
		samsung,pin-drv = <GS101_PIN_DRV_2_5_MA>;
		samsung,pin-function = <GS101_PIN_FUNC_3>;
		samsung,pin-pud = <GS101_PIN_PULL_NONE>;
		samsung,pin-con-pdn = <GS101_PIN_PDN_PREV>;
		samsung,pin-pud-pdn = <GS101_PIN_PULL_NONE>;
	};

	spi5_cs_func: spi5-cs-func-pins {
		samsung,pins = "gpp10-3";
		samsung,pin-drv = <GS101_PIN_DRV_2_5_MA>;
		samsung,pin-function = <GS101_PIN_FUNC_3>;
		samsung,pin-pud = <GS101_PIN_PULL_NONE>;
		samsung,pin-con-pdn = <GS101_PIN_PDN_PREV>;
		samsung,pin-pud-pdn = <GS101_PIN_PULL_NONE>;
	};

	hsi2c4_bus: hsi2c4-bus-pins {
		samsung,pins = "gpp8-0", "gpp8-1";
		samsung,pin-function = <GS101_PIN_FUNC_3>;
		samsung,pin-pud = <GS101_PIN_PULL_NONE>;
		samsung,pin-drv = <GS101_PIN_DRV_2_5_MA>;
	};

	uart4_bus_single: uart4-bus-pins {
		samsung,pins = "gpp8-0", "gpp8-1",
			       "gpp8-2", "gpp8-3";
		samsung,pin-function = <GS101_PIN_FUNC_3>;
		samsung,pin-pud = <GS101_PIN_PULL_NONE>;
	};

	spi4_bus: spi4-bus-pins {
		samsung,pins = "gpp8-0", "gpp8-1", "gpp8-2";
		samsung,pin-function = <GS101_PIN_FUNC_3>;
		samsung,pin-pud = <GS101_PIN_PULL_NONE>;
		samsung,pin-drv = <GS101_PIN_DRV_2_5_MA>;
	};

	spi4_cs: spi4-cs-pins {
		samsung,pins = "gpp8-3";
		samsung,pin-function = <GS101_PIN_FUNC_OUTPUT>;
		samsung,pin-pud = <GS101_PIN_PULL_NONE>;
		samsung,pin-drv = <GS101_PIN_DRV_2_5_MA>;
	};

	spi4_cs_func: spi4-cs-func-pins {
		samsung,pins = "gpp8-3";
		samsung,pin-function = <GS101_PIN_FUNC_3>;
		samsung,pin-pud = <GS101_PIN_PULL_NONE>;
		samsung,pin-drv = <GS101_PIN_DRV_2_5_MA>;
	};

	hsi2c3_bus: hsi2c3-bus-pins {
		samsung,pins = "gpp6-0", "gpp6-1";
		samsung,pin-function = <GS101_PIN_FUNC_3>;
		samsung,pin-pud = <GS101_PIN_PULL_NONE>;
		samsung,pin-drv = <GS101_PIN_DRV_2_5_MA>;
	};

	uart3_bus_single: uart3-bus-pins {
		samsung,pins = "gpp6-0", "gpp6-1",
			       "gpp6-2", "gpp6-3";
		samsung,pin-function = <GS101_PIN_FUNC_3>;
		samsung,pin-pud = <GS101_PIN_PULL_NONE>;
	};

	spi3_bus: spi3-bus-pins {
		samsung,pins = "gpp6-0", "gpp6-1", "gpp6-2";
		samsung,pin-function = <GS101_PIN_FUNC_3>;
		samsung,pin-pud = <GS101_PIN_PULL_NONE>;
		samsung,pin-drv = <GS101_PIN_DRV_2_5_MA>;
	};

	spi3_cs: spi3-cs-pins {
		samsung,pins = "gpp6-3";
		samsung,pin-function = <GS101_PIN_FUNC_OUTPUT>;
		samsung,pin-pud = <GS101_PIN_PULL_NONE>;
		samsung,pin-drv = <GS101_PIN_DRV_2_5_MA>;
	};

	spi3_cs_func: spi3-cs-func-pins {
		samsung,pins = "gpp6-3";
		samsung,pin-function = <GS101_PIN_FUNC_3>;
		samsung,pin-pud = <GS101_PIN_PULL_NONE>;
		samsung,pin-drv = <GS101_PIN_DRV_2_5_MA>;
	};

	hsi2c2_bus: hsi2c2-bus-pins {
		samsung,pins = "gpp4-0", "gpp4-1";
		samsung,pin-function = <GS101_PIN_FUNC_3>;
		samsung,pin-pud = <GS101_PIN_PULL_NONE>;
		samsung,pin-drv = <GS101_PIN_DRV_2_5_MA>;
	};

	uart2_bus_single: uart2-bus-pins {
		samsung,pins = "gpp4-0", "gpp4-1",
			       "gpp4-2", "gpp4-3";
		samsung,pin-function = <GS101_PIN_FUNC_3>;
		samsung,pin-pud = <GS101_PIN_PULL_NONE>;
	};

	spi2_bus: spi2-bus-pins {
		samsung,pins = "gpp4-0", "gpp4-1", "gpp4-2";
		samsung,pin-function = <GS101_PIN_FUNC_3>;
		samsung,pin-pud = <GS101_PIN_PULL_NONE>;
		samsung,pin-drv = <GS101_PIN_DRV_2_5_MA>;
	};

	spi2_cs: spi2-cs-pins {
		samsung,pins = "gpp4-3";
		samsung,pin-function = <GS101_PIN_FUNC_OUTPUT>;
		samsung,pin-pud = <GS101_PIN_PULL_NONE>;
		samsung,pin-drv = <GS101_PIN_DRV_2_5_MA>;
	};

	spi2_cs_func: spi2-cs-func-pins {
		samsung,pins = "gpp4-3";
		samsung,pin-function = <GS101_PIN_FUNC_3>;
		samsung,pin-pud = <GS101_PIN_PULL_NONE>;
		samsung,pin-drv = <GS101_PIN_DRV_2_5_MA>;
	};

	hsi2c1_bus: hsi2c1-bus-pins {
		samsung,pins = "gpp2-0", "gpp2-1";
		samsung,pin-function = <GS101_PIN_FUNC_3>;
		samsung,pin-pud = <GS101_PIN_PULL_NONE>;
		samsung,pin-drv = <GS101_PIN_DRV_2_5_MA>;
	};

	uart1_bus_single: uart1-bus-pins {
		samsung,pins = "gpp2-0", "gpp2-1",
			       "gpp2-2", "gpp2-3";
		samsung,pin-function = <GS101_PIN_FUNC_3>;
		samsung,pin-pud = <GS101_PIN_PULL_NONE>;
	};

	spi1_bus: spi1-bus-pins {
		samsung,pins = "gpp2-0", "gpp2-1", "gpp2-2";
		samsung,pin-function = <GS101_PIN_FUNC_3>;
		samsung,pin-pud = <GS101_PIN_PULL_NONE>;
		samsung,pin-drv = <GS101_PIN_DRV_2_5_MA>;
	};

	spi1_cs: spi1-cs-pins {
		samsung,pins = "gpp2-3";
		samsung,pin-function = <GS101_PIN_FUNC_OUTPUT>;
		samsung,pin-pud = <GS101_PIN_PULL_NONE>;
		samsung,pin-drv = <GS101_PIN_DRV_2_5_MA>;
	};

	spi1_cs_func: spi1-cs-func-pins {
		samsung,pins = "gpp2-3";
		samsung,pin-function = <GS101_PIN_FUNC_3>;
		samsung,pin-pud = <GS101_PIN_PULL_NONE>;
		samsung,pin-drv = <GS101_PIN_DRV_2_5_MA>;
	};
};

&pinctrl_peric1 {
	gpp20: gpp20-gpio-bank {
		gpio-controller;
		#gpio-cells = <2>;
		interrupt-controller;
		#interrupt-cells = <2>;
	};

	gpp21: gpp21-gpio-bank {
		gpio-controller;
		#gpio-cells = <2>;
		interrupt-controller;
		#interrupt-cells = <2>;
	};

	gpp22: gpp22-gpio-bank {
		gpio-controller;
		#gpio-cells = <2>;
		interrupt-controller;
		#interrupt-cells = <2>;
	};

	gpp23: gpp23-gpio-bank {
		gpio-controller;
		#gpio-cells = <2>;
		interrupt-controller;
		#interrupt-cells = <2>;
	};

	gpp24: gpp24-gpio-bank {
		gpio-controller;
		#gpio-cells = <2>;
		interrupt-controller;
		#interrupt-cells = <2>;
	};

	gpp25: gpp25-gpio-bank {
		gpio-controller;
		#gpio-cells = <2>;
		interrupt-controller;
		#interrupt-cells = <2>;
	};

	gpp26: gpp26-gpio-bank {
		gpio-controller;
		#gpio-cells = <2>;
		interrupt-controller;
		#interrupt-cells = <2>;
	};

	gpp27: gpp27-gpio-bank {
		gpio-controller;
		#gpio-cells = <2>;
		interrupt-controller;
		#interrupt-cells = <2>;
	};

	hsi2c13_bus: hsi2c13-bus-pins  {
		samsung,pins = "gpp25-0", "gpp25-1";
		samsung,pin-function = <GS101_PIN_FUNC_2>;
		samsung,pin-pud = <GS101_PIN_PULL_NONE>;
		samsung,pin-drv = <GS101_PIN_DRV_2_5_MA>;
	};

	uart13_bus_single: uart13-bus-pins {
		samsung,pins = "gpp25-0", "gpp25-1",
			       "gpp25-2", "gpp25-3";
		samsung,pin-function = <GS101_PIN_FUNC_2>;
		samsung,pin-pud = <GS101_PIN_PULL_NONE>;
	};

	spi13_bus: spi13-bus-pins {
		samsung,pins = "gpp25-0", "gpp25-1", "gpp25-2";
		samsung,pin-function = <GS101_PIN_FUNC_2>;
		samsung,pin-pud = <GS101_PIN_PULL_NONE>;
		samsung,pin-drv = <GS101_PIN_DRV_2_5_MA>;
	};

	spi13_cs: spi13-cs-pins {
		samsung,pins = "gpp25-3";
		samsung,pin-function = <GS101_PIN_FUNC_OUTPUT>;
		samsung,pin-pud = <GS101_PIN_PULL_NONE>;
		samsung,pin-drv = <GS101_PIN_DRV_2_5_MA>;
	};

	spi13_cs_func: spi13-cs-func-pins {
		samsung,pins = "gpp25-3";
		samsung,pin-function = <GS101_PIN_FUNC_2>;
		samsung,pin-pud = <GS101_PIN_PULL_NONE>;
		samsung,pin-drv = <GS101_PIN_DRV_2_5_MA>;
	};

	hsi2c12_bus: hsi2c12-bus-pins {
		samsung,pins = "gpp23-4", "gpp23-5";
		samsung,pin-function = <GS101_PIN_FUNC_2>;
		samsung,pin-pud = <GS101_PIN_PULL_NONE>;
		samsung,pin-drv = <GS101_PIN_DRV_2_5_MA>;
	};

	uart12_bus_single: uart12-bus-pins {
		samsung,pins = "gpp23-4", "gpp23-5",
			       "gpp23-6", "gpp23-7";
		samsung,pin-function = <GS101_PIN_FUNC_2>;
		samsung,pin-pud = <GS101_PIN_PULL_NONE>;
	};

	spi12_bus: spi12-bus-pins {
		samsung,pins = "gpp23-4", "gpp23-5", "gpp23-6";
		samsung,pin-function = <GS101_PIN_FUNC_2>;
		samsung,pin-pud = <GS101_PIN_PULL_NONE>;
		samsung,pin-drv = <GS101_PIN_DRV_2_5_MA>;
	};

	spi14_cs2: spi14-cs2-pins {
		samsung,pins = "gpp23-6";
		samsung,pin-function = <GS101_PIN_FUNC_OUTPUT>;
		samsung,pin-pud = <GS101_PIN_PULL_NONE>;
		samsung,pin-drv = <GS101_PIN_DRV_2_5_MA>;
	};

	spi12_cs: spi12-cs-pins {
		samsung,pins = "gpp23-7";
		samsung,pin-function = <GS101_PIN_FUNC_OUTPUT>;
		samsung,pin-pud = <GS101_PIN_PULL_NONE>;
		samsung,pin-drv = <GS101_PIN_DRV_2_5_MA>;
	};

	spi12_cs_func: spi12-cs-func-pins {
		samsung,pins = "gpp23-7";
		samsung,pin-function = <GS101_PIN_FUNC_2>;
		samsung,pin-pud = <GS101_PIN_PULL_NONE>;
		samsung,pin-drv = <GS101_PIN_DRV_2_5_MA>;
	};

	hsi2c11_bus: hsi2c11-bus-pins {
		samsung,pins = "gpp23-0", "gpp23-1";
		samsung,pin-function = <GS101_PIN_FUNC_2>;
		samsung,pin-pud = <GS101_PIN_PULL_NONE>;
		samsung,pin-drv = <GS101_PIN_DRV_2_5_MA>;
	};

	uart11_bus_single: uart11-bus-pins {
		samsung,pins = "gpp23-0", "gpp23-1",
			       "gpp23-2", "gpp23-3";
		samsung,pin-function = <GS101_PIN_FUNC_2>;
		samsung,pin-pud = <GS101_PIN_PULL_NONE>;
	};

	spi11_bus: spi11-bus-pins {
		samsung,pins = "gpp23-0", "gpp23-1", "gpp23-2";
		samsung,pin-function = <GS101_PIN_FUNC_2>;
		samsung,pin-pud = <GS101_PIN_PULL_NONE>;
		samsung,pin-drv = <GS101_PIN_DRV_2_5_MA>;
	};

	spi11_cs: spi11-cs-pins {
		samsung,pins = "gpp23-3";
		samsung,pin-function = <GS101_PIN_FUNC_OUTPUT>;
		samsung,pin-pud = <GS101_PIN_PULL_NONE>;
		samsung,pin-drv = <GS101_PIN_DRV_2_5_MA>;
	};

	spi11_cs_func: spi11-cs-func-pins {
		samsung,pins = "gpp23-3";
		samsung,pin-function = <GS101_PIN_FUNC_2>;
		samsung,pin-pud = <GS101_PIN_PULL_NONE>;
		samsung,pin-drv = <GS101_PIN_DRV_2_5_MA>;
	};

	hsi2c10_bus: hsi2c10-bus-pins {
		samsung,pins = "gpp21-0", "gpp21-1";
		samsung,pin-function = <GS101_PIN_FUNC_2>;
		samsung,pin-pud = <GS101_PIN_PULL_NONE>;
		samsung,pin-drv = <GS101_PIN_DRV_2_5_MA>;
	};

	uart10_bus_single: uart10-bus-pins {
		samsung,pins = "gpp21-0", "gpp21-1",
			       "gpp21-2", "gpp21-3";
		samsung,pin-function = <GS101_PIN_FUNC_2>;
		samsung,pin-pud = <GS101_PIN_PULL_NONE>;
	};

	spi10_bus: spi10-bus-pins {
		samsung,pins = "gpp21-0", "gpp21-1", "gpp21-2";
		samsung,pin-function = <GS101_PIN_FUNC_2>;
		samsung,pin-pud = <GS101_PIN_PULL_NONE>;
		samsung,pin-drv = <GS101_PIN_DRV_2_5_MA>;
	};

	spi10_cs: spi10-cs-pins {
		samsung,pins = "gpp21-3";
		samsung,pin-function = <GS101_PIN_FUNC_OUTPUT>;
		samsung,pin-pud = <GS101_PIN_PULL_NONE>;
		samsung,pin-drv = <GS101_PIN_DRV_2_5_MA>;
	};

	spi10_cs_func: spi10-cs-func-pins {
		samsung,pins = "gpp21-3";
		samsung,pin-function = <GS101_PIN_FUNC_2>;
		samsung,pin-pud = <GS101_PIN_PULL_NONE>;
		samsung,pin-drv = <GS101_PIN_DRV_2_5_MA>;
	};

	hsi2c9_bus: hsi2c9-bus-pins {
		samsung,pins = "gpp20-4", "gpp20-5";
		samsung,pin-function = <GS101_PIN_FUNC_2>;
		samsung,pin-pud = <GS101_PIN_PULL_NONE>;
		samsung,pin-drv = <GS101_PIN_DRV_2_5_MA>;
	};

	uart9_bus_single: uart9-bus-pins {
		samsung,pins = "gpp20-4", "gpp20-5",
			       "gpp20-6", "gpp20-7";
		samsung,pin-function = <GS101_PIN_FUNC_2>;
		samsung,pin-pud = <GS101_PIN_PULL_NONE>;
	};

	spi9_bus: spi9-bus-pins {
		samsung,pins = "gpp20-4", "gpp20-5", "gpp20-6";
		samsung,pin-function = <GS101_PIN_FUNC_2>;
		samsung,pin-pud = <GS101_PIN_PULL_NONE>;
		samsung,pin-drv = <GS101_PIN_DRV_2_5_MA>;
	};

	spi9_cs: spi9-cs-pins {
		samsung,pins = "gpp20-7";
		samsung,pin-function = <GS101_PIN_FUNC_OUTPUT>;
		samsung,pin-pud = <GS101_PIN_PULL_NONE>;
		samsung,pin-drv = <GS101_PIN_DRV_2_5_MA>;
	};

	spi9_cs_func: spi9-cs-func-pins {
		samsung,pins = "gpp20-7";
		samsung,pin-function = <GS101_PIN_FUNC_2>;
		samsung,pin-pud = <GS101_PIN_PULL_NONE>;
		samsung,pin-drv = <GS101_PIN_DRV_2_5_MA>;
	};

	hsi2c0_bus: hsi2c0-bus-pins {
		samsung,pins = "gpp20-0", "gpp20-1";
		samsung,pin-function = <GS101_PIN_FUNC_3>;
		samsung,pin-pud = <GS101_PIN_PULL_NONE>;
		samsung,pin-drv = <GS101_PIN_DRV_2_5_MA>;
	};

	uart0_bus_single: uart0-bus-pins {
		samsung,pins = "gpp20-0", "gpp20-1",
			       "gpp20-2", "gpp20-3";
		samsung,pin-function = <GS101_PIN_FUNC_3>;
		samsung,pin-pud = <GS101_PIN_PULL_NONE>;
	};

	spi0_bus: spi0-bus-pins {
		samsung,pins = "gpp20-0", "gpp20-1", "gpp20-2";
		samsung,pin-function = <GS101_PIN_FUNC_3>;
		samsung,pin-pud = <GS101_PIN_PULL_NONE>;
		samsung,pin-drv = <GS101_PIN_DRV_2_5_MA>;
	};

	spi0_cs: spi0-cs-pins {
		samsung,pins = "gpp20-3";
		samsung,pin-function = <GS101_PIN_FUNC_OUTPUT>;
		samsung,pin-pud = <GS101_PIN_PULL_NONE>;
		samsung,pin-drv = <GS101_PIN_DRV_2_5_MA>;
	};

	spi0_cs_func: spi0-cs-func-pins {
		samsung,pins = "gpp20-3";
		samsung,pin-function = <GS101_PIN_FUNC_3>;
		samsung,pin-pud = <GS101_PIN_PULL_NONE>;
		samsung,pin-drv = <GS101_PIN_DRV_2_5_MA>;
	};
};
