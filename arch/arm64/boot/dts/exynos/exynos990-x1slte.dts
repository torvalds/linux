// SPDX-License-Identifier: GPL-2.0 OR BSD-3-Clause
/*
 * Samsung Galaxy S20 (x1slte/SM-G980F) device tree source
 *
 * Copyright (c) 2024, Umer Uddin <umer.uddin@mentallysanemainliners.org>
 */

/dts-v1/;
#include "exynos990-x1s-common.dtsi"

/ {
	#address-cells = <2>;
	#size-cells = <2>;

	model = "Samsung Galaxy S20";
	compatible = "samsung,x1slte", "samsung,exynos990";

	memory@80000000 {
		device_type = "memory";
		reg = <0x0 0x80000000 0x0 0x3ab00000>,
		      /* Memory hole */
		      <0x0 0xc1200000 0x0 0x1ee00000>,
		      /* Memory hole */
		      <0x0 0xe1900000 0x0 0x1e700000>,
		      /* Memory hole */
		      <0x8 0x80000000 0x1 0x7ec00000>;
	};
};
