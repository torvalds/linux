// SPDX-License-Identifier: (GPL-2.0-only OR BSD-2-Clause)
/*
 * Device Tree Source for the RZ/G2UL Type-1 SMARC EVK board
 *
 * Copyright (C) 2022 Renesas Electronics Corp.
 */

/dts-v1/;

/*
 * DIP-Switch SW1 setting
 * 1 : High; 0: Low
 * SW1-2 : SW_SD0_DEV_SEL	(0: uSD; 1: eMMC)
 * SW1-3 : SW_ET0_EN_N		(0: ETHER0; 1: CAN0, CAN1, SSI1, RSPI1)
 * Please change below macros according to SW1 setting on the SoM
 */
#define SW_SW0_DEV_SEL	1
#define SW_ET0_EN_N	1

/*
 * To enable MTU3a PWM on PMOD0,
 *  - Set DIP-Switch SW1-3 to On position.
 *  - Set PMOD_MTU3 macro to 1.
 */
#define PMOD_MTU3	0

#if (PMOD_MTU3 && !SW_ET0_EN_N)
#error "Cannot set as both PMOD_MTU3 and !SW_ET0_EN_N are mutually exclusive"
#endif

#include "r9a07g043u.dtsi"
#include "rzg2ul-smarc-som.dtsi"
#include "rzg2ul-smarc.dtsi"

/ {
	model = "Renesas SMARC EVK based on r9a07g043u11";
	compatible = "renesas,smarc-evk", "renesas,r9a07g043u11", "renesas,r9a07g043";
};
