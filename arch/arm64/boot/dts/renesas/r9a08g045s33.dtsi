// SPDX-License-Identifier: (GPL-2.0-only OR BSD-2-Clause)
/*
 * Device Tree Source for the RZ/G3S R9A08G045S33 SoC specific part
 *
 * Copyright (C) 2023 Renesas Electronics Corp.
 */

/dts-v1/;

#include "r9a08g045.dtsi"

/ {
	compatible = "renesas,r9a08g045s33", "renesas,r9a08g045";
};
