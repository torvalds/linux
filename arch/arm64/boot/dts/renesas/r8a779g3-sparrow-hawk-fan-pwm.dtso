// SPDX-License-Identifier: (GPL-2.0-only OR BSD-2-Clause)
/*
 * Device Tree Overlay for the PWM controlled blower fan on connector J3:FAN
 * on R-Car V4H ES3.0 Sparrow Hawk board
 *
 * Copyright (C) 2025 Marek Vasut <marek.vasut+renesas@mailbox.org>
 *
 * Example usage:
 *
 * # Localize hwmon sysfs directory that matches the PWM fan,
 * # enable the PWM fan, and configure the fan speed manually.
 * r8a779g3-sparrow-hawk$ ls -1 /sys/devices/platform/pwm-fan/hwmon/hwmon?/pwm?_enable
 * /sys/devices/platform/pwm-fan/hwmon/hwmon4/pwm1_enable
 *
 * # Select mode 2 , enable fan PWM and regulator and keep them enabled.
 * # For details, see Linux Documentation/hwmon/pwm-fan.rst
 * r8a779g3-sparrow-hawk$ echo 2 > /sys/devices/platform/pwm-fan/hwmon/hwmon4/pwm1_enable
 *
 * # Configure PWM fan speed in range 0..255 , 0 is stopped , 255 is full speed .
 * # Fan speed 101 is about 2/5 of the PWM fan speed:
 * r8a779g3-sparrow-hawk$ echo 101 > /sys/devices/platform/pwm-fan/hwmon/hwmon4/pwm1
 */

/dts-v1/;
/plugin/;

/*
 * Override default PWM fan settings. For a list of available properties,
 * see schema Documentation/devicetree/bindings/hwmon/pwm-fan.yaml .
 */
&fan {
	/* Available cooling levels */
	cooling-levels = <0 50 100 150 200 255>;
	/* Four pulses of tacho signal per one revolution */
	pulses-per-revolution = <4>;
	/* PWM period: 100us ~= 10 kHz */
	pwms = <&pwm0 0 100000>;
};
