// SPDX-License-Identifier: GPL-2.0
/*
 * Device Tree Source for the Condor board with R-Car V3H
 *
 * Copyright (C) 2018 Renesas Electronics Corp.
 * Copyright (C) 2018 Cogent Embedded, Inc.
 */

/dts-v1/;
#include "r8a77980.dtsi"
#include "condor-common.dtsi"

/ {
	model = "Renesas Condor board based on r8a77980";
	compatible = "renesas,condor", "renesas,r8a77980";
};
