// SPDX-License-Identifier: GPL-2.0
/*
 * Device Tree Source for the M3ULCB Kingfisher board
 *
 * Copyright (C) 2020 Eugeniu Rosca <rosca.eugeniu@gmail.com>
 */

#include "r8a77961-ulcb.dts"
#include "ulcb-kf.dtsi"

/ {
	model = "Renesas M3ULCB Kingfisher board based on r8a77961";
	compatible = "shimafuji,kingfisher", "renesas,m3ulcb",
		     "renesas,r8a77961";
};
