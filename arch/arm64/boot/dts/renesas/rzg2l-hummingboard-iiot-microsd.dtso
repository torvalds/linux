// SPDX-License-Identifier: (GPL-2.0-only OR BSD-2-Clause)
/*
 * Device Tree Overlay for the RZ/G2L(C) Solidrun SOM SD
 *
 * Copyright (C) 2024 SolidRun Ltd.
 */

/dts-v1/;
/plugin/;

#include <dt-bindings/gpio/gpio.h>
#include <dt-bindings/pinctrl/rzg2l-pinctrl.h>

&sdhi0 {
	bus-width = <4>;
	full-pwr-cycle;
	mux-states = <&sdhi0_mux 1>;
	pinctrl-0 = <&sdhi0_4bit_pins>, <&sdhi0_cd_pins>;
	pinctrl-1 = <&sdhi0_4bit_uhs_pins>, <&sdhi0_cd_pins>;
	pinctrl-names = "default", "state_uhs";
	sd-uhs-sdr104;
	sd-uhs-sdr50;
	vmmc-supply = <&vmmc>;
	vqmmc-supply = <&reg_pmic_ldo1>;
	status = "okay";
};
