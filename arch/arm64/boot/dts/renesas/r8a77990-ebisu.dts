// SPDX-License-Identifier: GPL-2.0
/*
 * Device Tree Source for the Ebisu board with R-Car E3
 *
 * Copyright (C) 2018 Renesas Electronics Corp.
 */

/dts-v1/;
#include "r8a77990.dtsi"
#include "ebisu.dtsi"

/ {
	model = "Renesas Ebisu board based on r8a77990";
	compatible = "renesas,ebisu", "renesas,r8a77990";
};
