// SPDX-License-Identifier: GPL-2.0
/*
 * Device Tree Source for the M3NULCB Kingfisher board
 *
 * Copyright (C) 2018 Renesas Electronics Corp.
 * Copyright (C) 2018 Cogent Embedded, Inc.
 */

#include "r8a77965-ulcb.dts"
#include "ulcb-kf.dtsi"

/ {
	model = "Renesas M3NULCB Kingfisher board based on r8a77965";
	compatible = "shimafuji,kingfisher", "renesas,m3nulcb",
		     "renesas,r8a77965";
};
