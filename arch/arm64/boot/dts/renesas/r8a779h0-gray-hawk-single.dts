// SPDX-License-Identifier: (GPL-2.0-only OR BSD-2-Clause)
/*
 * Device Tree Source for the R-Car V4M Gray Hawk Single board
 *
 * Copyright (C) 2023 Renesas Electronics Corp.
 * Copyright (C) 2024 Glider bv
 */

/dts-v1/;

#include "r8a779h0.dtsi"
#include "gray-hawk-single.dtsi"

/ {
	model = "Renesas Gray Hawk Single board based on r8a779h0";
	compatible = "renesas,gray-hawk-single", "renesas,r8a779h0";
};
