// SPDX-License-Identifier: (GPL-2.0-only OR BSD-2-Clause)
/*
 * Device Tree Source for the RZ/G3E R9A09G047E37 SoC specific parts
 *
 * Copyright (C) 2024 Renesas Electronics Corp.
 */

/dts-v1/;
#include "r9a09g047.dtsi"

/ {
	compatible = "renesas,r9a09g047e37", "renesas,r9a09g047";

	cpus {
		/delete-node/ cpu@200;
		/delete-node/ cpu@300;
	};
};
