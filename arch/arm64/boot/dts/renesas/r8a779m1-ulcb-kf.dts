// SPDX-License-Identifier: (GPL-2.0 or MIT)
/*
 * Device Tree Source for the H3ULCB Kingfisher board with R-Car H3e-2G
 *
 * Copyright (C) 2021 Glider bv
 *
 * Based on r8a77951-ulcb-kf.dts
 * Copyright (C) 2017 Renesas Electronics Corp.
 * Copyright (C) 2017 Cogent Embedded, Inc.
 */

#include "r8a779m1-ulcb.dts"
#include "ulcb-kf.dtsi"

/ {
	model = "Renesas H3ULCB Kingfisher board based on r8a779m1";
	compatible = "shimafuji,kingfisher", "renesas,h3ulcb",
		     "renesas,r8a779m1", "renesas,r8a7795";
};
