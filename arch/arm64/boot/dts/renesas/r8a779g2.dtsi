// SPDX-License-Identifier: (GPL-2.0-only OR BSD-2-Clause)
/*
 * Device Tree Source for the R-Car V4H (R8A779G2) SoC
 *
 * Copyright (C) 2023 Glider bv
 */

#include "r8a779g0.dtsi"

/ {
	compatible = "renesas,r8a779g2", "renesas,r8a779g0";
};
