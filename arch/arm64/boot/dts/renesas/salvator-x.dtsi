// SPDX-License-Identifier: GPL-2.0
/*
 * Device Tree Source for the Salvator-X board
 *
 * Copyright (C) 2015-2016 Renesas Electronics Corp.
 */

#include "salvator-common.dtsi"

/ {
	model = "Renesas Salvator-X board";
	compatible = "renesas,salvator-x";
};

&extal_clk {
	clock-frequency = <16666666>;
};

&i2c4 {
	clock-frequency = <400000>;

	versaclock5: clock-generator@6a {
		compatible = "idt,5p49v5923";
		reg = <0x6a>;
		#clock-cells = <1>;
		clocks = <&x23_clk>;
		clock-names = "xin";
		idt,shutdown = <0>;
		idt,output-enable-active = <1>;
	};
};
