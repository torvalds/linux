// SPDX-License-Identifier: (GPL-2.0-only OR BSD-2-Clause)
/*
 * Device Tree Source for the RZ/G2L SMARC EVK board
 *
 * Copyright (C) 2021 Renesas Electronics Corp.
 */

/dts-v1/;
#include "r9a07g044l2.dtsi"
#include "rzg2l-smarc.dtsi"

/ {
	model = "Renesas SMARC EVK based on r9a07g044l2";
	compatible = "renesas,smarc-evk", "renesas,r9a07g044l2", "renesas,r9a07g044";

	memory@48000000 {
		device_type = "memory";
		/* first 128MB is reserved for secure area. */
		reg = <0x0 0x48000000 0x0 0x78000000>;
	};
};
