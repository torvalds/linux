// SPDX-License-Identifier: GPL-2.0
/*
 * Device Tree Source for the H3ULCB Kingfisher board
 *
 * Copyright (C) 2017 Renesas Electronics Corp.
 * Copyright (C) 2017 Cogent Embedded, Inc.
 */

#include "r8a7795-es1-h3ulcb.dts"
#include "ulcb-kf.dtsi"

/ {
	model = "Renesas H3ULCB Kingfisher board based on r8a7795 ES1.x";
	compatible = "shimafuji,kingfisher", "renesas,h3ulcb",
		     "renesas,r8a7795";
};
