// SPDX-License-Identifier: (GPL-2.0-only OR BSD-2-Clause)
/*
 * Device Tree Overlay for the RPi Display 2 7" MIPI DSI panel connected
 * to J4:DSI on R-Car V4H ES3.0 Sparrow Hawk board
 *
 * Copyright (C) 2025 Marek Vasut <marek.vasut+renesas@mailbox.org>
 */

#include "r8a779g3-sparrow-hawk-rpi-display-2.dtsi"

&panel {
	compatible = "raspberrypi,dsi-7inch", "ilitek,ili9881c";
};
