// SPDX-License-Identifier: (GPL-2.0 OR MIT)
/*
 * Device Tree Source for the M3ULCB Kingfisher board with R-Car M3e-2G
 *
 * Copyright (C) 2021 Glider bv
 *
 * Based on r8a77961-ulcb-kf.dts
 * Copyright (C) 2020 Eugeniu Rosca <rosca.eugeniu@gmail.com>
 */

#include "r8a779m3-ulcb.dts"
#include "ulcb-kf.dtsi"

/ {
	model = "Renesas M3ULCB Kingfisher board based on r8a779m3";
	compatible = "shimafuji,kingfisher", "renesas,m3ulcb",
		     "renesas,r8a779m3", "renesas,r8a77961";
};
