// SPDX-License-Identifier: (GPL-2.0-only OR BSD-2-Clause)
/*
 * Device Tree Source for the R-Car V4H ES3.0 White Hawk Single board
 *
 * Copyright (C) 2024 Glider bv
 */

/dts-v1/;
#include "r8a779g3.dtsi"
#include "white-hawk-single.dtsi"

/ {
	model = "Renesas White Hawk Single board based on r8a779g3";
	compatible = "renesas,white-hawk-single", "renesas,r8a779g3",
		     "renesas,r8a779g0";
};
