// SPDX-License-Identifier: (GPL-2.0-only OR BSD-2-Clause)
/*
 * Copyright 2025 Josua Mayer <josua@solid-run.com>
 *
 * Overlay for enabling HummingBoard IIoT on-board RS485 Port B on connector J5004.
 *
 * Because Renesas uart driver does not support rs485,
 * users must manually toggle P41_0 between RX & TX.
 */

/dts-v1/;
/plugin/;

&scif3_rs_232_485_mux {
	/* select rs485 */
	idle-state = <1>;
};
