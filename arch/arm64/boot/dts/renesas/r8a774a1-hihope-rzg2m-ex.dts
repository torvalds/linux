// SPDX-License-Identifier: GPL-2.0
/*
 * Device Tree Source for the HiHope RZ/G2M Rev.3.0/4.0 connected to
 * sub board
 *
 * Copyright (C) 2020 Renesas Electronics Corp.
 */

#include "r8a774a1-hihope-rzg2m.dts"
#include "hihope-rzg2-ex.dtsi"

/ {
	model = "HopeRun HiHope RZ/G2M with sub board";
	compatible = "hoperun,hihope-rzg2-ex", "hoperun,hihope-rzg2m",
		     "renesas,r8a774a1";
};

/* SW43 should be OFF, if in ON state SATA port will be activated */
&pciec1 {
	status = "okay";
};
