// SPDX-License-Identifier: (GPL-2.0-only OR BSD-2-Clause)
/*
 * Device Tree Source for the R-Car V4M-7 (R8A779H2) SoC
 *
 * Copyright (C) 2024 Renesas Electronics Corp.
 */

#include "r8a779h0.dtsi"

/ {
	compatible = "renesas,r8a779h2", "renesas,r8a779h0";
};
