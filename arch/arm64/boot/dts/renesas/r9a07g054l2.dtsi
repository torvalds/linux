// SPDX-License-Identifier: (GPL-2.0-only OR BSD-2-Clause)
/*
 * Device Tree Source for the RZ/V2L R9A07G054L2 SoC specific parts
 *
 * Copyright (C) 2021 Renesas Electronics Corp.
 */

/dts-v1/;
#include "r9a07g054.dtsi"

/ {
	compatible = "renesas,r9a07g054l2", "renesas,r9a07g054";
};
