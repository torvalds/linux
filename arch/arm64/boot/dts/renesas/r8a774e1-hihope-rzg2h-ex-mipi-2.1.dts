// SPDX-License-Identifier: GPL-2.0
/*
 * Device Tree Source for the HiHope RZ/G2H board
 * connected with aistarvision-mipi-v2-adapter board
 *
 * Copyright (C) 2020 Renesas Electronics Corp.
 */

/dts-v1/;
#include "r8a774e1-hihope-rzg2h-ex.dts"
#include "hihope-rzg2-ex-aistarvision-mipi-adapter-2.1.dtsi"

/ {
	model = "HopeRun HiHope RZ/G2H with sub board connected with aistarvision-mipi-v2-adapter board";
	compatible = "hoperun,hihope-rzg2h", "renesas,r8a774e1";
};
