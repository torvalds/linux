// SPDX-License-Identifier: (GPL-2.0 OR MIT)
/*
 * Device Tree Source for the R-Car M3Ne-2G (R8A779M5) SoC
 *
 * Copyright (C) 2021 Glider bv
 */

#include "r8a77965.dtsi"

/ {
	compatible = "renesas,r8a779m5", "renesas,r8a77965";
};

&cluster0_opp {
	opp-1800000000 {
		/delete-property/ turbo-mode;
	};
	opp-2000000000 {
		opp-hz = /bits/ 64 <2000000000>;
		opp-microvolt = <960000>;
		clock-latency-ns = <300000>;
		turbo-mode;
	};
};
