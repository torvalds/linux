// SPDX-License-Identifier: GPL-2.0
/*
 * Device Tree overlay for the RZ/G3E SMARC EVK with OV5645 camera
 * connected to CSI and CRU enabled.
 *
 * Copyright (C) 2025 Renesas Electronics Corp.
 */

/dts-v1/;
/plugin/;

#include <dt-bindings/gpio/gpio.h>
#include <dt-bindings/pinctrl/renesas,r9a09g047-pinctrl.h>

#define OV5645_PARENT_I2C i2c0
#include "rz-smarc-cru-csi-ov5645.dtsi"

&ov5645 {
	enable-gpios = <&pinctrl RZG3E_GPIO(D, 6) GPIO_ACTIVE_HIGH>;
	reset-gpios = <&pinctrl RZG3E_GPIO(D, 7) GPIO_ACTIVE_LOW>;
};
