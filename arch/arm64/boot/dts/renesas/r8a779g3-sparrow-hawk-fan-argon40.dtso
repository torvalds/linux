// SPDX-License-Identifier: (GPL-2.0-only OR BSD-2-Clause)
/*
 * Device Tree Overlay for the Argon40 HAT blower fan on connector CN7
 * on R-Car V4H ES3.0 Sparrow Hawk board
 *
 * Copyright (C) 2025 Marek Vasut <marek.vasut+renesas@mailbox.org>
 *
 * Example usage:
 *
 * # Localize hwmon sysfs directory that matches the PWM fan,
 * # enable the PWM fan, and configure the fan speed manually.
 * r8a779g3-sparrow-hawk$ ls -1 /sys/devices/platform/pwm-fan-ext/hwmon/hwmon?/pwm?_enable
 * /sys/devices/platform/pwm-fan-ext/hwmon/hwmon0/pwm1_enable
 *
 * # Select mode 2 , enable fan PWM and regulator and keep them enabled.
 * # For details, see Linux Documentation/hwmon/pwm-fan.rst
 * r8a779g3-sparrow-hawk$ echo 2 > /sys/devices/platform/pwm-fan-ext/hwmon/hwmon0/pwm1_enable
 *
 * # Configure PWM fan speed in range 0..255 , 0 is stopped , 255 is full speed .
 * # Fan speed 101 is about 2/5 of the PWM fan speed:
 * r8a779g3-sparrow-hawk$ echo 101 > /sys/devices/platform/pwm-fan-ext/hwmon/hwmon0/pwm1
 */

/dts-v1/;
/plugin/;

&{/} {
	pwm-fan-ext {
		compatible = "pwm-fan";
		#cooling-cells = <2>;
		/* PWM period: 33us ~= 30 kHz */
		pwms = <&pwmhat 0 33334 0>;
		/* Available cooling levels */
		cooling-levels = <0 50 100 150 200 255>;
		fan-shutdown-percent = <100>;
	};
};

/* Page 31 / IO_CN */
&i2c3 {
	#address-cells = <1>;
	#size-cells = <0>;
	clock-frequency = <400000>;
	status = "okay";

	pwmhat: pwm@1a {
		compatible = "argon40,fan-hat";
		reg = <0x1a>;
		#pwm-cells = <3>;
	};
};
