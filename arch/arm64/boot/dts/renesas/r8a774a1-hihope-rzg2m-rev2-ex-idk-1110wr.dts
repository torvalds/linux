// SPDX-License-Identifier: GPL-2.0
/*
 * Device Tree Source for the HiHope RZ/G2M Rev.2.0 sub board connected to an
 * Advantech IDK-1110WR 10.1" LVDS panel
 *
 * Copyright (C) 2020 Renesas Electronics Corp.
 */

#include "r8a774a1-hihope-rzg2m-rev2-ex.dts"
#include "hihope-rzg2-ex-lvds.dtsi"
#include "rzg2-advantech-idk-1110wr-panel.dtsi"

&lvds0 {
	status = "okay";
};
