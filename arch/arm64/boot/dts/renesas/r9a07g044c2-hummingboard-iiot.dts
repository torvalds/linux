// SPDX-License-Identifier: (GPL-2.0-only OR BSD-2-Clause)
/*
 * Copyright 2025 Josua Mayer <josua@solid-run.com>
 */

/dts-v1/;

#include "r9a07g044c2.dtsi"
#include "rzg2lc-sr-som.dtsi"
#include "rzg2l-hummingboard-iiot-common.dtsi"

/ {
	compatible = "solidrun,rzg2lc-hummingboard-iiot", "solidrun,rzg2lc-sr-som",
		     "renesas,r9a07g044c2", "renesas,r9a07g044";
	model = "SolidRun RZ/G2LC HummingBoard IIoT";
};

&vmmc {
	gpios = <&pinctrl RZG2L_GPIO(18, 1) GPIO_ACTIVE_HIGH>;
};
