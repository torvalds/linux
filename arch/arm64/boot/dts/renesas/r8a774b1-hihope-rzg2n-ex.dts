// SPDX-License-Identifier: GPL-2.0
/*
 * Device Tree Source for the HiHope RZ/G2N Rev.3.0/4.0 connected to
 * sub board
 *
 * Copyright (C) 2020 Renesas Electronics Corp.
 */

#include "r8a774b1-hihope-rzg2n.dts"
#include "hihope-rzg2-ex.dtsi"

/ {
	model = "HopeRun HiHope RZ/G2N with sub board";
	compatible = "hoperun,hihope-rzg2-ex", "hoperun,hihope-rzg2n",
		     "renesas,r8a774b1";
};
