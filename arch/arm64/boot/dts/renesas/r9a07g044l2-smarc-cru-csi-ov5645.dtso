// SPDX-License-Identifier: GPL-2.0
/*
 * Device Tree overlay for the RZ/{G2L, V2L} SMARC EVK with OV5645 camera
 * connected to CSI and CRU enabled.
 *
 * Copyright (C) 2023 Renesas Electronics Corp.
 */

/dts-v1/;
/plugin/;

#include <dt-bindings/gpio/gpio.h>
#include <dt-bindings/pinctrl/rzg2l-pinctrl.h>

#define OV5645_PARENT_I2C i2c0
#include "rz-smarc-cru-csi-ov5645.dtsi"

&ov5645 {
	enable-gpios = <&pinctrl RZG2L_GPIO(2, 0) GPIO_ACTIVE_HIGH>;
	reset-gpios = <&pinctrl RZG2L_GPIO(40, 2) GPIO_ACTIVE_LOW>;
};
