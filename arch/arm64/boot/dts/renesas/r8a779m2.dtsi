// SPDX-License-Identifier: (GPL-2.0 or MIT)
/*
 * Device Tree Source for the R-Car M3e (R8A779M2) SoC
 *
 * Copyright (C) 2021 Glider bv
 */

#include "r8a77961.dtsi"

/ {
	compatible = "renesas,r8a779m2", "renesas,r8a77961";
};
