// SPDX-License-Identifier: (GPL-2.0 or MIT)
/*
 * Device Tree Source for the R-Car D3e (R8A779M7) SoC
 *
 * Copyright (C) 2021 Glider bv
 */

#include "r8a77995.dtsi"

/ {
	compatible = "renesas,r8a779m7", "renesas,r8a77995";
};
