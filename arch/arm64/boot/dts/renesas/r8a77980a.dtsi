// SPDX-License-Identifier: (GPL-2.0 or MIT)
/*
 * Device Tree Source for the R-Car V3H2 (R8A77980A) SoC
 *
 * Copyright (C) 2022 Renesas Electronics Corp.
 */
#include "r8a77980.dtsi"

/ {
	compatible = "renesas,r8a77980a", "renesas,r8a77980";
};
