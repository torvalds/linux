// SPDX-License-Identifier: (GPL-2.0-only OR BSD-2-Clause)
/*
 * Device Tree Source for the RZ/G2L R9A07G044L2 SoC specific parts
 *
 * Copyright (C) 2021 Renesas Electronics Corp.
 */

/dts-v1/;
#include "r9a07g044.dtsi"

/ {
	compatible = "renesas,r9a07g044l2", "renesas,r9a07g044";
};
