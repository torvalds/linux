// SPDX-License-Identifier: (GPL-2.0-only OR BSD-2-Clause)
/*
 * Device Tree Source for the standalone R-Car V4H White Hawk CPU board
 *
 * Copyright (C) 2023 Glider bv
 */

/dts-v1/;
#include "r8a779g0-white-hawk-cpu.dtsi"

/ {
	model = "Renesas White Hawk CPU board based on r8a779g0";
};
