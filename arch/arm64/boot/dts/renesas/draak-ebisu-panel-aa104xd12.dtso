// SPDX-License-Identifier: (GPL-2.0+ OR MIT)
/*
 * Device Tree overlay for the AA104XD12 panel connected to LVDS1 on a Draak or
 * Ebisu board
 *
 * Copyright 2021 Ideas on Board Oy
 */

#define RENESAS_LVDS_OUTPUT	lvds1
#include "panel-aa104xd12.dtsi"
