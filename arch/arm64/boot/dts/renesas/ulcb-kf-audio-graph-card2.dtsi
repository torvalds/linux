// SPDX-License-Identifier: GPL-2.0
/*
 * Device Tree for ULCB + Kingfisher + Audio Graph Card2
 *
 * Copyright (C) 2022 Renesas Electronics Corp.
 */

/*
 *	(A) CPU0 <----> ak4613
 *	(B) CPU1  ----> HDMI
 *	(C) CPU2  ----> PCM3168A-p (8ch)
 *	(D) CPU3 <----  PCM3168A-c (6ch)
 *
 *	(A) aplay   -D plughw:0,0 xxx.wav
 *	(B) aplay   -D plughw:0,1 xxx.wav
 *	(C) aplay   -D plughw:1,0 xxx.wav
 *
 *	(A) arecord -D plughw:0,0 xxx.wav
 *	(D) arecord -D plughw:1,1 xxx.wav
 */
#include "ulcb-kf-audio-graph-card.dtsi"

&sound_card_kf {
	compatible = "audio-graph-card2";

	/delete-property/ dais;
	links = <&snd_kf1 /* (C) CPU2  -> PCM3168A-p */
		 &snd_kf2 /* (D) CPU3 <-  PCM3168A-c */
		>;
};
