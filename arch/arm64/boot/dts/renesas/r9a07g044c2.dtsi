// SPDX-License-Identifier: (GPL-2.0-only OR BSD-2-Clause)
/*
 * Device Tree Source for the RZ/G2LC R9A07G044C2 SoC specific parts
 *
 * Copyright (C) 2021 Renesas Electronics Corp.
 */

/dts-v1/;
#include "r9a07g044.dtsi"

/ {
	compatible = "renesas,r9a07g044c2", "renesas,r9a07g044";
};

&soc {
	/delete-node/ ssi@1004a800;
	/delete-node/ serial@1004c800;
	/delete-node/ adc@10059000;
	/delete-node/ ethernet@11c30000;
};
