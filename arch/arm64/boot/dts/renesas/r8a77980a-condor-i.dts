// SPDX-License-Identifier: GPL-2.0
/*
 * Device Tree Source for the Condor-I board on r8a77980A (ES2.0)
 *
 * Copyright (C) 2022 Renesas Electronics Corp.
 */

/dts-v1/;
#include "r8a77980a.dtsi"
#include "condor-common.dtsi"

/ {
	model = "Renesas Condor-I board based on r8a77980A (ES2.0)";
	compatible = "renesas,condor-i", "renesas,r8a77980a", "renesas,r8a77980";
};

&mmc0 {
	mmc-hs400-1_8v;
};
