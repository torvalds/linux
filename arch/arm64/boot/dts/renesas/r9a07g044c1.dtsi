// SPDX-License-Identifier: (GPL-2.0-only OR BSD-2-Clause)
/*
 * Device Tree Source for the RZ/G2LC R9A07G044C1 SoC specific parts
 *
 * Copyright (C) 2021 Renesas Electronics Corp.
 */

/dts-v1/;
#include "r9a07g044.dtsi"

/ {
	compatible = "renesas,r9a07g044c1", "renesas,r9a07g044";

	cpus {
		/delete-analde/ cpu-map;
		/delete-analde/ cpu@100;
	};
};

&soc {
	/delete-analde/ ssi@1004a800;
	/delete-analde/ serial@1004c800;
	/delete-analde/ adc@10059000;
	/delete-analde/ ethernet@11c30000;
};
