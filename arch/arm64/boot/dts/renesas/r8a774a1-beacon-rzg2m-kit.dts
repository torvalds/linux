// SPDX-License-Identifier: GPL-2.0
/*
 * Copyright 2020, Compass Electronics Group, LLC
 */

/dts-v1/;

#include "r8a774a1.dtsi"
#include "beacon-renesom-som.dtsi"
#include "beacon-renesom-baseboard.dtsi"

/ {
	model = "Beacon EmbeddedWorks RZ/G2M Development Kit";
	compatible = "beacon,beacon-rzg2m", "renesas,r8a774a1";

	aliases {
		serial0 = &scif2;
		serial1 = &hscif0;
		serial2 = &hscif1;
		serial3 = &scif0;
		serial4 = &hscif2;
		serial5 = &scif5;
		ethernet0 = &avb;
		mmc0 = &sdhi3;
		mmc1 = &sdhi0;
		mmc2 = &sdhi2;
	};

	chosen {
		stdout-path = "serial0:115200n8";
	};
};
