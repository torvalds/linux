// SPDX-License-Identifier: (GPL-2.0-only OR BSD-2-Clause)
/*
 * Device Tree Source for the R-Car V4H White Hawk CPU board
 *
 * Copyright (C) 2022 Renesas Electronics Corp.
 */

#include "r8a779g0.dtsi"
#include "white-hawk-cpu-common.dtsi"

/ {
	model = "Renesas White Hawk CPU board";
	compatible = "renesas,white-hawk-cpu", "renesas,r8a779g0";
};
