// SPDX-License-Identifier: (GPL-2.0-only OR BSD-2-Clause)
/*
 * Device Tree Source for the RZ/N2H 4-core SoC
 *
 * Copyright (C) 2025 Renesas Electronics Corp.
 */

/dts-v1/;
#include "r9a09g087.dtsi"

/ {
	compatible = "renesas,r9a09g087m44", "renesas,r9a09g087";
};
