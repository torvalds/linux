// SPDX-License-Identifier: (GPL-2.0-only OR BSD-2-Clause)
/*
 * Device Tree Source for the RZ/G3L R9A08G046L48 SoC specific parts
 *
 * Copyright (C) 2026 Renesas Electronics Corp.
 */

/dts-v1/;
#include "r9a08g046.dtsi"

/ {
	compatible = "renesas,r9a08g046l48", "renesas,r9a08g046";
};
