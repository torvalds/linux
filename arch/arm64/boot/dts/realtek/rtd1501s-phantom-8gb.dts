// SPDX-License-Identifier: GPL-2.0
/*
 * Realtek RTD1501S Phantom EVB
 *
 * Copyright (c) 2024 Realtek Semiconductor Corp.
 */

/dts-v1/;

#include "rtd1501s-phantom.dtsi"

/ {
	compatible = "realtek,phantom", "realtek,rtd1501s";
	model = "Realtek Phantom EVB Chromium (8GB)";

	memory@40000 {
		device_type = "memory";
		reg = <0x0 0x50000 0x0 0x7ffb0000>,
		      <0x0 0x8a100000 0x0 0xdef0000>,
		      <0x0 0x98700000 0x0 0x7900000>,
		      <0x0 0xa0600000 0x0 0x5ea00000>,
		      <0x1 0x0 0x0 0xa0000000>,
		      <0x1 0xa0600000 0x0 0x5fa00000>;
	};
};
