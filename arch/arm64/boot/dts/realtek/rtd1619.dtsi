// SPDX-License-Identifier: (GPL-2.0-or-later OR BSD-2-Clause)
/*
 * Realtek RTD1619 SoC
 *
 * Copyright (c) 2019 Realtek Semiconductor Corp.
 */

#include "rtd16xx.dtsi"

/ {
	compatible = "realtek,rtd1619";
};
