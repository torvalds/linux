// SPDX-License-Identifier: GPL-2.0
/*
 * Realtek RTD1920S Smallville EVB
 *
 * Copyright (c) 2024 Realtek Semiconductor Corp.
 */

/dts-v1/;

#include "rtd1920s-smallville.dtsi"

/ {
	compatible = "realtek,smallville", "realtek,rtd1920s";
	model = "Realtek Smallville EVB (4GB)";

	memory@40000 {
		device_type = "memory";
		reg = <0x0 0x50000 0x0 0x7ffb0000>,
		      <0x0 0x8a100000 0x0 0xdef0000>,
		      <0x0 0x98700000 0x0 0x7900000>,
		      <0x0 0xa1000000 0x0 0x5e000000>;
	};
};
