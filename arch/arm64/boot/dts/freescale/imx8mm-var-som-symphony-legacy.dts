// SPDX-License-Identifier: (GPL-2.0+ OR MIT)
/*
 * Copyright 2026 Variscite Ltd.
 */

#include "imx8mm-var-som-symphony.dts"
#include "imx8mm-var-som-wifi-brcm-legacy.dtsi"

&bluetooth_iw61x {
	status = "disabled";
};

&iw61x_pwrseq {
	status = "disabled";
};

&usdhc1 {
	/delete-property/ mmc-pwrseq;
};
