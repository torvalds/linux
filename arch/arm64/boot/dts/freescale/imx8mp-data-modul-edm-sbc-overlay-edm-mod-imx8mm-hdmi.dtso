// SPDX-License-Identifier: (GPL-2.0+ OR MIT)
/*
 * Copyright 2022-2026 Marek Vasut
 */
/dts-v1/;
/plugin/;

#include "imx8mm-data-modul-edm-sbc-overlay-edm-mod-imx8mm-hdmi.dtsi"

&lt9611_codec {
	interrupts-extended = <&gpio4 19 IRQ_TYPE_EDGE_FALLING>;
	reset-gpios = <&gpio4 0 GPIO_ACTIVE_HIGH>;
};

&lcdif1 {
	status = "okay";
};
