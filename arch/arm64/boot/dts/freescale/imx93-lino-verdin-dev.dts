// SPDX-License-Identifier: GPL-2.0-only OR MIT
/*
 * Copyright (c) Toradex
 *
 * Lino iMX93 SoM on Lino-Verdin Adapter / Development carrier board
 *
 * https://www.toradex.com/computer-on-modules/lino-arm-family/nxp-imx93
 * https://www.toradex.com/products/carrier-board/verdin-development-board-kit
 */

/dts-v1/;

#include "imx93.dtsi"
#include "imx93-lino.dtsi"
#include "imx93-imx91-lino-verdin-common.dtsi"
#include "imx93-imx91-lino-verdin-dev-common.dtsi"

/ {
	model = "Toradex Lino iMX93 on Verdin Adapter plus Development Board";
	compatible = "toradex,lino-imx93-verdin-dev",
		     "toradex,lino-imx93-verdin",
		     "toradex,lino-imx93",
		     "fsl,imx93";
};
