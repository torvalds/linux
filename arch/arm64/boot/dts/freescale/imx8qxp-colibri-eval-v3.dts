// SPDX-License-Identifier: GPL-2.0+ OR MIT
/*
 * Copyright 2019 Toradex
 */

/dts-v1/;

#include "imx8qxp-colibri.dtsi"
#include "imx8qxp-colibri-eval-v3.dtsi"

/ {
	model = "Toradex Colibri iMX8QXP/DX on Colibri Evaluation Board V3";
	compatible = "toradex,colibri-imx8x-eval-v3",
		     "toradex,colibri-imx8x", "fsl,imx8qxp";
};
