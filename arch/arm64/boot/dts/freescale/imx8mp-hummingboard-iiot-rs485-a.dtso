// SPDX-License-Identifier: (GPL-2.0+ OR MIT)
/*
 * Copyright 2025 Josua Mayer <josua@solid-run.com>
 *
 * Overlay for enabling HummingBoard IIoT on-board RS485 Port A on connector J5004.
 */

/dts-v1/;
/plugin/;

&uart3 {
	linux,rs485-enabled-at-boot-time;
};

&uart3_rs_232_485_mux {
	/* select rs485 */
	idle-state = <1>;
};
