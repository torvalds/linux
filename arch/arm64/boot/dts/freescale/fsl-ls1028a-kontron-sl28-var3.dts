// SPDX-License-Identifier: GPL-2.0+
/*
 * Device Tree file for the Kontron SMARC-sAL28 board.
 *
 * This is for the network variant 3 which has one ethernet ports.
 *
 * Copyright (C) 2024 Michael Walle <michael@walle.cc>
 *
 */

/dts-v1/;

#include "fsl-ls1028a-kontron-sl28.dts"

/ {
	model = "Kontron SMARC-sAL28 (Single PHY)";
	compatible = "kontron,sl28-var3", "kontron,sl28", "fsl,ls1028a";
};
