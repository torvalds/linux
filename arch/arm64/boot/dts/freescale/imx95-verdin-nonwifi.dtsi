// SPDX-License-Identifier: GPL-2.0-or-later OR MIT
/*
 * Copyright (c) Toradex
 *
 * Common dtsi for Verdin iMX95 SoM non-WB variant
 *
 * https://www.toradex.com/computer-on-modules/verdin-arm-family/nxp-imx95
 */

/* SDIO on MSP 30, 31, 32, 33, 34, 35 */
&usdhc3 {
	pinctrl-names = "default";
	pinctrl-0 = <&pinctrl_usdhc3>;

	status = "disabled";
};
