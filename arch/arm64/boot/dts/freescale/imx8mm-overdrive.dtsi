// SPDX-License-Identifier: (GPL-2.0+ OR MIT)

&gpu_2d {
	assigned-clocks = <&clk IMX8MM_CLK_GPU2D_CORE>,
			  <&clk IMX8MM_GPU_PLL_OUT>;
	assigned-clock-parents = <&clk IMX8MM_GPU_PLL_OUT>;
	assigned-clock-rates = <0>, <1000000000>;
};

&gpu_3d {
	assigned-clocks = <&clk IMX8MM_CLK_GPU3D_CORE>,
			  <&clk IMX8MM_GPU_PLL_OUT>;
	assigned-clock-parents = <&clk IMX8MM_GPU_PLL_OUT>;
	assigned-clock-rates = <0>, <1000000000>;
};

&vpu_blk_ctrl {
	assigned-clocks = <&clk IMX8MM_CLK_VPU_G1>,
			  <&clk IMX8MM_CLK_VPU_G2>,
			  <&clk IMX8MM_CLK_VPU_H1>,
			  <&clk IMX8MM_VPU_PLL_OUT>;
	assigned-clock-parents = <&clk IMX8MM_SYS_PLL3_OUT>,
				 <&clk IMX8MM_VPU_PLL_OUT>,
				 <&clk IMX8MM_SYS_PLL3_OUT>;
	assigned-clock-rates = <750000000>,
			       <700000000>,
			       <750000000>,
			       <700000000>;
};
