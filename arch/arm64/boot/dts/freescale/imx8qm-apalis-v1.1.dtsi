// SPDX-License-Identifier: GPL-2.0-or-later OR MIT
/*
 * Copyright 2022 Toradex
 */

#include <dt-bindings/pwm/pwm.h>
#include "imx8qm.dtsi"
#include "imx8-apalis-v1.1.dtsi"

/ {
	model = "Toradex Apalis iMX8QM V1.1";
};

&cooling_maps_map0 {
	cooling-device =
		<&A53_0 THERMAL_NO_LIMIT THERMAL_NO_LIMIT>,
		<&A53_1 THERMAL_NO_LIMIT THERMAL_NO_LIMIT>,
		<&A53_2 THERMAL_NO_LIMIT THERMAL_NO_LIMIT>,
		<&A53_3 THERMAL_NO_LIMIT THERMAL_NO_LIMIT>,
		<&A72_0 THERMAL_NO_LIMIT THERMAL_NO_LIMIT>,
		<&A72_1 THERMAL_NO_LIMIT THERMAL_NO_LIMIT>;
};
