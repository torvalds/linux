// SPDX-License-Identifier: (GPL-2.0+ OR MIT)
/*
 * Copyright 2025 NXP
 */

#include <dt-bindings/phy/phy.h>

/dts-v1/;
/plugin/;

&pcieb {
	status = "disabled";
};

&pcieb_ep {
	phys = <&hsio_phy 0 PHY_TYPE_PCIE 0>;
	phy-names = "pcie-phy";
	pinctrl-0 = <&pinctrl_pcieb>;
	pinctrl-names = "default";
	vpcie-supply = <&reg_pcieb>;
	status = "okay";
};
