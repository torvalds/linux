// SPDX-License-Identifier: (GPL-2.0+ OR MIT)
/*
 * Device Tree file for Freescale LS2080a software Simulator model
 *
 * Copyright 2014-2015 Freescale Semiconductor, Inc.
 *
 * Bhupesh Sharma <bhupesh.sharma@freescale.com>
 *
 */

/dts-v1/;

#include "fsl-ls2080a.dtsi"

/ {
	model = "Freescale Layerscape 2080a software Simulator model";
	compatible = "fsl,ls2080a-simu", "fsl,ls2080a";

	ethernet@2210000 {
		compatible = "smsc,lan91c111";
		reg = <0x0 0x2210000 0x0 0x100>;
		interrupts = <0 58 0x1>;
	};
};

&ifc {
	status = "okay";
};

