// SPDX-License-Identifier: GPL-2.0-or-later OR MIT
/*
 * Copyright 2024 Toradex
 */

/dts-v1/;

#include "imx8qm-apalis-v1.1.dtsi"
#include "imx8-apalis-eval-v1.2.dtsi"

/ {
	model = "Toradex Apalis iMX8QM V1.1 on Apalis Evaluation Board V1.2";
	compatible = "toradex,apalis-imx8-v1.1-eval-v1.2",
		     "toradex,apalis-imx8-v1.1",
		     "fsl,imx8qm";
};

/* Apalis MMC1 */
&usdhc2 {
	/delete-property/ no-1-8-v;
};

/* Apalis SD1 */
&usdhc3 {
	/delete-property/ no-1-8-v;
};
