// SPDX-License-Identifier: (GPL-2.0+ OR MIT)
/*
 * Copyright 2025 Josua Mayer <josua@solid-run.com>
 */

/dts-v1/;

#include "imx8mp-sr-som.dtsi"
#include "imx8mp-hummingboard-pulse-common.dtsi"
#include "imx8mp-hummingboard-pulse-mini-hdmi.dtsi"

/ {
	model = "SolidRun i.MX8MP HummingBoard Ripple";
	compatible = "solidrun,imx8mp-hummingboard-ripple",
		     "solidrun,imx8mp-sr-som", "fsl,imx8mp";

	aliases {
		ethernet0 = &eqos;
		/delete-property/ ethernet1;
	};
};

&fec {
	/* this board does not use second phy / ethernet on SoM */
	status = "disabled";
};

&iomuxc {
	pinctrl-names = "default";
	pinctrl-0 = <&mikro_pwm_pins>, <&mikro_int_pins>, <&mikro_rst_pins>;
};
