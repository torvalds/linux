// SPDX-License-Identifier: (GPL-2.0+ OR MIT)
/*
 * Copyright 2023-2026 Marek Vasut
 */
/dts-v1/;
/plugin/;

&reg_panel_bl {
	gpio = <&gpio3 0 0>;
};

&reg_panel_vcc {
	enable-gpios = <&gpio3 6 0>;
};
