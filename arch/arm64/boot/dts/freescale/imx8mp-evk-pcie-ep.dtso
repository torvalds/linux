// SPDX-License-Identifier: (GPL-2.0+ OR MIT)
/*
 * Copyright 2024 NXP
 */

/dts-v1/;
/plugin/;

&pcie {
	status = "disabled";
};

&pcie_ep {
	pinctrl-0 = <&pinctrl_pcie0>;
	pinctrl-names = "default";
	status = "okay";
};
