// SPDX-License-Identifier: (GPL-2.0-or-later OR X11)
/*
 * Copyright 2018-2023 TQ-Systems GmbH <linux@ew.tq-group.com>,
 * D-82229 Seefeld, Germany.
 * Author: Alexander Stein
 */

#include "imx8qxp.dtsi"
#include "tqma8xx.dtsi"

/ {
	model = "TQ-Systems i.MX8QXP TQMa8XQP";
	compatible = "tq,imx8qxp-tqma8xqp", "fsl,imx8qxp";
};
