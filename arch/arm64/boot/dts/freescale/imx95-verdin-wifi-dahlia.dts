// SPDX-License-Identifier: GPL-2.0-or-later OR MIT
/*
 * Copyright (c) Toradex
 *
 * https://www.toradex.com/computer-on-modules/verdin-arm-family/nxp-imx95
 * https://www.toradex.com/products/carrier-board/dahlia-carrier-board-kit
 */

/dts-v1/;

#include "imx95-verdin.dtsi"
#include "imx95-verdin-wifi.dtsi"
#include "imx95-verdin-dahlia.dtsi"

/ {
	model = "Toradex Verdin iMX95 WB on Dahlia Board";
	compatible = "toradex,verdin-imx95-wifi-dahlia",
		     "toradex,verdin-imx95-wifi",
		     "toradex,verdin-imx95",
		     "fsl,imx95";
};
