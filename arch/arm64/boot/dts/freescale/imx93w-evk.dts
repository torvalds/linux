// SPDX-License-Identifier: (GPL-2.0+ OR MIT)
/*
 * Copyright 2026 NXP
 */

/dts-v1/;

#include "imx93w.dtsi"
#include "imx93-11x11-evk-common.dtsi"

/ {
	model = "NXP i.MX93W EVK board";
	compatible = "fsl,imx93-wireless-evk", "fsl,imx93";
};

&lpi2c3 {
	pinctrl-names = "default";
	pinctrl-0 = <&pinctrl_lpi2c3>;
};

&iomuxc {
	pinctrl_lpi2c3: lpi2c3grp {
		fsl,pins = <
			MX93_PAD_GPIO_IO00__LPI2C3_SDA			0x40000b9e
			MX93_PAD_GPIO_IO01__LPI2C3_SCL			0x40000b9e
		>;
	};
};
