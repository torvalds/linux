// SPDX-License-Identifier: (GPL-2.0+ OR MIT)
/*
 * Copyright 2022-2026 Marek Vasut
 */
/dts-v1/;
/plugin/;

#include "imx8mm-data-modul-edm-sbc-overlay-edm-mod-imx8mm-common.dtsi"
#include "imx8mm-data-modul-edm-sbc-overlay-edm-mod-imx8mm-lvds-common.dtsi"

&lcdif {
	status = "okay";
};

&lt9211_codec {
	interrupts-extended = <&gpio2 3 IRQ_TYPE_EDGE_FALLING>;
	reset-gpios = <&gpio2 2 GPIO_ACTIVE_HIGH>;
};

&reg_panel_vcc {
	enable-gpios = <&gpio3 6 0>;
};
