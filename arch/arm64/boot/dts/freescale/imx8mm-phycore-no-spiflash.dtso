// SPDX-License-Identifier: GPL-2.0
/*
 * Copyright (C) 2025 PHYTEC Messtechnik GmbH
 * Author: Teresa Remmet <t.remmet@phytec.de>
 */

/dts-v1/;
/plugin/;

&flexspi {
	status = "disabled";
};

&som_flash {
	status = "disabled";
};
