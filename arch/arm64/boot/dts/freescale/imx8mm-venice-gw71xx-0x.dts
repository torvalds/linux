// SPDX-License-Identifier: (GPL-2.0+ OR MIT)
/*
 * Copyright 2020 Gateworks Corporation
 */

/dts-v1/;

#include "imx8mm.dtsi"
#include "imx8mm-venice-gw700x.dtsi"
#include "imx8mm-venice-gw71xx.dtsi"

/ {
	model = "Gateworks Venice GW71xx-0x i.MX8MM Development Kit";
	compatible = "gw,imx8mm-gw71xx-0x", "fsl,imx8mm";

	chosen {
		stdout-path = &uart2;
	};
};
