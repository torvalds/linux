// SPDX-License-Identifier: GPL-2.0-or-later OR MIT
/*
 * Copyright 2018-2021 Toradex
 */

/dts-v1/;

#include "imx8dx-colibri.dtsi"
#include "imx8x-colibri-eval-v3.dtsi"

/ {
	model = "Toradex Colibri iMX8DX on Colibri Evaluation Board V3";
	compatible = "toradex,colibri-imx8x-eval-v3",
		     "toradex,colibri-imx8x",
		     "fsl,imx8dx";
};
