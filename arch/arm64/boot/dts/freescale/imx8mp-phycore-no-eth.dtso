// SPDX-License-Identifier: GPL-2.0
/*
 * Copyright (C) 2024 PHYTEC Messtechnik GmbH
 * Author: Cem Tenruh <c.tenruh@phytec.de>
 */

/dts-v1/;
/plugin/;

&ethphy1 {
	status = "disabled";
};

&fec {
	status = "disabled";
};
