// SPDX-License-Identifier: (GPL-2.0+ OR MIT)
/*
 * Copyright 2023 Gateworks Corporation
 */

/dts-v1/;

#include "imx8mp.dtsi"
#include "imx8mp-venice-gw702x.dtsi"
#include "imx8mp-venice-gw75xx.dtsi"

/ {
	model = "Gateworks Venice GW75xx-2x i.MX8MP Development Kit";
	compatible = "gateworks,imx8mp-gw75xx-2x", "fsl,imx8mp";

	chosen {
		stdout-path = &uart2;
	};
};

/* Disable SOM interfaces not used on baseboard */
&eqos {
	status = "disabled";
};

&usdhc1 {
	status = "disabled";
};
