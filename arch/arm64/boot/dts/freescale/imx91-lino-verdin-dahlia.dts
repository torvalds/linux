// SPDX-License-Identifier: GPL-2.0-only OR MIT
/*
 * Copyright (c) Toradex
 *
 * Lino iMX91 SoM on Lino-Verdin Adapter / Dahlia carrier board
 *
 * https://www.toradex.com/computer-on-modules/lino-arm-family/nxp-imx91
 * https://www.toradex.com/products/carrier-board/dahlia-carrier-board-kit
 */

/dts-v1/;

#include "imx91.dtsi"
#include "imx91-lino.dtsi"
#include "imx93-imx91-lino-verdin-common.dtsi"
#include "imx93-imx91-lino-verdin-dahlia-common.dtsi"

/ {
	model = "Toradex Lino iMX91 on Verdin Adapter plus Dahlia Board";
	compatible = "toradex,lino-imx91-verdin-dahlia",
		     "toradex,lino-imx91-verdin",
		     "toradex,lino-imx91",
		     "fsl,imx91";
};
