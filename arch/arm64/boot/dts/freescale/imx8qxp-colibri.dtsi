// SPDX-License-Identifier: GPL-2.0-or-later OR MIT
/*
 * Copyright 2019 Toradex
 */

#include "imx8qxp.dtsi"
#include "imx8x-colibri.dtsi"

/ {
	model = "Toradex Colibri iMX8QXP Module";
	compatible = "toradex,colibri-imx8x", "fsl,imx8qxp";
};
