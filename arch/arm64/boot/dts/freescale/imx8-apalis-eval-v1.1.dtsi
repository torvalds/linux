// SPDX-License-Identifier: GPL-2.0-or-later OR MIT
/*
 * Copyright 2024 Toradex
 */

#include "imx8-apalis-eval.dtsi"

/* Apalis CAN1 */
&flexcan1 {
	status = "okay";
};

/* Apalis CAN2 */
&flexcan2 {
	status = "okay";
};

/* Apalis MMC1 */
&usdhc2 {
	status = "okay";
};

/* Apalis SD1 */
&usdhc3 {
	status = "okay";
};
