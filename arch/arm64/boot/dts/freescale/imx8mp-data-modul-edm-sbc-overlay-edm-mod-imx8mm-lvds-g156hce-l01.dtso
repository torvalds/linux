// SPDX-License-Identifier: (GPL-2.0+ OR MIT)
/*
 * Copyright 2023-2026 Marek Vasut
 */

#include "imx8mp-data-modul-edm-sbc-overlay-edm-mod-imx8mm-lvds.dtsi"
#include "imx8mm-data-modul-edm-sbc-overlay-edm-mod-imx8mm-lvds-g156hce-l01.dtsi"
