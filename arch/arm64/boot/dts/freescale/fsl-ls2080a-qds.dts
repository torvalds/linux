// SPDX-License-Identifier: (GPL-2.0+ OR MIT)
/*
 * Device Tree file for Freescale LS2080a QDS Board.
 *
 * Copyright 2015-2016 Freescale Semiconductor, Inc.
 * Copyright 2017 NXP
 *
 * Abhimanyu Saini <abhimanyu.saini@nxp.com>
 * Bhupesh Sharma <bhupesh.sharma@freescale.com>
 *
 */

/dts-v1/;

#include "fsl-ls2080a.dtsi"
#include "fsl-ls208xa-qds.dtsi"

/ {
	model = "Freescale Layerscape 2080a QDS Board";
	compatible = "fsl,ls2080a-qds", "fsl,ls2080a";

	chosen {
		stdout-path = "serial0:115200n8";
	};
};
