// SPDX-License-Identifier: GPL-2.0-only OR MIT
/*
 * Copyright (c) Toradex
 *
 * Toradex OSM iMX91 SoM on OSM Development carrier board
 *
 * https://www.toradex.com/computer-on-modules/osm-arm-family/nxp-imx91
 * https://www.toradex.com/products/carrier-board/osm-development-board
 */

/dts-v1/;

#include "imx91.dtsi"
#include "imx91-toradex-osm.dtsi"
#include "imx93-imx91-toradex-osm-dev-common.dtsi"

/ {
	model = "Toradex OSM iMX91 on OSM Development Board";
	compatible = "toradex,osm-imx91-dev",
		     "toradex,osm-imx91",
		     "fsl,imx91";
};
