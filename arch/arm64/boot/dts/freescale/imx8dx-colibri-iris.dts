// SPDX-License-Identifier: GPL-2.0-or-later OR MIT
/*
 * Copyright 2018-2021 Toradex
 */

/dts-v1/;

#include "imx8dx-colibri.dtsi"
#include "imx8x-colibri-iris.dtsi"

/ {
	model = "Toradex Colibri iMX8DX on Colibri Iris Board";
	compatible = "toradex,colibri-imx8x-iris",
		     "toradex,colibri-imx8x",
		     "fsl,imx8dx";
};
