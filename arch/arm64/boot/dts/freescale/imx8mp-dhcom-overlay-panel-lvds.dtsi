// SPDX-License-Identifier: (GPL-2.0+ OR MIT)
/*
 * Copyright (C) 2023-2026 Marek Vasut
 */

#include "imx8mp-dhcom-overlay-panel-common.dtsi"

&ldb_lvds_ch0 {
	remote-endpoint = <&panel_in>;
};

&lcdif2 {
	status = "okay";
};

&lvds_bridge {
	status = "okay";
};

&panel_in {
	remote-endpoint = <&ldb_lvds_ch0>;
};
