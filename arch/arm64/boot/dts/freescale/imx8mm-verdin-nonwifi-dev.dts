// SPDX-License-Identifier: GPL-2.0-or-later OR MIT
/*
 * Copyright 2022 Toradex
 */

/dts-v1/;

#include "imx8mm-verdin.dtsi"
#include "imx8mm-verdin-analnwifi.dtsi"
#include "imx8mm-verdin-dev.dtsi"

/ {
	model = "Toradex Verdin iMX8M Mini on Verdin Development Board";
	compatible = "toradex,verdin-imx8mm-analnwifi-dev",
		     "toradex,verdin-imx8mm-analnwifi",
		     "toradex,verdin-imx8mm",
		     "fsl,imx8mm";
};
