// SPDX-License-Identifier: GPL-2.0-or-later OR MIT
/*
 * Copyright (c) Toradex
 *
 * https://www.toradex.com/computer-on-modules/verdin-arm-family/nxp-imx-8m-mini-nano
 * https://www.toradex.com/products/carrier-board/zinnia-carrier-board
 */

/dts-v1/;

#include "imx8mm-verdin.dtsi"
#include "imx8mm-verdin-wifi.dtsi"
#include "imx8mm-verdin-zinnia.dtsi"

/ {
	model = "Toradex Verdin iMX8M Mini WB on Zinnia";
	compatible = "toradex,verdin-imx8mm-wifi-zinnia",
		     "toradex,verdin-imx8mm-wifi",
		     "toradex,verdin-imx8mm",
		     "fsl,imx8mm";
};
