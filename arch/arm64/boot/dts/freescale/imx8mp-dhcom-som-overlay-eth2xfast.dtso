// SPDX-License-Identifier: (GPL-2.0+ OR BSD-3-Clause)
/*
 * Copyright (C) 2023-2026 Marek Vasut
 */
#include "imx8mp-dhcom-som-overlay-eth1xfast.dtso"

/* Dual RMII 100/Full Fast ethernet on this SoM variant. */

&ethphy1f {	/* SMSC LAN8740Ai */
	status = "okay";
};

&fec {	/* Second ethernet */
	pinctrl-0 = <&pinctrl_fec_rmii>;
	phy-handle = <&ethphy1f>;
	phy-mode = "rmii";
	status = "okay";

	assigned-clock-parents = <&clk IMX8MP_SYS_PLL1_266M>,
				 <&clk IMX8MP_SYS_PLL2_100M>,
				 <&clk IMX8MP_SYS_PLL2_50M>,
				 <&clk IMX8MP_SYS_PLL2_50M>;
	assigned-clock-rates = <0>, <100000000>, <50000000>, <0>;
};

/* Resistive touch controller not populated on this one SoM variant. */
&touch_som {
	status = "disabled";
};
