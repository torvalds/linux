// SPDX-License-Identifier: (GPL-2.0+ OR MIT)
/*
 * Copyright 2024-2026 Marek Vasut
 */

#include "imx8mp-data-modul-edm-sbc-overlay-edm-sbc-imx8mp-lvds.dtsi"
#include "imx8mm-data-modul-edm-sbc-overlay-lvds-mi0700a2t-30.dtsi"

&media_blk_ctrl {
	/*
	 * The MI0700A2T-30 panel requires 33 MHz LVDS clock.
	 * Set IMX8MP_VIDEO_PLL1 to 231 MHz , since 231 MHz / 7 = 33 MHz .
	 */
	assigned-clock-rates = <500000000>, <200000000>,
			       <0>, <0>, <500000000>, <231000000>;
};

&ldb_lvds_ch1 {
	remote-endpoint = <&panel_lvds>;
};

&panel_lvds {
	remote-endpoint = <&ldb_lvds_ch1>;
};
