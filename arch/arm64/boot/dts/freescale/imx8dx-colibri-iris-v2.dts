// SPDX-License-Identifier: GPL-2.0-or-later OR MIT
/*
 * Copyright 2018-2021 Toradex
 */

/dts-v1/;

#include "imx8dx-colibri.dtsi"
#include "imx8x-colibri-iris-v2.dtsi"

/ {
	model = "Toradex Colibri iMX8DX on Colibri Iris V2 Board";
	compatible = "toradex,colibri-imx8x-iris-v2",
		     "toradex,colibri-imx8x",
		     "fsl,imx8dx";
};
