// SPDX-License-Identifier: (GPL-2.0-or-later OR X11)
/*
 * Copyright 2023 TQ-Systems GmbH <linux@ew.tq-group.com>,
 * D-82229 Seefeld, Germany.
 * Author: Alexander Stein
 */

&mu_m0 {
	interrupts = <GIC_SPI 469 IRQ_TYPE_LEVEL_HIGH>;
};

&mu1_m0 {
	interrupts = <GIC_SPI 470 IRQ_TYPE_LEVEL_HIGH>;
};

&vpu_core0 {
	reg = <0x2d040000 0x10000>;
};

&vpu_core1 {
	reg = <0x2d050000 0x10000>;
};

/delete-node/ &mu2_m0;
/delete-node/ &vpu_core2;
