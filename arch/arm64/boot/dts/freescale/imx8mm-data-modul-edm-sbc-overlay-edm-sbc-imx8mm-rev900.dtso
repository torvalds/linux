// SPDX-License-Identifier: (GPL-2.0+ OR MIT)
/*
 * Copyright (C) 2023-2026 Marek Vasut
 */
/dts-v1/;
/plugin/;

&fec1 {
	phy-handle = <&fec1_phy_ath>;
};

&fec1_phy_ath {
	status = "okay";
};

&fec1_phy_bcm {
	status = "disabled";
};
