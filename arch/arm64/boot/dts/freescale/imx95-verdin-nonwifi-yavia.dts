// SPDX-License-Identifier: GPL-2.0-or-later OR MIT
/*
 * Copyright (c) Toradex
 *
 * https://www.toradex.com/computer-on-modules/verdin-arm-family/nxp-imx95
 * https://www.toradex.com/products/carrier-board/yavia
 */

/dts-v1/;

#include "imx95-verdin.dtsi"
#include "imx95-verdin-nonwifi.dtsi"
#include "imx95-verdin-yavia.dtsi"

/ {
	model = "Toradex Verdin iMX95 on Yavia Board";
	compatible = "toradex,verdin-imx95-nonwifi-yavia",
		     "toradex,verdin-imx95-nonwifi",
		     "toradex,verdin-imx95",
		     "fsl,imx95";
};
