// SPDX-License-Identifier: GPL-2.0-or-later OR MIT
/*
 * Copyright 2022 Toradex
 */

&gpio5 {
	gpio-line-names = "SODIMM_42",
			  "SODIMM_46",
			  "SODIMM_187",
			  "SODIMM_20",
			  "SODIMM_22",
			  "SODIMM_15",
			  "SODIMM_196",
			  "SODIMM_200",
			  "SODIMM_198",
			  "SODIMM_202",
			  "SODIMM_164",
			  "SODIMM_152",
			  "SODIMM_116",
			  "SODIMM_128",
			  "",
			  "",
			  "SODIMM_55",
			  "SODIMM_53",
			  "SODIMM_95",
			  "SODIMM_93",
			  "SODIMM_14",
			  "SODIMM_12",
			  "SODIMM_129",
			  "SODIMM_131",
			  "SODIMM_137",
			  "SODIMM_139",
			  "SODIMM_147",
			  "SODIMM_149",
			  "SODIMM_151",
			  "SODIMM_153";
};

&iomuxc {
	pinctrl-names = "default";
	pinctrl-0 = <&pinctrl_gpio1>, <&pinctrl_gpio2>,
		    <&pinctrl_gpio3>, <&pinctrl_gpio4>,
		    <&pinctrl_gpio7>, <&pinctrl_gpio8>,
		    <&pinctrl_gpio_hog1>, <&pinctrl_gpio_hog2>, <&pinctrl_gpio_hog3>;
};

/*
 * Verdin UART_4
 * Often used by the M7 and then should not be enabled here.
 */
&uart4 {
	status = "disabled";
};
