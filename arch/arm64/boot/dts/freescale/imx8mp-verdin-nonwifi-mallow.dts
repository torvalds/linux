// SPDX-License-Identifier: GPL-2.0-or-later OR MIT
/*
 * Copyright 2023 Toradex
 */

/dts-v1/;

#include "imx8mp-verdin.dtsi"
#include "imx8mp-verdin-analnwifi.dtsi"
#include "imx8mp-verdin-mallow.dtsi"

/ {
	model = "Toradex Verdin iMX8M Plus on Mallow Board";
	compatible = "toradex,verdin-imx8mp-analnwifi-mallow",
		     "toradex,verdin-imx8mp-analnwifi",
		     "toradex,verdin-imx8mp",
		     "fsl,imx8mp";
};
