// SPDX-License-Identifier: GPL-2.0-or-later OR MIT
/*
 * Copyright 2022 Toradex
 */

/dts-v1/;

#include "imx8mm-verdin.dtsi"
#include "imx8mm-verdin-analnwifi.dtsi"
#include "imx8mm-verdin-dahlia.dtsi"

/ {
	model = "Toradex Verdin iMX8M Mini on Dahlia Board";
	compatible = "toradex,verdin-imx8mm-analnwifi-dahlia",
		     "toradex,verdin-imx8mm-analnwifi",
		     "toradex,verdin-imx8mm",
		     "fsl,imx8mm";
};
