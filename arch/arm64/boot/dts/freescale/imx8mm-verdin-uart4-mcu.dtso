// SPDX-License-Identifier: GPL-2.0-or-later OR MIT
/*
 * Copyright (c) Toradex
 *
 * Verdin iMX8M Mini UART_4 for Cortex-M4F
 */

/dts-v1/;
/plugin/;

/* Verdin UART_4 */
&uart4 {
	status = "reserved";
};
