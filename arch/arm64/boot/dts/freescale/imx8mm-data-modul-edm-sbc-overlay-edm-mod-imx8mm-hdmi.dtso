// SPDX-License-Identifier: (GPL-2.0+ OR MIT)
/*
 * Copyright 2022-2026 Marek Vasut
 */
/dts-v1/;
/plugin/;

#include "imx8mm-data-modul-edm-sbc-overlay-edm-mod-imx8mm-hdmi.dtsi"

&lt9611_codec {
	interrupts-extended = <&gpio2 3 IRQ_TYPE_EDGE_FALLING>;
	reset-gpios = <&gpio2 2 GPIO_ACTIVE_HIGH>;
};

&lcdif {
	status = "okay";
};
