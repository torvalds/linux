// SPDX-License-Identifier: (GPL-2.0+ OR MIT)
/*
 * Copyright 2023 Gateworks Corporation
 */

/dts-v1/;

#include "imx8mm.dtsi"
#include "imx8mm-venice-gw700x.dtsi"
#include "imx8mm-venice-gw7905.dtsi"

/ {
	model = "Gateworks Venice GW7905-0x i.MX8MM Development Kit";
	compatible = "gateworks,imx8mm-gw7905-0x", "fsl,imx8mm";

	chosen {
		stdout-path = &uart2;
	};
};

/* Disable SOM interfaces not used on baseboard */
&fec1 {
	status = "disabled";
};

&usdhc1 {
	status = "disabled";
};
