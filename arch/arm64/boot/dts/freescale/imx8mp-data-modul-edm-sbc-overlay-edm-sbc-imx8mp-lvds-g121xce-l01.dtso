// SPDX-License-Identifier: (GPL-2.0+ OR MIT)
/*
 * Copyright 2024 Wael Karman <wkarman@data-modul.com>
 */

#include "imx8mp-data-modul-edm-sbc-overlay-edm-sbc-imx8mp-lvds.dtsi"
#include "imx8mm-data-modul-edm-sbc-overlay-lvds-g121xce-l01.dtsi"

&media_blk_ctrl {
	/*
	 * The G121XCE-L01 panel requires 64.9 MHz LVDS clock.
	 * Set IMX8MP_VIDEO_PLL1 to 454.3 MHz , since 454.3 MHz / 7 = 64.9 MHz .
	 */
	assigned-clock-rates = <500000000>, <200000000>,
			       <0>, <0>, <500000000>, <454300000>;
};

&ldb_lvds_ch1 {
	remote-endpoint = <&panel_lvds>;
};

&panel_lvds {
	remote-endpoint = <&ldb_lvds_ch1>;
};
