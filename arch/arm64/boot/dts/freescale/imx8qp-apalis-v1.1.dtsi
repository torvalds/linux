// SPDX-License-Identifier: GPL-2.0-or-later OR MIT
/*
 * Copyright 2022 Toradex
 */

#include "imx8qp.dtsi"
#include "imx8-apalis-v1.1.dtsi"

&cooling_maps_map0 {
	cooling-device =
		<&A53_0 THERMAL_NO_LIMIT THERMAL_NO_LIMIT>,
		<&A53_1 THERMAL_NO_LIMIT THERMAL_NO_LIMIT>,
		<&A53_2 THERMAL_NO_LIMIT THERMAL_NO_LIMIT>,
		<&A53_3 THERMAL_NO_LIMIT THERMAL_NO_LIMIT>,
		<&A72_0 THERMAL_NO_LIMIT THERMAL_NO_LIMIT>;
};
