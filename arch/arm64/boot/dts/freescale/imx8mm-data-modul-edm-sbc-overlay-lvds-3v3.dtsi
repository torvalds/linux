// SPDX-License-Identifier: (GPL-2.0+ OR MIT)
/*
 * Copyright 2026 Marek Vasut
 */

&reg_backlight_pwm_level {
	regulator-min-microvolt = <3300000>;
	regulator-max-microvolt = <3300000>;
};

&reg_backlight_en_level {
	regulator-min-microvolt = <3300000>;
	regulator-max-microvolt = <3300000>;
};

&reg_panel_vcc {
	regulator-min-microvolt = <3300000>;
	regulator-max-microvolt = <3300000>;
};
