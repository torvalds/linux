// SPDX-License-Identifier: GPL-2.0 OR BSD-3-Clause
/*
 * Mustang Device Tree (Pixel 10 Pro XL)
 *
 * Copyright 2021-2023 Google LLC
 */

/dts-v1/;

#include "lga-pixel-common.dtsi"

/ {
	model = "Mustang";
	compatible = "google,lga-mustang", "google,lga";
};
