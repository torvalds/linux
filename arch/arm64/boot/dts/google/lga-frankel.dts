// SPDX-License-Identifier: GPL-2.0 OR BSD-3-Clause
/*
 * Frankel Device Tree (Pixel 10)
 *
 * Copyright 2021-2023 Google LLC
 */

/dts-v1/;

#include "lga-pixel-common.dtsi"

/ {
	model = "Frankel";
	compatible = "google,lga-frankel", "google,lga";
};
