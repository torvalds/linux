// SPDX-License-Identifier: GPL-2.0 OR BSD-3-Clause
/*
 * Blazer Device Tree (Pixel 10 Pro)
 *
 * Copyright 2021-2023 Google LLC
 */

/dts-v1/;

#include "lga-pixel-common.dtsi"

/ {
	model = "Blazer";
	compatible = "google,lga-blazer", "google,lga";
};
