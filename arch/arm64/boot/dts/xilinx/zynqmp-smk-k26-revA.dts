// SPDX-License-Identifier: GPL-2.0
/*
 * dts file for Xilinx ZynqMP SMK-K26 rev2/1/B/A
 *
 * (C) Copyright 2020 - 2021, Xilinx, Inc.
 * (C) Copyright 2023 - 2024, Advanced Micro Devices, Inc.
 *
 * Michal Simek <michal.simek@amd.com>
 */

#include "zynqmp-sm-k26-revA.dts"

/ {
	model = "ZynqMP SMK-K26 Rev2/1/B/A";
	compatible = "xlnx,zynqmp-smk-k26-rev2",
		     "xlnx,zynqmp-smk-k26-rev1", "xlnx,zynqmp-smk-k26-revB",
		     "xlnx,zynqmp-smk-k26-revA", "xlnx,zynqmp-smk-k26",
		     "xlnx,zynqmp";
};

&sdhci0 {
	status = "disabled";
};
