// SPDX-License-Identifier: GPL-2.0+
/*
 * dts file for Avnet Ultra96 rev1
 *
 * (C) Copyright 2018, Xilinx, Inc.
 *
 * Michal Simek <michal.simek@xilinx.com>
 */

/dts-v1/;

#include "zynqmp-zcu100-revC.dts"

/ {
	model = "Avnet Ultra96 Rev1";
	compatible = "avnet,ultra96-rev1", "avnet,ultra96",
		     "xlnx,zynqmp-zcu100-revC", "xlnx,zynqmp-zcu100",
		     "xlnx,zynqmp";
};
