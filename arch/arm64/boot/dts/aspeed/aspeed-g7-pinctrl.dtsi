// SPDX-License-Identifier: GPL-2.0-or-later

&pinctrl0 {
	pinctrl_emmc_default: emmc_default {
		function = "EMMC";
		groups = "EMMCG1";
	};

	pinctrl_emmc_default: emmc_default {
		function = "EMMC";
		groups = "EMMCG4";
	};

	pinctrl_emmcg8_default: emmcg8_default {
		function = "EMMC";
		groups = "EMMCG8";
	};

	pinctrl_vgaddc_default: vgaddc_default {
		function = "VGADDC";
		groups = "VGADDC";
	};

	pinctrl_usb3axhd_default: usb3axhd_default {
		function = "USB3A";
		groups = "USB3AXHD";
	};

	pinctrl_usb3axhpd_default: usb3axhpd_default {
		function = "USB3A";
		groups = "USB3AXHPD";
	};

	pinctrl_usb3ad_default: usb3ad_default {
		function = "USB3A";
		groups = "USB3AD";
	};

	pinctrl_usb3axh_default: usb3axh_default {
		function = "USB3A";
		groups = "USB3AXH";
	};

	pinctrl_usb3axhp_default: usb3axhp_default {
		function = "USB3A";
		groups = "USB3AXHP";
	};

	pinctrl_usb3a2bh_default: usb3a2bh_default {
		function = "USB3A";
		groups = "USB3A2BH";
	};

	pinctrl_usb3a2bhp_default: usb3a2bhp_default {
		function = "USB3A";
		groups = "USB3A2BHP";
	};

	pinctrl_usb2axd1_default: usb2axd1_default {
		function = "USB2A";
		groups = "USB2AXD1";
	};

	pinctrl_usb2axhpd1_default: usb2axhpd1_default {
		function = "USB2A";
		groups = "USB2AXHPD1";
	};

	pinctrl_usb2ad1_default: usb2ad1_default {
		function = "USB2A";
		groups = "USB2AD1";
	};

	pinctrl_usb2axh_default: usb2axh_default {
		function = "USB2A";
		groups = "USB2AXH";
	};

	pinctrl_usb2axhp_default: usb2axhp_default {
		function = "USB2A";
		groups = "USB2AXHP";
	};

	pinctrl_usb2a2bxh_default: usb2a2bxh_default {
		function = "USB2A";
		groups = "USB2A2BXH";
	};

	pinctrl_usb2a2bxhp_default: usb2a2bxhp_default {
		function = "USB2A";
		groups = "USB2A2BXHP";
	};

	pinctrl_usb2ahpd0_default: usb2ahpd0_default {
		function = "USB2A";
		groups = "USB2AHPD0";
	};

	pinctrl_usb2ad0_default: usb2ad0_default {
		function = "USB2A";
		groups = "USB2AD0";
	};

	pinctrl_usb2ah_default: usb2ah_default {
		function = "USB2A";
		groups = "USB2AH";
	};

	pinctrl_usb2ahp_default: usb2ahp_default {
		function = "USB2A";
		groups = "USB2AHP";
	};

	pinctrl_usb3bxhd_default: usb3bxhd_default {
		function = "USB3B";
		groups = "USB3BXHD";
	};

	pinctrl_usb3bxhpd_default: usb3bxhpd_default {
		function = "USB3B";
		groups = "USB3BXHPD";
	};

	pinctrl_usb3bd_default: usb3bd_default {
		function = "USB3B";
		groups = "USB3BD";
	};

	pinctrl_usb3bxh_default: usb3bxh_default {
		function = "USB3B";
		groups = "USB3BXH";
	};

	pinctrl_usb3bxhp_default: usb3bxhp_default {
		function = "USB3B";
		groups = "USB3BXHP";
	};

	pinctrl_usb3b2ah_default: usb3b2ah_default {
		function = "USB3B";
		groups = "USB3B2AH";
	};

	pinctrl_usb3b2ahp_default: usb3b2ahp_default {
		function = "USB3B";
		groups = "USB3B2AHP";
	};

	pinctrl_usb2bxd1_default: usb2bxd1_default {
		function = "USB2B";
		groups = "USB2BXD1";
	};

	pinctrl_usb2bxhpd1_default: usb2bxhpd1_default {
		function = "USB2B";
		groups = "USB2BXHPD1";
	};

	pinctrl_usb2bd1_default: usb2bd1_default {
		function = "USB2B";
		groups = "USB2BD1";
	};

	pinctrl_usb2bxh_default: usb2bxh_default {
		function = "USB2B";
		groups = "USB2BXH";
	};

	pinctrl_usb2bxhp_default: usb2bxhp_default {
		function = "USB2B";
		groups = "USB2BXHP";
	};

	pinctrl_usb2b2axh_default: usb2b2axh_default {
		function = "USB2B";
		groups = "USB2B2AXH";
	};

	pinctrl_usb2b2axhp_default: usb2b2axhp_default {
		function = "USB2B";
		groups = "USB2B2AXHP";
	};

	pinctrl_usb2bhpd0_default: usb2bhpd0_default {
		function = "USB2B";
		groups = "USB2BHPD0";
	};

	pinctrl_usb2bd0_default: usb2bd0_default {
		function = "USB2B";
		groups = "USB2BD0";
	};

	pinctrl_usb2bh_default: usb2bh_default {
		function = "USB2B";
		groups = "USB2BH";
	};

	pinctrl_usb2bhp_default: usb2bhp_default {
		function = "USB2B";
		groups = "USB2BHP";
	};

};

&pinctrl1 {
	pinctrl_adc0_default: adc0_default {
		function = "ADC0";
		groups = "ADC0";
	};

	pinctrl_adc1_default: adc1_default {
		function = "ADC1";
		groups = "ADC1";
	};

	pinctrl_adc2_default: adc2_default {
		function = "ADC2";
		groups = "ADC2";
	};

	pinctrl_adc3_default: adc3_default {
		function = "ADC3";
		groups = "ADC3";
	};

	pinctrl_adc4_default: adc4_default {
		function = "ADC4";
		groups = "ADC4";
	};

	pinctrl_adc5_default: adc5_default {
		function = "ADC5";
		groups = "ADC5";
	};

	pinctrl_adc6_default: adc6_default {
		function = "ADC6";
		groups = "ADC6";
	};

	pinctrl_adc7_default: adc7_default {
		function = "ADC7";
		groups = "ADC7";
	};

	pinctrl_adc8_default: adc8_default {
		function = "ADC8";
		groups = "ADC8";
	};

	pinctrl_adc9_default: adc9_default {
		function = "ADC9";
		groups = "ADC9";
	};

	pinctrl_adc10_default: adc10_default {
		function = "ADC10";
		groups = "ADC10";
	};

	pinctrl_adc11_default: adc11_default {
		function = "ADC11";
		groups = "ADC11";
	};

	pinctrl_adc12_default: adc12_default {
		function = "ADC12";
		groups = "ADC12";
	};

	pinctrl_adc13_default: adc13_default {
		function = "ADC13";
		groups = "ADC13";
	};

	pinctrl_adc14_default: adc14_default {
		function = "ADC14";
		groups = "ADC14";
	};

	pinctrl_adc15_default: adc15_default {
		function = "ADC15";
		groups = "ADC15";
	};

	pinctrl_mdio0_default: mdio0_default {
		function = "MDIO0";
		groups = "MDIO0";
	};

	pinctrl_mdio1_default: mdio1_default {
		function = "MDIO1";
		groups = "MDIO1";
	};

	pinctrl_mdio2_default: mdio2_default {
		function = "MDIO2";
		groups = "MDIO2";
	};

	pinctrl_rgmii0_default: rgmii0_default {
		function = "RGMII0";
		groups = "RGMII0";
	};

	pinctrl_rgmii1_default: rgmii1_default {
		function = "RGMII1";
		groups = "RGMII1";
	};

	pinctrl_espi0_default: espi0_default {
		function = "ESPI0";
		groups = "ESPI0";
	};

	pinctrl_espi1_default: espi1_default {
		function = "ESPI1";
		groups = "ESPI1";
	};

	pinctrl_lpc0_default: lpc0_default {
		function = "LPC0";
		groups = "LPC0";
	};

	pinctrl_lpc1_default: lpc1_default {
		function = "LPC1";
		groups = "LPC1";
	};

	pinctrl_vpi_default: vpi_default {
		function = "VPI";
		groups = "VPI";
	};

	pinctrl_sd_default: sd_default {
		function = "SD";
		groups = "SD";
	};

	pinctrl_i3c0_default: i3c0_default {
		function = "I3C0";
		groups = "I3C0";
	};

	pinctrl_i3c1_default: i3c1_default {
		function = "I3C1";
		groups = "I3C1";
	};

	pinctrl_i3c2_default: i3c2_default {
		function = "I3C2";
		groups = "I3C2";
	};

	pinctrl_i3c3_default: i3c3_default {
		function = "I3C3";
		groups = "I3C3";
	};

	pinctrl_i3c4_default: i3c4_default {
		function = "I3C4";
		groups = "I3C4";
	};

	pinctrl_i3c5_default: i3c5_default {
		function = "I3C5";
		groups = "I3C5";
	};

	pinctrl_i3c6_default: i3c6_default {
		function = "I3C6";
		groups = "I3C6";
	};

	pinctrl_i3c7_default: i3c7_default {
		function = "I3C7";
		groups = "I3C7";
	};

	pinctrl_i3c8_default: i3c8_default {
		function = "I3C8";
		groups = "I3C8";
	};

	pinctrl_i3c9_default: i3c9_default {
		function = "I3C9";
		groups = "I3C9";
	};

	pinctrl_i3c10_default: i3c10_default {
		function = "I3C10";
		groups = "I3C10";
	};

	pinctrl_i3c11_default: i3c11_default {
		function = "I3C11";
		groups = "I3C11";
	};

	pinctrl_hvi3c4_default: hvi3c4_default {
		function = "I3C4";
		groups = "HVI3C4";
	};

	pinctrl_hvi3c5_default: hvi3c5_default {
		function = "I3C5";
		groups = "HVI3C5";
	};

	pinctrl_hvi3c6_default: hvi3c6_default {
		function = "I3C6";
		groups = "HVI3C6";
	};

	pinctrl_hvi3c7_default: hvi3c7_default {
		function = "I3C7";
		groups = "HVI3C7";
	};

	pinctrl_hvi3c10_default: hvi3c10_default {
		function = "I3C10";
		groups = "HVI3C10";
	};

	pinctrl_hvi3c11_default: hvi3c11_default {
		function = "I3C11";
		groups = "HVI3C11";
	};

	pinctrl_hvi3c12_default: hvi3c12_default {
		function = "I3C12";
		groups = "HVI3C12";
	};

	pinctrl_hvi3c13_default: hvi3c13_default {
		function = "I3C13";
		groups = "HVI3C13";
	};

	pinctrl_hvi3c14_default: hvi3c14_default {
		function = "I3C14";
		groups = "HVI3C14";
	};

	pinctrl_hvi3c15_default: hvi3c15_default {
		function = "I3C15";
		groups = "HVI3C15";
	};

	pinctrl_tach0_default: tach0_default {
		function = "TACH0";
		groups = "TACH0";
	};

	pinctrl_tach1_default: tach1_default {
		function = "TACH1";
		groups = "TACH1";
	};

	pinctrl_tach2_default: tach2_default {
		function = "TACH2";
		groups = "TACH2";
	};

	pinctrl_tach3_default: tach3_default {
		function = "TACH3";
		groups = "TACH3";
	};

	pinctrl_tach4_default: tach4_default {
		function = "TACH4";
		groups = "TACH4";
	};

	pinctrl_tach5_default: tach5_default {
		function = "TACH5";
		groups = "TACH5";
	};

	pinctrl_tach6_default: tach6_default {
		function = "TACH6";
		groups = "TACH6";
	};

	pinctrl_tach7_default: tach7_default {
		function = "TACH7";
		groups = "TACH7";
	};

	pinctrl_tach8_default: tach8_default {
		function = "TACH8";
		groups = "TACH8";
	};

	pinctrl_tach9_default: tach9_default {
		function = "TACH9";
		groups = "TACH9";
	};

	pinctrl_tach10_default: tach10_default {
		function = "TACH10";
		groups = "TACH10";
	};

	pinctrl_tach11_default: tach11_default {
		function = "TACH11";
		groups = "TACH11";
	};

	pinctrl_tach12_default: tach12_default {
		function = "TACH12";
		groups = "TACH12";
	};

	pinctrl_tach13_default: tach13_default {
		function = "TACH13";
		groups = "TACH13";
	};

	pinctrl_tach14_default: tach14_default {
		function = "TACH14";
		groups = "TACH14";
	};

	pinctrl_tach15_default: tach15_default {
		function = "TACH15";
		groups = "TACH15";
	};

	pinctrl_thru0_default: thru0_default {
		function = "THRU0";
		groups = "THRU0";
	};

	pinctrl_thru1_default: thru1_default {
		function = "THRU1";
		groups = "THRU1";
	};

	pinctrl_ncts5_default: ncts5_default {
		function = "NCTS5";
		groups = "NCTS5";
	};

	pinctrl_ndcd5_default: ndcd5_default {
		function = "NDCD5";
		groups = "NDCD5";
	};

	pinctrl_ndsr5_default: ndsr5_default {
		function = "NDSR5";
		groups = "NDSR5";
	};

	pinctrl_nri5_default: nri5_default {
		function = "NRI5";
		groups = "NRI5";
	};

	pinctrl_i2c0_default: i2c0_default {
		function = "I2C0";
		groups = "I2C0";
	};

	pinctrl_i2c1_default: i2c1_default {
		function = "I2C1";
		groups = "I2C1";
	};

	pinctrl_i2c2_default: i2c2_default {
		function = "I2C2";
		groups = "I2C2";
	};

	pinctrl_i2c3_default: i2c3_default {
		function = "I2C3";
		groups = "I2C3";
	};

	pinctrl_i2c4_default: i2c4_default {
		function = "I2C4";
		groups = "I2C4";
	};

	pinctrl_i2c5_default: i2c5_default {
		function = "I2C5";
		groups = "I2C5";
	};

	pinctrl_i2c6_default: i2c6_default {
		function = "I2C6";
		groups = "I2C6";
	};

	pinctrl_i2c7_default: i2c7_default {
		function = "I2C7";
		groups = "I2C7";
	};

	pinctrl_i2c8_default: i2c8_default {
		function = "I2C8";
		groups = "I2C8";
	};

	pinctrl_i2c9_default: i2c9_default {
		function = "I2C9";
		groups = "I2C9";
	};

	pinctrl_i2c10_default: i2c10_default {
		function = "I2C10";
		groups = "I2C10";
	};

	pinctrl_i2c11_default: i2c11_default {
		function = "I2C11";
		groups = "I2C11";
	};

	pinctrl_i2c12_default: i2c12_default {
		function = "I2C12";
		groups = "I2C12";
	};

	pinctrl_i2c13_default: i2c13_default {
		function = "I2C13";
		groups = "I2C13";
	};

	pinctrl_i2c14_default: i2c14_default {
		function = "I2C14";
		groups = "I2C14";
	};

	pinctrl_i2c15_default: i2c15_default {
		function = "I2C15";
		groups = "I2C15";
	};

	pinctrl_di2c8_default: di2c8_default {
		function = "DI2C8";
		groups = "DI2C8";
	};

	pinctrl_di2c9_default: di2c9_default {
		function = "DI2C9";
		groups = "DI2C9";
	};

	pinctrl_di2c10_default: di2c10_default {
		function = "DI2C10";
		groups = "DI2C10";
	};

	pinctrl_di2c11_default: di2c11_default {
		function = "DI2C11";
		groups = "DI2C11";
	};

	pinctrl_di2c12_default: id2c12_default {
		function = "DI2C12";
		groups = "DI2C12";
	};

	pinctrl_di2c13_default: di2c13_default {
		function = "DI2C13";
		groups = "DI2C13";
	};

	pinctrl_di2c14_default: di2c14_default {
		function = "DI2C14";
		groups = "DI2C14";
	};

	pinctrl_di2c15_default: di2c15_default {
		function = "DI2C15";
		groups = "DI2C15";
	};

	pinctrl_ncts0_default: ncts0_default {
		function = "UART0";
		groups = "NCTS0";
	};

	pinctrl_ndcd0_default: ndcd0_default {
		function = "UART0";
		groups = "NDCD0";
	};

	pinctrl_ndsr0_default: ndsr0_default {
		function = "UART0";
		groups = "NDSR0";
	};

	pinctrl_nri0_default: nri0_default {
		function = "UART0";
		groups = "NRI0";
	};

	pinctrl_ndtr0_default: ndtr0_default {
		function = "UART0";
		groups = "NDTR0";
	};

	pinctrl_nrts0_default: nrts0_default {
		function = "UART0";
		groups = "NRTS0";
	};

	pinctrl_txd0_default: txd0_default {
		function = "UART0";
		groups = "TXD0";
	};

	pinctrl_rxd0_default: rxd0_default {
		function = "UART0";
		groups = "RXD0";
	};

	pinctrl_ncts1_default: ncts1_default {
		function = "UART1";
		groups = "NCTS1";
	};

	pinctrl_ndcd1_default: ndcd1_default {
		function = "UART1";
		groups = "NDCD1";
	};

	pinctrl_ndsr1_default: ndsr1_default {
		function = "UART1";
		groups = "NDSR1";
	};

	pinctrl_nri1_default: nri1_default {
		function = "UART1";
		groups = "NRI1";
	};

	pinctrl_ndtr1_default: ndtr1_default {
		function = "UART1";
		groups = "NDTR1";
	};

	pinctrl_nrts1_default: nrts1_default {
		function = "UART1";
		groups = "NRTS1";
	};

	pinctrl_txd1_default: txd1_default {
		function = "UART1";
		groups = "TXD1";
	};

	pinctrl_rxd1_default: rxd1_default {
		function = "UART1";
		groups = "RXD1";
	};

	pinctrl_txd2_default: txd2_default {
		function = "UART2";
		groups = "TXD2";
	};

	pinctrl_rxd2_default: rxd2_default {
		function = "UART2";
		groups = "RXD2";
	};

	pinctrl_txd3_default: txd3_default {
		function = "UART3";
		groups = "TXD3";
	};

	pinctrl_rxd3_default: rxd3_default {
		function = "UART3";
		groups = "RXD3";
	};

	pinctrl_ncts5_default: ncts5_default {
		function = "UART5";
		groups = "NCTS5";
	};

	pinctrl_ndcd5_default: ndcd5_default {
		function = "UART5";
		groups = "NDCD5";
	};

	pinctrl_ndsr5_default: ndsr5_default {
		function = "UART5";
		groups = "NDSR5";
	};

	pinctrl_nri5_default: nri5_default {
		function = "UART5";
		groups = "NRI5";
	};

	pinctrl_ndtr5_default: ndtr5_default {
		function = "UART5";
		groups = "NDTR5";
	};

	pinctrl_nrts5_default: nrts5_default {
		function = "UART5";
		groups = "NRTS5";
	};

	pinctrl_txd5_default: txd5_default {
		function = "UART5";
		groups = "TXD5";
	};

	pinctrl_rxd5_default: rxd5_default {
		function = "UART5";
		groups = "RXD5";
	};

	pinctrl_ncts6_default: ncts6_default {
		function = "UART6";
		groups = "NCTS6";
	};

	pinctrl_ndcd6_default: ndcd6_default {
		function = "UART6";
		groups = "NDCD6";
	};

	pinctrl_ndsr6_default: ndsr6_default {
		function = "UART6";
		groups = "NDSR6";
	};

	pinctrl_nri6_default: nri6_default {
		function = "UART6";
		groups = "NRI6";
	};

	pinctrl_ndtr6_default: ndtr6_default {
		function = "UART6";
		groups = "NDTR6";
	};

	pinctrl_nrts6_default: nrts6_default {
		function = "UART6";
		groups = "NRTS6";
	};

	pinctrl_txd6_default: txd6_default {
		function = "UART6";
		groups = "TXD6";
	};

	pinctrl_rxd6_default: rxd6_default {
		function = "UART6";
		groups = "RXD6";
	};

	pinctrl_txd7_default: txd7_default {
		function = "UART7";
		groups = "TXD7";
	};

	pinctrl_rxd7_default: rxd7_default {
		function = "UART7";
		groups = "RXD7";
	};

	pinctrl_txd8_default: txd8_default {
		function = "UART8";
		groups = "TXD8";
	};

	pinctrl_rxd8_default: rxd8_default {
		function = "UART8";
		groups = "RXD8";
	};

	pinctrl_txd9_default: txd9_default {
		function = "UART9";
		groups = "TXD9";
	};

	pinctrl_rxd9_default: rxd9_default {
		function = "UART9";
		groups = "RXD9";
	};

	pinctrl_txd10_default: txd10_default {
		function = "UART10";
		groups = "TXD10";
	};

	pinctrl_rxd10_default: rxd10_default {
		function = "UART10";
		groups = "RXD10";
	};

	pinctrl_txd11_default: txd11_default {
		function = "UART11";
		groups = "TXD11";
	};

	pinctrl_rxd11_default: rxd11_default {
		function = "UART11";
		groups = "RXD11";
	};
};
