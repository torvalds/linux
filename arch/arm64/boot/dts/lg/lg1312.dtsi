// SPDX-License-Identifier: GPL-2.0
/*
 * dts file for lg1312 SoC
 *
 * Copyright (C) 2016, LG Electronics
 */

#include <dt-bindings/interrupt-controller/arm-gic.h>

#include "lg131x.dtsi"

/ {
	compatible = "lge,lg1312";

	soc {
		#address-cells = <2>;
		#size-cells = <1>;

		compatible = "simple-bus";
		interrupt-parent = <&gic>;
		ranges;

		eth0: ethernet@c1b00000 {
			compatible = "cdns,gem";
			reg = <0x0 0xc1b00000 0x1000>;
			interrupts = <GIC_SPI 31 IRQ_TYPE_LEVEL_HIGH>;
			clocks = <&clk_bus>, <&clk_bus>;
			clock-names = "hclk", "pclk";
			phy-mode = "rmii";
			/* Filled in by boot */
			mac-address = [ 00 00 00 00 00 00 ];
		};
	};
};
