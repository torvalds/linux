// SPDX-License-Identifier: (GPL-2.0+ OR MIT)
/*
 * Copyright (c) 2021 Amlogic, Inc. All rights reserved.
 */

/dts-v1/;

#include "amlogic-c3.dtsi"

/ {
	model = "Amlogic C302 aw409 Development Board";
	compatible = "amlogic,aw409", "amlogic,c3";
	interrupt-parent = <&gic>;
	#address-cells = <2>;
	#size-cells = <2>;

	aliases {
		serial0 = &uart_b;
	};

	memory@0 {
		device_type = "memory";
		reg = <0x0 0x0 0x0 0x10000000>;
	};
};

&uart_b {
	status = "okay";
};
