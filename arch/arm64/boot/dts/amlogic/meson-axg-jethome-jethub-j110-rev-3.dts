// SPDX-License-Identifier: (GPL-2.0+ OR MIT)
/*
 * Copyright (c) 2022 Vyacheslav Bocharov <adeep@lexina.in>
 * Copyright (c) 2022 JetHome
 * Author: Vyacheslav Bocharov <adeep@lexina.in>
 */

/dts-v1/;

#include "meson-axg-jethome-jethub-j1xx.dtsi"

/ {
	compatible = "jethome,jethub-j110", "amlogic,a113d", "amlogic,meson-axg";
	model = "JetHome JetHub D1p (J110) Hw rev.3";

	/* 2GiB or 4GiB RAM */
	memory@0 {
		device_type = "memory";
		reg = <0x0 0x0 0x0 0x80000000>;
	};
};


/* wifi module */
&sd_emmc_b {
	broken-cd;/* cd-gpios = <&gpio_ao GPIOAO_3 GPIO_ACTIVE_LOW>;*/
};
