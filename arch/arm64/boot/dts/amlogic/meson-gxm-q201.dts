// SPDX-License-Identifier: (GPL-2.0+ OR MIT)
/*
 * Copyright (c) 2016 Endless Computers, Inc.
 * Author: Carlo Caione <carlo@endlessm.com>
 */

/dts-v1/;

#include "meson-gxm.dtsi"
#include "meson-gx-p23x-q20x.dtsi"

/ {
	compatible = "amlogic,q201", "amlogic,s912", "amlogic,meson-gxm";
	model = "Amlogic Meson GXM (S912) Q201 Development Board";
};

/* Q201 has only internal PHY port */
&ethmac {
	phy-mode = "rmii";
	phy-handle = <&internal_phy>;
};
