// SPDX-License-Identifier: (GPL-2.0+ OR MIT)
// Copyright (c) 2024 Freebox SAS

/dts-v1/;
/plugin/;

#include <dt-bindings/gpio/gpio.h>
#include <dt-bindings/gpio/meson-g12a-gpio.h>

&uart_A {
	bluetooth {
		compatible = "realtek,rtl8822cs-bt";
		enable-gpios = <&gpio GPIOX_17 GPIO_ACTIVE_HIGH>;
		host-wake-gpios = <&gpio GPIOX_19 GPIO_ACTIVE_HIGH>;
		device-wake-gpios = <&gpio GPIOX_18 GPIO_ACTIVE_HIGH>;
	};
};

&sd_emmc_a {
	/* No explicit compatible for rtl8822cs sdio */
};
