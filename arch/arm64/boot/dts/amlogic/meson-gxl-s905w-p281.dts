// SPDX-License-Identifier: (GPL-2.0+ OR MIT)
/*
 * Copyright (c) 2018 Martin Blumenstingl <martin.blumenstingl@googlemail.com>.
 * Based on meson-gxl-s905d-p231.dts:
 * - Copyright (c) 2016 Endless Computers, Inc.
 *   Author: Carlo Caione <carlo@endlessm.com>
 */

/dts-v1/;

#include "meson-gxl-s905x.dtsi"
#include "meson-gx-p23x-q20x.dtsi"

/ {
	compatible = "amlogic,p281", "amlogic,s905w", "amlogic,meson-gxl";
	model = "Amlogic Meson GXL (S905W) P281 Development Board";

	memory@0 {
		device_type = "memory";
		reg = <0x0 0x0 0x0 0x40000000>;
	};
};
