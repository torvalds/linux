// SPDX-License-Identifier: (GPL-2.0+ OR MIT)
/*
 * Copyright (c) 2019 Christian Hewitt <christianshewitt@gmail.com>
 */

/dts-v1/;

#include "meson-g12b-dreambox.dtsi"

/ {
	compatible = "dream,dreambox-one", "amlogic,s922x", "amlogic,g12b";
	model = "Dreambox One";
};

&sd_emmc_a {
	sd-uhs-sdr12;
};
