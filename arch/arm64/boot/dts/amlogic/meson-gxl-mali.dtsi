// SPDX-License-Identifier: (GPL-2.0+ OR MIT)
/*
 * Copyright (c) 2017 BayLibre SAS
 * Author: Neil Armstrong <narmstrong@baylibre.com>
 */

#include "meson-gx-mali450.dtsi"

&mali {
	compatible = "amlogic,meson-gxl-mali", "arm,mali-450";

	clocks = <&clkc CLKID_CLK81>, <&clkc CLKID_MALI>;
	clock-names = "bus", "core";

	assigned-clocks = <&clkc CLKID_GP0_PLL>;
	assigned-clock-rates = <744000000>;
};
