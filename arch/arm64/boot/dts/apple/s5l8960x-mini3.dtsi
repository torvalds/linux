// SPDX-License-Identifier: GPL-2.0+ OR MIT
/*
 * Apple iPad mini 3 common device tree
 * Based on A7 (APL0698), up to 1.3GHz
 *
 * Copyright (c) 2022, Konrad Dybcio <konradybcio@kernel.org>
 */

/*
 * The Mini 3 seems to be only an iteration over the Mini 2 with some
 * small changes, like the introduction of Touch ID, hence there is little
 * to no differentiation between these 2 for now.
 */
#include "s5l8960x-mini2.dtsi"
