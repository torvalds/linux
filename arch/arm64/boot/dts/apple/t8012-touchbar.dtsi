// SPDX-License-Identifier: GPL-2.0+ OR MIT
/*
 * Common Device Tree for T2 devices with a Touch Bar
 *
 * target-type: J152f, J213, J214k, J215, J223, J680, J780
 *
 * Copyright (c) 2024, Nick Chan <towinchenmi@gmail.com>
 */

/ {
	chosen {
		framebuffer0: framebuffer@0 {
			compatible = "apple,simple-framebuffer", "simple-framebuffer";
			reg = <0 0 0 0>; /* To be filled by loader */
			power-domains = <&ps_disp0_fe &ps_disp0_be &ps_mipi_dsi>;
			/* Format properties will be added by loader */
			status = "disabled";
		};
	};
};
