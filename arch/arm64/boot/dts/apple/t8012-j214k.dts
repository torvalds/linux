// SPDX-License-Identifier: GPL-2.0+ OR MIT
/*
 * Apple T2 MacBookPro16,2 (j214k), J214k, iBridge2,16
 * Copyright (c) 2024, Nick Chan <towinchenmi@gmail.com>
 */

/dts-v1/;

#include "t8012-jxxx.dtsi"
#include "t8012-touchbar.dtsi"

/ {
	model = "Apple T2 MacBookPro16,2 (j214k)";
	compatible = "apple,j214k", "apple,t8012", "apple,arm-platform";
};
