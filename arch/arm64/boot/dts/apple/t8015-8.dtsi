// SPDX-License-Identifier: GPL-2.0+ OR MIT
/*
 * Apple iPhone 8 common device tree
 *
 * Copyright (c) 2022, Konrad Dybcio <konradybcio@kernel.org>
 */

#include "t8015.dtsi"
#include "t8015-common.dtsi"

/ {
	chassis-type = "handset";
};
