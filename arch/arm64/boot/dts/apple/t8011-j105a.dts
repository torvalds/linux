// SPDX-License-Identifier: GPL-2.0+ OR MIT
/*
 * Apple TV 4K (1st Generation), J105a, AppleTV6,2 (A1482)
 * Copyright (c) 2024, Nick Chan <towinchenmi@gmail.com>
 */

/dts-v1/;

#include "t8011.dtsi"
#include "t8011-common.dtsi"

/ {
	compatible = "apple,j105a", "apple,t8011", "apple,arm-platform";
	model = "Apple TV 4K (1st Generation)";
	chassis-type = "television";
};
