// SPDX-License-Identifier: GPL-2.0+ OR MIT
/*
 * Apple iPad Pro 2 (12.9-inch) (Wi-Fi), J120, iPad7,1 (A1670)
 * Copyright (c) 2022, Konrad Dybcio <konradybcio@kernel.org>
 */

/dts-v1/;

#include "t8011.dtsi"
#include "t8011-common.dtsi"
#include "t8011-pro2.dtsi"

/ {
	compatible = "apple,j120", "apple,t8011", "apple,arm-platform";
	model = "Apple iPad Pro 2 (12.9-inch) (Wi-Fi)";
};
