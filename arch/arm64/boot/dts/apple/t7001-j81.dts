// SPDX-License-Identifier: GPL-2.0+ OR MIT
/*
 * Apple iPad Air 2 (Wi-Fi), J81, iPad5,3 (A1566)
 * Copyright (c) 2022, Konrad Dybcio <konradybcio@kernel.org>
 */

/dts-v1/;

#include "t7001-air2.dtsi"

/ {
	compatible = "apple,j81", "apple,t7001", "apple,arm-platform";
	model = "Apple iPad Air 2 (Wi-Fi)";
};
