// SPDX-License-Identifier: GPL-2.0+ OR MIT
/*
 * Apple iPhone 8 Plus common device tree
 *
 * Copyright (c) 2022, Konrad Dybcio <konradybcio@kernel.org>
 */

/* The 8 Plus has minor differences like 1 more camera, 1 GiB of RAM more and a bigger display. */
#include "t8015-8.dtsi"
