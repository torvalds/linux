// SPDX-License-Identifier: GPL-2.0+ OR MIT
/*
 * Apple iPhone X (GSM), D221, iPhone10,6 (A1901)
 * Copyright (c) 2022, Konrad Dybcio <konradybcio@kernel.org>
 */

/dts-v1/;

#include "t8015-x.dtsi"

/ {
	compatible = "apple,d221", "apple,t8015", "apple,arm-platform";
	model = "Apple iPhone X (GSM)";
};
