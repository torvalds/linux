// SPDX-License-Identifier: GPL-2.0+ OR MIT
/*
 * Apple iPad 6 (Cellular), J72b, iPad7,6 (A1954)
 * Copyright (c) 2022, Konrad Dybcio <konradybcio@kernel.org>
 */

/dts-v1/;

#include "t8010-ipad6.dtsi"

/ {
	compatible = "apple,j72b", "apple,t8010", "apple,arm-platform";
	model = "Apple iPad 6 (Cellular)";
};
