// SPDX-License-Identifier: GPL-2.0+ OR MIT
/*
 * Apple iPad Pro (12.9-inch) (Cellular), J99a, iPad6,8 (A1652)
 * Copyright (c) 2022, Konrad Dybcio <konradybcio@kernel.org>
 */

/dts-v1/;

#include "s8001-pro.dtsi"

/ {
	compatible = "apple,j99a", "apple,s8001", "apple,arm-platform";
	model = "Apple iPad Pro (12.9-inch) (Cellular)";
};
