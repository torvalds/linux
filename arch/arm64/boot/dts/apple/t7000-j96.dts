// SPDX-License-Identifier: GPL-2.0+ OR MIT
/*
 * Apple iPad mini 4 (Wi-Fi), J96, iPad5,1 (A1538)
 * Copyright (c) 2022, Konrad Dybcio <konradybcio@kernel.org>
 */

/dts-v1/;

#include "t7000-mini4.dtsi"

/ {
	compatible = "apple,j96", "apple,t7000", "apple,arm-platform";
	model = "Apple iPad mini 4 (Wi-Fi)";
};
