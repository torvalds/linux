// SPDX-License-Identifier: GPL-2.0+ OR MIT
/*
 * Apple iPad 7 (Cellular), J172, iPad7,12 (A2198/A2200)
 * Copyright (c) 2022, Konrad Dybcio <konradybcio@kernel.org>
 */

/dts-v1/;

#include "t8010-ipad7.dtsi"

/ {
	compatible = "apple,j172", "apple,t8010", "apple,arm-platform";
	model = "Apple iPad 7 (Cellular)";
};
