// SPDX-License-Identifier: GPL-2.0+ OR MIT
/*
 * Apple T2 MacBookPro15,2 (j132), J132, iBridge2,4
 * Copyright (c) 2024, Nick Chan <towinchenmi@gmail.com>
 */

/dts-v1/;

#include "t8012-jxxx.dtsi"
#include "t8012-touchbar.dtsi"

/ {
	model = "Apple T2 MacBookPro15,2 (j132)";
	compatible = "apple,j132", "apple,t8012", "apple,arm-platform";
};
