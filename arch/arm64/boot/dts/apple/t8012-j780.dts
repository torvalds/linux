// SPDX-License-Identifier: GPL-2.0+ OR MIT
/*
 * Apple T2 MacBookPro15,3 (j780), J780, iBridge2,7
 * Copyright (c) 2024, Nick Chan <towinchenmi@gmail.com>
 */

/dts-v1/;

#include "t8012-jxxx.dtsi"
#include "t8012-touchbar.dtsi"

/ {
	model = "Apple T2 MacBookPro15,3 (j780)";
	compatible = "apple,j780", "apple,t8012", "apple,arm-platform";
};
