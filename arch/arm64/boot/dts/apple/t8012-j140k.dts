// SPDX-License-Identifier: GPL-2.0+ OR MIT
/*
 * Apple T2 MacBookAir8,1 (j140k), J140k, iBridge2,8
 * Copyright (c) 2024, Nick Chan <towinchenmi@gmail.com>
 */

/dts-v1/;

#include "t8012-jxxx.dtsi"

/ {
	model = "Apple T2 MacBookAir8,1 (j140k)";
	compatible = "apple,j140k", "apple,t8012", "apple,arm-platform";
};
