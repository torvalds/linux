// SPDX-License-Identifier: GPL-2.0+ OR MIT
/*
 * Apple iPhone 5s (GSM), N51, iPhone6,1 (A1453/A1533)
 * Copyright (c) 2022, Konrad Dybcio <konradybcio@kernel.org>
 */

/dts-v1/;

#include "s5l8960x-5s.dtsi"

/ {
	compatible = "apple,n51", "apple,s5l8960x", "apple,arm-platform";
	model = "Apple iPhone 5s (GSM)";
};
