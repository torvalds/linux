// SPDX-License-Identifier: GPL-2.0+ OR MIT
/*
 * MacBook Pro (14-inch, M1 Pro, 2021)
 *
 * target-type: J314s
 *
 * Copyright The Asahi Linux Contributors
 */

/dts-v1/;

#include "t6000.dtsi"
#include "t600x-j314-j316.dtsi"

/ {
	compatible = "apple,j314s", "apple,t6000", "apple,arm-platform";
	model = "Apple MacBook Pro (14-inch, M1 Pro, 2021)";
};

&wifi0 {
	brcm,board-type = "apple,maldives";
};
