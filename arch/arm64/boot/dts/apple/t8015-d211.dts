// SPDX-License-Identifier: GPL-2.0+ OR MIT
/*
 * Apple iPhone 8 Plus (GSM), D211 iPhone10,5 (A1899)
 * Copyright (c) 2022, Konrad Dybcio <konradybcio@kernel.org>
 */

/dts-v1/;

#include "t8015-8plus.dtsi"

/ {
	compatible = "apple,d211", "apple,t8015", "apple,arm-platform";
	model = "Apple iPhone 8 Plus (GSM)";
};
