// SPDX-License-Identifier: GPL-2.0+ OR MIT
/*
 * Apple T2 MacBookPro16,1 (j152f), J152f, iBridge2,14
 * Copyright (c) 2024, Nick Chan <towinchenmi@gmail.com>
 */

/dts-v1/;

#include "t8012-jxxx.dtsi"
#include "t8012-touchbar.dtsi"

/ {
	model = "Apple T2 MacBookPro16,1 (j152f)";
	compatible = "apple,j152f", "apple,t8012", "apple,arm-platform";
};
