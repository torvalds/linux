// SPDX-License-Identifier: GPL-2.0+ OR MIT
/*
 * Apple iPad mini 2 (Cellular), J86, iPad4,5 (A1490)
 * Copyright (c) 2022, Konrad Dybcio <konradybcio@kernel.org>
 */

/dts-v1/;

#include "s5l8960x-mini2.dtsi"

/ {
	compatible = "apple,j86", "apple,s5l8960x", "apple,arm-platform";
	model = "Apple iPad mini 2 (Cellular)";
};
