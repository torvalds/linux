// SPDX-License-Identifier: GPL-2.0+ OR MIT
/*
 * MacBook Pro (16-inch, M2 Max, 2022)
 *
 * target-type: J416c
 *
 * Copyright The Asahi Linux Contributors
 */

/dts-v1/;

#include "t6021.dtsi"
#include "t602x-j414-j416.dtsi"

/ {
	compatible = "apple,j416c", "apple,t6021", "apple,arm-platform";
	model = "Apple MacBook Pro (16-inch, M2 Max, 2023)";
};

&wifi0 {
	brcm,board-type = "apple,amami";
};

&bluetooth0 {
	brcm,board-type = "apple,amami";
};
