// SPDX-License-Identifier: GPL-2.0+ OR MIT
/*
 * Apple iPad Air (Wi-Fi), J71, iPad4,1 (A1474)
 * Copyright (c) 2022, Konrad Dybcio <konradybcio@kernel.org>
 */

/dts-v1/;

#include "s5l8960x-air1.dtsi"

/ {
	compatible = "apple,j71", "apple,s5l8960x", "apple,arm-platform";
	model = "Apple iPad Air (Wi-Fi)";
};
