// SPDX-License-Identifier: GPL-2.0+ OR MIT
/*
 * Apple T2 MacBookAir9,1 (j230k), J230k, iBridge2,15
 * Copyright (c) 2024, Nick Chan <towinchenmi@gmail.com>
 */

/dts-v1/;

#include "t8012-jxxx.dtsi"

/ {
	model = "Apple T2 MacBookAir9,1 (j230k)";
	compatible = "apple,j230k", "apple,t8012", "apple,arm-platform";
};
