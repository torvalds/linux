// SPDX-License-Identifier: GPL-2.0+ OR MIT
/*
 * Apple iPhone 8 (Global), D20 iPhone10,1 (A1863/A1906/A1907)
 * Copyright (c) 2022, Konrad Dybcio <konradybcio@kernel.org>
 */

/dts-v1/;

#include "t8015-8.dtsi"

/ {
	compatible = "apple,d20", "apple,t8015", "apple,arm-platform";
	model = "Apple iPhone 8 (Global)";
};
