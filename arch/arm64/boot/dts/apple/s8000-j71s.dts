// SPDX-License-Identifier: GPL-2.0+ OR MIT
/*
 * Apple iPad 5 (Wi-Fi) (Samsung), J71s, iPad6,11 (A1822)
 * Copyright (c) 2022, Konrad Dybcio <konradybcio@kernel.org>
 */

/dts-v1/;

#include "s8000.dtsi"
#include "s800x-ipad5.dtsi"

/ {
	compatible = "apple,j71s", "apple,s8000", "apple,arm-platform";
	model = "Apple iPad 5 (Wi-Fi) (Samsung)";
};
