// SPDX-License-Identifier: GPL-2.0+ OR MIT
/*
 * Apple iPhone 6s (Samsung), N71, iPhone8,1 (A1633/A1688/A1691/A1700)
 * Copyright (c) 2022, Konrad Dybcio <konradybcio@kernel.org>
 */

/dts-v1/;

#include "s8000.dtsi"
#include "s800x-6s.dtsi"

/ {
	compatible = "apple,n71", "apple,s8000", "apple,arm-platform";
	model = "Apple iPhone 6s (Samsung)";
};
