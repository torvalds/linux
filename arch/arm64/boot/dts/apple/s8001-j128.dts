// SPDX-License-Identifier: GPL-2.0+ OR MIT
/*
 * Apple iPad Pro (9.7-inch) (Cellular), J128, iPad6,4 (A1674/A1675)
 * Copyright (c) 2022, Konrad Dybcio <konradybcio@kernel.org>
 */

/dts-v1/;

#include "s8001-pro.dtsi"

/ {
	compatible = "apple,j128", "apple,s8001", "apple,arm-platform";
	model = "Apple iPad Pro (9.7-inch) (Cellular)";
};
