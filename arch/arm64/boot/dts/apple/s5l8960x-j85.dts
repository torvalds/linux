// SPDX-License-Identifier: GPL-2.0+ OR MIT
/*
 * Apple iPad mini 2 (Wi-Fi), J85, iPad4,4 (A1489)
 * Copyright (c) 2022, Konrad Dybcio <konradybcio@kernel.org>
 */

/dts-v1/;

#include "s5l8960x-mini2.dtsi"

/ {
	compatible = "apple,j85", "apple,s5l8960x", "apple,arm-platform";
	model = "Apple iPad mini 2 (Wi-Fi)";
};
