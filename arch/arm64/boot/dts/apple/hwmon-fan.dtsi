// SPDX-License-Identifier: GPL-2.0+ OR MIT
/*
 * Copyright The Asahi Linux Contributors
 *
 * Fan hwmon sensors for machines with a single fan.
 */

&smc_hwmon {
	fan-F0Ac {
		apple,key-id = "F0Ac";
		label = "Fan";
		apple,fan-minimum = "F0Mn";
		apple,fan-maximum = "F0Mx";
		apple,fan-target = "F0Tg";
		apple,fan-mode = "F0Md";
	};
};
