// SPDX-License-Identifier: GPL-2.0+ OR MIT
/*
 * Apple T2 iMac20,1 (j185), J185, iBridge2,19
 * Copyright (c) 2024, Nick Chan <towinchenmi@gmail.com>
 */

/dts-v1/;

#include "t8012-jxxx.dtsi"

/ {
	model = "Apple T2 iMac20,1 (j185)";
	compatible = "apple,j185", "apple,t8012", "apple,arm-platform";
};
