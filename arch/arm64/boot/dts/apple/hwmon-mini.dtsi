// SPDX-License-Identifier: GPL-2.0+ OR MIT
/*
 * hwmon sensors common to the Mac mini desktop
 * models, but not the Studio or Pro.
 *
 * Copyright The Asahi Linux Contributors
 */

#include "hwmon-fan.dtsi"

&smc_hwmon {
	temperature-TW0P {
		apple,key-id = "TW0P";
		label = "WiFi/BT Module Temp";
	};
};
