// SPDX-License-Identifier: GPL-2.0+ OR MIT
/*
 * Apple T2 iMacPro1,1 (j137), J137, iBridge2,1
 * Copyright (c) 2024, Nick Chan <towinchenmi@gmail.com>
 */

/dts-v1/;

#include "t8012-jxxx.dtsi"

/ {
	model = "Apple T2 iMacPro1,1 (j137)";
	compatible = "apple,j137", "apple,t8012", "apple,arm-platform";
};
