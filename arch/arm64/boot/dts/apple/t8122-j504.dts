// SPDX-License-Identifier: GPL-2.0+ OR MIT
/*
 * Apple MacBook Pro (14-inch, M3, 2023)
 *
 * target-type: J504
 *
 * Copyright The Asahi Linux Contributors
 */

/dts-v1/;

#include "t8122.dtsi"
#include "t8122-usbpd-i2c.dtsi"
#include "t8122-jxxx.dtsi"
#include <dt-bindings/leds/common.h>

/ {
	compatible = "apple,j504", "apple,t8122", "apple,arm-platform";
	model = "Apple MacBook Pro (14-inch, M3, 2023)";

	led-controller {
		compatible = "pwm-leds";

		led-0 {
			color = <LED_COLOR_ID_WHITE>;
			default-state = "keep";
			function = LED_FUNCTION_KBD_BACKLIGHT;
			label = "kbd_backlight";
			max-brightness = <255>;
			pwms = <&fpwm1 0 40000>;
		};
	};
};

&fpwm1 {
	status = "okay";
};
