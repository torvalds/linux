// SPDX-License-Identifier: GPL-2.0+ OR MIT
/*
 * Apple iPad Pro (9.7-inch) (Wi-Fi), J127, iPad6,3 (A1673)
 * Copyright (c) 2022, Konrad Dybcio <konradybcio@kernel.org>
 */

/dts-v1/;

#include "s8001-pro.dtsi"

/ {
	compatible = "apple,j127", "apple,s8001", "apple,arm-platform";
	model = "Apple iPad Pro (9.7-inch) (Wi-Fi)";
};
