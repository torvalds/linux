// SPDX-License-Identifier: GPL-2.0+ OR MIT
/*
 * Apple T2 iMac20,2 (j185f), J185f, iBridge2,20
 * Copyright (c) 2024, Nick Chan <towinchenmi@gmail.com>
 */

/dts-v1/;

#include "t8012-jxxx.dtsi"

/ {
	model = "Apple T2 iMac20,2 (j185f)";
	compatible = "apple,j185f", "apple,t8012", "apple,arm-platform";
};
