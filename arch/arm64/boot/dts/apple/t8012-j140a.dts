// SPDX-License-Identifier: GPL-2.0+ OR MIT
/*
 * Apple T2 MacBookAir8,2 (j140a), J140a, iBridge2,12
 * Copyright (c) 2024, Nick Chan <towinchenmi@gmail.com>
 */

/dts-v1/;

#include "t8012-jxxx.dtsi"

/ {
	model = "Apple T2 MacBookAir8,2 (j140a)";
	compatible = "apple,j140a", "apple,t8012", "apple,arm-platform";
};
