// SPDX-License-Identifier: GPL-2.0+ OR MIT
/*
 * Apple MacBook Air (15-inch, M4, 2025)
 *
 * target-type: J715
 *
 * Copyright The Asahi Linux Contributors
 */

/dts-v1/;

#include "t8132.dtsi"
#include "t8132-jxxx.dtsi"
#include <dt-bindings/leds/common.h>

/ {
	compatible = "apple,j715", "apple,t8132", "apple,arm-platform";
	model = "Apple MacBook Air (15-inch, M4, 2025)";

	led-controller {
		compatible = "pwm-leds";
		led-0 {
			pwms = <&fpwm1 0 40000>;
			label = "kbd_backlight";
			function = LED_FUNCTION_KBD_BACKLIGHT;
			color = <LED_COLOR_ID_WHITE>;
			max-brightness = <255>;
			default-state = "keep";
		};
	};
};

&fpwm1 {
	status = "okay";
};
