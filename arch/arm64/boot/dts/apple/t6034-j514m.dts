// SPDX-License-Identifier: GPL-2.0+ OR MIT
/*
 * MacBook Pro (14-inch, M3 Max, 14 CPU cores, Nov 2023)
 *
 * target-type: J514m
 *
 * Copyright The Asahi Linux Contributors
 */

/dts-v1/;

#include "t6034.dtsi"
#include "t603x-j514-j516.dtsi"

/ {
	compatible = "apple,j514m", "apple,t6034", "apple,arm-platform";
	model = "Apple MacBook Pro (14-inch, M3 Max, 14 CPU cores, Nov 2023)";
};
