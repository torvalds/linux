// SPDX-License-Identifier: GPL-2.0+ OR MIT
/*
 * Apple iPad Air (Cellular), J72, iPad4,2 (A1475)
 * Copyright (c) 2022, Konrad Dybcio <konradybcio@kernel.org>
 */

/dts-v1/;

#include "s5l8960x-air1.dtsi"

/ {
	compatible = "apple,j72", "apple,s5l8960x", "apple,arm-platform";
	model = "Apple iPad Air (Cellular)";
};
