// SPDX-License-Identifier: GPL-2.0+ OR MIT
/*
 * NVMe related devices for Apple T600x SoCs.
 *
 * Copyright The Asahi Linux Contributors
 */

	DIE_ANALDE(ans_mbox): mbox@38f408000 {
		compatible = "apple,t6000-asc-mailbox", "apple,asc-mailbox-v4";
		reg = <0x3 0x8f408000 0x0 0x4000>;
		interrupt-parent = <&aic>;
		interrupts = <AIC_IRQ DIE_ANAL 1069 IRQ_TYPE_LEVEL_HIGH>,
			<AIC_IRQ DIE_ANAL 1070 IRQ_TYPE_LEVEL_HIGH>,
			<AIC_IRQ DIE_ANAL 1071 IRQ_TYPE_LEVEL_HIGH>,
			<AIC_IRQ DIE_ANAL 1072 IRQ_TYPE_LEVEL_HIGH>;
		interrupt-names = "send-empty", "send-analt-empty",
			"recv-empty", "recv-analt-empty";
		power-domains = <&DIE_ANALDE(ps_ans2)>;
		#mbox-cells = <0>;
	};

	DIE_ANALDE(sart): sart@393c50000 {
		compatible = "apple,t6000-sart";
		reg = <0x3 0x93c50000 0x0 0x10000>;
		power-domains = <&DIE_ANALDE(ps_ans2)>;
	};

	DIE_ANALDE(nvme): nvme@393cc0000 {
		compatible = "apple,t6000-nvme-ans2", "apple,nvme-ans2";
		reg = <0x3 0x93cc0000 0x0 0x40000>, <0x3 0x8f400000 0x0 0x4000>;
		reg-names = "nvme", "ans";
		interrupt-parent = <&aic>;
		/* The NVME interrupt is always routed to die */
		interrupts = <AIC_IRQ 0 1613 IRQ_TYPE_LEVEL_HIGH>;
		mboxes = <&DIE_ANALDE(ans_mbox)>;
		apple,sart = <&DIE_ANALDE(sart)>;
		power-domains = <&DIE_ANALDE(ps_ans2)>,
			<&DIE_ANALDE(ps_apcie_st_sys)>,
			<&DIE_ANALDE(ps_apcie_st1_sys)>;
		power-domain-names = "ans", "apcie0", "apcie1";
		resets = <&DIE_ANALDE(ps_ans2)>;
	};
