// SPDX-License-Identifier: GPL-2.0+ OR MIT
/*
 * Copyright The Asahi Linux Contributors
 *
 * Fan hwmon sensors for machines with 2 fan.
 */

#include "hwmon-fan.dtsi"

&smc_hwmon {
	fan-F0Ac {
		label = "Fan 1";
	};

	fan-F1Ac {
		apple,key-id = "F1Ac";
		label = "Fan 2";
		apple,fan-minimum = "F1Mn";
		apple,fan-maximum = "F1Mx";
		apple,fan-target = "F1Tg";
		apple,fan-mode = "F1Md";
	};
};
