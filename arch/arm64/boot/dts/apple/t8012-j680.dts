// SPDX-License-Identifier: GPL-2.0+ OR MIT
/*
 * Apple T2 MacBookPro15,1 (j680), J680, iBridge2,3
 * Copyright (c) 2024, Nick Chan <towinchenmi@gmail.com>
 */

/dts-v1/;

#include "t8012-jxxx.dtsi"
#include "t8012-touchbar.dtsi"

/ {
	model = "Apple T2 MacBookPro15,1 (j680)";
	compatible = "apple,j680", "apple,t8012", "apple,arm-platform";
};
