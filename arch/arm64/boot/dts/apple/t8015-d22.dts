// SPDX-License-Identifier: GPL-2.0+ OR MIT
/*
 * Apple iPhone X (Global), D22, iPhone10,3 (A1865)
 * Copyright (c) 2022, Konrad Dybcio <konradybcio@kernel.org>
 */

/dts-v1/;

#include "t8015-x.dtsi"

/ {
	compatible = "apple,d22", "apple,t8015", "apple,arm-platform";
	model = "Apple iPhone X (Global)";
};
