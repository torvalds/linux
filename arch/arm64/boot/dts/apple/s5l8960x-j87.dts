// SPDX-License-Identifier: GPL-2.0+ OR MIT
/*
 * Apple iPad mini 2 (Cellular, China), J87, iPad4,6 (A1491)
 * Copyright (c) 2022, Konrad Dybcio <konradybcio@kernel.org>
 */

/dts-v1/;

#include "s5l8960x-mini2.dtsi"

/ {
	compatible = "apple,j87", "apple,s5l8960x", "apple,arm-platform";
	model = "Apple iPad mini 2 (Cellular, China)";
};
