// SPDX-License-Identifier: GPL-2.0+ OR MIT
/*
 * Apple T2 Macmini8,1 (j174), J174, iBridge2,5
 * Copyright (c) 2024, Nick Chan <towinchenmi@gmail.com>
 */

/dts-v1/;

#include "t8012-jxxx.dtsi"

/ {
	model = "Apple T2 Macmini8,1 (j174)";
	compatible = "apple,j174", "apple,t8012", "apple,arm-platform";
};
