// SPDX-License-Identifier: GPL-2.0+ OR MIT
/*
 * Apple iPad mini 3 (Cellular), J86m, iPad4,8 (A1600)
 * Copyright (c) 2022, Konrad Dybcio <konradybcio@kernel.org>
 */

/dts-v1/;

#include "s5l8960x-mini3.dtsi"

/ {
	compatible = "apple,j86m", "apple,s5l8960x", "apple,arm-platform";
	model = "Apple iPad mini 3 (Cellular)";
};
