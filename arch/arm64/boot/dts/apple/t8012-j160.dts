// SPDX-License-Identifier: GPL-2.0+ OR MIT
/*
 * Apple T2 MacPro7,1 (j160), J160, iBridge2,6
 * Copyright (c) 2024, Nick Chan <towinchenmi@gmail.com>
 */

/dts-v1/;

#include "t8012-jxxx.dtsi"

/ {
	model = "Apple T2 MacPro7,1 (j160)";
	compatible = "apple,j160", "apple,t8012", "apple,arm-platform";
};
