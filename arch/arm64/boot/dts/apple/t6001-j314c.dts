// SPDX-License-Identifier: GPL-2.0+ OR MIT
/*
 * MacBook Pro (14-inch, M1 Max, 2021)
 *
 * target-type: J314c
 *
 * Copyright The Asahi Linux Contributors
 */

/dts-v1/;

#include "t6001.dtsi"
#include "t600x-j314-j316.dtsi"

/ {
	compatible = "apple,j314c", "apple,t6001", "apple,arm-platform";
	model = "Apple MacBook Pro (14-inch, M1 Max, 2021)";
};
