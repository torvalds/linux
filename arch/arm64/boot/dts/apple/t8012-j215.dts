// SPDX-License-Identifier: GPL-2.0+ OR MIT
/*
 * Apple T2 MacBookPro16,4 (j215), J215, iBridge2,22
 * Copyright (c) 2024, Nick Chan <towinchenmi@gmail.com>
 */

/dts-v1/;

#include "t8012-jxxx.dtsi"
#include "t8012-touchbar.dtsi"

/ {
	model = "Apple T2 MacBookPro16,4 (j215)";
	compatible = "apple,j215", "apple,t8012", "apple,arm-platform";
};
