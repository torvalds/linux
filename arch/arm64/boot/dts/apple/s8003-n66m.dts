// SPDX-License-Identifier: GPL-2.0+ OR MIT
/*
 * Apple iPhone 6s Plus (TSMC), N66m, iPhone8,2 (A1634/A1687/A1690/A1699)
 * Copyright (c) 2022, Konrad Dybcio <konradybcio@kernel.org>
 */

/dts-v1/;

#include "s8003.dtsi"
#include "s800x-6s.dtsi"

/ {
	compatible = "apple,n66m", "apple,s8003", "apple,arm-platform";
	model = "Apple iPhone 6s Plus (TSMC)";
};
