// SPDX-License-Identifier: GPL-2.0+ OR MIT
/*
 * Apple iPad 7 (Wi-Fi), J171, iPad7,11 (A2197)
 * Copyright (c) 2022, Konrad Dybcio <konradybcio@kernel.org>
 */

/dts-v1/;

#include "t8010-ipad7.dtsi"

/ {
	compatible = "apple,j171", "apple,t8010", "apple,arm-platform";
	model = "Apple iPad 7 (Wi-Fi)";
};
