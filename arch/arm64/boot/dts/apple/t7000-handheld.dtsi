// SPDX-License-Identifier: GPL-2.0+ OR MIT
/*
 * Apple iPhone 6, iPhone 6 Plus, iPad mini 4, iPod touch 6
 *
 * This file contains the parts common to handheld devices with t7000
 *
 * target-type: J96, J97, N56, N61, N102
 *
 * Copyright (c) 2024, Nick Chan <towinchenmi@gmail.com>
 */

/ {
	chosen {
		stdout-path = "serial0";

		framebuffer0: framebuffer@0 {
			compatible = "apple,simple-framebuffer", "simple-framebuffer";
			reg = <0 0 0 0>; /* To be filled by loader */
			/* Format properties will be added by loader */
			status = "disabled";
		};
	};
};

&serial0 {
	status = "okay";
};
