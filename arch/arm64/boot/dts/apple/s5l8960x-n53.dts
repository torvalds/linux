// SPDX-License-Identifier: GPL-2.0+ OR MIT
/*
 * Apple iPhone 5s (LTE), N53, iPhone6,2 (A1457/A1518/A1528/A1530)
 * Copyright (c) 2022, Konrad Dybcio <konradybcio@kernel.org>
 */

/dts-v1/;

#include "s5l8960x-5s.dtsi"

/ {
	compatible = "apple,n53", "apple,s5l8960x", "apple,arm-platform";
	model = "Apple iPhone 5s (LTE)";
};
