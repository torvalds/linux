// SPDX-License-Identifier: GPL-2.0-or-later OR MIT

#include "bcm4908.dtsi"

/ {
	cpus {
		/delete-node/ cpu@2;

		/delete-node/ cpu@3;
	};

	pmu {
		compatible = "arm,cortex-a53-pmu";
		interrupts = <GIC_SPI 9 IRQ_TYPE_LEVEL_HIGH>,
			     <GIC_SPI 10 IRQ_TYPE_LEVEL_HIGH>;
		interrupt-affinity = <&cpu0>, <&cpu1>;
	};
};
