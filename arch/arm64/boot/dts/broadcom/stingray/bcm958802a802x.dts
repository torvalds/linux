// SPDX-License-Identifier: (GPL-2.0 or BSD-3-Clause)
/*
 *Copyright(c) 2018 Broadcom
 */

/dts-v1/;

#include "stingray-board-base.dtsi"

/ {
	compatible = "brcm,bcm958802a802x", "brcm,stingray";
	model = "Stingray PS225xx (BCM958802A802x)";
};

&enet {
	status = "disabled";
};

&sdio0 {
	no-1-8-v;
	status = "okay";
};

&uart0 {
	status = "okay";
};
