// SPDX-License-Identifier: (GPL-2.0 OR MIT)

rp1_nexus {
	compatible = "pci1de4,1";
	#address-cells = <3>;
	#size-cells = <2>;
	ranges = <0x01 0x00 0x00000000
		  0x02000000 0x00 0x00000000
		  0x0 0x400000>;
	interrupt-controller;
	#interrupt-cells = <2>;

	#include "rp1-common.dtsi"
};
