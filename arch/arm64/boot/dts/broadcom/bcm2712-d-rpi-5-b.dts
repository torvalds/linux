// SPDX-License-Identifier: (GPL-2.0 OR MIT)
/dts-v1/;

#include "bcm2712-rpi-5-b.dts"

&gio_aon {
	brcm,gpio-bank-widths = <15 6>;

	gpio-line-names =
		"RP1_SDA", // AON_GPIO_00
		"RP1_SCL", // AON_GPIO_01
		"RP1_RUN", // AON_GPIO_02
		"SD_IOVDD_SEL", // AON_GPIO_03
		"SD_PWR_ON", // AON_GPIO_04
		"SD_CDET_N", // AON_GPIO_05
		"SD_FLG_N", // AON_GPIO_06
		"", // AON_GPIO_07
		"2712_WAKE", // AON_GPIO_08
		"2712_STAT_LED", // AON_GPIO_09
		"", // AON_GPIO_10
		"", // AON_GPIO_11
		"PMIC_INT", // AON_GPIO_12
		"UART_TX_FS", // AON_GPIO_13
		"UART_RX_FS", // AON_GPIO_14
		"", // AON_GPIO_15
		"", // AON_GPIO_16

		// Pad bank0 out to 32 entries
		"", "", "", "", "", "", "", "", "", "", "", "", "", "", "",

		"HDMI0_SCL", // AON_SGPIO_00
		"HDMI0_SDA", // AON_SGPIO_01
		"HDMI1_SCL", // AON_SGPIO_02
		"HDMI1_SDA", // AON_SGPIO_03
		"PMIC_SCL", // AON_SGPIO_04
		"PMIC_SDA"; // AON_SGPIO_05
};
