// SPDX-License-Identifier: GPL-2.0
/*
 * Copyright 2020 Amazon.com, Inc. or its affiliates. All Rights Reserved.
 */

#include "alpine-v3.dtsi"

/ {
	model = "Amazon's Annapurna Labs Alpine v3 Evaluation Platform (EVP)";
	compatible = "amazon,al-alpine-v3-evp", "amazon,al-alpine-v3";

	aliases {
		serial0 = &uart0;
		serial1 = &uart1;
		serial2 = &uart2;
		serial3 = &uart3;
	};

	chosen {
		stdout-path = "serial0:115200n8";
	};
};

&uart0 { status = "okay"; };
