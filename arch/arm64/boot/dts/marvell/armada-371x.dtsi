// SPDX-License-Identifier: (GPL-2.0+ OR MIT)
/*
 * Device Tree Include file for Marvell Armada 371x family of SoCs
 * (also named 88F3710)
 *
 * Copyright (C) 2016 Marvell
 *
 * Gregory CLEMENT <gregory.clement@free-electrons.com>
 *
 */

#include "armada-37xx.dtsi"

/ {
	model = "Marvell Armada 3710 SoC";
	compatible = "marvell,armada3710", "marvell,armada3700";
};
