// SPDX-License-Identifier: (GPL-2.0+ OR MIT)
/*
 * Copyright (C) 2019 Marvell Technology Group Ltd.
 *
 * Device Tree file for Marvell Armada CP115.
 */

#define CP11X_TYPE cp115

#include "armada-cp11x.dtsi"

#undef CP11X_TYPE
