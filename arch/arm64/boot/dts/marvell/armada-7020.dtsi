// SPDX-License-Identifier: (GPL-2.0+ OR MIT)
/*
 * Copyright (C) 2016 Marvell Technology Group Ltd.
 *
 * Device Tree file for the Armada 7020 SoC, made of an AP806 Dual and
 * one CP110.
 */

#include "armada-ap806-dual.dtsi"
#include "armada-70x0.dtsi"
