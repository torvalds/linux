// SPDX-License-Identifier: (GPL-2.0+ OR MIT)
/*
 * Device Tree Include file for Marvell Armada 372x family of SoCs
 * (also named 88F3720)
 *
 * Copyright (C) 2016 Marvell
 *
 * Gregory CLEMENT <gregory.clement@free-electrons.com>
 *
 */

#include "armada-37xx.dtsi"

/ {
	model = "Marvell Armada 3720 SoC";
	compatible = "marvell,armada3720", "marvell,armada3710";

	cpus {
		cpu1: cpu@1 {
			device_type = "cpu";
			compatible = "arm,cortex-a53";
			reg = <0x1>;
			clocks = <&nb_periph_clk 16>;
			enable-method = "psci";
		};
	};
};
