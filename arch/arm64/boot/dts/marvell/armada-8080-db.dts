// SPDX-License-Identifier: (GPL-2.0+ OR MIT)
/*
 * Copyright (C) 2017 Marvell Technology Group Ltd.
 *
 * Device Tree file for Marvell Armada-8080 Development board platform
 */

#include "armada-8080.dtsi"

/ {
	model = "Marvell 8080 board";
	compatible = "marvell,armada-8080-db", "marvell,armada-8080",
		     "marvell,armada-ap810-octa", "marvell,armada-ap810";

	chosen {
		stdout-path = "serial0:115200n8";
	};

	memory@0 {
		device_type = "memory";
		reg = <0x0 0x0 0x0 0x80000000>;
	};
};

&uart0_ap0 {
	clock-frequency = <384000>;
	status = "okay";
};
