// SPDX-License-Identifier: (GPL-2.0+ OR MIT)
/*
 * Copyright (C) 2017 Marvell Technology Group Ltd.
 *
 * Device Tree file for Marvell Armada-8080 SoC, made of an AP810 OCTA.
 */

#include "armada-ap810-ap0-octa-core.dtsi"
