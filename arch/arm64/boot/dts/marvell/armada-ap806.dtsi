// SPDX-License-Identifier: (GPL-2.0+ OR MIT)
/*
 * Copyright (C) 2016 Marvell Technology Group Ltd.
 *
 * Device Tree file for Marvell Armada AP806.
 */

#include "armada-ap80x.dtsi"

&ap_syscon0 {
	ap_clk: clock {
		compatible = "marvell,ap806-clock";
		#clock-cells = <1>;
	};
};

&ap_syscon1 {
	cpu_clk: clock-cpu@278 {
		compatible = "marvell,ap806-cpu-clock";
		clocks = <&ap_clk 0>, <&ap_clk 1>;
		#clock-cells = <1>;
		reg = <0x278 0xa30>;
	};
};
