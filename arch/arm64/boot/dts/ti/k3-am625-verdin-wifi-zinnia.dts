// SPDX-License-Identifier: GPL-2.0-or-later OR MIT
/*
 * Copyright (c) Toradex
 *
 * https://www.toradex.com/computer-on-modules/verdin-arm-family/ti-am62
 * https://www.toradex.com/products/carrier-board/zinnia-carrier-board
 */

/dts-v1/;

#include "k3-am625.dtsi"
#include "k3-am62-verdin.dtsi"
#include "k3-am62-verdin-wifi.dtsi"
#include "k3-am62-verdin-zinnia.dtsi"

/ {
	model = "Toradex Verdin AM62 WB on Zinnia Board";
	compatible = "toradex,verdin-am62-wifi-zinnia",
		     "toradex,verdin-am62-wifi",
		     "toradex,verdin-am62",
		     "ti,am625";
};
