// SPDX-License-Identifier: GPL-2.0-only OR MIT
/*
 * Copyright (C) 2024 Texas Instruments Incorporated - https://www.ti.com/
 *
 * EVM Board Schematics: https://www.ti.com/lit/zip/SPAC001
 */

/dts-v1/;

#include <dt-bindings/net/ti-dp83867.h>
#include <dt-bindings/gpio/gpio.h>
#include "k3-j742s2.dtsi"
#include "k3-j784s4-j742s2-evm-common.dtsi"

/ {
	model = "Texas Instruments J742S2 EVM";
	compatible = "ti,j742s2-evm", "ti,j742s2";

	memory@80000000 {
		/* 16G RAM */
		reg = <0x00000000 0x80000000 0x00000000 0x80000000>,
		      <0x00000008 0x80000000 0x00000003 0x80000000>;
		device_type = "memory";
		bootph-all;
	};
};
