// SPDX-License-Identifier: GPL-2.0-only OR MIT
/*
 * Device Tree Source for J742S2 SoC Family
 *
 * TRM: https://www.ti.com/lit/pdf/spruje3
 *
 * Copyright (C) 2025 Texas Instruments Incorporated - https://www.ti.com/
 *
 */

&mcu_r5fss0_core0 {
	firmware-name = "j742s2-mcu-r5f0_0-fw";
};

&mcu_r5fss0_core1 {
	firmware-name = "j742s2-mcu-r5f0_1-fw";
};
