// SPDX-License-Identifier: GPL-2.0-only OR MIT
/*
 * Copyright (C) 2022-2024 PHYTEC Messtechnik GmbH
 * Author: Wadim Egorov <w.egorov@phytec.de>
 *
 * Product homepage:
 * https://www.phytec.com/product/phyboard-am62x
 */

#include "k3-am625.dtsi"
#include "k3-am62-phycore-som.dtsi"
#include "k3-am62x-phyboard-lyra.dtsi"

/ {
	compatible = "phytec,am625-phyboard-lyra-rdk",
		     "phytec,am62-phycore-som", "ti,am625";
	model = "PHYTEC phyBOARD-Lyra AM625";
};
