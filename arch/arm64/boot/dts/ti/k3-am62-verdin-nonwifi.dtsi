// SPDX-License-Identifier: GPL-2.0-or-later OR MIT
/*
 * Copyright 2023 Toradex
 *
 * Common dtsi for Verdin AM62 SoM non-WB variant
 *
 * https://www.toradex.com/computer-on-modules/verdin-arm-family/ti-am62
 */

&sdhci2 {
	pinctrl-0 = <&pinctrl_sdhci2>;
	bus-width = <4>;
	status = "disabled";
};

&main_uart5 {
	pinctrl-names = "default";
	pinctrl-0 = <&pinctrl_uart5>;
	status = "disabled";
};
