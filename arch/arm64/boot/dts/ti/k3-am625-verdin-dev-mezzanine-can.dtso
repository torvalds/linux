// SPDX-License-Identifier: GPL-2.0-or-later OR MIT
/*
 * Copyright (c) Toradex
 *
 * Enable AM62 MCU_MCAN1 exposed on Toradex Verdin Development Board with
 * Verdin AM62 Mezzanine expansion board on CAN Header (J13),
 * Pin 3 (CAN1_CONN_N) and Pin 4 (CAN1_CONN_P).
 */

/dts-v1/;
/plugin/;

#include "k3-pinctrl.h"

&mcu_pmx0 {
	pinctrl_mcu_mcan1: mcu-mcan1-default-pins {
		pinctrl-single,pins = <
			AM62X_MCU_IOPAD(0x0040, PIN_INPUT,  0) /* (D4) MCU_MCAN1_RX (SODIMM 116) */
			AM62X_MCU_IOPAD(0x003c, PIN_OUTPUT, 0) /* (E5) MCU_MCAN1_TX (SODIMM 128) */
		>;
	};
};

&mcu_mcan1 {
	pinctrl-names = "default";
	pinctrl-0 = <&pinctrl_mcu_mcan1>;
	status = "okay";
};
