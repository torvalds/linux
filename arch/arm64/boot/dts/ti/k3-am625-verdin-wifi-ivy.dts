// SPDX-License-Identifier: GPL-2.0-or-later OR MIT
/*
 * Copyright 2024 Toradex
 *
 * https://www.toradex.com/computer-on-modules/verdin-arm-family/ti-am62
 * https://www.toradex.com/products/carrier-board/ivy-carrier-board
 */

/dts-v1/;

#include "k3-am625.dtsi"
#include "k3-am62-verdin.dtsi"
#include "k3-am62-verdin-wifi.dtsi"
#include "k3-am62-verdin-ivy.dtsi"

/ {
	model = "Toradex Verdin AM62 WB on Ivy Board";
	compatible = "toradex,verdin-am62-wifi-ivy",
		     "toradex,verdin-am62-wifi",
		     "toradex,verdin-am62",
		     "ti,am625";
};
