// SPDX-License-Identifier: GPL-2.0-only OR MIT
/*
 * Copyright (C) 2024 PHYTEC America LLC
 * Author: Nathan Morrisson <nmorrisson@phytec.com>
 */

/dts-v1/;
/plugin/;

#include "k3-pinctrl.h"

&serial_flash {
	spi-tx-bus-width = <1>;
	spi-rx-bus-width = <4>;
};
