// SPDX-License-Identifier: GPL-2.0-or-later OR MIT
/*
 * Copyright 2025 Toradex
 *
 * https://www.toradex.com/computer-on-modules/verdin-arm-family/ti-am62p
 * https://www.toradex.com/products/carrier-board/ivy-carrier-board
 */

/dts-v1/;

#include "k3-am62p5.dtsi"
#include "k3-am62p-verdin.dtsi"
#include "k3-am62p-verdin-wifi.dtsi"
#include "k3-am62p-verdin-ivy.dtsi"

/ {
	model = "Toradex Verdin AM62P WB on Ivy Board";
	compatible = "toradex,verdin-am62p-wifi-ivy",
		     "toradex,verdin-am62p-wifi",
		     "toradex,verdin-am62p",
		     "ti,am62p5";
};
