// SPDX-License-Identifier: GPL-2.0-or-later OR MIT
/*
 * Copyright 2023 Toradex
 *
 * https://www.toradex.com/computer-on-modules/verdin-arm-family/ti-am62
 * https://www.toradex.com/products/carrier-board/dahlia-carrier-board-kit
 */

/dts-v1/;

#include "k3-am625.dtsi"
#include "k3-am62-verdin.dtsi"
#include "k3-am62-verdin-nonwifi.dtsi"
#include "k3-am62-verdin-dahlia.dtsi"

/ {
	model = "Toradex Verdin AM62 on Dahlia Board";
	compatible = "toradex,verdin-am62-nonwifi-dahlia",
		     "toradex,verdin-am62-nonwifi",
		     "toradex,verdin-am62",
		     "ti,am625";
};
