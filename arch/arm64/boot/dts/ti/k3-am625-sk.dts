// SPDX-License-Identifier: GPL-2.0-only OR MIT
/*
 * AM625 SK: https://www.ti.com/lit/zip/sprr448
 *
 * Copyright (C) 2021-2024 Texas Instruments Incorporated - https://www.ti.com/
 */

/dts-v1/;

#include "k3-am625.dtsi"
#include "k3-am625-sk-common.dtsi"

/ {
	compatible = "ti,am625-sk", "ti,am625";
	model = "Texas Instruments AM625 SK";

	memory@80000000 {
		/* 2G RAM */
		reg = <0x00000000 0x80000000 0x00000000 0x80000000>;
		device_type = "memory";
		bootph-pre-ram;
	};
};
