// SPDX-License-Identifier: GPL-2.0-only OR MIT
/*
 * Copyright (C) 2023 PHYTEC America, LLC
 * Author: Garrett Giordano <ggiordano@phytec.com>
 *
 * Copyright (C) 2024 PHYTEC America, LLC
 * Author: Nathan Morrisson <nmorrisson@phytec.com>
 */

/dts-v1/;
/plugin/;

&cpsw3g_phy1 {
	status = "disabled";
};

&cpsw_port1 {
	status = "disabled";
};
