// SPDX-License-Identifier: GPL-2.0-only OR MIT
/**
 * DT Overlay for enabling USB0 instance of USB in the Host Mode of operation
 * with the Type-A Connector on the J7 common processor board.
 *
 * J7 Common Processor Board Product Link: https://www.ti.com/tool/J721EXCPXEVM
 *
 * Copyright (C) 2025 Texas Instruments Incorporated - https://www.ti.com/
 */

/dts-v1/;
/plugin/;

#include <dt-bindings/gpio/gpio.h>

&exp_som {
	p0-hog {
		/* P0 - USB2.0_MUX_SEL */
		gpio-hog;
		gpios = <0 GPIO_ACTIVE_HIGH>;
		output-high;
		line-name = "USB2.0_MUX_SEL";
	};
};

&usb0 {
	dr_mode = "host";
};
