// SPDX-License-Identifier: GPL-2.0
/*
 * IOT2050 M.2 variant, overlay for B-key PCIE0_LANE0 + E-key PCIE1_LANE0
 * Copyright (c) Siemens AG, 2022-2024
 *
 * Authors:
 *   Chao Zeng <chao.zeng@siemens.com>
 *   Jan Kiszka <jan.kiszka@siemens.com>
 */

/dts-v1/;
/plugin/;

#include <dt-bindings/phy/phy.h>
#include <dt-bindings/gpio/gpio.h>

&pcie0_rc {
	num-lanes = <1>;
	phys = <&serdes0 PHY_TYPE_PCIE 1>;
	phy-names = "pcie-phy0";
	reset-gpios = <&main_gpio1 15 GPIO_ACTIVE_HIGH>;
	status = "okay";
};

&pcie1_rc {
	status = "okay";
};
