// SPDX-License-Identifier: GPL-2.0-only OR MIT
/*
 * Device Tree file for the J722S MCU domain peripherals
 *
 * Copyright (C) 2026 Texas Instruments Incorporated - https://www.ti.com/
 * Copyright (C) 2026 Bootlin
 */

&mcu_pmx0 {
	compatible = "ti,j7200-padconf", "pinctrl-single";
};

&mcu_r5fss0_core0 {
	firmware-name = "j722s-mcu-r5f0_0-fw";
};
