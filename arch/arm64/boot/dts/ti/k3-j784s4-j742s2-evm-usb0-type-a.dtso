// SPDX-License-Identifier: GPL-2.0-only OR MIT
/**
 * DT Overlay for enabling USB0 instance of USB on J784S4 and J742S2 EVMs for
 * Host Mode of operation with the Type-A Connector.
 *
 * J784S4 EVM Product Link: https://www.ti.com/tool/J784S4XEVM
 * J742S2 EVM Product Link: https://www.ti.com/tool/J742S2XH01EVM
 *
 * Copyright (C) 2025 Texas Instruments Incorporated - https://www.ti.com/
 */

/dts-v1/;
/plugin/;

#include <dt-bindings/gpio/gpio.h>

&exp2 {
	p12-hog {
		/* P12 - USB2.0_MUX_SEL */
		gpio-hog;
		gpios = <12 GPIO_ACTIVE_HIGH>;
		output-high;
		line-name = "USB2.0_MUX_SEL";
	};
};

&usb0 {
	dr_mode = "host";
};
