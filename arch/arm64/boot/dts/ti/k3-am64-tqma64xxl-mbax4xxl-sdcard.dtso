// SPDX-License-Identifier: GPL-2.0-only
/*
 * Copyright (c) 2022-2023 TQ-Systems GmbH <linux@ew.tq-group.com>, D-82229 Seefeld, Germany.
 */

/dts-v1/;
/plugin/;

&sdhci1 {
	vmmc-supply = <&reg_sd>;
	no-sdio;
	status = "okay";
};

&main_gpio0 {
	line43-hog {
		gpio-hog;
		gpios = <43 0>;
		line-name = "MMC1_CTRL";
		output-low;
	};
};
