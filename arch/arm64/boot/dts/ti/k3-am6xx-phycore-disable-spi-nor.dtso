// SPDX-License-Identifier: GPL-2.0-only OR MIT
/*
 * Copyright (C) 2023 PHYTEC America, LLC
 * Author: Garrett Giordano <ggiordano@phytec.com>
 *
 * Copyright (C) 2024 PHYTEC America, LLC
 * Author: Nathan Morrisson <nmorrisson@phytec.com>
 */

/dts-v1/;
/plugin/;

&serial_flash {
	status = "disabled";
};
