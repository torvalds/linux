// SPDX-License-Identifier: GPL-2.0-or-later OR MIT
/*
 * Copyright 2025 Toradex
 *
 * https://www.toradex.com/computer-on-modules/verdin-arm-family/ti-am62p
 * https://www.toradex.com/products/carrier-board/mallow-carrier-board
 */

/dts-v1/;

#include "k3-am62p5.dtsi"
#include "k3-am62p-verdin.dtsi"
#include "k3-am62p-verdin-nonwifi.dtsi"
#include "k3-am62p-verdin-mallow.dtsi"

/ {
	model = "Toradex Verdin AM62P on Mallow Board";
	compatible = "toradex,verdin-am62p-nonwifi-mallow",
		     "toradex,verdin-am62p-nonwifi",
		     "toradex,verdin-am62p",
		     "ti,am62p5";
};
