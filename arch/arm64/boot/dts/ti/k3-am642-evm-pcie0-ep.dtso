// SPDX-License-Identifier: GPL-2.0-only OR MIT
/**
 * DT Overlay for enabling PCIE0 instance in Endpoint Configuration with the
 * AM642 EVM.
 *
 * AM642 EVM Product Link: https://www.ti.com/tool/TMDS64EVM
 *
 * Copyright (C) 2024 Texas Instruments Incorporated - https://www.ti.com/
 */

/dts-v1/;
/plugin/;

#include <dt-bindings/interrupt-controller/arm-gic.h>
#include <dt-bindings/soc/ti,sci_pm_domain.h>

#include "k3-pinctrl.h"

/*
 * Since Root Complex and Endpoint modes are mutually exclusive
 * disable Root Complex mode.
 */
&pcie0_rc {
	status = "disabled";
};

&cbass_main {
	#address-cells = <2>;
	#size-cells = <2>;
	interrupt-parent = <&gic500>;

	pcie0_ep: pcie-ep@f102000 {
		compatible = "ti,am64-pcie-ep", "ti,j721e-pcie-ep";
		reg = <0x00 0x0f102000 0x00 0x1000>,
		      <0x00 0x0f100000 0x00 0x400>,
		      <0x00 0x0d000000 0x00 0x00800000>,
		      <0x00 0x68000000 0x00 0x08000000>;
		reg-names = "intd_cfg", "user_cfg", "reg", "mem";
		interrupt-names = "link_state";
		interrupts = <GIC_SPI 203 IRQ_TYPE_EDGE_RISING>;
		max-link-speed = <2>;
		num-lanes = <1>;
		power-domains = <&k3_pds 114 TI_SCI_PD_EXCLUSIVE>;
		clocks = <&k3_clks 114 0>;
		clock-names = "fck";
		max-functions = /bits/ 8 <1>;
		phys = <&serdes0_pcie_link>;
		phy-names = "pcie-phy";
		ti,syscon-pcie-ctrl = <&main_conf 0x4070>;
	};
};
