// SPDX-License-Identifier: (GPL-2.0 OR MIT)
/*
 * Copyright (C) 2025 MediaTek Inc.
 * Author: Frank Wunderlich <frank-w@public-files.de>
 */

/dts-v1/;

#include "mt7988a-bananapi-bpi-r4-pro.dtsi"

/ {
	model = "Bananapi BPI-R4";
	compatible = "bananapi,bpi-r4-pro-4e",
		     "bananapi,bpi-r4-pro",
		     "mediatek,mt7988a";
};
