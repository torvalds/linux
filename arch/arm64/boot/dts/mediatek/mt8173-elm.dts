// SPDX-License-Identifier: GPL-2.0-only
/*
 * Copyright 2016 MediaTek Inc.
 */

/dts-v1/;
#include "mt8173-elm.dtsi"

/ {
	model = "Google Elm";
	compatible = "google,elm-rev8", "google,elm-rev7", "google,elm-rev6",
		     "google,elm-rev5", "google,elm-rev4", "google,elm-rev3",
		     "google,elm", "mediatek,mt8173";
};
