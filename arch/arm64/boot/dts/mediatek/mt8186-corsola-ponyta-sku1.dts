// SPDX-License-Identifier: (GPL-2.0 OR MIT)
/*
 * Copyright 2023 Google LLC
 */

/dts-v1/;
#include "mt8186-corsola-ponyta.dtsi"

/ {
	model = "Google Ponyta sku1 board";
	compatible = "google,ponyta-sku1", "google,ponyta", "mediatek,mt8186";
};

&i2c2 {
	trackpad@2c {
		status = "disabled";
	};
};

&usb_c1 {
	status = "disabled";
};
