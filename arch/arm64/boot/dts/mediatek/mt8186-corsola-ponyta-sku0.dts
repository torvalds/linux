// SPDX-License-Identifier: (GPL-2.0 OR MIT)
/*
 * Copyright 2023 Google LLC
 */

/dts-v1/;
#include "mt8186-corsola-ponyta.dtsi"

/ {
	model = "Google Ponyta sku0 board";
	compatible = "google,ponyta-sku0", "google,ponyta", "mediatek,mt8186";
};

&i2c2 {
	trackpad@15 {
		status = "disabled";
	};
};
