// SPDX-License-Identifier: (GPL-2.0 OR MIT)
/*
 * Copyright 2022 Google LLC
 */

/dts-v1/;
#include "mt8186-corsola-voltorb.dtsi"

/ {
	model = "Google Voltorb sku589824 board";
	compatible = "google,voltorb-sku589824", "google,voltorb",
		     "mediatek,mt8186";
};
