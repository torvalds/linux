// SPDX-License-Identifier: (GPL-2.0 OR MIT)
/*
 * Copyright (C) 2023 MediaTek Inc.
 * Author: Frank Wunderlich <frank-w@public-files.de>
 */

/dts-v1/;
/plugin/;

#include <dt-bindings/gpio/gpio.h>

/ {
	compatible = "bananapi,bpi-r4", "mediatek,mt7988a";
};

&{/soc/mmc@11230000} {
	pinctrl-names = "default", "state_uhs";
	pinctrl-0 = <&mmc0_pins_sdcard>;
	pinctrl-1 = <&mmc0_pins_sdcard>;
	cd-gpios = <&pio 12 GPIO_ACTIVE_LOW>;
	bus-width = <4>;
	max-frequency = <52000000>;
	cap-sd-highspeed;
	vmmc-supply = <&reg_3p3v>;
	vqmmc-supply = <&reg_3p3v>;
	no-mmc;
	#address-cells = <1>;
	#size-cells = <0>;
	status = "okay";
};

