// SPDX-License-Identifier: (GPL-2.0 OR MIT)
/*
 * Copyright (C) 2025 Grinn sp. z o.o.
 * Author: Bartosz Bilas <bartosz.bilas@grinn-global.com>
 */
/dts-v1/;

#include "mt8370.dtsi"
#include "mt8390-grinn-genio-som.dtsi"
#include "mt8390-grinn-genio-sbc.dtsi"

/ {
	model = "Grinn GenioSBC-510";
	compatible = "grinn,genio-510-sbc", "mediatek,mt8370", "mediatek,mt8188";

	memory@40000000 {
		device_type = "memory";
		reg = <0 0x40000000 1 0x00000000>;
	};
};
