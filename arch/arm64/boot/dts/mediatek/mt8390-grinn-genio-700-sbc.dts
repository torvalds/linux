// SPDX-License-Identifier: (GPL-2.0 OR MIT)
/*
 * Copyright (C) 2025 Grinn sp. z o.o.
 * Author: Mateusz Koza <mateusz.koza@grinn-global.com>
 */
/dts-v1/;

#include "mt8188.dtsi"
#include "mt8390-grinn-genio-som.dtsi"
#include "mt8390-grinn-genio-sbc.dtsi"

/ {
	model = "Grinn GenioSBC-700";
	compatible = "grinn,genio-700-sbc", "mediatek,mt8390", "mediatek,mt8188";

	memory@40000000 {
		device_type = "memory";
		reg = <0 0x40000000 1 0x00000000>;
	};
};
