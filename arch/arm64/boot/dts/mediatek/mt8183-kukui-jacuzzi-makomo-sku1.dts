// SPDX-License-Identifier: (GPL-2.0 OR MIT)
/*
 * Copyright 2023 Google LLC
 */

/dts-v1/;
#include "mt8183-kukui-jacuzzi-fennel.dtsi"
#include "mt8183-kukui-audio-ts3a227e-rt1015p.dtsi"

/ {
	model = "Google makomo sku1 board";
	chassis-type = "laptop";
	compatible = "google,makomo-sku1", "google,makomo", "mediatek,mt8183";
};

&qca_wifi {
	qcom,ath10k-calibration-variant = "GO_FENNEL14";
};

&mmc1_pins_uhs {
	pins-clk {
		drive-strength = <6>;
	};
};
