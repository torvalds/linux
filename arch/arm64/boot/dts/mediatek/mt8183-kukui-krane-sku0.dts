// SPDX-License-Identifier: (GPL-2.0 OR MIT)
/*
 * Copyright 2019 Google LLC
 *
 * Device-tree for Krane sku0.
 *
 * SKU is a 8-bit value (0x00 == 0):
 *  - Bits 7..4: Panel ID: 0x0 (AUO)
 *  - Bits 3..0: SKU ID:   0x0 (default)
 */

/dts-v1/;
#include "mt8183-kukui-krane.dtsi"

/ {
	model = "MediaTek krane sku0 board";
	chassis-type = "tablet";
	compatible = "google,krane-sku0", "google,krane", "mediatek,mt8183";
};

&panel {
	status = "okay";
	compatible = "auo,kd101n80-45na";
};
