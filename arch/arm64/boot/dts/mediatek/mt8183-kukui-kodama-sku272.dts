// SPDX-License-Identifier: (GPL-2.0 OR MIT)
/*
 * Copyright 2020 Google LLC
 *
 * SKU: 0x110 => 272
 *  - bit 8: Camera: 1 (GC5035)
 *  - bits 7..4: Panel ID: 0x1 (AUO)
 */

/dts-v1/;
#include "mt8183-kukui-kodama.dtsi"

/ {
	model = "MediaTek kodama sku272 board";
	compatible = "google,kodama-sku272", "google,kodama", "mediatek,mt8183";
};

&panel {
	status = "okay";
	compatible = "auo,b101uan08.3";
};
