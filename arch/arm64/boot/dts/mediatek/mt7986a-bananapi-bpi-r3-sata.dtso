// SPDX-License-Identifier: (GPL-2.0 OR MIT)
/*
 * Copyright (C) 2021 MediaTek Inc.
 * Author: Frank Wunderlich <frank-w@public-files.de>
 */

/dts-v1/;
/plugin/;

#include <dt-bindings/gpio/gpio.h>

&{/} {
	compatible = "bananapi,bpi-r3", "mediatek,mt7986a";

	reg_sata12v: regulator-sata12v {
		compatible = "regulator-fixed";
		regulator-name = "sata12v";
		regulator-min-microvolt = <12000000>;
		regulator-max-microvolt = <12000000>;
		gpio = <&pio 8 GPIO_ACTIVE_HIGH>;
		enable-active-high;
		regulator-always-on;
	};

	reg_sata5v: regulator-sata5v {
		compatible = "regulator-fixed";
		regulator-name = "sata5v";
		regulator-min-microvolt = <5000000>;
		regulator-max-microvolt = <5000000>;
		regulator-always-on;
		vin-supply = <&reg_sata12v>;
	};

};
