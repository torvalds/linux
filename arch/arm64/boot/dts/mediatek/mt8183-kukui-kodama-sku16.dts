// SPDX-License-Identifier: (GPL-2.0 OR MIT)
/*
 * Copyright 2021 Google LLC
 *
 * SKU: 0x10 => 16
 *  - bit 8: Camera: 0 (OV5695)
 *  - bits 7..4: Panel ID: 0x1 (AUO)
 */

/dts-v1/;
#include "mt8183-kukui-kodama.dtsi"

/ {
	model = "MediaTek kodama sku16 board";
	compatible = "google,kodama-sku16", "google,kodama", "mediatek,mt8183";
};

&panel {
	status = "okay";
	compatible = "auo,b101uan08.3";
};
