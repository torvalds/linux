// SPDX-License-Identifier: (GPL-2.0 OR MIT)
/*
 * Copyright 2022 Google LLC
 */

/dts-v1/;
#include "mt8186-corsola-voltorb.dtsi"

/ {
	model = "Google Voltorb sku589825 board";
	compatible = "google,voltorb-sku589825", "google,voltorb",
		     "mediatek,mt8186";
};

&i2c1 {
	touchscreen@10 {
		compatible = "elan,ekth6915";
		reg = <0x10>;
		interrupts-extended = <&pio 12 IRQ_TYPE_LEVEL_LOW>;
		pinctrl-names = "default";
		pinctrl-0 = <&touchscreen_pins>;
		reset-gpios = <&pio 60 GPIO_ACTIVE_LOW>;
		vcc33-supply = <&pp3300_s3>;
	};
};
