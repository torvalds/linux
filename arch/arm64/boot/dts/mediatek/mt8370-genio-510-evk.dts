// SPDX-License-Identifier: (GPL-2.0 OR MIT)
/*
 * Copyright (c) 2025 Collabora Ltd.
 * Author: Louis-Alexis Eyraud <louisalexis.eyraud@collabora.com>
 */
/dts-v1/;

#include "mt8370.dtsi"
#include "mt8390-genio-common.dtsi"

/ {
	model = "MediaTek Genio-510 EVK";
	compatible = "mediatek,mt8370-evk", "mediatek,mt8370", "mediatek,mt8188";

	memory@40000000 {
		device_type = "memory";
		reg = <0 0x40000000 0x1 0x00000000>;
	};
};
