// SPDX-License-Identifier: GPL-2.0
/*
 * Copyright (c) 2020 BayLibre, SAS.
 * Author: Fabien Parent <fparent@baylibre.com>
 */

/dts-v1/;

#include "mt8167.dtsi"
#include "pumpkin-common.dtsi"

/ {
	model = "Pumpkin MT8167";
	chassis-type = "embedded";
	compatible = "mediatek,mt8167-pumpkin", "mediatek,mt8167";

	memory@40000000 {
		device_type = "memory";
		reg = <0 0x40000000 0 0x80000000>;
	};
};
