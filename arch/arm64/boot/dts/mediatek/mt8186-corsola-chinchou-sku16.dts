// SPDX-License-Identifier: (GPL-2.0 OR MIT)
/*
 * Copyright 2024 Google LLC
 */

/dts-v1/;
#include "mt8186-corsola-chinchou.dtsi"

/ {
	model = "Google chinchou CZ1104FM2A/CZ1204FM2A";
	compatible = "google,chinchou-sku16", "google,chinchou-sku18",
			"google,chinchou-sku19", "google,chinchou-sku21",
			"google,chinchou", "mediatek,mt8186";
};

&i2c1 {
	i2c-scl-internal-delay-ns = <10000>;

	touchscreen: touchscreen@41 {
		compatible = "ilitek,ili2901";
		reg = <0x41>;
		interrupts-extended = <&pio 12 IRQ_TYPE_LEVEL_LOW>;
		pinctrl-names = "default";
		pinctrl-0 = <&touchscreen_pins>;
		reset-gpios = <&pio 60 GPIO_ACTIVE_LOW>;
		vccio-supply = <&pp1800_tchscr_report_disable>;
		vcc33-supply = <&pp3300_z2>;
	};
};
