// SPDX-License-Identifier: (GPL-2.0 OR MIT)
/*
 * Copyright 2021 Google LLC
 */

/dts-v1/;
#include "mt8183-kukui-jacuzzi-willow.dtsi"
#include "mt8183-kukui-audio-da7219-max98357a.dtsi"

/ {
	model = "Google willow board sku0";
	compatible = "google,willow-sku0", "google,willow", "mediatek,mt8183";
};

