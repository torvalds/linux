// SPDX-License-Identifier: (GPL-2.0 OR MIT)
/*
 * Copyright (C) 2025 MediaTek Inc.
 * Author: Ramax Lo <ramax.lo@mediatek.com>
 *         Macpaul Lin <macpaul.lin@mediatek.com>
 */
/dts-v1/;

#include "mt8395-genio-common.dtsi"

/ {
	model = "MediaTek Genio 1200 EVK-P1V2-UFS";
	compatible = "mediatek,mt8395-evk-ufs", "mediatek,mt8395",
		     "mediatek,mt8195";
};

&ufshci {
	status = "okay";
	vcc-supply = <&mt6359_vemc_1_ldo_reg>;
	vccq2-supply = <&mt6359_vufs_ldo_reg>;
};

&ufsphy {
	status = "okay";
};

&mmc0 {
	status = "disabled";
};
