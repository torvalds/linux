// SPDX-License-Identifier: (GPL-2.0 OR MIT)
/*
 * Copyright (C) 2025 Ezurio LLC
 * Author: Gary Bisson <bisson.gary@gmail.com>
 */
/dts-v1/;
#include "mt8188.dtsi"
#include "mt8390-tungsten-smarc.dtsi"

/ {
	model = "Ezurio Tungsten700 SMARC (MT8390)";
	compatible = "ezurio,mt8390-tungsten-smarc", "mediatek,mt8390",
		     "mediatek,mt8188";
};

&cpu4 {
	cpu-supply = <&mt6359_vcore_buck_reg>;
};

&cpu5 {
	cpu-supply = <&mt6359_vcore_buck_reg>;
};
