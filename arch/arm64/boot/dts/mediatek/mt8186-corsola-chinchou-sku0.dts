// SPDX-License-Identifier: (GPL-2.0 OR MIT)
/*
 * Copyright 2024 Google LLC
 */

/dts-v1/;
#include "mt8186-corsola-chinchou.dtsi"

/ {
	model = "Google chinchou CZ1104CM2A/CZ1204CM2A";
	compatible = "google,chinchou-sku0", "google,chinchou-sku2",
			"google,chinchou-sku4", "google,chinchou-sku5",
			"google,chinchou", "mediatek,mt8186";
};

&gpio_keys {
	status = "disabled";
};
