// SPDX-License-Identifier: (GPL-2.0 OR MIT)
/*
 * Copyright (C) 2025 MediaTek Inc.
 * Author: Frank Wunderlich <frank-w@public-files.de>
 */

/* This enables key-b slot CN15 on pcie2(11280000 1L0) on BPI-R4-Pro */

/dts-v1/;
/plugin/;

#include <dt-bindings/gpio/gpio.h>

/ {
	compatible = "bananapi,bpi-r4-pro", "mediatek,mt7988a";
};

&{/soc/pinctrl@1001f000/pcie-2-hog} {
	output-low;
};
