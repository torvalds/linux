// SPDX-License-Identifier: (GPL-2.0 OR MIT)
/*
 * Copyright 2023 Google LLC
 */

/dts-v1/;
#include "mt8183-kukui-jacuzzi-fennel.dtsi"
#include "mt8183-kukui-audio-da7219-rt1015p.dtsi"

/ {
	model = "Google makomo sku0 board";
	chassis-type = "laptop";
	compatible = "google,makomo-sku0", "google,makomo", "mediatek,mt8183";
};

&qca_wifi {
	qcom,ath10k-calibration-variant = "GO_FENNEL14";
};

&mmc1_pins_uhs {
	pins-clk {
		drive-strength = <MTK_DRIVE_6mA>;
	};
};
