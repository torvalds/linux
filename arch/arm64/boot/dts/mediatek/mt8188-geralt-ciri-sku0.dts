// SPDX-License-Identifier: (GPL-2.0 OR MIT)
/*
 * Copyright 2023 Google LLC
 */
/dts-v1/;
#include "mt8188-geralt-ciri.dtsi"

/ {
	model = "Google Ciri sku0 board";
	compatible = "google,ciri-sku0", "google,ciri", "mediatek,mt8188";
};

&dsi_panel {
	compatible = "boe,nv110wum-l60", "himax,hx83102";
};

&sound {
	compatible = "mediatek,mt8188-rt5682s";
	model = "mt8188_m98390_5682";

	audio-routing =
		"ETDM1_OUT", "ETDM_SPK_PIN",
		"ETDM2_OUT", "ETDM_HP_PIN",
		"ETDM1_IN", "ETDM_SPK_PIN",
		"ETDM2_IN", "ETDM_HP_PIN",
		"ADDA Capture", "MTKAIF_PIN",
		"Headphone Jack", "HPOL",
		"Headphone Jack", "HPOR",
		"IN1P", "Headset Mic",
		"Left Spk", "Front Left BE_OUT",
		"Right Spk", "Front Right BE_OUT";
};
