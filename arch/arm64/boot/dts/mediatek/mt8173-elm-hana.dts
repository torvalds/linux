// SPDX-License-Identifier: GPL-2.0-only
/*
 * Copyright 2016 MediaTek Inc.
 */

/dts-v1/;
#include "mt8173-elm-hana.dtsi"

/ {
	model = "Google Hana";
	chassis-type = "laptop";
	compatible = "google,hana-rev6", "google,hana-rev5",
		     "google,hana-rev4", "google,hana-rev3",
		     "google,hana", "mediatek,mt8173";
};
