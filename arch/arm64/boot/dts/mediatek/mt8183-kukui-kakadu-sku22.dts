// SPDX-License-Identifier: (GPL-2.0 OR MIT)
/*
 * Copyright 2021 Google LLC
 */

/dts-v1/;
#include "mt8183-kukui-kakadu.dtsi"
#include "mt8183-kukui-audio-rt1015p.dtsi"

/ {
	model = "MediaTek kakadu board sku22";
	compatible = "google,kakadu-rev3-sku22", "google,kakadu-rev2-sku22",
		     "google,kakadu", "mediatek,mt8183";
};

&sound {
	compatible = "mediatek,mt8183_mt6358_ts3a227_rt1015p";
};

