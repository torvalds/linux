// SPDX-License-Identifier: (GPL-2.0 OR MIT)
/*
 * Copyright 2021 Google LLC
 */

/dts-v1/;
#include "mt8183-kukui-jacuzzi-juniper.dtsi"
#include "mt8183-kukui-audio-ts3a227e-max98357a.dtsi"

/ {
	model = "Google kenzo sku17 board";
	chassis-type = "laptop";
	compatible = "google,juniper-sku17", "google,juniper", "mediatek,mt8183";
};

&i2c0 {
	touchscreen@40 {
		compatible = "hid-over-i2c";
		reg = <0x40>;

		pinctrl-names = "default";
		pinctrl-0 = <&touchscreen_pins>;

		interrupts-extended = <&pio 155 IRQ_TYPE_LEVEL_LOW>;

		post-power-on-delay-ms = <70>;
		hid-descr-addr = <0x0001>;
	};
};
