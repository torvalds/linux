// SPDX-License-Identifier: (GPL-2.0 OR MIT)
/*
 * Copyright (C) 2023 MediaTek Inc.
 * Author: Chris Chen <chris-qj.chen@mediatek.com>
 *	   Pablo Sun <pablo.sun@mediatek.com>
 *	   Macpaul Lin <macpaul.lin@mediatek.com>
 */
/dts-v1/;

#include "mt8188.dtsi"
#include "mt8390-genio-common.dtsi"

/ {
	model = "MediaTek Genio-700 EVK";
	compatible = "mediatek,mt8390-evk", "mediatek,mt8390",
		     "mediatek,mt8188";

	memory@40000000 {
		device_type = "memory";
		reg = <0 0x40000000 0x2 0x00000000>;
	};
};

