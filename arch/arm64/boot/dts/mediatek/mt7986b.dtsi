// SPDX-License-Identifier: (GPL-2.0 OR MIT)
/*
 * Copyright (C) 2021 MediaTek Inc.
 * Author: Sam.Shih <sam.shih@mediatek.com>
 */

#include "mt7986a.dtsi"
/ {
	compatible = "mediatek,mt7986b";
};

&pio {
	compatible = "mediatek,mt7986b-pinctrl";
	gpio-ranges = <&pio 0 0 41>, <&pio 66 66 35>;
};
