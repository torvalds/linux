// SPDX-License-Identifier: (GPL-2.0+ or MIT)
/*
 * Copyright (c) 2017 Icenowy Zheng <icenowy@aosc.io>
 */

/dts-v1/;

#include "sun50i-h6.dtsi"

#include <dt-bindings/gpio/gpio.h>

/ {
	model = "Pine H64";
	compatible = "pine64,pine-h64", "allwinner,sun50i-h6";

	aliases {
		serial0 = &uart0;
	};

	chosen {
		stdout-path = "serial0:115200n8";
	};
};

&uart0 {
	pinctrl-names = "default";
	pinctrl-0 = <&uart0_ph_pins>;
	status = "okay";
};
