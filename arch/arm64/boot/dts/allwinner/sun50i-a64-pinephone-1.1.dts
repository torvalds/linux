// SPDX-License-Identifier: (GPL-2.0+ OR MIT)
// Copyright (C) 2020 Ondrej Jirman <megous@megous.com>

/dts-v1/;

#include "sun50i-a64-pinephone.dtsi"

/ {
	model = "Pine64 PinePhone Braveheart (1.1)";
	compatible = "pine64,pinephone-1.1", "allwinner,sun50i-a64";
};

&backlight {
	power-supply = <&reg_ldo_io0>;
	/*
	 * PWM backlight circuit on this PinePhone revision was changed since
	 * 1.0, and the lowest PWM duty cycle that doesn't lead to backlight
	 * being off is around 20%. Duty cycle for the lowest brightness level
	 * also varries quite a bit between individual boards, so the lowest
	 * value here was chosen as a safe default.
	 */
	brightness-levels = <
		774  793  814  842
		882  935  1003 1088
		1192 1316 1462 1633
		1830 2054 2309 2596
		2916 3271 3664 4096>;
	num-interpolated-steps = <50>;
	default-brightness-level = <400>;
};
