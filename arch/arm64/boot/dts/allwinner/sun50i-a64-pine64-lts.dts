// SPDX-License-Identifier: (GPL-2.0+ OR MIT)
// Copyright (c) 2018 ARM Ltd.

#include "sun50i-a64-sopine-baseboard.dts"

/ {
	model = "Pine64 LTS";
	compatible = "pine64,pine64-lts", "allwinner,sun50i-r18",
		     "allwinner,sun50i-a64";
};
