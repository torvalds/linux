## arch/mips/pmcs-msp71xx/Kconfig
```kconfig
choice
	prompt "PMC-Sierra MSP SOC type"
	depends on PMC_MSP

config PMC_MSP4200_EVAL
	bool "PMC-Sierra MSP4200 Eval Board"
	select IRQ_MSP_SLP
	select HW_HAS_PCI
	select MIPS_L1_CACHE_SHIFT_4

config PMC_MSP4200_GW
	bool "PMC-Sierra MSP4200 VoIP Gateway"
	select IRQ_MSP_SLP
	select HW_HAS_PCI

config PMC_MSP7120_EVAL
	bool "PMC-Sierra MSP7120 Eval Board"
	select SYS_SUPPORTS_MULTITHREADING
	select IRQ_MSP_CIC
	select HW_HAS_PCI

config PMC_MSP7120_GW
	bool "PMC-Sierra MSP7120 Residential Gateway"
	select SYS_SUPPORTS_MULTITHREADING
	select IRQ_MSP_CIC
	select HW_HAS_PCI
	select MSP_HAS_USB
	select MSP_ETH

config PMC_MSP7120_FPGA
	bool "PMC-Sierra MSP7120 FPGA"
	select SYS_SUPPORTS_MULTITHREADING
	select IRQ_MSP_CIC
	select HW_HAS_PCI

endchoice

config MSP_HAS_USB
	bool
	depends on PMC_MSP

config MSP_ETH
	bool
	select MSP_HAS_MAC
	depends on PMC_MSP

config MSP_HAS_MAC
	bool
	depends on PMC_MSP
```

## arch/mips/powertv/Kconfig
```kconfig
config BOOTLOADER_FAMILY
	string "POWERTV Bootloader Family string"
	default "85"
	depends on POWERTV
	help
	  This value should be specified when the bootloader driver is disabled
	  and must be exactly two characters long. Families supported are:
	    R1 - RNG-100  R2 - RNG-200
	    A1 - Class A  B1 - Class B
	    E1 - Class E  F1 - Class F
	    44 - 45xx     46 - 46xx
	    85 - 85xx     86 - 86xx
```

## arch/mips/powertv/asic/Kconfig
```kconfig
config MIN_RUNTIME_RESOURCES
	bool "Support for minimum runtime resources"
	default n
	depends on POWERTV
	help
	  Enables support for minimizing the number of (SA asic) runtime
	  resources that are preallocated by the kernel.

config MIN_RUNTIME_DOCSIS
	bool "Support for minimum DOCSIS resource"
	default y
	depends on MIN_RUNTIME_RESOURCES
	help
	  Enables support for the preallocated DOCSIS resource.

config MIN_RUNTIME_PMEM
	bool "Support for minimum PMEM resource"
	default y
	depends on MIN_RUNTIME_RESOURCES
	help
	  Enables support for the preallocated Memory resource.

config MIN_RUNTIME_TFTP
	bool "Support for minimum TFTP resource"
	default y
	depends on MIN_RUNTIME_RESOURCES
	help
	  Enables support for the preallocated TFTP resource.
```

## arch/mips/ralink/Kconfig
```kconfig
# SPDX-License-Identifier: GPL-2.0
if RALINK

config CLKEVT_RT3352
	bool
	depends on SOC_RT305X || SOC_MT7620
	default y
	select TIMER_OF
	select CLKSRC_MMIO

config RALINK_ILL_ACC
	bool
	depends on SOC_RT305X
	default y

config IRQ_INTC
	bool
	default y
	depends on !SOC_MT7621

choice
	prompt "Ralink SoC selection"
	default SOC_RT305X
	help
	  Select Ralink MIPS SoC type.

	config SOC_RT288X
		bool "RT288x"
		select MIPS_AUTO_PFN_OFFSET
		select MIPS_L1_CACHE_SHIFT_4
		select HAVE_PCI

	config SOC_RT305X
		bool "RT305x"

	config SOC_RT3883
		bool "RT3883"
		select HAVE_PCI

	config SOC_MT7620
		bool "MT7620/8"
		select CPU_MIPSR2_IRQ_VI
		select HAVE_PCI

	config SOC_MT7621
		bool "MT7621"
		select MIPS_CPU_SCACHE
		select SYS_SUPPORTS_MULTITHREADING
		select SYS_SUPPORTS_SMP
		select SYS_SUPPORTS_MIPS_CPS
		select SYS_SUPPORTS_HIGHMEM
		select MIPS_GIC
		select CLKSRC_MIPS_GIC
		select HAVE_PCI
		select PCI_DRIVERS_GENERIC
		select SOC_BUS

		help
		  The MT7621 system-on-a-chip includes an 880 MHz MIPS1004Kc dual-core CPU,
		  a 5-port 10/100/1000 switch/PHY and one RGMII.
endchoice

choice
	prompt "Devicetree selection"
	depends on !SOC_MT7621
	default DTB_RT_NONE
	help
	  Select the devicetree.

	config DTB_RT_NONE
		bool "None"

	config DTB_RT2880_EVAL
		bool "RT2880 eval kit"
		depends on SOC_RT288X
		select BUILTIN_DTB

	config DTB_RT305X_EVAL
		bool "RT305x eval kit"
		depends on SOC_RT305X
		select BUILTIN_DTB

	config DTB_RT3883_EVAL
		bool "RT3883 eval kit"
		depends on SOC_RT3883
		select BUILTIN_DTB

	config DTB_MT7620A_EVAL
		bool "MT7620A eval kit"
		depends on SOC_MT7620
		select BUILTIN_DTB

	config DTB_OMEGA2P
		bool "Onion Omega2+"
		depends on SOC_MT7620
		select BUILTIN_DTB

	config DTB_VOCORE2
		bool "VoCore2"
		depends on SOC_MT7620
		select BUILTIN_DTB

endchoice

endif
```

## arch/mips/sgi-ip27/Kconfig
```kconfig
choice
	prompt "Node addressing mode"
	depends on SGI_IP27
	default SGI_SN_M_MODE

config SGI_SN_M_MODE
	bool "IP27 M-Mode"
	help
	  The nodes of Origin, Onyx, Fuel and Tezro systems can be configured
	  in either N-Modes which allows for more nodes or M-Mode which allows
	  for more memory.  Your hardware is almost certainly running in
	  M-Mode, so choose M-mode here.

config SGI_SN_N_MODE
	bool "IP27 N-Mode"
	depends on EXPERIMENTAL
	help
	  The nodes of Origin, Onyx, Fuel and Tezro systems can be configured
	  in either N-Modes which allows for more nodes or M-Mode which allows
	  for more memory.  Your hardware is almost certainly running in
	  M-Mode, so choose M-mode here.

endchoice

config MAPPED_KERNEL
	bool "Mapped kernel support"
	depends on SGI_IP27
	help
	  Change the way a Linux kernel is loaded into memory on a MIPS64
	  machine.  This is required in order to support text replication on
	  NUMA.  If you need to understand it, read the source code.

config REPLICATE_KTEXT
	bool "Kernel text replication support"
	depends on SGI_IP27
	select MAPPED_KERNEL
	help
	  Say Y here to enable replicating the kernel text across multiple
	  nodes in a NUMA cluster.  This trades memory for speed.

config REPLICATE_EXHANDLERS
	bool "Exception handler replication support"
	depends on SGI_IP27
	help
	  Say Y here to enable replicating the kernel exception handlers
	  across multiple nodes in a NUMA cluster. This trades memory for
	  speed.
```

## arch/mips/sibyte/Kconfig
```kconfig
config SIBYTE_SB1250
	bool
	select CEVT_SB1250
	select CSRC_SB1250
	select HW_HAS_PCI
	select IRQ_CPU
	select SIBYTE_ENABLE_LDT_IF_PCI
	select SIBYTE_HAS_ZBUS_PROFILING
	select SIBYTE_SB1xxx_SOC
	select SYS_SUPPORTS_SMP

config SIBYTE_BCM1120
	bool
	select CEVT_SB1250
	select CSRC_SB1250
	select IRQ_CPU
	select SIBYTE_BCM112X
	select SIBYTE_HAS_ZBUS_PROFILING
	select SIBYTE_SB1xxx_SOC

config SIBYTE_BCM1125
	bool
	select CEVT_SB1250
	select CSRC_SB1250
	select HW_HAS_PCI
	select IRQ_CPU
	select SIBYTE_BCM112X
	select SIBYTE_HAS_ZBUS_PROFILING
	select SIBYTE_SB1xxx_SOC

config SIBYTE_BCM1125H
	bool
	select CEVT_SB1250
	select CSRC_SB1250
	select HW_HAS_PCI
	select IRQ_CPU
	select SIBYTE_BCM112X
	select SIBYTE_ENABLE_LDT_IF_PCI
	select SIBYTE_HAS_ZBUS_PROFILING
	select SIBYTE_SB1xxx_SOC

config SIBYTE_BCM112X
	bool
	select CEVT_SB1250
	select CSRC_SB1250
	select IRQ_CPU
	select SIBYTE_SB1xxx_SOC
	select SIBYTE_HAS_ZBUS_PROFILING

config SIBYTE_BCM1x80
	bool
	select CEVT_BCM1480
	select CSRC_BCM1480
	select HW_HAS_PCI
	select IRQ_CPU
	select SIBYTE_HAS_ZBUS_PROFILING
	select SIBYTE_SB1xxx_SOC
	select SYS_SUPPORTS_SMP

config SIBYTE_BCM1x55
	bool
	select CEVT_BCM1480
	select CSRC_BCM1480
	select HW_HAS_PCI
	select IRQ_CPU
	select SIBYTE_SB1xxx_SOC
	select SIBYTE_HAS_ZBUS_PROFILING
	select SYS_SUPPORTS_SMP

config SIBYTE_SB1xxx_SOC
	bool
	select DMA_COHERENT
	select IRQ_CPU
	select SWAP_IO_SPACE
	select SYS_SUPPORTS_32BIT_KERNEL
	select SYS_SUPPORTS_64BIT_KERNEL
	select FW_CFE
	select SYS_HAS_EARLY_PRINTK

choice
	prompt "SiByte SOC Stepping"
	depends on SIBYTE_SB1xxx_SOC

config CPU_SB1_PASS_1
	bool "1250 Pass1"
	depends on SIBYTE_SB1250
	select CPU_HAS_PREFETCH

config CPU_SB1_PASS_2_1250
	bool "1250 An"
	depends on SIBYTE_SB1250
	select CPU_SB1_PASS_2
	help
	  Also called BCM1250 Pass 2

config CPU_SB1_PASS_2_2
	bool "1250 Bn"
	depends on SIBYTE_SB1250
	select CPU_HAS_PREFETCH
	help
	  Also called BCM1250 Pass 2.2

config CPU_SB1_PASS_4
	bool "1250 Cn"
	depends on SIBYTE_SB1250
	select CPU_HAS_PREFETCH
	help
	  Also called BCM1250 Pass 3

config CPU_SB1_PASS_2_112x
	bool "112x Hybrid"
	depends on SIBYTE_BCM112X
	select CPU_SB1_PASS_2

config CPU_SB1_PASS_3
	bool "112x An"
	depends on SIBYTE_BCM112X
	select CPU_HAS_PREFETCH

endchoice

config CPU_SB1_PASS_2
	bool

config SIBYTE_HAS_LDT
	bool

config SIBYTE_ENABLE_LDT_IF_PCI
	bool
	select SIBYTE_HAS_LDT if PCI

config SB1_CEX_ALWAYS_FATAL
	bool "All cache exceptions considered fatal (no recovery attempted)"
	depends on SIBYTE_SB1xxx_SOC

config SB1_CERR_STALL
	bool "Stall (rather than panic) on fatal cache error"
	depends on SIBYTE_SB1xxx_SOC

config SIBYTE_CFE_CONSOLE
	bool "Use firmware console"
	depends on SIBYTE_SB1xxx_SOC
	help
	  Use the CFE API's console write routines during boot.  Other console
	  options (VT console, sb1250 duart console, etc.) should not be
	  configured.

config SIBYTE_BUS_WATCHER
	bool "Support for Bus Watcher statistics"
	depends on SIBYTE_SB1xxx_SOC && \
		(SIBYTE_BCM112X || SIBYTE_SB1250)
	help
	  Handle and keep statistics on the bus error interrupts (COR_ECC,
	  BAD_ECC, IO_BUS).

config SIBYTE_BW_TRACE
	bool "Capture bus trace before bus error"
	depends on SIBYTE_BUS_WATCHER
	help
	  Run a continuous bus trace, dumping the raw data as soon as
	  a ZBbus error is detected.  Cannot work if ZBbus profiling
	  is turned on, and also will interfere with JTAG-based trace
	  buffer activity.  Raw buffer data is dumped to console, and
	  must be processed off-line.

config SIBYTE_TBPROF
	tristate "Support for ZBbus profiling"
	depends on SIBYTE_HAS_ZBUS_PROFILING

config SIBYTE_HAS_ZBUS_PROFILING
	bool
```

## arch/mips/tx4927/Kconfig
```kconfig
config TOSHIBA_FPCIB0
	bool "FPCIB0 Backplane Support"
	depends on TOSHIBA_RBTX4927
```

## arch/mips/tx4938/Kconfig
```kconfig
if TOSHIBA_RBTX4938

comment "Multiplex Pin Select"
choice
	prompt "PIO[58:61]"
	default TOSHIBA_RBTX4938_MPLEX_PIO58_61

config TOSHIBA_RBTX4938_MPLEX_PIO58_61
	bool "PIO"
config TOSHIBA_RBTX4938_MPLEX_NAND
	bool "NAND"
config TOSHIBA_RBTX4938_MPLEX_ATA
	bool "ATA"

endchoice

config TX4938_NAND_BOOT
	depends on EXPERIMENTAL && TOSHIBA_RBTX4938_MPLEX_NAND
	bool "NAND Boot Support (EXPERIMENTAL)"
	help
	  This is only for Toshiba RBTX4938 reference board, which has NAND IPL.
	  Select this option if you need to use NAND boot.

endif
```
