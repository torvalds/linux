## arch/mips/kvm/Kconfig
```kconfig
# SPDX-License-Identifier: GPL-2.0
#
# KVM configuration
#
source "virt/kvm/Kconfig"

menuconfig VIRTUALIZATION
	bool "Virtualization"
	help
	  Say Y here to get to see options for using your Linux host to run
	  other operating systems inside virtual machines (guests).
	  This option alone does not add any kernel code.

	  If you say N, all options in this submenu will be skipped and disabled.

if VIRTUALIZATION

config KVM
	tristate "Kernel-based Virtual Machine (KVM) support"
	depends on HAVE_KVM
	depends on MIPS_FP_SUPPORT
	select EXPORT_UASM
	select PREEMPT_NOTIFIERS
	select KVM_GENERIC_DIRTYLOG_READ_PROTECT
	select HAVE_KVM_EVENTFD
	select HAVE_KVM_VCPU_ASYNC_IOCTL
	select KVM_MMIO
	select MMU_NOTIFIER
	select SRCU
	help
	  Support for hosting Guest kernels.

config KVM_MIPS_DEBUG_COP0_COUNTERS
	bool "Maintain counters for COP0 accesses"
	depends on KVM
	help
	  Maintain statistics for Guest COP0 accesses.
	  A histogram of COP0 accesses is printed when the VM is
	  shutdown.

	  If unsure, say N.

endif # VIRTUALIZATION
```

## arch/mips/lantiq/Kconfig
```kconfig
# SPDX-License-Identifier: GPL-2.0
if LANTIQ

config SOC_TYPE_XWAY
	bool
	select PINCTRL_XWAY
	default n

choice
	prompt "SoC Type"
	default SOC_XWAY

config SOC_AMAZON_SE
	bool "Amazon SE"
	select SOC_TYPE_XWAY
	select MFD_SYSCON
	select MFD_CORE

config SOC_XWAY
	bool "XWAY"
	select SOC_TYPE_XWAY
	select HAVE_PCI
	select MFD_SYSCON
	select MFD_CORE

config SOC_FALCON
	bool "FALCON"
	select PINCTRL_FALCON

endchoice

choice
	prompt "Built-in device tree"
	help
	  Legacy bootloaders do not pass a DTB pointer to the kernel, so
	  if a "wrapper" is not being used, the kernel will need to include
	  a device tree that matches the target board.

	  The builtin DTB will only be used if the firmware does not supply
	  a valid DTB.

config LANTIQ_DT_NONE
	bool "None"

config DT_EASY50712
	bool "Easy50712"
	depends on SOC_XWAY
	select BUILTIN_DTB
endchoice

config PCI_LANTIQ
	bool "PCI Support"
	depends on SOC_XWAY && PCI

config XRX200_PHY_FW
	bool "XRX200 PHY firmware loader"
	depends on SOC_XWAY

endif
```

## arch/mips/lantiq/xway/Kconfig
```kconfig
if SOC_XWAY

menu "MIPS Machine"

config LANTIQ_MACH_EASY50712
	bool "Easy50712 - Danube"
	default y

endmenu

endif

if SOC_AMAZON_SE

menu "MIPS Machine"

config LANTIQ_MACH_EASY50601
	bool "Easy50601 - Amazon SE"
	default y

endmenu

endif
```

## arch/mips/lasat/Kconfig
```kconfig
# SPDX-License-Identifier: GPL-2.0
config PICVUE
	tristate "PICVUE LCD display driver"
	depends on LASAT

config PICVUE_PROC
	tristate "PICVUE LCD display driver /proc interface"
	depends on PICVUE && PROC_FS

config DS1603
	bool "DS1603 RTC driver"
	depends on LASAT

config LASAT_SYSCTL
	bool "LASAT sysctl interface"
	depends on LASAT
```

## arch/mips/loongson/Kconfig
```kconfig
if MACH_LOONGSON

choice
	prompt "Machine Type"

config LEMOTE_FULOONG2E
	bool "Lemote Fuloong(2e) mini-PC"
	select ARCH_SPARSEMEM_ENABLE
	select CEVT_R4K
	select CSRC_R4K
	select SYS_HAS_CPU_LOONGSON2E
	select DMA_NONCOHERENT
	select BOOT_ELF32
	select BOARD_SCACHE
	select HW_HAS_PCI
	select I8259
	select ISA
	select IRQ_CPU
	select SYS_SUPPORTS_32BIT_KERNEL
	select SYS_SUPPORTS_64BIT_KERNEL
	select SYS_SUPPORTS_LITTLE_ENDIAN
	select SYS_SUPPORTS_HIGHMEM
	select SYS_HAS_EARLY_PRINTK
	select GENERIC_ISA_DMA_SUPPORT_BROKEN
	select CPU_HAS_WB
	select LOONGSON_MC146818
	help
	  Lemote Fuloong(2e) mini-PC board based on the Chinese Loongson-2E CPU and
	  an FPGA northbridge

	  Lemote Fuloong(2e) mini PC have a VIA686B south bridge.

config LEMOTE_MACH2F
	bool "Lemote Loongson 2F family machines"
	select ARCH_SPARSEMEM_ENABLE
	select BOARD_SCACHE
	select BOOT_ELF32
	select CEVT_R4K if ! MIPS_EXTERNAL_TIMER
	select CPU_HAS_WB
	select CS5536
	select CSRC_R4K if ! MIPS_EXTERNAL_TIMER
	select DMA_NONCOHERENT
	select GENERIC_ISA_DMA_SUPPORT_BROKEN
	select HAVE_CLK
	select HW_HAS_PCI
	select I8259
	select IRQ_CPU
	select ISA
	select SYS_HAS_CPU_LOONGSON2F
	select SYS_HAS_EARLY_PRINTK
	select SYS_SUPPORTS_32BIT_KERNEL
	select SYS_SUPPORTS_64BIT_KERNEL
	select SYS_SUPPORTS_HIGHMEM
	select SYS_SUPPORTS_LITTLE_ENDIAN
	select LOONGSON_MC146818
	help
	  Lemote Loongson 2F family machines utilize the 2F revision of
	  Loongson processor and the AMD CS5536 south bridge.

	  These family machines include fuloong2f mini PC, yeeloong2f notebook,
	  LingLoong allinone PC and so forth.

config LEMOTE_MACH3A
	bool "Lemote Loongson 3A family machines"
	select ARCH_SPARSEMEM_ENABLE
	select GENERIC_ISA_DMA_SUPPORT_BROKEN
	select BOOT_ELF32
	select BOARD_SCACHE
	select CSRC_R4K
	select CEVT_R4K
	select CPU_HAS_WB
	select HW_HAS_PCI
	select ISA
	select HT_PCI
	select I8259
	select IRQ_CPU
	select NR_CPUS_DEFAULT_4
	select SYS_HAS_CPU_LOONGSON3
	select SYS_HAS_EARLY_PRINTK
	select SYS_SUPPORTS_SMP
	select SYS_SUPPORTS_HOTPLUG_CPU
	select SYS_SUPPORTS_NUMA
	select SYS_SUPPORTS_64BIT_KERNEL
	select SYS_SUPPORTS_HIGHMEM
	select SYS_SUPPORTS_LITTLE_ENDIAN
	select LOONGSON_MC146818
	select ZONE_DMA32
	select LEFI_FIRMWARE_INTERFACE
	help
		Lemote Loongson 3A family machines utilize the 3A revision of
		Loongson processor and RS780/SBX00 chipset.
endchoice

config CS5536
	bool

config CS5536_MFGPT
	bool "CS5536 MFGPT Timer"
	depends on CS5536 && !HIGH_RES_TIMERS
	select MIPS_EXTERNAL_TIMER
	help
	  This option enables the mfgpt0 timer of AMD CS5536. With this timer
	  switched on you can not use high resolution timers.

	  If you want to enable the Loongson2 CPUFreq Driver, Please enable
	  this option at first, otherwise, You will get wrong system time.

	  If unsure, say Yes.

config LOONGSON_SUSPEND
	bool
	default y
	depends on CPU_SUPPORTS_CPUFREQ && SUSPEND

config LOONGSON_UART_BASE
	bool
	default y
	depends on EARLY_PRINTK || SERIAL_8250

config IOMMU_HELPER
	bool

config NEED_SG_DMA_LENGTH
	bool

config SWIOTLB
	bool "Soft IOMMU Support for All-Memory DMA"
	default y
	depends on CPU_LOONGSON3
	select IOMMU_HELPER
	select NEED_SG_DMA_LENGTH
	select NEED_DMA_MAP_STATE

config LOONGSON_MC146818
	bool
	default n

config LEFI_FIRMWARE_INTERFACE
	bool

endif # MACH_LOONGSON
```

## arch/mips/loongson1/Kconfig
```kconfig
if MACH_LOONGSON1

choice
	prompt "Machine Type"

config LOONGSON1_LS1B
	bool "Loongson LS1B board"
	select CEVT_R4K
	select CSRC_R4K
	select SYS_HAS_CPU_LOONGSON1B
	select DMA_NONCOHERENT
	select BOOT_ELF32
	select IRQ_CPU
	select SYS_SUPPORTS_32BIT_KERNEL
	select SYS_SUPPORTS_LITTLE_ENDIAN
	select SYS_SUPPORTS_HIGHMEM
	select SYS_SUPPORTS_MIPS16
	select SYS_HAS_EARLY_PRINTK
	select COMMON_CLK

endchoice

endif # MACH_LOONGSON1
```

## arch/mips/loongson2ef/Kconfig
```kconfig
# SPDX-License-Identifier: GPL-2.0
if MACH_LOONGSON2EF

choice
	prompt "Machine Type"

config LEMOTE_FULOONG2E
	bool "Lemote Fuloong(2e) mini-PC"
	select ARCH_SPARSEMEM_ENABLE
	select ARCH_MIGHT_HAVE_PC_PARPORT
	select ARCH_MIGHT_HAVE_PC_SERIO
	select CEVT_R4K
	select CSRC_R4K
	select SYS_HAS_CPU_LOONGSON2E
	select DMA_NONCOHERENT
	select BOOT_ELF32
	select BOARD_SCACHE
	select FORCE_PCI
	select I8259
	select ISA
	select IRQ_MIPS_CPU
	select SYS_SUPPORTS_64BIT_KERNEL
	select SYS_SUPPORTS_LITTLE_ENDIAN
	select SYS_SUPPORTS_HIGHMEM
	select SYS_HAS_EARLY_PRINTK
	select USE_GENERIC_EARLY_PRINTK_8250
	select GENERIC_ISA_DMA_SUPPORT_BROKEN
	select CPU_HAS_WB
	select LOONGSON_MC146818
	help
	  Lemote Fuloong(2e) mini-PC board based on the Chinese Loongson-2E CPU and
	  an FPGA northbridge

	  Lemote Fuloong(2e) mini PC have a VIA686B south bridge.

config LEMOTE_MACH2F
	bool "Lemote Loongson 2F family machines"
	select ARCH_SPARSEMEM_ENABLE
	select ARCH_MIGHT_HAVE_PC_PARPORT
	select ARCH_MIGHT_HAVE_PC_SERIO
	select BOARD_SCACHE
	select BOOT_ELF32
	select CEVT_R4K if ! MIPS_EXTERNAL_TIMER
	select CPU_HAS_WB
	select CS5536
	select CSRC_R4K if ! MIPS_EXTERNAL_TIMER
	select DMA_NONCOHERENT
	select GENERIC_ISA_DMA_SUPPORT_BROKEN
	select HAVE_CLK
	select FORCE_PCI
	select I8259
	select IRQ_MIPS_CPU
	select ISA
	select SYS_HAS_CPU_LOONGSON2F
	select SYS_HAS_EARLY_PRINTK
	select USE_GENERIC_EARLY_PRINTK_8250
	select SYS_SUPPORTS_64BIT_KERNEL
	select SYS_SUPPORTS_HIGHMEM
	select SYS_SUPPORTS_LITTLE_ENDIAN
	select LOONGSON_MC146818
	help
	  Lemote Loongson 2F family machines utilize the 2F revision of
	  Loongson processor and the AMD CS5536 south bridge.

	  These family machines include fuloong2f mini PC, yeeloong2f notebook,
	  LingLoong allinone PC and so forth.

endchoice

config CS5536
	bool

config CS5536_MFGPT
	bool "CS5536 MFGPT Timer"
	depends on CS5536 && !HIGH_RES_TIMERS
	select MIPS_EXTERNAL_TIMER
	help
	  This option enables the mfgpt0 timer of AMD CS5536. With this timer
	  switched on you can not use high resolution timers.

	  If you want to enable the Loongson2 CPUFreq Driver, Please enable
	  this option at first, otherwise, You will get wrong system time.

	  If unsure, say Yes.

config LOONGSON_UART_BASE
	bool
	default y
	depends on EARLY_PRINTK || SERIAL_8250

config LOONGSON_MC146818
	bool
	default n

endif # MACH_LOONGSON2EF
```

## arch/mips/loongson32/Kconfig
```kconfig
# SPDX-License-Identifier: GPL-2.0

config BUILTIN_DTB_NAME
	string "Source file for built-in DTB"
	depends on BUILTIN_DTB
	help
	  Base name (without suffix, relative to arch/mips/boot/dts/loongson)
	  for the DTS file that will be used to produce the DTB linked into
	  the kernel.
```

## arch/mips/loongson64/Kconfig
```kconfig
# SPDX-License-Identifier: GPL-2.0
if MACH_LOONGSON64

config RS780_HPET
	bool "RS780/SBX00 HPET Timer"
	depends on MACH_LOONGSON64
	depends on BROKEN
	select MIPS_EXTERNAL_TIMER
	help
	  This option enables the hpet timer of AMD RS780/SBX00.

	  Note: This driver is doing some dangerous hack. Please only enable
	  it on RS780E systems.

endif # MACH_LOONGSON64
```

## arch/mips/mobileye/Kconfig
```kconfig
# SPDX-License-Identifier: GPL-2.0
if EYEQ

choice
	prompt "Mobileye EyeQ SoC selection"
	default MACH_EYEQ5
	help
	  Select Mobileye EyeQ MIPS SoC type.

	config MACH_EYEQ5
		bool "Mobileye EyeQ5 SoC"

	config MACH_EYEQ6H
		bool "Mobileye EyeQ6H SoC"
endchoice

config FIT_IMAGE_FDT_EPM5
	bool "Include FDT for Mobileye EyeQ5 development platforms"
	depends on MACH_EYEQ5
	default n
	help
	  Enable this to include the FDT for the EyeQ5 development platforms
	  from Mobileye in the FIT kernel image.
	  This requires u-boot on the platform.

endif
```

## arch/mips/momentum/Kconfig
```kconfig
config JAGUAR_DMALOW
	bool "Low DMA Mode"
	depends on MOMENCO_JAGUAR_ATX
	help
	  Select to Y if jump JP5 is set on your board, N otherwise.  Normally
	  the jumper is set, so if you feel unsafe, just say Y.
```

## arch/mips/netlogic/Kconfig
```kconfig
# SPDX-License-Identifier: GPL-2.0
if NLM_XLP_BOARD || NLM_XLR_BOARD

if NLM_XLP_BOARD
config DT_XLP_EVP
	bool "Built-in device tree for XLP EVP boards"
	default y
	select BUILTIN_DTB
	help
	  Add an FDT blob for XLP EVP boards into the kernel.
	  This DTB will be used if the firmware does not pass in a DTB
	  pointer to the kernel.  The corresponding DTS file is at
	  arch/mips/netlogic/dts/xlp_evp.dts

config DT_XLP_SVP
	bool "Built-in device tree for XLP SVP boards"
	default y
	select BUILTIN_DTB
	help
	  Add an FDT blob for XLP VP boards into the kernel.
	  This DTB will be used if the firmware does not pass in a DTB
	  pointer to the kernel.  The corresponding DTS file is at
	  arch/mips/netlogic/dts/xlp_svp.dts

config DT_XLP_FVP
	bool "Built-in device tree for XLP FVP boards"
	default y
	select BUILTIN_DTB
	help
	  Add an FDT blob for XLP FVP board into the kernel.
	  This DTB will be used if the firmware does not pass in a DTB
	  pointer to the kernel.  The corresponding DTS file is at
	  arch/mips/netlogic/dts/xlp_fvp.dts

config DT_XLP_GVP
	bool "Built-in device tree for XLP GVP boards"
	default y
	select BUILTIN_DTB
	help
	  Add an FDT blob for XLP GVP board into the kernel.
	  This DTB will be used if the firmware does not pass in a DTB
	  pointer to the kernel.  The corresponding DTS file is at
	  arch/mips/netlogic/dts/xlp_gvp.dts

config DT_XLP_RVP
	bool "Built-in device tree for XLP RVP boards"
	default y
	help
	  Add an FDT blob for XLP RVP board into the kernel.
	  This DTB will be used if the firmware does not pass in a DTB
	  pointer to the kernel.  The corresponding DTS file is at
	  arch/mips/netlogic/dts/xlp_rvp.dts

config NLM_MULTINODE
	bool "Support for multi-chip boards"
	depends on NLM_XLP_BOARD
	default n
	help
	  Add support for boards with 2 or 4 XLPs connected over ICI.

if NLM_MULTINODE
choice
	prompt "Number of XLPs on the board"
	default NLM_MULTINODE_2
	help
	  In the multi-node case, specify the number of SoCs on the board.

config NLM_MULTINODE_2
	bool "Dual-XLP board"
	help
	  Support boards with upto two XLPs connected over ICI.

config NLM_MULTINODE_4
	bool "Quad-XLP board"
	help
	  Support boards with upto four XLPs connected over ICI.

endchoice

endif
endif

config NLM_COMMON
	bool

config IOMMU_HELPER
	bool

config NEED_SG_DMA_LENGTH
	bool

config SWIOTLB
	def_bool y
	select NEED_SG_DMA_LENGTH
	select IOMMU_HELPER

endif
```

## arch/mips/paravirt/Kconfig
```kconfig
# SPDX-License-Identifier: GPL-2.0-only
if MIPS_PARAVIRT

config MIPS_PCI_VIRTIO
	def_bool y

endif #  MIPS_PARAVIRT
```

## arch/mips/pic32/Kconfig
```kconfig
# SPDX-License-Identifier: GPL-2.0
if MACH_PIC32

choice
	prompt "Machine Type"

config PIC32MZDA
	bool "Microchip PIC32MZDA Platform"
	select BOOT_ELF32
	select BOOT_RAW
	select CEVT_R4K
	select CSRC_R4K
	select DMA_NONCOHERENT
	select SYS_HAS_CPU_MIPS32_R2
	select SYS_HAS_EARLY_PRINTK
	select SYS_SUPPORTS_32BIT_KERNEL
	select SYS_SUPPORTS_LITTLE_ENDIAN
	select GPIOLIB
	select COMMON_CLK
	select CLKDEV_LOOKUP
	select LIBFDT
	select USE_OF
	select PINCTRL
	select PIC32_EVIC
	help
	  Support for the Microchip PIC32MZDA microcontroller.

	  This is a 32-bit microcontroller with support for external or
	  internally packaged DDR2 memory up to 128MB.

	  For more information, see <http://www.microchip.com/>.

endchoice

choice
	prompt "Devicetree selection"
	default DTB_PIC32_NONE
	help
	  Select the devicetree.

config DTB_PIC32_NONE
       bool "None"

config DTB_PIC32_MZDA_SK
       bool "PIC32MZDA Starter Kit"
       depends on PIC32MZDA
       select BUILTIN_DTB

endchoice

endif # MACH_PIC32
```

## arch/mips/pistachio/Kconfig
```kconfig
# SPDX-License-Identifier: GPL-2.0
config PISTACHIO_GPTIMER_CLKSRC
	bool "Enable General Purpose Timer based clocksource"
	depends on MACH_PISTACHIO
	select CLKSRC_PISTACHIO
	select MIPS_EXTERNAL_TIMER
	help
	  This option enables a clocksource driver based on a Pistachio
	  SoC General Purpose external timer.

	  If you want to enable the CPUFreq, you need to enable
	  this option.

	  If you don't want to enable CPUFreq, you can leave this disabled.
```

## arch/mips/pmc-sierra/Kconfig
```kconfig
choice
	prompt "PMC-Sierra MSP SOC type"
	depends on PMC_MSP

config PMC_MSP4200_EVAL
	bool "PMC-Sierra MSP4200 Eval Board"
	select CEVT_R4K
	select CSRC_R4K
	select IRQ_MSP_SLP
	select HW_HAS_PCI

config PMC_MSP4200_GW
	bool "PMC-Sierra MSP4200 VoIP Gateway"
	select CEVT_R4K
	select CSRC_R4K
	select IRQ_MSP_SLP
	select HW_HAS_PCI

config PMC_MSP7120_EVAL
	bool "PMC-Sierra MSP7120 Eval Board"
	select SYS_SUPPORTS_MULTITHREADING
	select IRQ_MSP_CIC
	select HW_HAS_PCI

config PMC_MSP7120_GW
	bool "PMC-Sierra MSP7120 Residential Gateway"
	select SYS_SUPPORTS_MULTITHREADING
	select IRQ_MSP_CIC
	select HW_HAS_PCI

config PMC_MSP7120_FPGA
	bool "PMC-Sierra MSP7120 FPGA"
	select SYS_SUPPORTS_MULTITHREADING
	select IRQ_MSP_CIC
	select HW_HAS_PCI

endchoice

config HYPERTRANSPORT
	bool "Hypertransport Support for PMC-Sierra Yosemite"
	depends on PMC_YOSEMITE
```
