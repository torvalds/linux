## arch/mips/txx9/Kconfig
```kconfig
# SPDX-License-Identifier: GPL-2.0
config MACH_TX39XX
	bool
	select MACH_TXX9
	select SYS_HAS_CPU_TX39XX

config MACH_TX49XX
	bool
	select BOOT_ELF32
	select MACH_TXX9
	select CEVT_R4K
	select CSRC_R4K
	select IRQ_MIPS_CPU
	select SYS_HAS_CPU_TX49XX
	select SYS_SUPPORTS_64BIT_KERNEL

config MACH_TXX9
	bool
	select DMA_NONCOHERENT
	select SWAP_IO_SPACE
	select SYS_HAS_EARLY_PRINTK
	select SYS_SUPPORTS_32BIT_KERNEL
	select SYS_SUPPORTS_LITTLE_ENDIAN
	select SYS_SUPPORTS_BIG_ENDIAN
	select COMMON_CLK

config TOSHIBA_JMR3927
	bool "Toshiba JMR-TX3927 board"
	depends on MACH_TX39XX
	select SOC_TX3927

config TOSHIBA_RBTX4927
	bool "Toshiba RBTX49[23]7 board"
	depends on MACH_TX49XX
	select SOC_TX4927
	# TX4937 is subset of TX4938
	select SOC_TX4938
	help
	  This Toshiba board is based on the TX4927 processor. Say Y here to
	  support this machine type

config SOC_TX3927
	bool
	select CEVT_TXX9
	imply HAS_TXX9_SERIAL
	select HAVE_PCI
	select IRQ_TXX9
	select GPIO_TXX9

config SOC_TX4927
	bool
	select CEVT_TXX9
	imply HAS_TXX9_SERIAL
	select HAVE_PCI
	select IRQ_TXX9
	select PCI_TX4927
	select GPIO_TXX9

config SOC_TX4938
	bool
	select CEVT_TXX9
	imply HAS_TXX9_SERIAL
	select HAVE_PCI
	select IRQ_TXX9
	select PCI_TX4927
	select GPIO_TXX9

config TOSHIBA_FPCIB0
	bool "FPCIB0 Backplane Support"
	depends on PCI && MACH_TXX9
	select I8259

config PICMG_PCI_BACKPLANE_DEFAULT
	bool "Support for PICMG PCI Backplane"
	depends on PCI && MACH_TXX9
	default y if !TOSHIBA_FPCIB0

config PCI_TX4927
	bool
```

## arch/mips/vdso/Kconfig
```kconfig
# GCC (at least up to version 9.2) appears to emit function calls that make use
# of the GOT when targeting microMIPS, which we can't use in the VDSO due to
# the lack of relocations. As such, we disable the VDSO for microMIPS builds.

config MIPS_DISABLE_VDSO
	def_bool CPU_MICROMIPS
```

## arch/mips/vr41xx/Kconfig
```kconfig
# SPDX-License-Identifier: GPL-2.0
choice
	prompt "Machine type"
	depends on MACH_VR41XX
	default TANBAC_TB022X

config CASIO_E55
	bool "CASIO CASSIOPEIA E-10/15/55/65"
	select CEVT_R4K
	select CSRC_R4K
	select DMA_NONCOHERENT
	select IRQ_MIPS_CPU
	select ISA
	select SYS_SUPPORTS_32BIT_KERNEL
	select SYS_SUPPORTS_LITTLE_ENDIAN

config IBM_WORKPAD
	bool "IBM WorkPad z50"
	select CEVT_R4K
	select CSRC_R4K
	select DMA_NONCOHERENT
	select IRQ_MIPS_CPU
	select ISA
	select SYS_SUPPORTS_32BIT_KERNEL
	select SYS_SUPPORTS_LITTLE_ENDIAN

config TANBAC_TB022X
	bool "TANBAC VR4131 multichip module and TANBAC VR4131DIMM"
	select CEVT_R4K
	select CSRC_R4K
	select DMA_NONCOHERENT
	select IRQ_MIPS_CPU
	select HAVE_PCI
	select SYS_SUPPORTS_32BIT_KERNEL
	select SYS_SUPPORTS_LITTLE_ENDIAN
	help
	  The TANBAC VR4131 multichip module(TB0225) and
	  the TANBAC VR4131DIMM(TB0229) are MIPS-based platforms
	  manufactured by TANBAC.
	  Please refer to <http://www.tanbac.co.jp/>
	  about VR4131 multichip module and VR4131DIMM.

config VICTOR_MPC30X
	bool "Victor MP-C303/304"
	select CEVT_R4K
	select CSRC_R4K
	select DMA_NONCOHERENT
	select IRQ_MIPS_CPU
	select HAVE_PCI
	select PCI_VR41XX
	select SYS_SUPPORTS_32BIT_KERNEL
	select SYS_SUPPORTS_LITTLE_ENDIAN

config ZAO_CAPCELLA
	bool "ZAO Networks Capcella"
	select CEVT_R4K
	select CSRC_R4K
	select DMA_NONCOHERENT
	select IRQ_MIPS_CPU
	select HAVE_PCI
	select PCI_VR41XX
	select SYS_SUPPORTS_32BIT_KERNEL
	select SYS_SUPPORTS_LITTLE_ENDIAN

endchoice

choice
	prompt "Base board type"
	depends on TANBAC_TB022X
	default TANBAC_TB0287

config TANBAC_TB0219
	bool "TANBAC DIMM Evaluation Kit(TB0219)"
	select GPIO_VR41XX
	select PCI_VR41XX
	help
	  The TANBAC DIMM Evaluation Kit(TB0219) is a MIPS-based platform
	  manufactured by TANBAC.
	  Please refer to <http://www.tanbac.co.jp/> about DIMM Evaluation Kit.

config TANBAC_TB0226
	bool "TANBAC Mbase(TB0226)"
	select GPIO_VR41XX
	select PCI_VR41XX
	help
	  The TANBAC Mbase(TB0226) is a MIPS-based platform
	  manufactured by TANBAC.
	  Please refer to <http://www.tanbac.co.jp/> about Mbase.

config TANBAC_TB0287
	bool "TANBAC Mini-ITX DIMM base(TB0287)"
	select PCI_VR41XX
	help
	  The TANBAC Mini-ITX DIMM base(TB0287) is a MIPS-based platform
	  manufactured by TANBAC.
	  Please refer to <http://www.tanbac.co.jp/> about Mini-ITX DIMM base.

endchoice

config PCI_VR41XX
	bool "Add PCI control unit support of NEC VR4100 series"
	depends on MACH_VR41XX && HAVE_PCI
	default y
	select PCI
```

## arch/mips/xilfpga/Kconfig
```kconfig
# SPDX-License-Identifier: GPL-2.0
choice
	prompt "Machine type"
	depends on MACH_XILFPGA
	default XILFPGA_NEXYS4DDR

config XILFPGA_NEXYS4DDR
	bool "Nexys4DDR by Digilent"

endchoice
```
