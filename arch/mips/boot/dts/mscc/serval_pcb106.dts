// SPDX-License-Identifier: (GPL-2.0+ OR MIT)
/*
 * Copyright (c) 2018 Microsemi Corporation
 */

/dts-v1/;
#include "serval_common.dtsi"

/ {
	model = "Serval PCB106 Reference Board";
	compatible = "mscc,serval-pcb106", "mscc,serval";

	aliases {
	};

};

