// SPDX-License-Identifier: GPL-2.0

/dts-v1/;

#include "loongson3-package.dtsi"
#include "rs780e-pch.dtsi"

/ {
	compatible = "loongson,loongson3-4core-rs780e";
};

&package0 {
	htpic: interrupt-controller@efdfb000080 {
		compatible = "loongson,htpic-1.0";
		reg = <0xefd 0xfb000080 0x40>;
		interrupt-controller;
		#interrupt-cells = <1>;

		interrupt-parent = <&liointc>;
		interrupts = <24 IRQ_TYPE_LEVEL_HIGH>,
				<25 IRQ_TYPE_LEVEL_HIGH>,
				<26 IRQ_TYPE_LEVEL_HIGH>,
				<27 IRQ_TYPE_LEVEL_HIGH>;
	};
};
