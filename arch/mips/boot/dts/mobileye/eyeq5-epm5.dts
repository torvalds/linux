// SPDX-License-Identifier: (GPL-2.0-only OR BSD-2-Clause)
/*
 * Copyright 2023 Mobileye Vision Technologies Ltd.
 */

/dts-v1/;

#include "eyeq5.dtsi"

/ {
	compatible = "mobileye,eyeq5-epm5", "mobileye,eyeq5";
	model = "Mobile EyeQ5 MP5 Evaluation board";

	chosen {
		stdout-path = "serial2:115200n8";
	};

	memory@0 {
		device_type = "memory";
		reg = <0x0 0x40000000 0x0 0x02000000>,
		      <0x8 0x02000000 0x0 0x7E000000>;
	};
};
