## arch/mips/jazz/Kconfig
```kconfig
config ACER_PICA_61
	bool "Support for Acer PICA 1 chipset"
	depends on MACH_JAZZ
	select DMA_NONCOHERENT
	select SYS_SUPPORTS_LITTLE_ENDIAN
	help
	  This is a machine with a R4400 133/150 MHz CPU. To compile a Linux
	  kernel that runs on these, say Y here. For details about Linux on
	  the MIPS architecture, check out the Linux/MIPS FAQ on the WWW at
	  <http://www.linux-mips.org/>.

config MIPS_MAGNUM_4000
	bool "Support for MIPS Magnum 4000"
	depends on MACH_JAZZ
	select DMA_NONCOHERENT
	select SYS_SUPPORTS_BIG_ENDIAN
	select SYS_SUPPORTS_LITTLE_ENDIAN
	help
	  This is a machine with a R4000 100 MHz CPU. To compile a Linux
	  kernel that runs on these, say Y here. For details about Linux on
	  the MIPS architecture, check out the Linux/MIPS FAQ on the WWW at
	  <http://www.linux-mips.org/>.

config OLIVETTI_M700
	bool "Support for Olivetti M700-10"
	depends on MACH_JAZZ
	select DMA_NONCOHERENT
	select SYS_SUPPORTS_LITTLE_ENDIAN
	help
	  This is a machine with a R4000 100 MHz CPU. To compile a Linux
	  kernel that runs on these, say Y here. For details about Linux on
	  the MIPS architecture, check out the Linux/MIPS FAQ on the WWW at
	  <http://www.linux-mips.org/>.
```

## arch/mips/jz4740/Kconfig
```kconfig
# SPDX-License-Identifier: GPL-2.0
choice
	prompt "Machine type"
	depends on MACH_INGENIC
	default INGENIC_GENERIC_BOARD

config INGENIC_GENERIC_BOARD
	bool "Generic board"
	select MACH_JZ4740
	select MACH_JZ4770
	select MACH_JZ4780
	select MACH_X1000

config JZ4740_QI_LB60
	bool "Qi Hardware Ben NanoNote"
	select MACH_JZ4740

config JZ4770_GCW0
	bool "Game Consoles Worldwide GCW Zero"
	select MACH_JZ4770

config JZ4780_CI20
	bool "MIPS Creator CI20"
	select MACH_JZ4780

config X1000_CU1000_NEO
	bool "YSH & ATIL CU1000 Module with Neo backplane"
	select MACH_X1000

endchoice

config MACH_JZ4740
	bool
	select SYS_HAS_CPU_MIPS32_R1

config MACH_JZ4770
	bool
	select MIPS_CPU_SCACHE
	select SYS_HAS_CPU_MIPS32_R2
	select SYS_SUPPORTS_HIGHMEM

config MACH_JZ4780
	bool
	select MIPS_CPU_SCACHE
	select SYS_HAS_CPU_MIPS32_R2
	select SYS_SUPPORTS_HIGHMEM

config MACH_X1000
	bool
	select MIPS_CPU_SCACHE
	select SYS_HAS_CPU_MIPS32_R2
	select SYS_SUPPORTS_HIGHMEM
```

## arch/mips/kernel/cpufreq/Kconfig
```kconfig
#
# CPU Frequency scaling
#

config MIPS_EXTERNAL_TIMER
	bool

config MIPS_CPUFREQ
	bool
	default y
	depends on CPU_SUPPORTS_CPUFREQ && MIPS_EXTERNAL_TIMER

if MIPS_CPUFREQ

menu "CPU Frequency scaling"

source "drivers/cpufreq/Kconfig"

if CPU_FREQ

comment "CPUFreq processor drivers"

config LOONGSON2_CPUFREQ
	tristate "Loongson2 CPUFreq Driver"
	select CPU_FREQ_TABLE
	depends on MIPS_CPUFREQ
	help
	  This option adds a CPUFreq driver for loongson processors which
	  support software configurable cpu frequency.

	  Loongson2F and it's successors support this feature.

	  For details, take a look at <file:Documentation/cpu-freq/>.

	  If in doubt, say N.

endif	# CPU_FREQ

endmenu

endif	# MIPS_CPUFREQ
```
