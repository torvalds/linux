## arch/mips/configs/wrppmc_defconfig
```kconfig
CONFIG_WR_PPMC=y
CONFIG_HZ_1000=y
CONFIG_EXPERIMENTAL=y
# CONFIG_SWAP is not set
CONFIG_SYSVIPC=y
CONFIG_BSD_PROCESS_ACCT=y
CONFIG_LOG_BUF_SHIFT=14
CONFIG_BLK_DEV_INITRD=y
# CONFIG_CC_OPTIMIZE_FOR_SIZE is not set
CONFIG_EXPERT=y
CONFIG_KALLSYMS_EXTRA_PASS=y
# CONFIG_EPOLL is not set
CONFIG_SLAB=y
CONFIG_MODULES=y
CONFIG_MODULE_UNLOAD=y
CONFIG_MODVERSIONS=y
CONFIG_MODULE_SRCVERSION_ALL=y
CONFIG_PCI=y
CONFIG_HOTPLUG_PCI=y
CONFIG_BINFMT_MISC=y
CONFIG_PM=y
CONFIG_NET=y
CONFIG_PACKET=y
CONFIG_UNIX=y
CONFIG_XFRM_MIGRATE=y
CONFIG_INET=y
CONFIG_IP_MULTICAST=y
CONFIG_IP_PNP=y
CONFIG_IP_PNP_DHCP=y
CONFIG_IP_PNP_BOOTP=y
CONFIG_IP_PNP_RARP=y
CONFIG_IP_MROUTE=y
CONFIG_ARPD=y
CONFIG_INET_XFRM_MODE_TRANSPORT=m
CONFIG_INET_XFRM_MODE_TUNNEL=m
CONFIG_INET_XFRM_MODE_BEET=m
CONFIG_TCP_MD5SIG=y
# CONFIG_IPV6 is not set
CONFIG_NETWORK_SECMARK=y
CONFIG_FW_LOADER=m
CONFIG_BLK_DEV_RAM=y
CONFIG_SGI_IOC4=m
CONFIG_NETDEVICES=y
CONFIG_PHYLIB=y
CONFIG_VITESSE_PHY=m
CONFIG_SMSC_PHY=m
CONFIG_NET_ETHERNET=y
CONFIG_NET_PCI=y
CONFIG_E100=y
CONFIG_QLA3XXX=m
CONFIG_CHELSIO_T3=m
CONFIG_NETXEN_NIC=m
# CONFIG_INPUT is not set
# CONFIG_SERIO is not set
# CONFIG_VT is not set
CONFIG_SERIAL_8250=y
CONFIG_SERIAL_8250_CONSOLE=y
CONFIG_SERIAL_8250_NR_UARTS=1
CONFIG_SERIAL_8250_RUNTIME_UARTS=1
# CONFIG_HW_RANDOM is not set
CONFIG_PROC_KCORE=y
CONFIG_TMPFS=y
CONFIG_TMPFS_POSIX_ACL=y
CONFIG_NFS_FS=y
CONFIG_NFS_V3=y
CONFIG_ROOT_NFS=y
CONFIG_DLM=m
CONFIG_CMDLINE_BOOL=y
CONFIG_CMDLINE="console=ttyS0,115200n8"
CONFIG_CRYPTO_NULL=m
CONFIG_CRYPTO_CBC=m
CONFIG_CRYPTO_ECB=m
CONFIG_CRYPTO_LRW=m
CONFIG_CRYPTO_PCBC=m
CONFIG_CRYPTO_XCBC=m
CONFIG_CRYPTO_MD4=m
CONFIG_CRYPTO_MICHAEL_MIC=m
CONFIG_CRYPTO_SHA256=m
CONFIG_CRYPTO_SHA512=m
CONFIG_CRYPTO_TGR192=m
CONFIG_CRYPTO_WP512=m
CONFIG_CRYPTO_ANUBIS=m
CONFIG_CRYPTO_ARC4=m
CONFIG_CRYPTO_BLOWFISH=m
CONFIG_CRYPTO_CAMELLIA=m
CONFIG_CRYPTO_CAST5=m
CONFIG_CRYPTO_CAST6=m
CONFIG_CRYPTO_DES=m
CONFIG_CRYPTO_FCRYPT=m
CONFIG_CRYPTO_KHAZAD=m
CONFIG_CRYPTO_SERPENT=m
CONFIG_CRYPTO_TEA=m
CONFIG_CRYPTO_TWOFISH=m
CONFIG_CRYPTO_DEFLATE=m
CONFIG_CRC_CCITT=y
CONFIG_CRC16=y
CONFIG_LIBCRC32C=y
```

## arch/mips/configs/xilfpga_defconfig
```kconfig
CONFIG_MACH_XILFPGA=y
# CONFIG_COMPACTION is not set
# CONFIG_LOCALVERSION_AUTO is not set
CONFIG_EMBEDDED=y
# CONFIG_VM_EVENT_COUNTERS is not set
# CONFIG_COMPAT_BRK is not set
CONFIG_SLAB=y
# CONFIG_BLOCK is not set
# CONFIG_SUSPEND is not set
CONFIG_NET=y
CONFIG_PACKET=y
CONFIG_UNIX=y
CONFIG_INET=y
# CONFIG_IPV6 is not set
# CONFIG_WIRELESS is not set
# CONFIG_UEVENT_HELPER is not set
CONFIG_DEVTMPFS=y
CONFIG_DEVTMPFS_MOUNT=y
# CONFIG_STANDALONE is not set
# CONFIG_PREVENT_FIRMWARE_BUILD is not set
# CONFIG_FW_LOADER is not set
# CONFIG_ALLOW_DEV_COREDUMP is not set
CONFIG_NETDEVICES=y
# CONFIG_NET_CORE is not set
# CONFIG_NET_VENDOR_ARC is not set
# CONFIG_NET_CADENCE is not set
# CONFIG_NET_VENDOR_BROADCOM is not set
# CONFIG_NET_VENDOR_EZCHIP is not set
# CONFIG_NET_VENDOR_INTEL is not set
# CONFIG_NET_VENDOR_MARVELL is not set
# CONFIG_NET_VENDOR_MICREL is not set
# CONFIG_NET_VENDOR_NATSEMI is not set
# CONFIG_NET_VENDOR_NETRONOME is not set
# CONFIG_NET_VENDOR_QUALCOMM is not set
# CONFIG_NET_VENDOR_RENESAS is not set
# CONFIG_NET_VENDOR_ROCKER is not set
# CONFIG_NET_VENDOR_SAMSUNG is not set
# CONFIG_NET_VENDOR_SEEQ is not set
# CONFIG_NET_VENDOR_SMSC is not set
# CONFIG_NET_VENDOR_STMICRO is not set
# CONFIG_NET_VENDOR_SYNOPSYS is not set
# CONFIG_NET_VENDOR_VIA is not set
# CONFIG_NET_VENDOR_WIZNET is not set
CONFIG_XILINX_EMACLITE=y
CONFIG_SMSC_PHY=y
# CONFIG_WLAN is not set
# CONFIG_INPUT_MOUSEDEV is not set
# CONFIG_INPUT_KEYBOARD is not set
# CONFIG_INPUT_MOUSE is not set
# CONFIG_SERIO is not set
CONFIG_VT_HW_CONSOLE_BINDING=y
# CONFIG_UNIX98_PTYS is not set
# CONFIG_LEGACY_PTYS is not set
CONFIG_SERIAL_8250=y
CONFIG_SERIAL_8250_CONSOLE=y
CONFIG_SERIAL_OF_PLATFORM=y
# CONFIG_HW_RANDOM is not set
CONFIG_I2C=y
CONFIG_I2C_CHARDEV=y
# CONFIG_I2C_HELPER_AUTO is not set
CONFIG_I2C_XILINX=y
CONFIG_GPIO_SYSFS=y
CONFIG_GPIO_XILINX=y
CONFIG_SENSORS_ADT7410=y
# CONFIG_USB_SUPPORT is not set
# CONFIG_MIPS_PLATFORM_DEVICES is not set
# CONFIG_IOMMU_SUPPORT is not set
# CONFIG_PROC_PAGE_MONITOR is not set
CONFIG_TMPFS=y
# CONFIG_MISC_FILESYSTEMS is not set
CONFIG_PANIC_ON_OOPS=y
# CONFIG_SCHED_DEBUG is not set
# CONFIG_FTRACE is not set
CONFIG_CMDLINE_BOOL=y
CONFIG_CMDLINE="console=ttyS0,115200"
```

## arch/mips/configs/yosemite_defconfig
```kconfig
CONFIG_PMC_YOSEMITE=y
CONFIG_HIGHMEM=y
CONFIG_SMP=y
CONFIG_NR_CPUS=2
CONFIG_HZ_1000=y
CONFIG_SYSVIPC=y
CONFIG_IKCONFIG=y
CONFIG_IKCONFIG_PROC=y
CONFIG_LOG_BUF_SHIFT=14
CONFIG_RELAY=y
CONFIG_EMBEDDED=y
CONFIG_SLAB=y
CONFIG_MODULES=y
CONFIG_MODULE_UNLOAD=y
CONFIG_PCI=y
CONFIG_PM=y
CONFIG_NET=y
CONFIG_PACKET=m
CONFIG_UNIX=y
CONFIG_XFRM_USER=m
CONFIG_INET=y
CONFIG_IP_PNP=y
CONFIG_IP_PNP_BOOTP=y
CONFIG_INET_XFRM_MODE_TRANSPORT=m
CONFIG_INET_XFRM_MODE_TUNNEL=m
CONFIG_INET_XFRM_MODE_BEET=m
CONFIG_IPV6_PRIVACY=y
CONFIG_IPV6_ROUTER_PREF=y
CONFIG_INET6_AH=m
CONFIG_INET6_ESP=m
CONFIG_INET6_IPCOMP=m
CONFIG_IPV6_TUNNEL=m
CONFIG_NETWORK_SECMARK=y
CONFIG_FW_LOADER=m
CONFIG_CONNECTOR=m
CONFIG_CDROM_PKTCDVD=m
CONFIG_ATA_OVER_ETH=m
CONFIG_SGI_IOC4=m
CONFIG_RAID_ATTRS=m
CONFIG_NETDEVICES=y
CONFIG_PHYLIB=m
CONFIG_MARVELL_PHY=m
CONFIG_DAVICOM_PHY=m
CONFIG_QSEMI_PHY=m
CONFIG_LXT_PHY=m
CONFIG_CICADA_PHY=m
CONFIG_VITESSE_PHY=m
CONFIG_SMSC_PHY=m
CONFIG_NET_ETHERNET=y
CONFIG_MII=y
CONFIG_QLA3XXX=m
CONFIG_CHELSIO_T3=m
CONFIG_NETXEN_NIC=m
# CONFIG_INPUT is not set
# CONFIG_SERIO is not set
# CONFIG_VT is not set
CONFIG_SERIAL_8250=y
CONFIG_SERIAL_8250_CONSOLE=y
# CONFIG_HW_RANDOM is not set
# CONFIG_HWMON is not set
CONFIG_FUSE_FS=m
CONFIG_PROC_KCORE=y
CONFIG_TMPFS=y
CONFIG_TMPFS_POSIX_ACL=y
CONFIG_NFS_FS=y
CONFIG_ROOT_NFS=y
CONFIG_DEBUG_KERNEL=y
CONFIG_DEBUG_MUTEXES=y
CONFIG_KEYS=y
CONFIG_KEYS_DEBUG_PROC_KEYS=y
CONFIG_CRYPTO_NULL=m
CONFIG_CRYPTO_ECB=m
CONFIG_CRYPTO_PCBC=m
CONFIG_CRYPTO_HMAC=y
CONFIG_CRYPTO_MD4=m
CONFIG_CRYPTO_MICHAEL_MIC=m
CONFIG_CRYPTO_SHA256=m
CONFIG_CRYPTO_SHA512=m
CONFIG_CRYPTO_TGR192=m
CONFIG_CRYPTO_WP512=m
CONFIG_CRYPTO_ANUBIS=m
CONFIG_CRYPTO_ARC4=m
CONFIG_CRYPTO_BLOWFISH=m
CONFIG_CRYPTO_CAMELLIA=m
CONFIG_CRYPTO_CAST5=m
CONFIG_CRYPTO_CAST6=m
CONFIG_CRYPTO_FCRYPT=m
CONFIG_CRYPTO_KHAZAD=m
CONFIG_CRYPTO_SERPENT=m
CONFIG_CRYPTO_TEA=m
CONFIG_CRYPTO_TWOFISH=m
CONFIG_CRC16=m
CONFIG_CRC32=m
CONFIG_LIBCRC32C=m
```

## arch/mips/crypto/Kconfig
```kconfig
# SPDX-License-Identifier: GPL-2.0

menu "Accelerated Cryptographic Algorithms for CPU (mips)"

config CRYPTO_MD5_OCTEON
	tristate "Digests: MD5 (OCTEON)"
	depends on CPU_CAVIUM_OCTEON
	select CRYPTO_MD5
	select CRYPTO_HASH
	help
	  MD5 message digest algorithm (RFC1321)

	  Architecture: mips OCTEON using crypto instructions, when available

endmenu
```

## arch/mips/ddb5xxx/Kconfig
```kconfig
config DDB5477_BUS_FREQUENCY
	int "bus frequency (in kHZ, 0 for auto-detect)"
	depends on DDB5477
	default 0
```

## arch/mips/econet/Kconfig
```kconfig
# SPDX-License-Identifier: GPL-2.0
if ECONET

choice
	prompt "EcoNet SoC selection"
	default SOC_ECONET_EN751221
	help
	  Select EcoNet MIPS SoC type. Individual SoCs within a family are
	  very similar, so is it enough to select the right family, and
	  then customize to the specific SoC using the device tree only.

	config SOC_ECONET_EN751221
		bool "EN751221 family"
		select COMMON_CLK
		select ECONET_EN751221_INTC
		select IRQ_MIPS_CPU
		select SMP
		select SMP_UP
		select SYS_SUPPORTS_SMP
		help
		  The EN751221 family includes EN7512, RN7513, EN7521, EN7526.
		  They are based on single core MIPS 34Kc processors. To boot
		  this kernel, you will need a device tree such as
		  MIPS_RAW_APPENDED_DTB=y, and a root filesystem.
endchoice

choice
	prompt "Devicetree selection"
	default DTB_ECONET_NONE
	help
	  Select the devicetree.

	config DTB_ECONET_NONE
		bool "None"

	config DTB_ECONET_SMARTFIBER_XP8421_B
		bool "EN751221 SmartFiber XP8421-B"
		depends on SOC_ECONET_EN751221
		select BUILTIN_DTB
		help
		  The SmartFiber XP8421-B is a device based on the EN751221 SoC.
		  It has 512MB of memory and 256MB of NAND flash. This kernel
		  needs only an appended initramfs to boot. It can be loaded
		  through XMODEM and booted from memory in the bootloader, or
		  it can be packed in tclinux.trx format and written to flash.
endchoice

endif
```

## arch/mips/emma/Kconfig
```kconfig
choice
	prompt "Machine type"
	depends on MACH_EMMA
	default NEC_MARKEINS

config NEC_MARKEINS
	bool "NEC EMMA2RH Mark-eins board"
	select SOC_EMMA2RH
	select HW_HAS_PCI
	help
	  This enables support for the NEC Electronics Mark-eins boards.

endchoice

config SOC_EMMA2RH
	bool
	select SOC_EMMA
	select SYS_HAS_CPU_R5500
	select SYS_SUPPORTS_32BIT_KERNEL
	select SYS_SUPPORTS_64BIT_KERNEL

config SOC_EMMA
	bool
	select CEVT_R4K
	select CSRC_R4K
	select DMA_NONCOHERENT
	select IRQ_CPU
	select SWAP_IO_SPACE
	select SYS_SUPPORTS_BIG_ENDIAN
```

## arch/mips/generic/Kconfig
```kconfig
# SPDX-License-Identifier: GPL-2.0
if MIPS_GENERIC_KERNEL

config LEGACY_BOARDS
	bool
	help
	  Select this from your board if the board must use a legacy, non-UHI,
	  boot protocol. This will cause the kernel to scan through the list of
	  supported machines calling their detect functions in turn if the
	  kernel is booted without being provided with an FDT via the UHI
	  boot protocol.

config YAMON_DT_SHIM
	bool
	help
	  Select this from your board if the board uses the YAMON bootloader
	  and you wish to include code which helps translate various
	  YAMON-provided environment variables into a device tree properties.

comment "Legacy (non-UHI/non-FIT) Boards"

config LEGACY_BOARD_SEAD3
	bool "Support MIPS SEAD-3 boards"
	select LEGACY_BOARDS
	select YAMON_DT_SHIM
	help
	  Enable this to include support for booting on MIPS SEAD-3 FPGA-based
	  development boards, which boot using a legacy boot protocol.

comment "MSCC Ocelot doesn't work with SEAD3 enabled"
	depends on LEGACY_BOARD_SEAD3

config LEGACY_BOARD_OCELOT
	bool "Legacy support for Ocelot based boards"
	depends on LEGACY_BOARD_SEAD3=n
	select LEGACY_BOARDS
	select SOC_VCOREIII
	select SYS_HAS_EARLY_PRINTK
	select USE_GENERIC_EARLY_PRINTK_8250

config SOC_VCOREIII
	bool
	select GPIOLIB
	select MSCC_OCELOT_IRQ
	select MSCC_OCELOT #will be removed when driver no more use it

#Will be removed when the driver using it will be converted to SOC_VCOREIII
config MSCC_OCELOT
	bool

comment "FIT/UHI Boards"

config FIT_IMAGE_FDT_BOSTON
	bool "Include FDT for MIPS Boston boards"
	help
	  Enable this to include the FDT for the MIPS Boston development board
	  from Imagination Technologies in the FIT kernel image. You should
	  enable this if you wish to boot on a MIPS Boston board, as it is
	  expected by the bootloader.

config FIT_IMAGE_FDT_MARDUK
	bool "Include FDT for IMG Pistachio Marduk (CI40) boards"
	help
	  Enable this to include the FDT for the IMG Pistachio Marduk (CI40)
	  from Imagination Technologies in the FIT kernel image.

config FIT_IMAGE_FDT_NI169445
	bool "Include FDT for NI 169445"
	help
	  Enable this to include the FDT for the 169445 platform from
	  National Instruments in the FIT kernel image.

config FIT_IMAGE_FDT_XILFPGA
	bool "Include FDT for Xilfpga"
	help
	  Enable this to include the FDT for the MIPSfpga platform
	  from Imagination Technologies in the FIT kernel image.

config FIT_IMAGE_FDT_OCELOT
	bool "Include FDT for Microsemi Ocelot development platforms"
	select SOC_VCOREIII
	help
	  Enable this to include the FDT for the Ocelot development platforms
	  from Microsemi in the FIT kernel image.
	  This requires u-boot on the platform.

config FIT_IMAGE_FDT_LUTON
	bool "Include FDT for Microsemi Luton development platforms"
	select SOC_VCOREIII
	help
	  Enable this to include the FDT for the Luton development platforms
	  from Microsemi in the FIT kernel image.
	  This requires u-boot on the platform.

config FIT_IMAGE_FDT_JAGUAR2
	bool "Include FDT for Microsemi Jaguar2 development platforms"
	select SOC_VCOREIII
	help
	  Enable this to include the FDT for the Jaguar2 development platforms
	  from Microsemi in the FIT kernel image.
	  This requires u-boot on the platform.

config FIT_IMAGE_FDT_SERVAL
	bool "Include FDT for Microsemi Serval development platforms"
	select SOC_VCOREIII
	help
	  Enable this to include the FDT for the Serval development platforms
	  from Microsemi in the FIT kernel image.
	  This requires u-boot on the platform.

config BOARD_INGENIC
	bool "Support boards based on Ingenic SoCs"
	select MACH_INGENIC_GENERIC
	help
	  Enable support for boards based on Ingenic SoCs.

config VIRT_BOARD_RANCHU
	bool "Support Ranchu platform for Android emulator"
	help
	  This enables support for the platform used by Android emulator.

	  Ranchu platform consists of a set of virtual devices. This platform
	  enables emulation of variety of virtual configurations while using
	  Android emulator. Android emulator is based on Qemu, and contains
	  the support for the same set of virtual devices.

endif
```

## arch/mips/ingenic/Kconfig
```kconfig
# SPDX-License-Identifier: GPL-2.0

config MACH_INGENIC_GENERIC
	bool
	select MACH_INGENIC
	select MACH_JZ4740
	select MACH_JZ4770
	select MACH_JZ4780
	select MACH_X1000

choice
	prompt "Machine type"
	depends on MACH_INGENIC_SOC
	default INGENIC_GENERIC_BOARD

config INGENIC_GENERIC_BOARD
	bool "Generic board"
	select MACH_INGENIC_GENERIC

config JZ4740_QI_LB60
	bool "Qi Hardware Ben NanoNote"
	select MACH_JZ4740

config JZ4740_RS90
	bool "YLM RetroMini (RS-90)"
	select MACH_JZ4725B

config JZ4770_GCW0
	bool "Game Consoles Worldwide GCW Zero"
	select MACH_JZ4770

config JZ4780_CI20
	bool "MIPS Creator CI20"
	select MACH_JZ4780

config X1000_CU1000_NEO
	bool "YSH & ATIL CU1000 Module with Neo backplane"
	select MACH_X1000

config X1830_CU1830_NEO
	bool "YSH & ATIL CU1830 Module with Neo backplane"
	select MACH_X1830

endchoice

config MACH_JZ4725B
	bool
	select SYS_HAS_CPU_MIPS32_R1

config MACH_JZ4740
	bool
	select SYS_HAS_CPU_MIPS32_R1

config MACH_JZ4770
	bool
	select MIPS_CPU_SCACHE
	select SYS_HAS_CPU_MIPS32_R2
	select SYS_SUPPORTS_HIGHMEM

config MACH_JZ4780
	bool
	select MIPS_CPU_SCACHE
	select SYS_HAS_CPU_MIPS32_R2
	select SYS_SUPPORTS_HIGHMEM

config MACH_X1000
	bool
	select MIPS_CPU_SCACHE
	select SYS_HAS_CPU_MIPS32_R2
	select SYS_SUPPORTS_HIGHMEM

config MACH_X1830
	bool
	select MIPS_CPU_SCACHE
	select SYS_HAS_CPU_MIPS32_R2
	select SYS_SUPPORTS_HIGHMEM
```

## arch/mips/ite-boards/Kconfig
```kconfig
config IT8172_REVC
	bool "Support for older IT8172 (Rev C)"
	depends on MIPS_ITE8172
	help
	  Say Y here to support the older, Revision C version of the Integrated
	  Technology Express, Inc. ITE8172 SBC.  Vendor page at
	  <http://www.ite.com.tw/ia/brief_it8172bsp.htm>; picture of the
	  board at <http://www.mvista.com/partners/semiconductor/ite.html>.
```
