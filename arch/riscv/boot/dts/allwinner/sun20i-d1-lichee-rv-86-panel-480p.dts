// SPDX-License-Identifier: (GPL-2.0+ or MIT)
// Copyright (C) 2022 Samuel Holland <samuel@sholland.org>

#include "sun20i-d1-lichee-rv-86-panel.dtsi"

/ {
	model = "Sipeed Lichee RV 86 Panel (480p)";
	compatible = "sipeed,lichee-rv-86-panel-480p", "sipeed,lichee-rv",
		     "allwinner,sun20i-d1";
};

&i2c2 {
	pinctrl-0 = <&i2c2_pb0_pins>;
	pinctrl-names = "default";
	status = "okay";

	touchscreen@48 {
		compatible = "focaltech,ft6236";
		reg = <0x48>;
		interrupt-parent = <&pio>;
		interrupts = <6 14 IRQ_TYPE_LEVEL_LOW>; /* PG14 */
		iovcc-supply = <&reg_vcc_3v3>;
		reset-gpios = <&pio 6 15 GPIO_ACTIVE_LOW>; /* PG15 */
		touchscreen-size-x = <480>;
		touchscreen-size-y = <480>;
		vcc-supply = <&reg_vcc_3v3>;
		wakeup-source;
	};
};
