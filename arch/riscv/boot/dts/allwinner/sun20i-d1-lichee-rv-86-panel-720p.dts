// SPDX-License-Identifier: (GPL-2.0+ or MIT)
// Copyright (C) 2022 Samuel Holland <samuel@sholland.org>

#include "sun20i-d1-lichee-rv-86-panel.dtsi"

/ {
	model = "Sipeed Lichee RV 86 Panel (720p)";
	compatible = "sipeed,lichee-rv-86-panel-720p", "sipeed,lichee-rv",
		     "allwinner,sun20i-d1";
};
