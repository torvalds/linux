// SPDX-License-Identifier: (GPL-2.0-only OR BSD-2-Clause)
/*
 * Device Tree Source for the RZ/Five SMARC EVK
 *
 * Copyright (C) 2022 Renesas Electronics Corp.
 */

/dts-v1/;

/*
 * DIP-Switch SW1 setting
 * 1 : High; 0: Low
 * SW1-2 : SW_SD0_DEV_SEL	(0: uSD; 1: eMMC)
 * SW1-3 : SW_ET0_EN_N		(0: ETHER0; 1: CAN0, CAN1, SSI1, RSPI1)
 * Please change below macros according to SW1 setting on the SoM
 */
#define SW_SW0_DEV_SEL	1
#define SW_ET0_EN_N	1

#include "r9a07g043f.dtsi"
#include "rzfive-smarc-som.dtsi"
#include "rzfive-smarc.dtsi"

/ {
	model = "Renesas SMARC EVK based on r9a07g043f01";
	compatible = "renesas,smarc-evk", "renesas,r9a07g043f01", "renesas,r9a07g043";
};
