// SPDX-License-Identifier: GPL-2.0+
/*
 * Copyright (C) 2020 Western Digital Corporation or its affiliates.
 */

/dts-v1/;

#include "k210.dtsi"

/ {
	model = "Kendryte K210 generic";
	compatible = "kendryte,k210";

	chosen {
		bootargs = "earlycon console=ttySIF0";
		stdout-path = "serial0";
	};
};

&uarths0 {
	status = "okay";
};

