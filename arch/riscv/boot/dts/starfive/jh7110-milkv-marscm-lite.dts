// SPDX-License-Identifier: GPL-2.0 OR MIT
/*
 * Copyright (C) 2025 E Shattow <e@freeshell.de>
 */

/dts-v1/;
#include "jh7110-milkv-marscm.dtsi"

/ {
	model = "Milk-V Mars CM Lite";
	compatible = "milkv,marscm-lite", "starfive,jh7110";
};

&mmc0 {
	bus-width = <4>;
	cd-gpios = <&sysgpio 41 GPIO_ACTIVE_LOW>;
};

&mmc0_pins {
	pwren-pins {
		pinmux = <GPIOMUX(22, GPOUT_HIGH,
				      GPOEN_ENABLE,
				      GPI_NONE)>;
	};
};
