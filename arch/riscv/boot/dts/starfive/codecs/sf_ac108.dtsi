&sound0 {
	/* i2s + ac108 */
	simple-audio-card,dai-link@0 {
		reg = <0>;
		format = "i2s";
		bitclock-master = <&sndcodec1>;
		frame-master = <&sndcodec1>;

		widgets =
				"Microphone", "Mic Jack",
				"Line", "Line In",
				"Line", "Line Out",
				"Speaker", "Speaker",
				"Headphone", "Headphone Jack";
		routing =
				"Headphone Jack", "HP_L",
				"Headphone Jack", "HP_R",
				"Speaker", "SPK_LP",
				"Speaker", "SPK_LN",
				"LINPUT1", "Mic Jack",
				"LINPUT3", "Mic Jack",
				"RINPUT1", "Mic Jack",
				"RINPUT2", "Mic Jack";

		cpu {
			sound-dai = <&i2srx_3ch>;
		};
		sndcodec1: codec {
			sound-dai = <&ac108_a>;
			clocks = <&ac108_mclk>;
			clock-names = "mclk";
		};
	};
};
