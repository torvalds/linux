&sound4 {
	simple-audio-card,dai-link@0 {
		reg = <0>;
		format = "left_j";
		bitclock-master = <&sndcpu0>;
		frame-master = <&sndcpu0>;
		status = "okay";

		sndcpu0: cpu {
			sound-dai = <&spdif0>;
		};

		codec {
			sound-dai = <&spdif_transmitter>;
		};
	};
};
