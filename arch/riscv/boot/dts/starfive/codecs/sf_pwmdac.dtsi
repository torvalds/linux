&sound {                
	simple-audio-card,dai-link@1 {
		reg = <0>;
		format = "left_j";
		bitclock-master = <&sndcpu0>;
		frame-master = <&sndcpu0>;
		status = "okay";

		sndcpu0: cpu {
			sound-dai = <&pwmdac>;
		};

		codec {
			sound-dai = <&pwmdac_codec>;
		};
	};
};

