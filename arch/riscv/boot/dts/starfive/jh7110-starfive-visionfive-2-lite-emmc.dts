// SPDX-License-Identifier: GPL-2.0 OR MIT
/*
 * Copyright (C) 2025 StarFive Technology Co., Ltd.
 * Copyright (C) 2025 Hal Feng <hal.feng@starfivetech.com>
 */

/dts-v1/;
#include "jh7110-starfive-visionfive-2-lite.dtsi"

/ {
	model = "StarFive VisionFive 2 Lite eMMC";
	compatible = "starfive,visionfive-2-lite-emmc", "starfive,jh7110s", "starfive,jh7110";
};

&mmc0 {
	cap-mmc-highspeed;
	cap-mmc-hw-reset;
	mmc-ddr-1_8v;
	mmc-hs200-1_8v;
	vmmc-supply = <&vcc_3v3>;
	vqmmc-supply = <&emmc_vdd>;
};
