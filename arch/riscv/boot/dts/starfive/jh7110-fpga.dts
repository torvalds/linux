// SPDX-License-Identifier: GPL-2.0 OR MIT
/*
 * Copyright (C) 2022 StarFive Technology Co., Ltd.
 * Copyright (C) 2022 Hal Feng <hal.feng@starfivetech.com>
 */

/dts-v1/;
#include "jh7110-common.dtsi"
//#include "codecs/sf_wm8960.dtsi"

/ {
	model = "StarFive JH7110 FPGA";
	compatible = "starfive,jh7110-fpga", "starfive,jh7110";

	cpus {
		timebase-frequency = <2000000>;
	};
};

&timer {
	clock-frequency = <2000000>;
};

&wdog {
	clock-frequency = <2000000>;
};