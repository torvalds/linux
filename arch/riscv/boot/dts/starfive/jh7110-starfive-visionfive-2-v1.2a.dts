// SPDX-License-Identifier: GPL-2.0 OR MIT
/*
 * Copyright (C) 2022 StarFive Technology Co., Ltd.
 * Copyright (C) 2022 Emil Renner Berthing <kernel@esmil.dk>
 */

/dts-v1/;
#include "jh7110-starfive-visionfive-2.dtsi"

/ {
	model = "StarFive VisionFive 2 v1.2A";
	compatible = "starfive,visionfive-2-v1.2a", "starfive,jh7110";
};

&gmac1 {
	phy-mode = "rmii";
	assigned-clocks = <&syscrg JH7110_SYSCLK_GMAC1_TX>,
			  <&syscrg JH7110_SYSCLK_GMAC1_RX>;
	assigned-clock-parents = <&syscrg JH7110_SYSCLK_GMAC1_RMII_RTX>,
				 <&syscrg JH7110_SYSCLK_GMAC1_RMII_RTX>;
};

&phy0 {
	rx-internal-delay-ps = <1900>;
	tx-internal-delay-ps = <1350>;
};
