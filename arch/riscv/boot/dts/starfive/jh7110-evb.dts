// SPDX-License-Identifier: GPL-2.0 OR MIT
/*
 * Copyright (C) 2022 StarFive Technology Co., Ltd.
 * Copyright (C) 2022 Hal Feng <hal.feng@starfivetech.com>
 */

/dts-v1/;
#include "jh7110-evb.dtsi"

/ {
	model = "StarFive JH7110 EVB";
	compatible = "starfive,jh7110-evb", "starfive,jh7110";
};

/* default sd card */
&sdio0 {
	max-frequency = <100000000>;
	card-detect-delay = <300>;
	bus-width = <4>;
	no-sdio;
	no-mmc;
	broken-cd;
	sd-uhs-sdr12;
	sd-uhs-sdr25;
	sd-uhs-sdr50;
	sd-uhs-sdr104;
	sd-uhs-ddr50;
	cap-sd-highspeed;
	post-power-on-delay-ms = <200>;
	status = "okay";
};

&usbdrd30 {
	xhci-lowmem-pool;
	status = "okay";
};


&pcie1 {
	status = "okay";
};
