// SPDX-License-Identifier: GPL-2.0 OR MIT
/*
 * Copyright (C) 2021 StarFive Technology Co., Ltd.
 * Copyright (C) 2021 Emil Renner Berthing <kernel@esmil.dk>
 */

/dts-v1/;
#include "jh7100-common.dtsi"
#include <dt-bindings/gpio/gpio.h>

/ {
	model = "StarFive VisionFive V1";
	compatible = "starfive,visionfive-v1", "starfive,jh7100";

	gpio-restart {
		compatible = "gpio-restart";
		gpios = <&gpio 63 GPIO_ACTIVE_HIGH>;
		priority = <224>;
	};
};
