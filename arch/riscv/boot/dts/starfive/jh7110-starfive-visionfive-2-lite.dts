// SPDX-License-Identifier: GPL-2.0 OR MIT
/*
 * Copyright (C) 2025 StarFive Technology Co., Ltd.
 * Copyright (C) 2025 Hal Feng <hal.feng@starfivetech.com>
 */

/dts-v1/;
#include "jh7110-starfive-visionfive-2-lite.dtsi"

/ {
	model = "StarFive VisionFive 2 Lite";
	compatible = "starfive,visionfive-2-lite", "starfive,jh7110s", "starfive,jh7110";
};

&mmc0 {
	bus-width = <4>;
	cd-gpios = <&sysgpio 41 GPIO_ACTIVE_HIGH>;
	disable-wp;
	cap-sd-highspeed;
};
