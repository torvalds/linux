// SPDX-License-Identifier: (GPL-2.0 OR MIT)
/*
 * Enable ethernet on Milk-V Duo 256M with the USB & Ethernet IO board.
 *
 * Copyright (c) 2026, Chen-Yu Yeh <chenyou910331@gmail.com>
 */

/dts-v1/;
/plugin/;

&gmac0 {
	status = "okay";
};

&mdio {
	status = "okay";
};
