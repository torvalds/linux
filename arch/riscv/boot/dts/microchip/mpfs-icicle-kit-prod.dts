// SPDX-License-Identifier: (GPL-2.0 OR MIT)
/* Copyright (c) 2025 Microchip Technology Inc */

/dts-v1/;

#include "mpfs-icicle-kit-common.dtsi"

/ {
	model = "Microchip PolarFire-SoC Icicle Kit (Production Silicon)";
	compatible = "microchip,mpfs-icicle-prod-reference-rtl-v2507",
		     "microchip,mpfs-icicle-kit-prod",
		     "microchip,mpfs-icicle-kit",
		     "microchip,mpfs-prod",
		     "microchip,mpfs";
};

&syscontroller {
	microchip,bitstream-flash = <&sys_ctrl_flash>;
};

&syscontroller_qspi {
	status = "okay";
};
