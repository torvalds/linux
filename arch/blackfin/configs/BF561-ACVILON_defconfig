## arch/blackfin/mach-bf533/boards/Kconfig
```kconfig
choice
	prompt "System type"
	default BFIN533_STAMP
	help
	  Select your board!

config BFIN533_EZKIT
	bool "BF533-EZKIT"
	help
	  BF533-EZKIT-LITE board support.

config BFIN533_STAMP
	bool "BF533-STAMP"
	help
	  BF533-STAMP board support.

config BLACKSTAMP
	bool "BlackStamp"
	help
	  Support for the BlackStamp board.  Hardware info available at
	  http://blackfin.uclinux.org/gf/project/blackstamp/

config BFIN533_BLUETECHNIX_CM
	bool "Bluetechnix CM-BF533"
	depends on (BF533)
	help
	  CM-BF533 support for EVAL- and DEV-Board.

config H8606_HVSISTEMAS
	bool "HV Sistemas H8606"
	depends on (BF532)
	help
	  HV Sistemas H8606 board support.

config BFIN532_IP0X
	bool "IP04/IP08 IP-PBX"
	depends on (BF532)
	help
	  Core support for IP04/IP04 open hardware IP-PBX.

endchoice
```

## arch/blackfin/mach-bf537/Kconfig
```kconfig
# SPDX-License-Identifier: GPL-2.0
if (BF537 || BF534 || BF536)

source "arch/blackfin/mach-bf537/boards/Kconfig"

menu "BF537 Specific Configuration"

comment "Interrupt Priority Assignment"
menu "Priority"

config IRQ_PLL_WAKEUP
	int "IRQ_PLL_WAKEUP"
	default 7
config IRQ_DMA_ERROR
	int "IRQ_DMA_ERROR Generic"
	default 7
config IRQ_ERROR
	int "IRQ_ERROR: PPI CAN MAC SPORT0 SPORT1 SPI UART0 UART1"
	default 11
config IRQ_RTC
	int "IRQ_RTC"
	default 8
config IRQ_PPI
	int "IRQ_PPI"
	default 8
config IRQ_SPORT0_RX
	int "IRQ_SPORT0_RX"
	default 9
config IRQ_SPORT0_TX
	int "IRQ_SPORT0_TX"
	default 9
config IRQ_SPORT1_RX
	int "IRQ_SPORT1_RX"
	default 9
config IRQ_SPORT1_TX
	int "IRQ_SPORT1_TX"
	default 9
config IRQ_TWI
	int "IRQ_TWI"
	default 10
config IRQ_SPI
	int "IRQ_SPI"
	default 10
config IRQ_UART0_RX
	int "IRQ_UART0_RX"
	default 10
config IRQ_UART0_TX
	int "IRQ_UART0_TX"
	default 10
config IRQ_UART1_RX
	int "IRQ_UART1_RX"
	default 10
config IRQ_UART1_TX
	int "IRQ_UART1_TX"
	default 10
config IRQ_CAN_RX
	int "IRQ_CAN_RX"
	default 11
config IRQ_CAN_TX
	int "IRQ_CAN_TX"
	default 11
config IRQ_MAC_RX
	int "IRQ_MAC_RX"
	default 11
config IRQ_MAC_TX
	int "IRQ_MAC_TX"
	default 11
config IRQ_TIMER0
	int "IRQ_TIMER0"
	default 7 if TICKSOURCE_GPTMR0
	default 8
config IRQ_TIMER1
	int "IRQ_TIMER1"
	default 12
config IRQ_TIMER2
	int "IRQ_TIMER2"
	default 12
config IRQ_TIMER3
	int "IRQ_TIMER3"
	default 12
config IRQ_TIMER4
	int "IRQ_TIMER4"
	default 12
config IRQ_TIMER5
	int "IRQ_TIMER5"
	default 12
config IRQ_TIMER6
	int "IRQ_TIMER6"
	default 12
config IRQ_TIMER7
	int "IRQ_TIMER7"
	default 12
config IRQ_PROG_INTA
	int "IRQ_PROG_INTA"
	default 12
config IRQ_PORTG_INTB
	int "IRQ_PORTG_INTB"
	default 12
config IRQ_MEM_DMA0
	int "IRQ_MEM_DMA0"
	default 13
config IRQ_MEM_DMA1
	int "IRQ_MEM_DMA1"
	default 13
config IRQ_WATCH
	int "IRQ_WATCH"
	default 13

	help
	  Enter the priority numbers between 7-13 ONLY.  Others are Reserved.
	  This applies to all the above.  It is not recommended to assign the
	  highest priority number 7 to UART or any other device.

endmenu

endmenu

endif
```

## arch/blackfin/mach-bf537/boards/Kconfig
```kconfig
choice
	prompt "System type"
	default BFIN537_STAMP
	help
	  Select your board!

config BFIN537_STAMP
	bool "BF537-STAMP"
	help
	  BF537-STAMP board support.

config BFIN537_BLUETECHNIX_CM_E
	bool "Bluetechnix CM-BF537E"
	depends on (BF537)
	help
	  CM-BF537E support for EVAL- and DEV-Board.

config BFIN537_BLUETECHNIX_CM_U
	bool "Bluetechnix CM-BF537U"
	depends on (BF537)
	help
	  CM-BF537U support for EVAL- and DEV-Board.

config BFIN537_BLUETECHNIX_TCM
	bool "Bluetechnix TCM-BF537"
	depends on (BF537)
	help
	  TCM-BF537 support for EVAL- and DEV-Board.

config PNAV10
	bool "PNAV board"
	depends on (BF537)
	help
	  PNAV board support.

config CAMSIG_MINOTAUR
	bool "Cambridge Signal Processing LTD Minotaur"
	depends on (BF537)
	help
	  Board supply package for CSP Minotaur

config DNP5370
	bool "SSV Dil/NetPC DNP/5370"
	depends on (BF537)
	help
	  Board supply package for DNP/5370 DIL64 module

endchoice
```

## arch/blackfin/mach-bf538/Kconfig
```kconfig
if (BF538 || BF539)

source "arch/blackfin/mach-bf538/boards/Kconfig"

menu "BF538 Specific Configuration"

comment "Interrupt Priority Assignment"
menu "Priority"

config IRQ_PLL_WAKEUP
	int "IRQ_PLL_WAKEUP"
	default 7
config IRQ_DMA0_ERROR
	int "IRQ_DMA0_ERROR"
	default 7
config IRQ_PPI_ERROR
	int "IRQ_PPI_ERROR"
	default 7
config IRQ_SPORT0_ERROR
	int "IRQ_SPORT0_ERROR"
	default 7
config IRQ_SPORT1_ERROR
	int "IRQ_SPORT1_ERROR"
	default 7
config IRQ_SPI0_ERROR
	int "IRQ_SPI0_ERROR"
	default 7
config IRQ_UART0_ERROR
	int "IRQ_UART0_ERROR"
	default 7
config IRQ_RTC
	int "IRQ_RTC"
	default 8
config IRQ_PPI
	int "IRQ_PPI"
	default 8
config IRQ_SPORT0_RX
	int "IRQ_SPORT0_RX"
	default 9
config IRQ_SPORT0_TX
	int "IRQ_SPORT0_TX"
	default 9
config IRQ_SPORT1_RX
	int "IRQ_SPORT1_RX"
	default 9
config IRQ_SPORT1_TX
	int "IRQ_SPORT1_TX"
	default 9
config IRQ_SPI0
	int "IRQ_SPI0"
	default 10
config IRQ_UART0_RX
	int "IRQ_UART0_RX"
	default 10
config IRQ_UART0_TX
	int "IRQ_UART0_TX"
	default 10
config IRQ_TIMER0
	int "IRQ_TIMER0"
	default 8
config IRQ_TIMER1
	int "IRQ_TIMER1"
	default 11
config IRQ_TIMER2
	int "IRQ_TIMER2"
	default 11
config IRQ_PORTF_INTA
	int "IRQ_PORTF_INTA"
	default 12
config IRQ_PORTF_INTB
	int "IRQ_PORTF_INTB"
	default 12
config IRQ_MEM0_DMA0
	int "IRQ_MEM0_DMA0"
	default 13
config IRQ_MEM0_DMA1
	int "IRQ_MEM0_DMA1"
	default 13
config IRQ_WATCH
	int "IRQ_WATCH"
	default 13
config IRQ_DMA1_ERROR
	int "IRQ_DMA1_ERROR"
	default 7
config IRQ_SPORT2_ERROR
	int "IRQ_SPORT2_ERROR"
	default 7
config IRQ_SPORT3_ERROR
	int "IRQ_SPORT3_ERROR"
	default 7
config IRQ_SPI1_ERROR
	int "IRQ_SPI1_ERROR"
	default 7
config IRQ_SPI2_ERROR
	int "IRQ_SPI2_ERROR"
	default 7
config IRQ_UART1_ERROR
	int "IRQ_UART1_ERROR"
	default 7
config IRQ_UART2_ERROR
	int "IRQ_UART2_ERROR"
	default 7
config IRQ_CAN_ERROR
	int "IRQ_CAN_ERROR"
	default 7
config IRQ_SPORT2_RX
	int "IRQ_SPORT2_RX"
	default 9
config IRQ_SPORT2_TX
	int "IRQ_SPORT2_TX"
	default 9
config IRQ_SPORT3_RX
	int "IRQ_SPORT3_RX"
	default 9
config IRQ_SPORT3_TX
	int "IRQ_SPORT3_TX"
	default 9
config IRQ_SPI1
	int "IRQ_SPI1"
	default 10
config IRQ_SPI2
	int "IRQ_SPI2"
	default 10
config IRQ_UART1_RX
	int "IRQ_UART1_RX"
	default 10
config IRQ_UART1_TX
	int "IRQ_UART1_TX"
	default 10
config IRQ_UART2_RX
	int "IRQ_UART2_RX"
	default 10
config IRQ_UART2_TX
	int "IRQ_UART2_TX"
	default 10
config IRQ_TWI0
	int "IRQ_TWI0"
	default 11
config IRQ_TWI1
	int "IRQ_TWI1"
	default 11
config IRQ_CAN_RX
	int "IRQ_CAN_RX"
	default 11
config IRQ_CAN_TX
	int "IRQ_CAN_TX"
	default 11
config IRQ_MEM1_DMA0
	int "IRQ_MEM1_DMA0"
	default 13
config IRQ_MEM1_DMA1
	int "IRQ_MEM1_DMA1"
	default 13

	help
	  Enter the priority numbers between 7-13 ONLY.  Others are Reserved.
	  This applies to all the above.  It is not recommended to assign the
	  highest priority number 7 to UART or any other device.

endmenu

endmenu

endif
```
