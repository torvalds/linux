## arch/blackfin/mach-bf609/Kconfig
```kconfig
config BF60x
	def_bool y
	depends on (BF609)
	select IRQ_PREFLOW_FASTEOI

if (BF60x)

source "arch/blackfin/mach-bf609/boards/Kconfig"

menu "BF609 Specific Configuration"

comment "Pin Interrupt to Port Assignment"
menu "Assignment"

config PINTx_REASSIGN
	bool "Reprogram PINT Assignment"
	default y
	help
	  The interrupt assignment registers controls the pin-to-interrupt
	  assignment in a byte-wide manner. Each option allows you to select
	  a set of pins (High/Low Byte) of an specific Port being mapped
	  to one of the four PIN Interrupts IRQ_PINTx.

	  You shouldn't change any of these unless you know exactly what you're doing.
	  Please consult the Blackfin BF60x Processor Hardware Reference Manual.

config PINT0_ASSIGN
	hex "PINT0_ASSIGN"
	depends on PINTx_REASSIGN
	default 0x00000101
config PINT1_ASSIGN
	hex "PINT1_ASSIGN"
	depends on PINTx_REASSIGN
	default 0x00000101
config PINT2_ASSIGN
	hex "PINT2_ASSIGN"
	depends on PINTx_REASSIGN
	default 0x00000101
config PINT3_ASSIGN
	hex "PINT3_ASSIGN"
	depends on PINTx_REASSIGN
	default 0x00000101
config PINT4_ASSIGN
	hex "PINT3_ASSIGN"
	depends on PINTx_REASSIGN
	default 0x00000101
config PINT5_ASSIGN
	hex "PINT3_ASSIGN"
	depends on PINTx_REASSIGN
	default 0x00000101

endmenu

config SEC_IRQ_PRIORITY_LEVELS
	int "SEC interrupt priority levels"
	default 7
	range 0 7
	help
	  Divide the total number of interrupt priority levels into sub-levels.
	  There is 2 ^ (SEC_IRQ_PRIORITY_LEVELS + 1) different levels.


comment "System Cross Bar Priority Assignment"

config SCB_PRIORITY
	bool "Init System Cross Bar Priority"
	default n

menuconfig	SCB0_MI0
	bool "SCB0 Master Interface 0 (DDR)"
	default n
	depends on SCB_PRIORITY
	help
	The slave interface id of each slot should be set according following table.
	Core 0	-- 0
	Core 1	-- 2
	SCB1	-- 9
	SCB2	-- 10
	SCB3	-- 11
	SCB4	-- 12
	SCB5	-- 5
	SCB6	-- 6
	SCB7	-- 8
	SCB8	-- 7
	SCB9	-- 4
	USB	-- 13

if SCB0_MI0

config SCB0_MI0_SLOT0
	int "Slot 0 slave interface id"
	default 0
	range 0 13

config SCB0_MI0_SLOT1
	int "Slot 1 slave interface id"
	default 2
	range 0 13

config SCB0_MI0_SLOT2
	int "Slot 2 slave interface id"
	default 4
	range 0 13

config SCB0_MI0_SLOT3
	int "Slot 3 slave interface id"
	default 5
	range 0 13

config SCB0_MI0_SLOT4
	int "Slot 4 slave interface id"
	default 6
	range 0 13

config SCB0_MI0_SLOT5
	int "Slot 5 slave interface id"
	default 7
	range 0 13

config SCB0_MI0_SLOT6
	int "Slot 6 slave interface id"
	default 8
	range 0 13

config SCB0_MI0_SLOT7
	int "Slot 7 slave interface id"
	default 9
	range 0 13

config SCB0_MI0_SLOT8
	int "Slot 8 slave interface id"
	default 10
	range 0 13

config SCB0_MI0_SLOT9
	int "Slot 9 slave interface id"
	default 11
	range 0 13

config SCB0_MI0_SLOT10
	int "Slot 10 slave interface id"
	default 13
	range 0 13

config SCB0_MI0_SLOT11
	int "Slot 11 slave interface id"
	default 12
	range 0 13

config SCB0_MI0_SLOT12
	int "Slot 12 slave interface id"
	default 0
	range 0 13

config SCB0_MI0_SLOT13
	int "Slot 13 slave interface id"
	default 2
	range 0 13

config SCB0_MI0_SLOT14
	int "Slot 14 slave interface id"
	default 4
	range 0 13

config SCB0_MI0_SLOT15
	int "Slot 15 slave interface id"
	default 5
	range 0 13

config SCB0_MI0_SLOT16
	int "Slot 16 slave interface id"
	default 6
	range 0 13

config SCB0_MI0_SLOT17
	int "Slot 17 slave interface id"
	default 7
	range 0 13

config SCB0_MI0_SLOT18
	int "Slot 18 slave interface id"
	default 8
	range 0 13

config SCB0_MI0_SLOT19
	int "Slot 19 slave interface id"
	default 9
	range 0 13

config SCB0_MI0_SLOT20
	int "Slot 20 slave interface id"
	default 10
	range 0 13

config SCB0_MI0_SLOT21
	int "Slot 21 slave interface id"
	default 11
	range 0 13

config SCB0_MI0_SLOT22
	int "Slot 22 slave interface id"
	default 13
	range 0 13

config SCB0_MI0_SLOT23
	int "Slot 23 slave interface id"
	default 12
	range 0 13

config SCB0_MI0_SLOT24
	int "Slot 24 slave interface id"
	default 0
	range 0 13

config SCB0_MI0_SLOT25
	int "Slot 25 slave interface id"
	default 2
	range 0 13

config SCB0_MI0_SLOT26
	int "Slot 26 slave interface id"
	default 4
	range 0 13

config SCB0_MI0_SLOT27
	int "Slot 27 slave interface id"
	default 5
	range 0 13

config SCB0_MI0_SLOT28
	int "Slot 28 slave interface id"
	default 6
	range 0 13

config SCB0_MI0_SLOT29
	int "Slot 29 slave interface id"
	default 7
	range 0 13

config SCB0_MI0_SLOT30
	int "Slot 30 slave interface id"
	default 8
	range 0 13

config SCB0_MI0_SLOT31
	int "Slot 31 slave interface id"
	default 13
	range 0 13

endif # SCB0_MI0

menuconfig	SCB0_MI1
	bool "SCB0 Master Interface 1 (SMC)"
	default n
	depends on SCB_PRIORITY
	help
	The slave interface id of each slot should be set according following table.
	Core 0	-- 0
	Core 1	-- 2
	SCB1	-- 9
	SCB2	-- 10
	SCB3	-- 11
	SCB4	-- 12
	SCB5	-- 5
	SCB6	-- 6
	SCB7	-- 8
	SCB8	-- 7
	SCB9	-- 4
	USB	-- 13

if SCB0_MI1

config SCB0_MI1_SLOT0
	int "Slot 0 slave interface id"
	default 0
	range 0 13

config SCB0_MI1_SLOT1
	int "Slot 1 slave interface id"
	default 2
	range 0 13

config SCB0_MI1_SLOT2
	int "Slot 2 slave interface id"
	default 4
	range 0 13

config SCB0_MI1_SLOT3
	int "Slot 3 slave interface id"
	default 5
	range 0 13

config SCB0_MI1_SLOT4
	int "Slot 4 slave interface id"
	default 6
	range 0 13

config SCB0_MI1_SLOT5
	int "Slot 5 slave interface id"
	default 7
	range 0 13

config SCB0_MI1_SLOT6
	int "Slot 6 slave interface id"
	default 8
	range 0 13

config SCB0_MI1_SLOT7
	int "Slot 7 slave interface id"
	default 9
	range 0 13

config SCB0_MI1_SLOT8
	int "Slot 8 slave interface id"
	default 10
	range 0 13

config SCB0_MI1_SLOT9
	int "Slot 9 slave interface id"
	default 11
	range 0 13

config SCB0_MI1_SLOT10
	int "Slot 10 slave interface id"
	default 13
	range 0 13

config SCB0_MI1_SLOT11
	int "Slot 11 slave interface id"
	default 12
	range 0 13

config SCB0_MI1_SLOT12
	int "Slot 12 slave interface id"
	default 0
	range 0 13

config SCB0_MI1_SLOT13
	int "Slot 13 slave interface id"
	default 2
	range 0 13

config SCB0_MI1_SLOT14
	int "Slot 14 slave interface id"
	default 4
	range 0 13

config SCB0_MI1_SLOT15
	int "Slot 15 slave interface id"
	default 5
	range 0 13

config SCB0_MI1_SLOT16
	int "Slot 16 slave interface id"
	default 6
	range 0 13

config SCB0_MI1_SLOT17
	int "Slot 17 slave interface id"
	default 7
	range 0 13

config SCB0_MI1_SLOT18
	int "Slot 18 slave interface id"
	default 8
	range 0 13

config SCB0_MI1_SLOT19
	int "Slot 19 slave interface id"
	default 9
	range 0 13

config SCB0_MI1_SLOT20
	int "Slot 20 slave interface id"
	default 10
	range 0 13

config SCB0_MI1_SLOT21
	int "Slot 21 slave interface id"
	default 11
	range 0 13

config SCB0_MI1_SLOT22
	int "Slot 22 slave interface id"
	default 13
	range 0 13

config SCB0_MI1_SLOT23
	int "Slot 23 slave interface id"
	default 12
	range 0 13

config SCB0_MI1_SLOT24
	int "Slot 24 slave interface id"
	default 0
	range 0 13

config SCB0_MI1_SLOT25
	int "Slot 25 slave interface id"
	default 2
	range 0 13

config SCB0_MI1_SLOT26
	int "Slot 26 slave interface id"
	default 4
	range 0 13

config SCB0_MI1_SLOT27
	int "Slot 27 slave interface id"
	default 5
	range 0 13

config SCB0_MI1_SLOT28
	int "Slot 28 slave interface id"
	default 6
	range 0 13

config SCB0_MI1_SLOT29
	int "Slot 29 slave interface id"
	default 7
	range 0 13

config SCB0_MI1_SLOT30
	int "Slot 30 slave interface id"
	default 8
	range 0 13

config SCB0_MI1_SLOT31
	int "Slot 31 slave interface id"
	default 13
	range 0 13

endif # SCB0_MI1

menuconfig	SCB0_MI2
	bool "SCB0 Master Interface 2 (Data L2)"
	default n
	depends on SCB_PRIORITY
	help
	The slave interface id of each slot should be set according following table.
	Core 0	-- 0
	Core 1	-- 2
	SCB1	-- 9
	SCB2	-- 10
	SCB3	-- 11
	SCB4	-- 12
	SCB5	-- 5
	SCB6	-- 6
	SCB7	-- 8
	SCB8	-- 7
	SCB9	-- 4
	USB	-- 13

if SCB0_MI2

config SCB0_MI2_SLOT0
	int "Slot 0 slave interface id"
	default 4
	range 0 13

config SCB0_MI2_SLOT1
	int "Slot 1 slave interface id"
	default 5
	range 0 13

config SCB0_MI2_SLOT2
	int "Slot 2 slave interface id"
	default 6
	range 0 13

config SCB0_MI2_SLOT3
	int "Slot 3 slave interface id"
	default 7
	range 0 13

config SCB0_MI2_SLOT4
	int "Slot 4 slave interface id"
	default 8
	range 0 13

config SCB0_MI2_SLOT5
	int "Slot 5 slave interface id"
	default 9
	range 0 13

config SCB0_MI2_SLOT6
	int "Slot 6 slave interface id"
	default 10
	range 0 13

config SCB0_MI2_SLOT7
	int "Slot 7 slave interface id"
	default 11
	range 0 13

config SCB0_MI2_SLOT8
	int "Slot 8 slave interface id"
	default 13
	range 0 13

config SCB0_MI2_SLOT9
	int "Slot 9 slave interface id"
	default 12
	range 0 13

config SCB0_MI2_SLOT10
	int "Slot 10 slave interface id"
	default 4
	range 0 13

config SCB0_MI2_SLOT11
	int "Slot 11 slave interface id"
	default 5
	range 0 13

config SCB0_MI2_SLOT12
	int "Slot 12 slave interface id"
	default 6
	range 0 13

config SCB0_MI2_SLOT13
	int "Slot 13 slave interface id"
	default 7
	range 0 13

config SCB0_MI2_SLOT14
	int "Slot 14 slave interface id"
	default 8
	range 0 13

config SCB0_MI2_SLOT15
	int "Slot 15 slave interface id"
	default 9
	range 0 13

config SCB0_MI2_SLOT16
	int "Slot 16 slave interface id"
	default 10
	range 0 13

config SCB0_MI2_SLOT17
	int "Slot 17 slave interface id"
	default 11
	range 0 13

config SCB0_MI2_SLOT18
	int "Slot 18 slave interface id"
	default 13
	range 0 13

config SCB0_MI2_SLOT19
	int "Slot 19 slave interface id"
	default 12
	range 0 13

config SCB0_MI2_SLOT20
	int "Slot 20 slave interface id"
	default 4
	range 0 13

config SCB0_MI2_SLOT21
	int "Slot 21 slave interface id"
	default 5
	range 0 13

config SCB0_MI2_SLOT22
	int "Slot 22 slave interface id"
	default 6
	range 0 13

config SCB0_MI2_SLOT23
	int "Slot 23 slave interface id"
	default 7
	range 0 13

config SCB0_MI2_SLOT24
	int "Slot 24 slave interface id"
	default 8
	range 0 13

config SCB0_MI2_SLOT25
	int "Slot 25 slave interface id"
	default 9
	range 0 13

config SCB0_MI2_SLOT26
	int "Slot 26 slave interface id"
	default 10
	range 0 13

config SCB0_MI2_SLOT27
	int "Slot 27 slave interface id"
	default 11
	range 0 13

config SCB0_MI2_SLOT28
	int "Slot 28 slave interface id"
	default 13
	range 0 13

config SCB0_MI2_SLOT29
	int "Slot 29 slave interface id"
	default 12
	range 0 13

config SCB0_MI2_SLOT30
	int "Slot 30 slave interface id"
	default 4
	range 0 13

config SCB0_MI2_SLOT31
	int "Slot 31 slave interface id"
	default 7
	range 0 13

endif # SCB0_MI2

menuconfig	SCB0_MI3
	bool "SCB0 Master Interface 3 (L1A)"
	default n
	depends on SCB_PRIORITY
	help
	The slave interface id of each slot should be set according following table.
	Core 0	-- 0
	Core 1	-- 2
	SCB1	-- 9
	SCB2	-- 10
	SCB3	-- 11
	SCB4	-- 12
	SCB5	-- 5
	SCB6	-- 6
	SCB7	-- 8
	SCB8	-- 7
	SCB9	-- 4
	USB	-- 13

if SCB0_MI3

config SCB0_MI3_SLOT0
	int "Slot 0 slave interface id"
	default 4
	range 0 13

config SCB0_MI3_SLOT1
	int "Slot 1 slave interface id"
	default 5
	range 0 13

config SCB0_MI3_SLOT2
	int "Slot 2 slave interface id"
	default 6
	range 0 13

config SCB0_MI3_SLOT3
	int "Slot 3 slave interface id"
	default 7
	range 0 13

config SCB0_MI3_SLOT4
	int "Slot 4 slave interface id"
	default 8
	range 0 13

config SCB0_MI3_SLOT5
	int "Slot 5 slave interface id"
	default 9
	range 0 13

config SCB0_MI3_SLOT6
	int "Slot 6 slave interface id"
	default 10
	range 0 13

config SCB0_MI3_SLOT7
	int "Slot 7 slave interface id"
	default 11
	range 0 13

config SCB0_MI3_SLOT8
	int "Slot 8 slave interface id"
	default 13
	range 0 13

config SCB0_MI3_SLOT9
	int "Slot 9 slave interface id"
	default 12
	range 0 13

config SCB0_MI3_SLOT10
	int "Slot 10 slave interface id"
	default 4
	range 0 13

config SCB0_MI3_SLOT11
	int "Slot 11 slave interface id"
	default 5
	range 0 13

config SCB0_MI3_SLOT12
	int "Slot 12 slave interface id"
	default 6
	range 0 13

config SCB0_MI3_SLOT13
	int "Slot 13 slave interface id"
	default 7
	range 0 13

config SCB0_MI3_SLOT14
	int "Slot 14 slave interface id"
	default 8
	range 0 13

config SCB0_MI3_SLOT15
	int "Slot 15 slave interface id"
	default 9
	range 0 13

config SCB0_MI3_SLOT16
	int "Slot 16 slave interface id"
	default 10
	range 0 13

config SCB0_MI3_SLOT17
	int "Slot 17 slave interface id"
	default 11
	range 0 13

config SCB0_MI3_SLOT18
	int "Slot 18 slave interface id"
	default 13
	range 0 13

config SCB0_MI3_SLOT19
	int "Slot 19 slave interface id"
	default 12
	range 0 13

config SCB0_MI3_SLOT20
	int "Slot 20 slave interface id"
	default 4
	range 0 13

config SCB0_MI3_SLOT21
	int "Slot 21 slave interface id"
	default 5
	range 0 13

config SCB0_MI3_SLOT22
	int "Slot 22 slave interface id"
	default 6
	range 0 13

config SCB0_MI3_SLOT23
	int "Slot 23 slave interface id"
	default 7
	range 0 13

config SCB0_MI3_SLOT24
	int "Slot 24 slave interface id"
	default 8
	range 0 13

config SCB0_MI3_SLOT25
	int "Slot 25 slave interface id"
	default 9
	range 0 13

config SCB0_MI3_SLOT26
	int "Slot 26 slave interface id"
	default 10
	range 0 13

config SCB0_MI3_SLOT27
	int "Slot 27 slave interface id"
	default 11
	range 0 13

config SCB0_MI3_SLOT28
	int "Slot 28 slave interface id"
	default 13
	range 0 13

config SCB0_MI3_SLOT29
	int "Slot 29 slave interface id"
	default 12
	range 0 13

config SCB0_MI3_SLOT30
	int "Slot 30 slave interface id"
	default 4
	range 0 13

config SCB0_MI3_SLOT31
	int "Slot 31 slave interface id"
	default 7
	range 0 13

endif # SCB0_MI3

menuconfig	SCB0_MI4
	bool "SCB0 Master Interface 4 (L1B)"
	default n
	depends on SCB_PRIORITY
	help
	The slave interface id of each slot should be set according following table.
	Core 0	-- 0
	Core 1	-- 2
	SCB1	-- 9
	SCB2	-- 10
	SCB3	-- 11
	SCB4	-- 12
	SCB5	-- 5
	SCB6	-- 6
	SCB7	-- 8
	SCB8	-- 7
	SCB9	-- 4
	USB	-- 13

if SCB0_MI4

config SCB0_MI4_SLOT0
	int "Slot 0 slave interface id"
	default 4
	range 0 13

config SCB0_MI4_SLOT1
	int "Slot 1 slave interface id"
	default 5
	range 0 13

config SCB0_MI4_SLOT2
	int "Slot 2 slave interface id"
	default 6
	range 0 13

config SCB0_MI4_SLOT3
	int "Slot 3 slave interface id"
	default 7
	range 0 13

config SCB0_MI4_SLOT4
	int "Slot 4 slave interface id"
	default 8
	range 0 13

config SCB0_MI4_SLOT5
	int "Slot 5 slave interface id"
	default 9
	range 0 13

config SCB0_MI4_SLOT6
	int "Slot 6 slave interface id"
	default 10
	range 0 13

config SCB0_MI4_SLOT7
	int "Slot 7 slave interface id"
	default 11
	range 0 13

config SCB0_MI4_SLOT8
	int "Slot 8 slave interface id"
	default 13
	range 0 13

config SCB0_MI4_SLOT9
	int "Slot 9 slave interface id"
	default 12
	range 0 13

config SCB0_MI4_SLOT10
	int "Slot 10 slave interface id"
	default 4
	range 0 13

config SCB0_MI4_SLOT11
	int "Slot 11 slave interface id"
	default 5
	range 0 13

config SCB0_MI4_SLOT12
	int "Slot 12 slave interface id"
	default 6
	range 0 13

config SCB0_MI4_SLOT13
	int "Slot 13 slave interface id"
	default 7
	range 0 13

config SCB0_MI4_SLOT14
	int "Slot 14 slave interface id"
	default 8
	range 0 13

config SCB0_MI4_SLOT15
	int "Slot 15 slave interface id"
	default 9
	range 0 13

config SCB0_MI4_SLOT16
	int "Slot 16 slave interface id"
	default 10
	range 0 13

config SCB0_MI4_SLOT17
	int "Slot 17 slave interface id"
	default 11
	range 0 13

config SCB0_MI4_SLOT18
	int "Slot 18 slave interface id"
	default 13
	range 0 13

config SCB0_MI4_SLOT19
	int "Slot 19 slave interface id"
	default 12
	range 0 13

config SCB0_MI4_SLOT20
	int "Slot 20 slave interface id"
	default 4
	range 0 13

config SCB0_MI4_SLOT21
	int "Slot 21 slave interface id"
	default 5
	range 0 13

config SCB0_MI4_SLOT22
	int "Slot 22 slave interface id"
	default 6
	range 0 13

config SCB0_MI4_SLOT23
	int "Slot 23 slave interface id"
	default 7
	range 0 13

config SCB0_MI4_SLOT24
	int "Slot 24 slave interface id"
	default 8
	range 0 13

config SCB0_MI4_SLOT25
	int "Slot 25 slave interface id"
	default 9
	range 0 13

config SCB0_MI4_SLOT26
	int "Slot 26 slave interface id"
	default 10
	range 0 13

config SCB0_MI4_SLOT27
	int "Slot 27 slave interface id"
	default 11
	range 0 13

config SCB0_MI4_SLOT28
	int "Slot 28 slave interface id"
	default 13
	range 0 13

config SCB0_MI4_SLOT29
	int "Slot 29 slave interface id"
	default 12
	range 0 13

config SCB0_MI4_SLOT30
	int "Slot 30 slave interface id"
	default 4
	range 0 13

config SCB0_MI4_SLOT31
	int "Slot 31 slave interface id"
	default 7
	range 0 13

endif # SCB0_MI4

menuconfig	SCB0_MI5
	bool "SCB0 Master Interface 5 (SMMR)"
	default n
	depends on SCB_PRIORITY
	help
	The slave interface id of each slot should be set according following table.
	MMR0	-- 1
	MMR1	-- 3
	SCB2	-- 10
	SCB4	-- 12

if SCB0_MI5

config SCB0_MI5_SLOT0
	int "Slot 0 slave interface id"
	default 1
	range 0 13

config SCB0_MI5_SLOT1
	int "Slot 1 slave interface id"
	default 3
	range 0 13

config SCB0_MI5_SLOT2
	int "Slot 2 slave interface id"
	default 10
	range 0 13

config SCB0_MI5_SLOT3
	int "Slot 3 slave interface id"
	default 12
	range 0 13

config SCB0_MI5_SLOT4
	int "Slot 4 slave interface id"
	default 1
	range 0 13

config SCB0_MI5_SLOT5
	int "Slot 5 slave interface id"
	default 3
	range 0 13

config SCB0_MI5_SLOT6
	int "Slot 6 slave interface id"
	default 10
	range 0 13

config SCB0_MI5_SLOT7
	int "Slot 7 slave interface id"
	default 12
	range 0 13

config SCB0_MI5_SLOT8
	int "Slot 8 slave interface id"
	default 1
	range 0 13

config SCB0_MI5_SLOT9
	int "Slot 9 slave interface id"
	default 3
	range 0 13

config SCB0_MI5_SLOT10
	int "Slot 10 slave interface id"
	default 10
	range 0 13

config SCB0_MI5_SLOT11
	int "Slot 11 slave interface id"
	default 12
	range 0 13

config SCB0_MI5_SLOT12
	int "Slot 12 slave interface id"
	default 1
	range 0 13

config SCB0_MI5_SLOT13
	int "Slot 13 slave interface id"
	default 3
	range 0 13

config SCB0_MI5_SLOT14
	int "Slot 14 slave interface id"
	default 10
	range 0 13

config SCB0_MI5_SLOT15
	int "Slot 15 slave interface id"
	default 12
	range 0 13

endif # SCB0_MI5

menuconfig	SCB1_MI0
	bool "SCB1 Master Interface 0"
	default n
	depends on SCB_PRIORITY
	help
	The slave interface id of each slot should be set according following table.
	SPORT0A	-- 0
	SPORT0B	-- 1
	SPORT1A	-- 2
	SPORT1B	-- 3
	SPORT2A	-- 4
	SPORT2B	-- 5
	SPI0TX	-- 6
	SPI0RX	-- 7
	SPI1TX	-- 8
	SPI1RX	-- 9

if SCB1_MI0

config SCB1_MI0_SLOT0
	int "Slot 0 slave interface id"
	default 0
	range 0 9

config SCB1_MI0_SLOT1
	int "Slot 1 slave interface id"
	default 1
	range 0 9

config SCB1_MI0_SLOT2
	int "Slot 2 slave interface id"
	default 2
	range 0 9

config SCB1_MI0_SLOT3
	int "Slot 3 slave interface id"
	default 3
	range 0 9

config SCB1_MI0_SLOT4
	int "Slot 4 slave interface id"
	default 4
	range 0 9

config SCB1_MI0_SLOT5
	int "Slot 5 slave interface id"
	default 5
	range 0 9

config SCB1_MI0_SLOT6
	int "Slot 6 slave interface id"
	default 6
	range 0 9

config SCB1_MI0_SLOT7
	int "Slot 7 slave interface id"
	default 7
	range 0 9

config SCB1_MI0_SLOT8
	int "Slot 8 slave interface id"
	default 8
	range 0 9

config SCB1_MI0_SLOT9
	int "Slot 9 slave interface id"
	default 9
	range 0 9

config SCB1_MI0_SLOT10
	int "Slot 10 slave interface id"
	default 0
	range 0 9

config SCB1_MI0_SLOT11
	int "Slot 11 slave interface id"
	default 1
	range 0 9

config SCB1_MI0_SLOT12
	int "Slot 12 slave interface id"
	default 2
	range 0 9

config SCB1_MI0_SLOT13
	int "Slot 13 slave interface id"
	default 3
	range 0 9

config SCB1_MI0_SLOT14
	int "Slot 14 slave interface id"
	default 4
	range 0 9

config SCB1_MI0_SLOT15
	int "Slot 15 slave interface id"
	default 5
	range 0 9

config SCB1_MI0_SLOT16
	int "Slot 16 slave interface id"
	default 6
	range 0 13

config SCB1_MI0_SLOT17
	int "Slot 17 slave interface id"
	default 7
	range 0 13

config SCB1_MI0_SLOT18
	int "Slot 18 slave interface id"
	default 8
	range 0 13

config SCB1_MI0_SLOT19
	int "Slot 19 slave interface id"
	default 9
	range 0 13

endif # SCB1_MI0

menuconfig	SCB2_MI0
	bool "SCB2 Master Interface 0"
	default n
	depends on SCB_PRIORITY
	help
	The slave interface id of each slot should be set according following table.
	RSI	-- 0
	SDU DMA	-- 1
	SDU	-- 2
	EMAC0	-- 3
	EMAC1	-- 4

if SCB2_MI0

config SCB2_MI0_SLOT0
	int "Slot 0 slave interface id"
	default 0
	range 0 4

config SCB2_MI0_SLOT1
	int "Slot 1 slave interface id"
	default 1
	range 0 4

config SCB2_MI0_SLOT2
	int "Slot 2 slave interface id"
	default 2
	range 0 4

config SCB2_MI0_SLOT3
	int "Slot 3 slave interface id"
	default 3
	range 0 4

config SCB2_MI0_SLOT4
	int "Slot 4 slave interface id"
	default 4
	range 0 4

config SCB2_MI0_SLOT5
	int "Slot 5 slave interface id"
	default 0
	range 0 4

config SCB2_MI0_SLOT6
	int "Slot 6 slave interface id"
	default 1
	range 0 4

config SCB2_MI0_SLOT7
	int "Slot 7 slave interface id"
	default 2
	range 0 4

config SCB2_MI0_SLOT8
	int "Slot 8 slave interface id"
	default 3
	range 0 4

config SCB2_MI0_SLOT9
	int "Slot 9 slave interface id"
	default 4
	range 0 4

endif # SCB2_MI0

menuconfig	SCB3_MI0
	bool "SCB3 Master Interface 0"
	default n
	depends on SCB_PRIORITY
	help
	The slave interface id of each slot should be set according following table.
	LP0	-- 0
	LP1	-- 1
	LP2	-- 2
	LP3	-- 3
	UART0TX	-- 4
	UART0RX	-- 5
	UART1TX	-- 4
	UART1RX	-- 5

if SCB3_MI0

config SCB3_MI0_SLOT0
	int "Slot 0 slave interface id"
	default 0
	range 0 7

config SCB3_MI0_SLOT1
	int "Slot 1 slave interface id"
	default 1
	range 0 7

config SCB3_MI0_SLOT2
	int "Slot 2 slave interface id"
	default 2
	range 0 7

config SCB3_MI0_SLOT3
	int "Slot 3 slave interface id"
	default 3
	range 0 7

config SCB3_MI0_SLOT4
	int "Slot 4 slave interface id"
	default 4
	range 0 7

config SCB3_MI0_SLOT5
	int "Slot 5 slave interface id"
	default 5
	range 0 7

config SCB3_MI0_SLOT6
	int "Slot 6 slave interface id"
	default 6
	range 0 7

config SCB3_MI0_SLOT7
	int "Slot 7 slave interface id"
	default 7
	range 0 7

config SCB3_MI0_SLOT8
	int "Slot 8 slave interface id"
	default 0
	range 0 7

config SCB3_MI0_SLOT9
	int "Slot 9 slave interface id"
	default 1
	range 0 7

config SCB3_MI0_SLOT10
	int "Slot 10 slave interface id"
	default 2
	range 0 7

config SCB3_MI0_SLOT11
	int "Slot 11 slave interface id"
	default 3
	range 0 7

config SCB3_MI0_SLOT12
	int "Slot 12 slave interface id"
	default 4
	range 0 7

config SCB3_MI0_SLOT13
	int "Slot 13 slave interface id"
	default 5
	range 0 7

config SCB3_MI0_SLOT14
	int "Slot 14 slave interface id"
	default 6
	range 0 7

config SCB3_MI0_SLOT15
	int "Slot 15 slave interface id"
	default 7
	range 0 7

endif # SCB3_MI0

menuconfig	SCB4_MI0
	bool "SCB4 Master Interface 0"
	default n
	depends on SCB_PRIORITY
	help
	The slave interface id of each slot should be set according following table.
	MDA21	-- 0
	MDA22	-- 1
	MDA23	-- 2
	MDA24	-- 3
	MDA25	-- 4
	MDA26	-- 5
	MDA27	-- 6
	MDA28	-- 7

if SCB4_MI0

config SCB4_MI0_SLOT0
	int "Slot 0 slave interface id"
	default 0
	range 0 7

config SCB4_MI0_SLOT1
	int "Slot 1 slave interface id"
	default 1
	range 0 7

config SCB4_MI0_SLOT2
	int "Slot 2 slave interface id"
	default 2
	range 0 7

config SCB4_MI0_SLOT3
	int "Slot 3 slave interface id"
	default 3
	range 0 7

config SCB4_MI0_SLOT4
	int "Slot 4 slave interface id"
	default 4
	range 0 7

config SCB4_MI0_SLOT5
	int "Slot 5 slave interface id"
	default 5
	range 0 7

config SCB4_MI0_SLOT6
	int "Slot 6 slave interface id"
	default 6
	range 0 7

config SCB4_MI0_SLOT7
	int "Slot 7 slave interface id"
	default 7
	range 0 7

config SCB4_MI0_SLOT8
	int "Slot 8 slave interface id"
	default 0
	range 0 7

config SCB4_MI0_SLOT9
	int "Slot 9 slave interface id"
	default 1
	range 0 7

config SCB4_MI0_SLOT10
	int "Slot 10 slave interface id"
	default 2
	range 0 7

config SCB4_MI0_SLOT11
	int "Slot 11 slave interface id"
	default 3
	range 0 7

config SCB4_MI0_SLOT12
	int "Slot 12 slave interface id"
	default 4
	range 0 7

config SCB4_MI0_SLOT13
	int "Slot 13 slave interface id"
	default 5
	range 0 7

config SCB4_MI0_SLOT14
	int "Slot 14 slave interface id"
	default 6
	range 0 7

config SCB4_MI0_SLOT15
	int "Slot 15 slave interface id"
	default 7
	range 0 7

endif # SCB4_MI0

menuconfig	SCB5_MI0
	bool "SCB5 Master Interface 0"
	default n
	depends on SCB_PRIORITY
	help
	The slave interface id of each slot should be set according following table.
	PPI0 MDA29	-- 0
	PPI0 MDA30	-- 1
	PPI2 MDA31	-- 2
	PPI2 MDA32	-- 3

if SCB5_MI0

config SCB5_MI0_SLOT0
	int "Slot 0 slave interface id"
	default 0
	range 0 3

config SCB5_MI0_SLOT1
	int "Slot 1 slave interface id"
	default 1
	range 0 3

config SCB5_MI0_SLOT2
	int "Slot 2 slave interface id"
	default 2
	range 0 3

config SCB5_MI0_SLOT3
	int "Slot 3 slave interface id"
	default 3
	range 0 3

config SCB5_MI0_SLOT4
	int "Slot 4 slave interface id"
	default 0
	range 0 3

config SCB5_MI0_SLOT5
	int "Slot 5 slave interface id"
	default 1
	range 0 3

config SCB5_MI0_SLOT6
	int "Slot 6 slave interface id"
	default 2
	range 0 3

config SCB5_MI0_SLOT7
	int "Slot 7 slave interface id"
	default 3
	range 0 3

endif # SCB5_MI0

menuconfig	SCB6_MI0
	bool "SCB6 Master Interface 0"
	default n
	depends on SCB_PRIORITY
	help
	The slave interface id of each slot should be set according following table.
	PPI1 MDA33	-- 0
	PPI1 MDA34	-- 1

if SCB6_MI0

config SCB6_MI0_SLOT0
	int "Slot 0 slave interface id"
	default 0
	range 0 1

config SCB6_MI0_SLOT1
	int "Slot 1 slave interface id"
	default 1
	range 0 1

config SCB6_MI0_SLOT2
	int "Slot 2 slave interface id"
	default 0
	range 0 1

config SCB6_MI0_SLOT3
	int "Slot 3 slave interface id"
	default 1
	range 0 1

endif # SCB6_MI0

menuconfig	SCB7_MI0
	bool "SCB7 Master Interface 0"
	default n
	depends on SCB_PRIORITY
	help
	The slave interface id of each slot should be set according following table.
	PIXC0	-- 0
	PIXC1	-- 1
	PIXC2	-- 2

if SCB7_MI0

config SCB7_MI0_SLOT0
	int "Slot 0 slave interface id"
	default 0
	range 0 2

config SCB7_MI0_SLOT1
	int "Slot 1 slave interface id"
	default 1
	range 0 2

config SCB7_MI0_SLOT2
	int "Slot 2 slave interface id"
	default 2
	range 0 2

config SCB7_MI0_SLOT3
	int "Slot 3 slave interface id"
	default 0
	range 0 2

config SCB7_MI0_SLOT4
	int "Slot 4 slave interface id"
	default 1
	range 0 2

config SCB7_MI0_SLOT5
	int "Slot 5 slave interface id"
	default 2
	range 0 2

endif # SCB7_MI0

menuconfig	SCB8_MI0
	bool "SCB8 Master Interface 0"
	default n
	depends on SCB_PRIORITY
	help
	The slave interface id of each slot should be set according following table.
	PVP CPDOB	-- 0
	PVP CPDOC	-- 1
	PVP CPCO	-- 2
	PVP CPCI	-- 3

if SCB8_MI0

config SCB8_MI0_SLOT0
	int "Slot 0 slave interface id"
	default 0
	range 0 3

config SCB8_MI0_SLOT1
	int "Slot 1 slave interface id"
	default 1
	range 0 3

config SCB8_MI0_SLOT2
	int "Slot 2 slave interface id"
	default 2
	range 0 3

config SCB8_MI0_SLOT3
	int "Slot 3 slave interface id"
	default 3
	range 0 3

config SCB8_MI0_SLOT4
	int "Slot 4 slave interface id"
	default 0
	range 0 3

config SCB8_MI0_SLOT5
	int "Slot 5 slave interface id"
	default 1
	range 0 3

config SCB8_MI0_SLOT6
	int "Slot 6 slave interface id"
	default 2
	range 0 3

config SCB8_MI0_SLOT7
	int "Slot 7 slave interface id"
	default 3
	range 0 3

endif # SCB8_MI0

menuconfig	SCB9_MI0
	bool "SCB9 Master Interface 0"
	default n
	depends on SCB_PRIORITY
	help
	The slave interface id of each slot should be set according following table.
	PVP MPDO	-- 0
	PVP MPDI	-- 1
	PVP MPCO	-- 2
	PVP MPCI	-- 3
	PVP CPDOA	-- 4

if SCB9_MI0

config SCB9_MI0_SLOT0
	int "Slot 0 slave interface id"
	default 0
	range 0 4

config SCB9_MI0_SLOT1
	int "Slot 1 slave interface id"
	default 1
	range 0 4

config SCB9_MI0_SLOT2
	int "Slot 2 slave interface id"
	default 2
	range 0 4

config SCB9_MI0_SLOT3
	int "Slot 3 slave interface id"
	default 3
	range 0 4

config SCB9_MI0_SLOT4
	int "Slot 4 slave interface id"
	default 4
	range 0 4

config SCB9_MI0_SLOT5
	int "Slot 5 slave interface id"
	default 0
	range 0 4

config SCB9_MI0_SLOT6
	int "Slot 6 slave interface id"
	default 1
	range 0 4

config SCB9_MI0_SLOT7
	int "Slot 7 slave interface id"
	default 2
	range 0 4

config SCB9_MI0_SLOT8
	int "Slot 8 slave interface id"
	default 3
	range 0 4

config SCB9_MI0_SLOT9
	int "Slot 9 slave interface id"
	default 4
	range 0 4

endif # SCB9_MI0

endmenu

endif
```
