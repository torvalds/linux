## arch/blackfin/mach-bf609/boards/Kconfig
```kconfig
# SPDX-License-Identifier: GPL-2.0
choice
	prompt "System type"
	default BFIN609_EZKIT
	help
	  Select your board!

config BFIN609_EZKIT
	bool "BF609-EZKIT"
	help
	  BFIN609-EZKIT board support.
	  
endchoice
```

## arch/blackfin/oprofile/Kconfig
```kconfig
menu "Profiling support"
depends on EXPERIMENTAL

config PROFILING
	bool "Profiling support (EXPERIMENTAL)"
	help
	  Say Y here to enable the extended profiling support mechanisms used
	  by profilers such as OProfile.

config OPROFILE
	tristate "OProfile system profiling (EXPERIMENTAL)"
	depends on PROFILING
	help
	  OProfile is a profiling system capable of profiling the
	  whole system, include the kernel, kernel modules, libraries,
	  and applications.

	  If unsure, say N.

config HARDWARE_PM
	tristate "Hardware Performance Monitor Profiling"
	depends on PROFILING
	help
	  take use of hardware performance monitor to profiling the kernel
	  and application.

	  If unsure, say N.

endmenu
```

## arch/c6x/Kconfig
```kconfig
# SPDX-License-Identifier: GPL-2.0
#
# For a description of the syntax of this configuration file,
# see Documentation/kbuild/kconfig-language.rst.
#

config C6X
	def_bool y
	select ARCH_32BIT_OFF_T
	select ARCH_HAS_BINFMT_FLAT
	select ARCH_HAS_SYNC_DMA_FOR_CPU
	select ARCH_HAS_SYNC_DMA_FOR_DEVICE
	select CLKDEV_LOOKUP
	select GENERIC_ATOMIC64
	select GENERIC_IRQ_SHOW
	select HAVE_ARCH_TRACEHOOK
	select SPARSE_IRQ
	select IRQ_DOMAIN
	select OF
	select OF_EARLY_FLATTREE
	select GENERIC_CLOCKEVENTS
	select MODULES_USE_ELF_RELA
	select MMU_GATHER_NO_RANGE if MMU

config MMU
	def_bool n

config FPU
	def_bool n

config GENERIC_CALIBRATE_DELAY
	def_bool y

config GENERIC_HWEIGHT
	def_bool y

config GENERIC_BUG
	def_bool y
	depends on BUG

config C6X_BIG_KERNEL
	bool "Build a big kernel"
	help
	  The C6X function call instruction has a limited range of +/- 2MiB.
	  This is sufficient for most kernels, but some kernel configurations
	  with lots of compiled-in functionality may require a larger range
	  for function calls. Use this option to have the compiler generate
	  function calls with 32-bit range. This will make the kernel both
	  larger and slower.

	  If unsure, say N.

# Use the generic interrupt handling code in kernel/irq/

config CMDLINE_BOOL
	bool "Default bootloader kernel arguments"

config CMDLINE
	string "Kernel command line"
	depends on CMDLINE_BOOL
	default "console=ttyS0,57600"
	help
	  On some architectures there is currently no way for the boot loader
	  to pass arguments to the kernel. For these architectures, you should
	  supply some command-line options at build time by entering them
	  here.

config CMDLINE_FORCE
	bool "Force default kernel command string"
	depends on CMDLINE_BOOL
	default n
	help
	  Set this to have arguments from the default kernel command string
	  override those passed by the boot loader.

config CPU_BIG_ENDIAN
	bool "Build big-endian kernel"
	default n
	help
	  Say Y if you plan on running a kernel in big-endian mode.
	  Note that your board must be properly built and your board
	  port must properly enable any big-endian related features
	  of your chipset/board/processor.

config FORCE_MAX_ZONEORDER
	int "Maximum zone order"
	default "13"
	help
	  The kernel memory allocator divides physically contiguous memory
	  blocks into "zones", where each zone is a power of two number of
	  pages.  This option selects the largest power of two that the kernel
	  keeps in the memory allocator.  If you need to allocate very large
	  blocks of physically contiguous memory, then you may need to
	  increase this value.

	  This config option is actually maximum order plus one. For example,
	  a value of 11 means that the largest free memory block is 2^10 pages.

menu "Processor type and features"

source "arch/c6x/platforms/Kconfig"

config KERNEL_RAM_BASE_ADDRESS
	hex "Virtual address of memory base"
	default 0xe0000000 if SOC_TMS320C6455
	default 0xe0000000 if SOC_TMS320C6457
	default 0xe0000000 if SOC_TMS320C6472
	default 0x80000000

source "kernel/Kconfig.hz"

endmenu
```

## arch/c6x/Kconfig.debug
```kconfig
# SPDX-License-Identifier: GPL-2.0

config ACCESS_CHECK
	bool "Check the user pointer address"
	default y
	help
	  Usually the pointer transfer from user space is checked to see if its
	  address is in the kernel space.

	  Say N here to disable that check to improve the performance.
```

## arch/c6x/configs/evmc6678_defconfig
```kconfig
CONFIG_SOC_TMS320C6678=y
CONFIG_EXPERIMENTAL=y
# CONFIG_LOCALVERSION_AUTO is not set
CONFIG_SYSVIPC=y
CONFIG_SPARSE_IRQ=y
CONFIG_LOG_BUF_SHIFT=14
CONFIG_NAMESPACES=y
# CONFIG_UTS_NS is not set
# CONFIG_USER_NS is not set
# CONFIG_PID_NS is not set
CONFIG_BLK_DEV_INITRD=y
CONFIG_CC_OPTIMIZE_FOR_SIZE=y
CONFIG_EXPERT=y
# CONFIG_FUTEX is not set
# CONFIG_SLUB_DEBUG is not set
CONFIG_MODULES=y
CONFIG_MODULE_FORCE_LOAD=y
CONFIG_MODULE_UNLOAD=y
CONFIG_MODULE_FORCE_UNLOAD=y
CONFIG_CMDLINE_BOOL=y
CONFIG_CMDLINE=""
# CONFIG_CMDLINE_FORCE is not set
CONFIG_BOARD_EVM6678=y
CONFIG_NO_HZ=y
CONFIG_HIGH_RES_TIMERS=y
CONFIG_BLK_DEV_LOOP=y
CONFIG_BLK_DEV_RAM=y
CONFIG_BLK_DEV_RAM_COUNT=2
CONFIG_BLK_DEV_RAM_SIZE=17000
CONFIG_MISC_DEVICES=y
# CONFIG_INPUT is not set
# CONFIG_SERIO is not set
# CONFIG_VT is not set
# CONFIG_HW_RANDOM is not set
# CONFIG_HWMON is not set
# CONFIG_USB_SUPPORT is not set
# CONFIG_IOMMU_SUPPORT is not set
# CONFIG_MISC_FILESYSTEMS is not set
CONFIG_CRC16=y
# CONFIG_ENABLE_MUST_CHECK is not set
# CONFIG_SCHED_DEBUG is not set
# CONFIG_DEBUG_BUGVERBOSE is not set
```

## arch/c6x/platforms/Kconfig
```kconfig
# SPDX-License-Identifier: GPL-2.0

config SOC_TMS320C6455
	bool "TMS320C6455"
	default n

config SOC_TMS320C6457
	bool "TMS320C6457"
	default n

config SOC_TMS320C6472
	bool "TMS320C6472"
	default n

config SOC_TMS320C6474
	bool "TMS320C6474"
	default n

config SOC_TMS320C6678
	bool "TMS320C6678"
	default n
```
