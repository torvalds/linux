## arch/ppc/platforms/4xx/Kconfig
```kconfig
config 4xx
	bool
	depends on 40x || 44x
	default y

menu "IBM 4xx options"
	depends on 4xx

choice
	prompt "Machine Type"
	depends on 40x
	default WALNUT

config ASH
	bool "Ash"
	help
	  This option enables support for the IBM NP405H evaluation board.

config BUBINGA
	bool "Bubinga"
	help
	  This option enables support for the IBM 405EP evaluation board.

config CPCI405
	bool "CPCI405"
	help
	  This option enables support for the CPCI405 board.

config EP405
	bool "EP405/EP405PC"
	help
	  This option enables support for the EP405/EP405PC boards.

config OAK
	bool "Oak"
	help
	  This option enables support for the IBM 403GCX evaluation board.

config REDWOOD_5
	bool "Redwood-5"
	help
	  This option enables support for the IBM STB04 evaluation board.

config REDWOOD_6
	bool "Redwood-6"
	help
	  This option enables support for the IBM STBx25xx evaluation board.

config SYCAMORE
	bool "Sycamore"
	help
	  This option enables support for the IBM PPC405GPr evaluation board.

config WALNUT
	bool "Walnut"
	help
	  This option enables support for the IBM PPC405GP evaluation board.

config XILINX_ML300
	bool "Xilinx-ML300"
	help
	  This option enables support for the Xilinx ML300 evaluation board.

endchoice

choice
	prompt "Machine Type"
	depends on 44x
	default EBONY

config EBONY
	bool "Ebony"
	help
	  This option enables support for the IBM PPC440GP evaluation board.

config LUAN
	bool "Luan"
	help
	  This option enables support for the IBM PPC440SP evaluation board.

config OCOTEA
	bool "Ocotea"
	help
	  This option enables support for the IBM PPC440GX evaluation board.

endchoice

config EP405PC
	bool "EP405PC Support"
	depends on EP405


# It's often necessary to know the specific 4xx processor type.
# Fortunately, it is impled (so far) from the board type, so we
# don't need to ask more redundant questions.
config NP405H
	bool
	depends on ASH
	default y

config 440GP
	bool
	depends on EBONY
	default y

config 440GX
	bool
	depends on OCOTEA
	default y

config 440SP
	bool
	depends on LUAN
	default y

config 440
	bool
	depends on 440GP || 440SP
	default y

config 440A
	bool
	depends on 440GX
	default y

# All 405-based cores up until the 405GPR and 405EP have this errata.
config IBM405_ERR77
	bool
	depends on 40x && !403GCX && !405GPR
	default y

# All 40x-based cores, up until the 405GPR and 405EP have this errata.
config IBM405_ERR51
	bool
	depends on 40x && !405GPR
	default y

config BOOKE
	bool
	depends on 44x
	default y

config IBM_OCP
	bool
	depends on ASH || BUBINGA || CPCI405 || EBONY || EP405 || LUAN || OCOTEA || REDWOOD_5 || REDWOOD_6 || SYCAMORE || WALNUT
	default y

config XILINX_OCP
	bool
	depends on XILINX_ML300
	default y

config IBM_EMAC4
	bool
	depends on 440GX || 440SP
	default y

config BIOS_FIXUP
	bool
	depends on BUBINGA || EP405 || SYCAMORE || WALNUT
	default y

config 403GCX
	bool
	depends OAK
	default y

config 405EP
	bool
	depends on BUBINGA
	default y

config 405GP
	bool
	depends on CPCI405 || EP405 || WALNUT
	default y

config 405GPR
	bool
	depends on SYCAMORE
	default y

config VIRTEX_II_PRO
	bool
	depends on XILINX_ML300
	default y

config STB03xxx
	bool
	depends on REDWOOD_5 || REDWOOD_6
	default y

config EMBEDDEDBOOT
	bool
	depends on EP405 || XILINX_ML300
	default y

config IBM_OPENBIOS
	bool
	depends on ASH || BUBINGA || REDWOOD_5 || REDWOOD_6 || SYCAMORE || WALNUT
	default y

config PPC4xx_DMA
	bool "PPC4xx DMA controller support"
	depends on 4xx

config PPC4xx_EDMA
	bool
	depends on !STB03xxx && PPC4xx_DMA
	default y

config PPC_GEN550
	bool
	depends on 4xx
	default y

config PM
	bool "Power Management support (EXPERIMENTAL)"
	depends on 4xx && EXPERIMENTAL

choice
	prompt "TTYS0 device and default console"
	depends on 40x
	default UART0_TTYS0

config UART0_TTYS0
	bool "UART0"

config UART0_TTYS1
	bool "UART1"

endchoice

config SERIAL_SICC
	bool "SICC Serial port support"
	depends on STB03xxx

config UART1_DFLT_CONSOLE
	bool
	depends on SERIAL_SICC && UART0_TTYS1
	default y

config SERIAL_SICC_CONSOLE
	bool
	depends on SERIAL_SICC && UART0_TTYS1
	default y
endmenu
```

## arch/ppc/platforms/85xx/Kconfig
```kconfig
config 85xx
	bool
	depends on E500
	default y

config PPC_INDIRECT_PCI_BE
	bool
	depends on 85xx
	default y

menu "Freescale 85xx options"
	depends on E500

choice
	prompt "Machine Type"
	depends on 85xx
	default MPC8540_ADS

config MPC8540_ADS
	bool "Freescale MPC8540 ADS"
	help
	  This option enables support for the MPC 8540 ADS evaluation board.

config MPC8548_CDS
	bool "Freescale MPC8548 CDS"
	help
	  This option enablese support for the MPC8548 CDS evaluation board.

config MPC8555_CDS
	bool "Freescale MPC8555 CDS"
	help
	  This option enablese support for the MPC8555 CDS evaluation board.

config MPC8560_ADS
	bool "Freescale MPC8560 ADS"
	help
	  This option enables support for the MPC 8560 ADS evaluation board.

config SBC8560
	bool "WindRiver PowerQUICC III SBC8560"
	help
	  This option enables support for the WindRiver PowerQUICC III
	  SBC8560 board.

config STX_GP3
	bool "Silicon Turnkey Express GP3"
	help
	  This option enables support for the Silicon Turnkey Express GP3
	  board.

config TQM8540
	bool "TQ Components TQM8540"
	help
	  This option enablese support for the TQ Components TQM8540 board.

config TQM8541
	bool "TQ Components TQM8541"
	help
	  This option enablese support for the TQ Components TQM8541 board.

config TQM8555
	bool "TQ Components TQM8555"
	help
	  This option enablese support for the TQ Components TQM8555 board.

config TQM8560
	bool "TQ Components TQM8560"
	help
	  This option enablese support for the TQ Components TQM8560 board.

endchoice

# It's often necessary to know the specific 85xx processor type.
# Fortunately, it is implied (so far) from the board type, so we
# don't need to ask more redundant questions.
config MPC8540
	bool
	depends on MPC8540_ADS || TQM8540
	default y

config MPC8548
	bool
	depends on MPC8548_CDS
	default y

config MPC8555
	bool
	depends on MPC8555_CDS || TQM8541 || TQM8555
	default y

config MPC8560
	bool
	depends on SBC8560 || MPC8560_ADS || STX_GP3 || TQM8560
	default y

config 85xx_PCI2
	bool "Supprt for 2nd PCI host controller"
	depends on MPC8555_CDS
	default y

config PPC_GEN550
	bool
	depends on MPC8540 || SBC8560 || MPC8555
	default y

endmenu
```
