## arch/powerpc/platforms/44x/Kconfig
```kconfig
config PPC_47x
	bool "Support for 47x variant"
	depends on 44x
	default n
	select MPIC
	help
	  This option enables support for the 47x family of processors and is
	  not currently compatible with other 44x or 46x varients

config BAMBOO
	bool "Bamboo"
	depends on 44x
	default n
	select PPC44x_SIMPLE
	select 440EP
	select PCI
	help
	  This option enables support for the IBM PPC440EP evaluation board.

config BLUESTONE
	bool "Bluestone"
	depends on 44x
	default n
	select PPC44x_SIMPLE
	select APM821xx
	select IBM_NEW_EMAC_RGMII
	help
	  This option enables support for the APM APM821xx Evaluation board.

config EBONY
	bool "Ebony"
	depends on 44x
	default y
	select 440GP
	select PCI
	select OF_RTC
	help
	  This option enables support for the IBM PPC440GP evaluation board.

config SAM440EP
        bool "Sam440ep"
	depends on 44x
        default n
        select 440EP
        select PCI
        help
          This option enables support for the ACube Sam440ep board.

config SEQUOIA
	bool "Sequoia"
	depends on 44x
	default n
	select PPC44x_SIMPLE
	select 440EPX
	help
	  This option enables support for the AMCC PPC440EPX evaluation board.

config TAISHAN
	bool "Taishan"
	depends on 44x
	default n
	select PPC44x_SIMPLE
	select 440GX
	select PCI
	help
	  This option enables support for the AMCC PPC440GX "Taishan"
	  evaluation board.

config KATMAI
	bool "Katmai"
	depends on 44x
	default n
	select PPC44x_SIMPLE
	select 440SPe
	select PCI
	select PPC4xx_PCI_EXPRESS
	help
	  This option enables support for the AMCC PPC440SPe evaluation board.

config RAINIER
	bool "Rainier"
	depends on 44x
	default n
	select PPC44x_SIMPLE
	select 440GRX
	select PCI
	help
	  This option enables support for the AMCC PPC440GRX evaluation board.

config WARP
	bool "PIKA Warp"
	depends on 44x
	default n
	select 440EP
	help
	  This option enables support for the PIKA Warp(tm) Appliance. The Warp
	  is a small computer replacement with up to 9 ports of FXO/FXS plus VOIP
	  stations and trunks.

	  See http://www.pikatechnologies.com/ and follow the "PIKA for Computer
	  Telephony Developers" link for more information.

config ARCHES
	bool "Arches"
	depends on 44x
	default n
	select PPC44x_SIMPLE
	select 460EX # Odd since it uses 460GT but the effects are the same
	select PCI
	select PPC4xx_PCI_EXPRESS
	help
	  This option enables support for the AMCC Dual PPC460GT evaluation board.

config CANYONLANDS
	bool "Canyonlands"
	depends on 44x
	default n
	select 460EX
	select PCI
	select PPC4xx_PCI_EXPRESS
	select IBM_NEW_EMAC_RGMII
	select IBM_NEW_EMAC_ZMII
	help
	  This option enables support for the AMCC PPC460EX evaluation board.

config GLACIER
	bool "Glacier"
	depends on 44x
	default n
	select PPC44x_SIMPLE
	select 460EX # Odd since it uses 460GT but the effects are the same
	select PCI
	select PPC4xx_PCI_EXPRESS
	select IBM_NEW_EMAC_RGMII
	select IBM_NEW_EMAC_ZMII
	help
	  This option enables support for the AMCC PPC460GT evaluation board.

config REDWOOD
	bool "Redwood"
	depends on 44x
	default n
	select PPC44x_SIMPLE
	select 460SX
	select PCI
	select PPC4xx_PCI_EXPRESS
	help
	  This option enables support for the AMCC PPC460SX Redwood board.

config EIGER
	bool "Eiger"
	depends on 44x
	default n
	select PPC44x_SIMPLE
	select 460SX
	select PCI
	select PPC4xx_PCI_EXPRESS
	select IBM_NEW_EMAC_RGMII
	help
	  This option enables support for the AMCC PPC460SX evaluation board.

config YOSEMITE
	bool "Yosemite"
	depends on 44x
	default n
	select PPC44x_SIMPLE
	select 440EP
	select PCI
	help
	  This option enables support for the AMCC PPC440EP evaluation board.

config ISS4xx
	bool "ISS 4xx Simulator"
	depends on (44x || 40x)
	default n
	select 405GP if 40x
	select 440GP if 44x && !PPC_47x
	select PPC_FPU
	select OF_RTC
	help
	  This option enables support for the IBM ISS simulation environment

config ICON
	bool "Icon"
	depends on 44x
	default n
	select PPC44x_SIMPLE
	select 440SPe
	select PCI
	select PPC4xx_PCI_EXPRESS
	help
	  This option enables support for the AMCC PPC440SPe evaluation board.

#config LUAN
#	bool "Luan"
#	depends on 44x
#	default n
#	select 440SP
#	help
#	  This option enables support for the IBM PPC440SP evaluation board.

#config OCOTEA
#	bool "Ocotea"
#	depends on 44x
#	default n
#	select 440GX
#	help
#	  This option enables support for the IBM PPC440GX evaluation board.

config XILINX_VIRTEX440_GENERIC_BOARD
	bool "Generic Xilinx Virtex 5 FXT board support"
	depends on 44x
	default n
	select XILINX_VIRTEX_5_FXT
	help
	  This option enables generic support for Xilinx Virtex based boards
	  that use a 440 based processor in the Virtex 5 FXT FPGA architecture.

	  The generic virtex board support matches any device tree which
	  specifies 'xlnx,virtex440' in its compatible field.  This includes
	  the Xilinx ML5xx reference designs using the powerpc core.

	  Most Virtex 5 designs should use this unless it needs to do some
	  special configuration at board probe time.

config XILINX_ML510
	bool "Xilinx ML510 extra support"
	depends on XILINX_VIRTEX440_GENERIC_BOARD
	select PPC_PCI_CHOICE
	select XILINX_PCI if PCI
	select PPC_INDIRECT_PCI if PCI
	select PPC_I8259 if PCI
	help
	  This option enables extra support for features on the Xilinx ML510
	  board.  The ML510 has a PCI bus with ALI south bridge.

config PPC44x_SIMPLE
	bool "Simple PowerPC 44x board support"
	depends on 44x
	default n
	help
	  This option enables the simple PowerPC 44x platform support.

config PPC4xx_GPIO
	bool "PPC4xx GPIO support"
	depends on 44x
	select ARCH_REQUIRE_GPIOLIB
	select GENERIC_GPIO
	help
	  Enable gpiolib support for ppc440 based boards

# 44x specific CPU modules, selected based on the board above.
config 440EP
	bool
	select PPC_FPU
	select IBM440EP_ERR42
	select IBM_NEW_EMAC_ZMII
	select USB_ARCH_HAS_OHCI

config 440EPX
	bool
	select PPC_FPU
	select IBM_NEW_EMAC_EMAC4
	select IBM_NEW_EMAC_RGMII
	select IBM_NEW_EMAC_ZMII

config 440GRX
	bool
	select IBM_NEW_EMAC_EMAC4
	select IBM_NEW_EMAC_RGMII
	select IBM_NEW_EMAC_ZMII

config 440GP
	bool
	select IBM_NEW_EMAC_ZMII

config 440GX
	bool
	select IBM_NEW_EMAC_EMAC4
	select IBM_NEW_EMAC_RGMII
	select IBM_NEW_EMAC_ZMII #test only
	select IBM_NEW_EMAC_TAH  #test only

config 440SP
	bool

config 440SPe
	bool
	select IBM_NEW_EMAC_EMAC4

config 460EX
	bool
	select PPC_FPU
	select IBM_NEW_EMAC_EMAC4
	select IBM_NEW_EMAC_TAH

config 460SX
	bool
	select PPC_FPU
	select IBM_NEW_EMAC_EMAC4
	select IBM_NEW_EMAC_RGMII
	select IBM_NEW_EMAC_ZMII
	select IBM_NEW_EMAC_TAH

config APM821xx
	bool
	select PPC_FPU
	select IBM_NEW_EMAC_EMAC4
	select IBM_NEW_EMAC_TAH

# 44x errata/workaround config symbols, selected by the CPU models above
config IBM440EP_ERR42
	bool

# Xilinx specific config options.
config XILINX_VIRTEX
	bool
	select DEFAULT_UIMAGE

# Xilinx Virtex 5 FXT FPGA architecture, selected by a Xilinx board above
config XILINX_VIRTEX_5_FXT
	bool
	select XILINX_VIRTEX
```

## arch/powerpc/platforms/4xx/Kconfig
```kconfig
config 4xx
	bool
	depends on 40x || 44x
	default y

config WANT_EARLY_SERIAL
	bool
	select SERIAL_8250
	default n

menu "AMCC 4xx options"
	depends on 4xx

choice
	prompt "Machine Type"
	depends on 40x
	default WALNUT

config BUBINGA
	bool "Bubinga"
	select WANT_EARLY_SERIAL
	help
	  This option enables support for the IBM 405EP evaluation board.

config CPCI405
	bool "CPCI405"
	help
	  This option enables support for the CPCI405 board.

config EP405
	bool "EP405/EP405PC"
	help
	  This option enables support for the EP405/EP405PC boards.

config REDWOOD_5
	bool "Redwood-5"
	help
	  This option enables support for the IBM STB04 evaluation board.

config REDWOOD_6
	bool "Redwood-6"
	help
	  This option enables support for the IBM STBx25xx evaluation board.

config SYCAMORE
	bool "Sycamore"
	help
	  This option enables support for the IBM PPC405GPr evaluation board.

config WALNUT
	bool "Walnut"
	help
	  This option enables support for the IBM PPC405GP evaluation board.

config XILINX_ML300
	bool "Xilinx-ML300"
	help
	  This option enables support for the Xilinx ML300 evaluation board.

endchoice

choice
	prompt "Machine Type"
	depends on 44x
	default EBONY

config BAMBOO
	bool "Bamboo"
	select WANT_EARLY_SERIAL
	help
	  This option enables support for the IBM PPC440EP evaluation board.

config EBONY
	bool "Ebony"
	select WANT_EARLY_SERIAL
	help
	  This option enables support for the IBM PPC440GP evaluation board.

config LUAN
	bool "Luan"
	select WANT_EARLY_SERIAL
	help
	  This option enables support for the IBM PPC440SP evaluation board.

config OCOTEA
	bool "Ocotea"
	select WANT_EARLY_SERIAL
	help
	  This option enables support for the IBM PPC440GX evaluation board.

endchoice

config EP405PC
	bool "EP405PC Support"
	depends on EP405


# It's often necessary to know the specific 4xx processor type.
# Fortunately, it is impled (so far) from the board type, so we
# don't need to ask more redundant questions.
config NP405H
	bool
	depends on ASH
	default y

config 440EP
	bool
	depends on BAMBOO
	select PPC_FPU
	default y

config 440GP
	bool
	depends on EBONY
	default y

config 440GX
	bool
	depends on OCOTEA
	default y

config 440SP
	bool
	depends on LUAN
	default y

config 440
	bool
	depends on 440GP || 440SP || 440EP
	default y

config 440A
	bool
	depends on 440GX
	default y

config IBM440EP_ERR42
	bool
	depends on 440EP
	default y

# All 405-based cores up until the 405GPR and 405EP have this errata.
config IBM405_ERR77
	bool
	depends on 40x && !403GCX && !405GPR && !405EP
	default y

# All 40x-based cores, up until the 405GPR and 405EP have this errata.
config IBM405_ERR51
	bool
	depends on 40x && !405GPR && !405EP
	default y

config BOOKE
	bool
	depends on 44x
	default y

config IBM_OCP
	bool
	depends on ASH || BAMBOO || BUBINGA || CPCI405 || EBONY || EP405 || LUAN || OCOTEA || REDWOOD_5 || REDWOOD_6 || SYCAMORE || WALNUT
	default y

config XILINX_OCP
	bool
	depends on XILINX_ML300
	default y

config IBM_EMAC4
	bool
	depends on 440GX || 440SP
	default y

config BIOS_FIXUP
	bool
	depends on BUBINGA || EP405 || SYCAMORE || WALNUT
	default y

# OAK doesn't exist but wanted to keep this around for any future 403GCX boards
config 403GCX
	bool
	depends on OAK
	default y

config 405EP
	bool
	depends on BUBINGA
	default y

config 405GP
	bool
	depends on CPCI405 || EP405 || WALNUT
	default y

config 405GPR
	bool
	depends on SYCAMORE
	default y

config VIRTEX_II_PRO
	bool
	depends on XILINX_ML300
	default y

config STB03xxx
	bool
	depends on REDWOOD_5 || REDWOOD_6
	default y

config EMBEDDEDBOOT
	bool
	depends on EP405 || XILINX_ML300
	default y

config IBM_OPENBIOS
	bool
	depends on ASH || BUBINGA || REDWOOD_5 || REDWOOD_6 || SYCAMORE || WALNUT
	default y

config PPC4xx_DMA
	bool "PPC4xx DMA controller support"
	depends on 4xx

config PPC4xx_EDMA
	bool
	depends on !STB03xxx && PPC4xx_DMA
	default y

config PPC_GEN550
	bool
	depends on 4xx
	default y

choice
	prompt "TTYS0 device and default console"
	depends on 40x
	default UART0_TTYS0

config UART0_TTYS0
	bool "UART0"

config UART0_TTYS1
	bool "UART1"

endchoice

config SERIAL_SICC
	bool "SICC Serial port support"
	depends on STB03xxx

config UART1_DFLT_CONSOLE
	bool
	depends on SERIAL_SICC && UART0_TTYS1
	default y

config SERIAL_SICC_CONSOLE
	bool
	depends on SERIAL_SICC && UART0_TTYS1
	default y
endmenu


menu "IBM 40x options"
	depends on 40x

config SERIAL_SICC
	bool "SICC Serial port"
	depends on STB03xxx

config UART1_DFLT_CONSOLE
	bool
	depends on SERIAL_SICC && UART0_TTYS1
	default y

config SERIAL_SICC_CONSOLE
	bool
	depends on SERIAL_SICC && UART0_TTYS1
	default y

endmenu
```

## arch/powerpc/platforms/512x/Kconfig
```kconfig
config PPC_MPC512x
	bool "512x-based boards"
	depends on 6xx
	select COMMON_CLK
	select FSL_SOC
	select IPIC
	select PPC_PCI_CHOICE
	select FSL_PCI if PCI
	select ARCH_WANT_OPTIONAL_GPIOLIB
	select USB_EHCI_BIG_ENDIAN_MMIO if USB_EHCI_HCD
	select USB_EHCI_BIG_ENDIAN_DESC if USB_EHCI_HCD

config MPC512x_LPBFIFO
	tristate "MPC512x LocalPlus Bus FIFO driver"
	depends on PPC_MPC512x && MPC512X_DMA
	help
	  Enable support for Freescale MPC512x LocalPlus Bus FIFO (SCLPC).

config MPC5121_ADS
	bool "Freescale MPC5121E ADS"
	depends on PPC_MPC512x
	select DEFAULT_UIMAGE
	help
	  This option enables support for the MPC5121E ADS board.

config MPC512x_GENERIC
	bool "Generic support for simple MPC512x based boards"
	depends on PPC_MPC512x
	select DEFAULT_UIMAGE
	help
	  This option enables support for simple MPC512x based boards
	  which do not need custom platform specific setup.

	  Compatible boards include:  Protonic LVT base boards (ZANMCU
	  and VICVT2), Freescale MPC5125 Tower system.

config PDM360NG
	bool "ifm PDM360NG board"
	depends on PPC_MPC512x
	select DEFAULT_UIMAGE
	help
	  This option enables support for the PDM360NG board.
```

## arch/powerpc/platforms/52xx/Kconfig
```kconfig
config PPC_MPC52xx
	bool "52xx-based boards"
	depends on 6xx
	select COMMON_CLK
	select PPC_PCI_CHOICE

config PPC_MPC5200_SIMPLE
	bool "Generic support for simple MPC5200 based boards"
	depends on PPC_MPC52xx
	select DEFAULT_UIMAGE
	help
	  This option enables support for a simple MPC52xx based boards which
	  do not need a custom platform specific setup. Such boards are
	  supported assuming the following:

	  - GPIO pins are configured by the firmware,
	  - CDM configuration (clocking) is setup correctly by firmware,
	  - if the 'fsl,has-wdt' property is present in one of the
	    gpt nodes, then it is safe to use such gpt to reset the board,
	  - PCI is supported if enabled in the kernel configuration
	    and if there is a PCI bus node defined in the device tree.

	  Boards that are compatible with this generic platform support
	  are:
	     intercontrol,digsy-mtc
	     phytec,pcm030
	     phytec,pcm032
	     promess,motionpro
	     schindler,cm5200
	     tqc,tqm5200

config PPC_EFIKA
	bool "bPlan Efika 5k2. MPC5200B based computer"
	depends on PPC_MPC52xx
	select PPC_RTAS
	select RTAS_PROC
	select PPC_NATIVE

config PPC_LITE5200
	bool "Freescale Lite5200 Eval Board"
	depends on PPC_MPC52xx
	select DEFAULT_UIMAGE

config PPC_MEDIA5200
	bool "Freescale Media5200 Eval Board"
	depends on PPC_MPC52xx
	select DEFAULT_UIMAGE

config PPC_MPC5200_BUGFIX
	bool "MPC5200 (L25R) bugfix support"
	depends on PPC_MPC52xx
	help
	  Enable workarounds for original MPC5200 errata.  This is not required
	  for MPC5200B based boards.

	  It is safe to say 'Y' here

config PPC_MPC5200_LPBFIFO
	tristate "MPC5200 LocalPlus bus FIFO driver"
	depends on PPC_MPC52xx && PPC_BESTCOMM
	select PPC_BESTCOMM_GEN_BD
```

## arch/powerpc/platforms/82xx/Kconfig
```kconfig
# SPDX-License-Identifier: GPL-2.0
menuconfig PPC_82xx
	bool "82xx-based boards (PQ II)"
	depends on PPC_BOOK3S_32
	select FSL_SOC

if PPC_82xx

config EP8248E
	bool "Embedded Planet EP8248E (a.k.a. CWH-PPC-8248N-VE)"
	select CPM2
	select PPC_INDIRECT_PCI if PCI
	select PHYLIB if NETDEVICES
	select MDIO_BITBANG if PHYLIB
	help
	  This enables support for the Embedded Planet EP8248E board.

	  This board is also resold by Freescale as the QUICCStart
	  MPC8248 Evaluation System and/or the CWH-PPC-8248N-VE.

config MGCOGE
	bool "Keymile MGCOGE"
	select CPM2
	select PPC_INDIRECT_PCI if PCI
	help
	  This enables support for the Keymile MGCOGE board.

endif
```
