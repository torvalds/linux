/*
 * P1010 RDB Device Tree Source
 *
 * Copyright 2011 Freescale Semiconductor Inc.
 *
 * This program is free software; you can redistribute  it and/or modify it
 * under  the terms of  the GNU General  Public License as published by the
 * Free Software Foundation;  either version 2 of the  License, or (at your
 * option) any later version.
 */

/include/ "fsl/p1010si-pre.dtsi"

/ {
	model = "fsl,P1010RDB-PB";
	compatible = "fsl,P1010RDB-PB";

	/include/ "p1010rdb_32b.dtsi"
};

/include/ "p1010rdb.dtsi"

&phy0 {
	interrupts = <0 1 0 0>;
};

&phy1 {
	interrupts = <2 1 0 0>;
};

&phy2 {
	interrupts = <1 1 0 0>;
};

/include/ "fsl/p1010si-post.dtsi"
