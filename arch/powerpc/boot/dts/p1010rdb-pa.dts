/*
 * P1010 RDB Device Tree Source
 *
 * Copyright 2011 Freescale Semiconductor Inc.
 *
 * This program is free software; you can redistribute  it and/or modify it
 * under  the terms of  the GNU General  Public License as published by the
 * Free Software Foundation;  either version 2 of the  License, or (at your
 * option) any later version.
 */

/include/ "fsl/p1010si-pre.dtsi"

/ {
	model = "fsl,P1010RDB";
	compatible = "fsl,P1010RDB";

	/include/ "p1010rdb_32b.dtsi"
};

/include/ "p1010rdb.dtsi"
/include/ "p1010rdb-pa.dtsi"
/include/ "fsl/p1010si-post.dtsi"
