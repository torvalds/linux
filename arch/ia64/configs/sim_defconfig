## arch/ia64/configs/sim_defconfig
```kconfig
CONFIG_SYSVIPC=y
CONFIG_IKCONFIG=y
CONFIG_IKCONFIG_PROC=y
CONFIG_LOG_BUF_SHIFT=16
CONFIG_MODULES=y
CONFIG_MODULE_UNLOAD=y
CONFIG_MODULE_FORCE_UNLOAD=y
CONFIG_MODVERSIONS=y
CONFIG_PARTITION_ADVANCED=y
CONFIG_IA64_HP_SIM=y
CONFIG_MCKINLEY=y
CONFIG_IA64_PAGE_SIZE_64KB=y
CONFIG_SMP=y
CONFIG_NR_CPUS=64
CONFIG_PREEMPT=y
CONFIG_IA64_PALINFO=m
CONFIG_EFI_VARS=y
CONFIG_BINFMT_MISC=y
CONFIG_NET=y
CONFIG_PACKET=y
CONFIG_INET=y
CONFIG_IP_MULTICAST=y
# CONFIG_IPV6 is not set
# CONFIG_STANDALONE is not set
CONFIG_BLK_DEV_LOOP=y
CONFIG_BLK_DEV_RAM=y
CONFIG_SCSI=y
CONFIG_BLK_DEV_SD=y
CONFIG_SCSI_CONSTANTS=y
CONFIG_SCSI_LOGGING=y
CONFIG_SCSI_SPI_ATTRS=y
# CONFIG_INPUT_KEYBOARD is not set
# CONFIG_INPUT_MOUSE is not set
# CONFIG_SERIO_I8042 is not set
# CONFIG_LEGACY_PTYS is not set
CONFIG_EFI_RTC=y
# CONFIG_VGA_CONSOLE is not set
CONFIG_HP_SIMETH=y
CONFIG_HP_SIMSERIAL=y
CONFIG_HP_SIMSERIAL_CONSOLE=y
CONFIG_HP_SIMSCSI=y
CONFIG_EXT2_FS=y
CONFIG_EXT3_FS=y
# CONFIG_EXT3_FS_XATTR is not set
CONFIG_PROC_KCORE=y
CONFIG_HUGETLBFS=y
CONFIG_NFS_FS=y
CONFIG_NFSD=y
CONFIG_NFSD_V3=y
CONFIG_DEBUG_INFO=y
CONFIG_DEBUG_KERNEL=y
CONFIG_DEBUG_MUTEXES=y
```

## arch/ia64/configs/zx1_defconfig
```kconfig
CONFIG_SYSVIPC=y
CONFIG_BSD_PROCESS_ACCT=y
CONFIG_BLK_DEV_INITRD=y
CONFIG_KPROBES=y
CONFIG_MODULES=y
CONFIG_PARTITION_ADVANCED=y
CONFIG_MCKINLEY=y
CONFIG_SMP=y
CONFIG_NR_CPUS=16
CONFIG_HOTPLUG_CPU=y
CONFIG_FLATMEM_MANUAL=y
CONFIG_IA64_MCA_RECOVERY=y
CONFIG_PERFMON=y
CONFIG_IA64_PALINFO=y
CONFIG_CRASH_DUMP=y
CONFIG_EFI_VARS=y
CONFIG_BINFMT_MISC=y
CONFIG_HOTPLUG_PCI=y
CONFIG_HOTPLUG_PCI_ACPI=y
CONFIG_NET=y
CONFIG_PACKET=y
CONFIG_UNIX=y
CONFIG_INET=y
CONFIG_IP_MULTICAST=y
# CONFIG_IPV6 is not set
CONFIG_NETFILTER=y
CONFIG_BLK_DEV_LOOP=y
CONFIG_BLK_DEV_RAM=y
CONFIG_IDE=y
CONFIG_BLK_DEV_IDECD=y
CONFIG_BLK_DEV_GENERIC=y
CONFIG_BLK_DEV_CMD64X=y
CONFIG_SCSI=y
CONFIG_BLK_DEV_SD=y
CONFIG_CHR_DEV_ST=y
CONFIG_CHR_DEV_OSST=y
CONFIG_BLK_DEV_SR=y
CONFIG_CHR_DEV_SG=y
CONFIG_SCSI_CONSTANTS=y
CONFIG_SCSI_LOGGING=y
CONFIG_SCSI_FC_ATTRS=y
CONFIG_SCSI_SYM53C8XX_2=y
CONFIG_SCSI_QLOGIC_1280=y
CONFIG_FUSION=y
CONFIG_FUSION_SPI=y
CONFIG_FUSION_FC=y
CONFIG_FUSION_CTL=m
CONFIG_NETDEVICES=y
CONFIG_DUMMY=y
CONFIG_TIGON3=y
CONFIG_NET_TULIP=y
CONFIG_TULIP=y
CONFIG_TULIP_MWI=y
CONFIG_TULIP_MMIO=y
CONFIG_TULIP_NAPI=y
CONFIG_TULIP_NAPI_HW_MITIGATION=y
CONFIG_E100=y
CONFIG_E1000=y
CONFIG_INPUT_JOYDEV=y
CONFIG_INPUT_EVDEV=y
# CONFIG_INPUT_KEYBOARD is not set
# CONFIG_INPUT_MOUSE is not set
# CONFIG_SERIO_I8042 is not set
# CONFIG_SERIO_SERPORT is not set
CONFIG_SERIAL_8250=y
CONFIG_SERIAL_8250_CONSOLE=y
CONFIG_SERIAL_8250_NR_UARTS=8
CONFIG_SERIAL_8250_EXTENDED=y
CONFIG_SERIAL_8250_SHARE_IRQ=y
# CONFIG_HW_RANDOM is not set
CONFIG_RTC_CLASS=y
CONFIG_RTC_DRV_EFI=y
CONFIG_I2C_CHARDEV=y
CONFIG_AGP=y
CONFIG_AGP_HP_ZX1=y
CONFIG_DRM=y
CONFIG_DRM_RADEON=y
CONFIG_FB_RADEON=y
CONFIG_FB_RADEON_DEBUG=y
CONFIG_LOGO=y
# CONFIG_LOGO_LINUX_MONO is not set
# CONFIG_LOGO_LINUX_VGA16 is not set
CONFIG_SOUND=y
CONFIG_SND=y
CONFIG_SND_SEQUENCER=y
CONFIG_SND_MIXER_OSS=y
CONFIG_SND_PCM_OSS=y
CONFIG_SND_SEQUENCER_OSS=y
CONFIG_SND_FM801=y
CONFIG_USB_HIDDEV=y
CONFIG_USB=y
CONFIG_USB_MON=y
CONFIG_USB_EHCI_HCD=y
CONFIG_USB_OHCI_HCD=y
CONFIG_USB_UHCI_HCD=y
CONFIG_USB_STORAGE=y
CONFIG_EXT2_FS=y
CONFIG_EXT2_FS_XATTR=y
CONFIG_EXT3_FS=y
CONFIG_ISO9660_FS=y
CONFIG_JOLIET=y
CONFIG_UDF_FS=y
CONFIG_MSDOS_FS=y
CONFIG_VFAT_FS=y
CONFIG_PROC_KCORE=y
CONFIG_TMPFS=y
CONFIG_HUGETLBFS=y
CONFIG_NFS_FS=y
CONFIG_NFS_V4=y
CONFIG_NFSD=y
CONFIG_NFSD_V3=y
CONFIG_NLS_CODEPAGE_437=y
CONFIG_NLS_CODEPAGE_737=y
CONFIG_NLS_CODEPAGE_775=y
CONFIG_NLS_CODEPAGE_850=y
CONFIG_NLS_CODEPAGE_852=y
CONFIG_NLS_CODEPAGE_855=y
CONFIG_NLS_CODEPAGE_857=y
CONFIG_NLS_CODEPAGE_860=y
CONFIG_NLS_CODEPAGE_861=y
CONFIG_NLS_CODEPAGE_862=y
CONFIG_NLS_CODEPAGE_863=y
CONFIG_NLS_CODEPAGE_864=y
CONFIG_NLS_CODEPAGE_865=y
CONFIG_NLS_CODEPAGE_866=y
CONFIG_NLS_CODEPAGE_869=y
CONFIG_NLS_CODEPAGE_936=y
CONFIG_NLS_CODEPAGE_950=y
CONFIG_NLS_CODEPAGE_932=y
CONFIG_NLS_CODEPAGE_949=y
CONFIG_NLS_CODEPAGE_874=y
CONFIG_NLS_ISO8859_8=y
CONFIG_NLS_CODEPAGE_1251=y
CONFIG_NLS_ISO8859_1=y
CONFIG_NLS_ISO8859_2=y
CONFIG_NLS_ISO8859_3=y
CONFIG_NLS_ISO8859_4=y
CONFIG_NLS_ISO8859_5=y
CONFIG_NLS_ISO8859_6=y
CONFIG_NLS_ISO8859_7=y
CONFIG_NLS_ISO8859_9=y
CONFIG_NLS_ISO8859_13=y
CONFIG_NLS_ISO8859_14=y
CONFIG_NLS_ISO8859_15=y
CONFIG_NLS_KOI8_R=y
CONFIG_NLS_KOI8_U=y
CONFIG_NLS_UTF8=y
CONFIG_MAGIC_SYSRQ=y
CONFIG_DEBUG_KERNEL=y
CONFIG_DEBUG_MUTEXES=y
CONFIG_IA64_PRINT_HAZARDS=y
CONFIG_CRYPTO_ECB=m
CONFIG_CRYPTO_PCBC=m
```

## arch/ia64/hp/sim/Kconfig
```kconfig
menu "HP Simulator drivers"
	depends on IA64_HP_SIM || IA64_GENERIC

config HP_SIMETH
	bool "Simulated Ethernet "
	depends on NET

config HP_SIMSERIAL
	bool "Simulated serial driver support"

config HP_SIMSERIAL_CONSOLE
	bool "Console for HP simulator"
	depends on HP_SIMSERIAL

config HP_SIMSCSI
	bool "Simulated SCSI disk"
	depends on SCSI=y

endmenu
```

## arch/ia64/kernel/cpufreq/Kconfig
```kconfig
#
# CPU Frequency scaling
#

menu "CPU Frequency scaling"

source "drivers/cpufreq/Kconfig"

if CPU_FREQ

comment "CPUFreq processor drivers"

config IA64_ACPI_CPUFREQ
	tristate "ACPI Processor P-States driver"
	select CPU_FREQ_TABLE
	depends on ACPI_PROCESSOR
	help
	This driver adds a CPUFreq driver which utilizes the ACPI
	Processor Performance States.

	For details, take a look at <file:Documentation/cpu-freq/>.

	If in doubt, say N.

endif   # CPU_FREQ

endmenu
```

## arch/ia64/kvm/Kconfig
```kconfig
#
# KVM configuration
#

source "virt/kvm/Kconfig"

menuconfig VIRTUALIZATION
	bool "Virtualization"
	depends on HAVE_KVM || IA64
	default y
	---help---
	  Say Y here to get to see options for using your Linux host to run other
	  operating systems inside virtual machines (guests).
	  This option alone does not add any kernel code.

	  If you say N, all options in this submenu will be skipped and disabled.

if VIRTUALIZATION

config KVM
	tristate "Kernel-based Virtual Machine (KVM) support"
	depends on BROKEN
	depends on HAVE_KVM && MODULES
	depends on BROKEN
	select PREEMPT_NOTIFIERS
	select ANON_INODES
	select HAVE_KVM_IRQCHIP
	select HAVE_KVM_IRQFD
	select HAVE_KVM_IRQ_ROUTING
	select KVM_APIC_ARCHITECTURE
	select KVM_MMIO
	---help---
	  Support hosting fully virtualized guest machines using hardware
	  virtualization extensions.  You will need a fairly recent
	  processor equipped with virtualization extensions. You will also
	  need to select one or more of the processor modules below.

	  This module provides access to the hardware capabilities through
	  a character device node named /dev/kvm.

	  To compile this as a module, choose M here: the module
	  will be called kvm.

	  If unsure, say N.

config KVM_INTEL
	tristate "KVM for Intel Itanium 2 processors support"
	depends on KVM && m
	---help---
	  Provides support for KVM on Itanium 2 processors equipped with the VT
	  extensions.

config KVM_DEVICE_ASSIGNMENT
	bool "KVM legacy PCI device assignment support"
	depends on KVM && PCI && IOMMU_API
	default y
	---help---
	  Provide support for legacy PCI device assignment through KVM.  The
	  kernel now also supports a full featured userspace device driver
	  framework through VFIO, which supersedes much of this support.

	  If unsure, say Y.

source drivers/vhost/Kconfig

endif # VIRTUALIZATION
```

## arch/ia64/oprofile/Kconfig
```kconfig
menu "Profiling support"
	depends on EXPERIMENTAL

config PROFILING
	bool "Profiling support (EXPERIMENTAL)"
	help
	  Say Y here to enable the extended profiling support mechanisms used
	  by profilers such as OProfile.

config OPROFILE
	tristate "OProfile system profiling (EXPERIMENTAL)"
	depends on PROFILING
	help
	  OProfile is a profiling system capable of profiling the
	  whole system, include the kernel, kernel modules, libraries,
	  and applications.

	  Due to firmware bugs, you may need to use the "nohalt" boot
	  option if you're using OProfile with the hardware performance
	  counters.

	  If unsure, say N.

endmenu
```

## arch/ia64/xen/Kconfig
```kconfig
#
# This Kconfig describes xen/ia64 options
#

config XEN
	bool "Xen hypervisor support"
	default y
	depends on PARAVIRT && MCKINLEY && IA64_PAGE_SIZE_16KB
	select XEN_XENCOMM
	select NO_IDLE_HZ
	# followings are required to save/restore.
	select ARCH_SUSPEND_POSSIBLE
	select SUSPEND
	select PM_SLEEP
	help
	  Enable Xen hypervisor support.  Resulting kernel runs
	  both as a guest OS on Xen and natively on hardware.

config XEN_XENCOMM
	depends on XEN
	bool

config NO_IDLE_HZ
	depends on XEN
	bool
```

## arch/lkl/Kconfig
```kconfig
config LKL
       def_bool y
       depends on !SMP && !COREDUMP && !SECCOMP && !UPROBES && !COMPAT && !USER_RETURN_NOTIFIER
       select ARCH_THREAD_STACK_ALLOCATOR
       select GENERIC_ATOMIC64
       select GENERIC_HWEIGHT
       select FLATMEM
       select GENERIC_CLOCKEVENTS
       select GENERIC_CPU_DEVICES
       select NO_HZ_IDLE
       select NO_PREEMPT
       select ARCH_WANT_FRAME_POINTERS
       select UACCESS_MEMCPY
       select GENERIC_STRNCPY_FROM_USER
       select GENERIC_STRNLEN_USER
       select HAVE_ARCH_KASAN
       select TRACING

config LKL_FUZZING
       bool "LLVM fuzzing instrumentation"
       default n
       help
         This configuration option enables fuzzing instrumentation
         for the Linux kernel source files to enable coverage-guided
         fuzzing. At the moment LKL supports libFuzzer fuzzing
         engine only.

config LKL_LINE_COV
       bool "Code coverage instrumentation for fuzzers"
       depends on LKL_FUZZING && CC_IS_CLANG
       default n
       help
         This configuration option enables line code coverage
         instrumentation for the Linux kernel to generate fuzzing
         code coverage reports. When this option is enabled the
         kernel source files are built with LLVM SanitizerCoverage
         instrumentation.

config OUTPUT_FORMAT
       string "Output format"
       default ""

config ARCH_DMA_ADDR_T_64BIT
       def_bool 64BIT

config PHYS_ADDR_T_64BIT
       def_bool 64BIT

config 64BIT
       bool "64bit kernel"
       default n

config MMU
       bool "LKL MMU implementation"
       depends on 64BIT
       default n

if MMU
config PGTABLE_LEVELS
       int
       default 3

config LKL_MEMORY_START
       hex
       default 0x50000000
       help
         Base address of kernel virtual address space for LKL. No particular
         reason for picking this specific value. It is assumed that the host
         mmap is able to map requested amount of memory at this address.
         STACK_TOP and VMALLOC_START values depend on it.


config LKL_TASK_UNMAPPED_BASE
       hex
       default 0x100000
       help
         Starting virtual address for LKL user-space mmap. It is assumed that
         the host mmap is able to map requested amount of memory starting from
         this address.

config LKL_MMU_KUNIT_TEST
       bool "Kunit tests for LKL MMU"
       default n
       depends on KUNIT
       help
         Kunit tests to test correctness of MMU-related kernel interfaces (such
         as vmalloc, for example) which are difficult to test in user-space.
endif

config COREDUMP
       def_bool n

config BIG_ENDIAN
       def_bool n

config CPU_BIG_ENDIAN
       def_bool BIG_ENDIAN

config GENERIC_CSUM
       def_bool y

config GENERIC_HWEIGHT
       def_bool y

config NO_IOPORT_MAP
       def_bool y

config HZ
        int
        default 100

config CONSOLE_LOGLEVEL_QUIET
	int "quiet console loglevel (1-15)"
	range 1 15
	default "4"
	help
	  loglevel to use when "quiet" is passed on the kernel commandline.

	  When "quiet" is passed on the kernel commandline this loglevel
	  will be used as the loglevel. IOW passing "quiet" will be the
	  equivalent of passing "loglevel=<CONSOLE_LOGLEVEL_QUIET>"

config PCI
	bool "PCI support"
	select NO_GENERIC_PCI_IOPORT_MAP
	select GENERIC_PCI_IOMAP
	select HAS_DMA
	select DMA_OPS
	default y

config RAID6_PQ_BENCHMARK
	bool
	default n

config STACKTRACE_SUPPORT
       def_bool y

if KASAN
config KASAN_SHADOW_OFFSET
       hex "KASAN shadow offset"
       default "0"

config KASAN_SHADOW_SIZE
       hex "KASAN shadow size"
       default "0"
endif

config BUILTIN_CMDLINE
	string "Built-in kernel command string"
	default ""
	help
	  Enter arguments here that should be compiled into the kernel
	  image and used at boot time. The command line provided to
	  lkl_start_kernel is appended to this string to form the full
	  command line.

config LKL_HOST_MEMCPY
	bool "Host provides memcpy"
	default n
	help
	  This options should be set (in tools/lkl/Makefile.autoconf)
	  if the host provides a memcpy implementation.

config LKL_HOST_MEMSET
	bool "Host provides memset"
	default n
	help
	  This options should be set (in tools/lkl/Makefile.autoconf)
	  if the host provides a memset implementation.

config LKL_HOST_MEMMOVE
	bool "Host provides memmove"
	default n
	help
	  This options should be set (in tools/lkl/Makefile.autoconf)
	  if the host provides a memmove implementation.
```
